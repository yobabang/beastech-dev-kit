/*@!Encoding:936*/

variables
{
  long   Ret, Tmp[1];   
  char   DevName[20] = "VH1150",ActualDevice[128],DevType[128];
  long   gOpenSearch,gDevHandle = 0;
  enum   VH1150_PowerMode{VH1150_Off,VH1150_On};
  
}

long VH1150_InitConfig()
{
  long res;
  res = VH1150_Open();
  VH1150_KL30(T_off);
  VH1150_KL15(T_off);
  VH1150_KL31(T_on);
  testwaitfortimeout(1000);
  VH1150_VoltageSet(12);
  return res;
}

void VH1150_Relay15(long index)
{
  if(index>0)
    VH1150_KL15(T_on);
  else
    VH1150_KL15(T_off);
}

void VH1150_Relay30(long index)
{
  if(index == 1)
    VH1150_KL30(T_on);
  else
    VH1150_KL30(T_off);
}

void VH1150_Relay31()
{
  if(1)
    VH1150_KL31(T_on);
  else
    VH1150_KL31(T_off);
}

void VH1150_OpenSearch()
{
  VH1150_Open();
  SetPictureBoxImage("VH1150", "ConnectState", "Images\\connect.png");
}

void VH1150_Close()
{
  Ret = VHDevClose(gDevHandle);
  write("Close() for handle %d",gDevHandle) ;
  VH1150_HandleAPIRet(Ret, "Close");
  
  SetPictureBoxImage("VH1150", "ConnectState", "Images\\disconnect.png");
  reset();
}


void VH1150_VoltageSet(float Volt)
{
  if (gDevHandle)
  {    
    Ret=  VHDevSetVoltageVBatt(gDevHandle, Volt);
    VH1150_HandleAPIRet(Ret, "VHDevSetVoltageVBatt");
  }
}

void VH1150_CurrentGet()
{
  float curr[1];
  if (gDevHandle)
  {      
    Ret=  VHDevGetCurrent(gDevHandle,1 ,curr);
  }
  @sysvar::DeviceControl::PPS::readingCurrent = curr[0];
//  return curr[0];
}

void VH1150_SetOffsetvoltage()
{
  double offsetVoltage;
//  offsetVoltage=@sysvar::VH1150::offsetVoltage;
  VHDevSetGroundOffset(gDevHandle,offsetVoltage);
}

float VH1150_VoltageGet()
{
  float Volt[1];
  if (gDevHandle)
  {
    Ret=  VHDevGetVoltage(gDevHandle,0 ,Volt);
    @sysvar::DeviceControl::PPS::readingVoltage = Volt[0];
  }
  return Volt[0];
}


void VH1150_KL30(enum T_mode PowerMode)
{
  if (gDevHandle) 
  {
    Ret = VHDevSetRelay (gDevHandle, 0, PowerMode);
    VH1150_HandleAPIRet(Ret, "VHDevSetRelay");
    writeToLog("kL30=%d [0-off,1-on]",PowerMode);
  }
}

void VH1150_KL15(enum T_mode PowerMode)
{
  if (gDevHandle) 
  {
    Ret = VHDevSetRelay (gDevHandle, 1, PowerMode);
    VH1150_HandleAPIRet(Ret, "VHDevSetRelay");
    writeToLog("kL15=%d [0-off,1-on]",PowerMode);
  }
}

void   VH1150_KL31(enum T_mode PowerMode)
{
  if (gDevHandle)
  {
    Ret = VHDevSetRelay (gDevHandle, 2, PowerMode);
    VH1150_HandleAPIRet(Ret, "VHDevSetRelay");
    writeToLog("kL31=%d [0-off,1-on]",PowerMode);
  }
}

long VH1150_Open()
{
  Ret = VHDevSearchOpen(Tmp, DevType, ActualDevice, elcount(ActualDevice));
  VH1150_HandleAPIRet(Ret, "OpenSearch");  
  write("gOpenSearch is %d, Ret = %d", gOpenSearch, Ret);
  if(Ret==0) 
  {
    gDevHandle = Tmp[0];
    write("OpenSearch() opened %s device %s (size: %i) using handle %d", DevType, ActualDevice,elcount(ActualDevice), gDevHandle) ;
    VHDevSetCurrentMeasurementRange(gDevHandle,2);
    VH1150_HandleAPIRet(Ret, "CurrentMeasurementRange"); 
    
    sysSetVariableString(sysvar::DeviceControl::DeviceList::PPS,DeviceName);
    sysSetVariableString(sysvar::DeviceControl::DeviceList::KL,DeviceName);
  }
  return Ret;
}


void VH1150_HandleAPIRet (long Ret, char Str[])
{
  char ErrStr[128];
  if(Ret==0) {
//    write("%9.3f %NODE_NAME% ok on %s",  timeNow()*1.E-5, Str);
    Return; 
  }

  VH1150_ErrToStrPrint(Ret, ErrStr);
  write("%9.3f %NODE_NAME% Error %d %s on %s",  timeNow()*1.E-5, Ret, ErrStr, Str);
  Return; 
}

void VH1150_ErrToStrPrint(long ErrNumber, char ErrStr[])
{
  Switch(ErrNumber) {
    case  0:   strncpy(ErrStr, "ERR_OK                          ", elcount(ErrStr)); break;
    case -1:   strncpy(ErrStr, "ERR_FAILED                      ", elcount(ErrStr)); break;
    case  2:   strncpy(ErrStr, "ERR_INVALID_HANDLE              ", elcount(ErrStr)); break;
    case  3:   strncpy(ErrStr, "ERR_NOT_IMPLEMENTED             ", elcount(ErrStr)); break;
    case  4:   strncpy(ErrStr, "ERR_INVALID_PARAMETER           ", elcount(ErrStr)); break;
    case  5:   strncpy(ErrStr, "ERR_DEVICE_INUSE                ", elcount(ErrStr)); break;
    case  6:   strncpy(ErrStr, "ERR_VIA_NL                      ", elcount(ErrStr)); break;
    case  7:   strncpy(ErrStr, "ERR_VIA_CAST                    ", elcount(ErrStr)); break;
    case  8:   strncpy(ErrStr, "ERR_AINFAILED                   ", elcount(ErrStr)); break;
    case  9:   strncpy(ErrStr, "ERR_AINNODATA                   ", elcount(ErrStr)); break;
    case 10:   strncpy(ErrStr, "ERR_DRIVERDLL_NOT_LOADED        ", elcount(ErrStr)); break;
    case 11:   strncpy(ErrStr, "ERR_INTERNAL_NONL               ", elcount(ErrStr)); break;
    case 12:   strncpy(ErrStr, "ERR_VOLTAGEPROFILE_RUNNING      ", elcount(ErrStr)); break;
    case 13:   strncpy(ErrStr, "ERR_HARDWARE_REV_NUMBER_TOO_LOW ", elcount(ErrStr)); break;
    case 14:   strncpy(ErrStr, "ERR_CALIB_FAILED                ", elcount(ErrStr)); break;
    case 15:   strncpy(ErrStr, "ERR_OPEN_NO_REPLACEMENT_FOUND   ", elcount(ErrStr)); break;
    case 16:   strncpy(ErrStr, "ERR_INCOMPATIBLE_DEVICE         ", elcount(ErrStr)); break;
    case 17:   strncpy(ErrStr, "ERR_NO_ANPowerModeER_FROM_INTERFACE    ", elcount(ErrStr)); break;
    default:   strncpy(ErrStr, "Unknown error code"              , elcount(ErrStr)); break;
  }
  Return;
}


void reset()
{
  @sysvar::DeviceControl::KL::KL15=0;
  @sysvar::DeviceControl::KL::KL30=0;
  @sysvar::DeviceControl::KL::KL31=0;
}


