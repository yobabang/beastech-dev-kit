/*@!Encoding:936*/
includes
{
  #include "DiagReqDB.cin"
  #include "03_FileHandle\FileHandle.cin"
  #include "01_TP\CAN_TP_Test.cin"
  #include "01_TP\COM_TP.cin"
  #include "02_UDS\UDS_Functions_1.0.cin"
  #include "02_UDS\UDS_Service_1.5.cin" 
  #include "02_UDS\0x29Function.cin"
}

variables
{
  #pragma warning(disable: 2008)
  #pragma warning(disable: 2003)
  
//  #pragma message("TODO: Implement process() for node %NODE_NAME%") 
  
  dword gReceivedIDNow;

  enum DiagnosticState {Diag_APP = 1,Diag_Boot = 2};
  enum DiagnosticSwitch {Diag_On = 0,Diag_Off = 1};

  //诊断TP层参数
	char gBusContext[9] = "";
	//CAN/CANFD
	long gCANHandle1;
	long gCANFuncHandle1;
	int  gCAN_RequestID ;
	int  gCAN_ResponseID ;
	int  gCAN_FuncRequestID ;
	int  gCAN_As = 1000;
	int  gCAN_Ar = 1000;
	int  gCAN_Bs = 1000;
	int  gCAN_Br = 1000;
	int  gCAN_Cs = 1000;
	int  gCAN_Cr = 1000;
	int  gCAN_STmin = 0;
	int  gCAN_BlockSize = 0;
  int  gCAN_FDFrameLength=64; //若是CANFD在这里修改报文最大长度
  int  gCAN_FDbitRateSwitch;
  int  gCAN_Padding;
	//CAN/CANFD

	//LIN
	int  gLIN_TP_NAD = 0x72;
	int  gLIN_TP_STmin = 20;
	//LIN
	
	//Ethernet
  enum EthNodeType {EdgeNode = 1,InternalNode = 2}; //EdgeNode:As a server for the TCP connection ; InternalNode:As a client for the TCP connection
	int  gTesterLogicAddress ;
	int  gECULogicAddress;
	dword   gFunctionalLogicAddress ;
	char gTesterIpv4Address[400] ;
  char gECUIpv4Address[400] ;
	char   gNetmask[400] ;
  enum EthNodeType EthNodeTypeNow;
  //Ethernet
	//诊断TP层参数

	//诊断应用层参数
//  int  gP2Client ;

	int  gP2Client_APP ;
  int  gP2Client_BOOT ;
	int  gP2StarClient ;
  int gP2StarClientFor10Check;
  float gP4Client ;
	int  gP6Client ;
	int  gS3Server ;
	int  gS3Client ;
	byte  gSeedArray[16] = {0x00,0x00,0x00,0x00,0x00,0x00,0x00,0x00,0x00,0x00,0x00,0x00,0x00,0x00,0x00,0x00};
	byte  gKeyArray[16] = {0x00,0x00,0x00,0x00,0x00,0x00,0x00,0x00,0x00,0x00,0x00,0x00,0x00,0x00,0x00,0x00};
  int   gSeedLength;
  int   gConstLength;
	byte gDataFormatIdentifer = 0x00;
  byte gAvailiableMask;
	byte gDataAddAndLenIdentifer = 0x44;
	byte glengthFormatIdentifier = 0x20;
  
  /* P4 */
  byte NRC78AllowFlag;
  dword P4DefaultValue=10000;
  byte ServiceIDNow;
  struct DataID {
    word Data;
    dword SeparateValue; // set to the Separate P4 Value(ms)
  };
  struct TimeParameters {
    byte ServiceID;
    byte SupportNRC78Flag; // if not support NRC0x78,set to 0,else set to 1;
    byte SubFunctionSeparate; // if different sub-functions distinguish P4 time,set to the subfunction,else set to 0xFF 
    byte DataIDSeparateNum; // If different DATAID distinguish P4 time,set to DATAID number,else set to 0
    struct DataID DataIDForSepP4[100]; // If different DATAID distinguish P4 time, set to the corresponding DATAID(0-1,H→L),and its  SeparateValue P4 value
    dword DefaultValue; // If not all DataID distinguish P4 time or none of DataID distinguish P4 time or none of SubFunction and DataID distinguish P4 time,set to the corresponding default P4 value, else set to 0xFF.
  };
  const int ServiceNum=24;
  struct TimeParameters P4ServerTime[ServiceNum] = {
    {0x10,0,0xFF,0,0,0xFF},
    {0x11,0,0xFF,0,0,0xFF},
    {0x27,1,0xFF,0,0,200},//2025-2-19 SHITAIJIA ,27 P4 change to 200ms
    {0x28,1,0xFF,0,0,200},//2025-2-19 SHITAIJIA ,27 P4 change to 200ms
    {0x29,1,0xFF,0,0,10000},
    {0x85,1,0xFF,0,0,200},//2025-2-19 SHITAIJIA ,27 P4 change to 200ms
    {0x3E,0,0xFF,0,0,0xFF},
    {0x22,1,0xFF,0,0,200},
    {0x23,1,0xFF,0,0,200},//2025-2-19 SHITAIJIA ,27 P4 change to 200ms
    {0x2A,1,0xFF,0,0,200},
    {0x2C,1,0xFF,0,0,200},
    {0x2E,1,0xFF,0,0,5000},
    {0x2F,1,0xFF,0,0,200},//2025-2-19 SHITAIJIA
    {0x3D,1,0xFF,0,0,5000},
    {0x14,1,0xFF,0,0,5000},//2025-2-19 SHITAIJIA ,27 P4 change to 5000ms
    {0x19,1,0xFF,0,0,500},
    {0x31,1,1,14,{{0xFF00,60000},{0x0212,5000},{0x0301,200},{0x0240,2},{0xA000,200},//增加0205的P4
      {0xA001,200},{0xA002,200},{0xA003,200},{0xA004,200},{0xA005,200},
      {0xB000,500},{0xB001,5000},{0xA040,200},{0x0205,200}},5000},
    {0x31,1,2,0,0,200},
    {0x31,1,3,0,0,200},
    {0x34,1,0xFF,0,0,1000},
    {0x35,1,0xFF,0,0,1000},
    {0x36,1,0xFF,0,0,5000},
    {0x37,1,0xFF,0,0,1000},
    {0x38,1,0xFF,0,0,1000}
  };
  /* P4 */
  
	//诊断应用层参数
}



void InitTPParameter()
{
  int flag;
  
  if(strncmp(gBusContext,"CAN",10) == 0)
  {
    flag = 1;
  }
  else if(strncmp(gBusContext,"CANFD",10) == 0)
  {
    flag = 2;
  }
  else if(strncmp(gBusContext,"LIN",10) == 0)
  {
    flag = 3;
    TestStepIntervalTime = TestStepIntervalTimeLIN;
  }
  else if(strncmp(gBusContext,"FlexRay",10) == 0)
  {
    flag = 4;
  }
  else if(strncmp(gBusContext,"Ethernet",10) == 0)
  {
    flag = 5;
  }
  
  write("The bus type is %s and the type num is %d",gBusContext,flag);
  
  switch (flag)
  {
    case 1:
      write("The bus context now is CAN");
      TP_BusSet(TP_CAN);
      CAN_TP_Init();
      break;
    case 2:
      write("The bus context now is CANFD");
      TP_BusSet(TP_CANFD);
      CANFD_TP_Init();
      break;
    case 3:
      write("The bus context now is LIN");
      TP_BusSet(TP_LIN);
      LIN_TP_Init();
//      linWakeup();
//      LIN_TP_NAD = gLIN_TP_NAD;
//      LIN_TP_STmin = gLIN_TP_STmin;
//      LocalWakeUpCondition();
      break;
    case 4:
      write("The bus context now is FlexRay");
//      TP_BusSet(TP_FLEXRAY);
//      FRconfig();
//      FR_TP_Init();
      break;
    case 5:
      write("The bus context now is Erhernet");
      TP_BusSet(TP_ETHERNET);
      ETH_TP_Init();
//      ETH_TP_SetTransportParameters(gECUAddress_Temp,gTesterLogicAddress,gFunctionalLogicAddress,gTesterIpv4Address,gECUIpv4Address,gNetmask);
      break;
    default:
      break;      
  }
}


void CloseCANConnection()
{
  @Diagnostic::ReleaseConnection=1;
}

void OpenCANConnection()
{
  @Diagnostic::CAN_TPparameterInit=1;
  
}