/*@!Encoding:936*/

variables
{
  char cmd[300]="";
  char cmd2[300]="";
  char cmd3[300]="";
  char cmd4[300]="";
  
  dword BOBID_test;
  byte BOB_SendData[13] = {0x08,0x00,0x00,0x00,0x00,0x00,0x00,0x00,0x00,0x00,0x00,0x00,0x00} ;

  enum OperName 
  {
   BN_OPEN,BN_RESET,CAN1_ALL,CAN1_RESET,LIN_ALL,LIN_RESET,COM_ALL,COM_RESET,ALL_RESET,//BN_Open短路，
   BN0_OPEN,BN1_OPEN,BN2_OPEN,BN3_OPEN,ECU_GND_OPEN,
   BN0_OPEN_R,BN1_OPEN_R,BN2_OPEN_R,BN3_OPEN_R,ECU_GND_OPEN_R,
   CAN1H_OPEN,CAN1H_BAT,CAN1H_GND,CAN1H_CAN1L,CAN1L_OPEN,CAN1L_BAT,CAN1L_GND,
   CAN1H_OPEN_R,CAN1H_BAT_R,CAN1H_GND_R,CAN1H_CAN1L_R,CAN1L_OPEN_R,CAN1L_BAT_R,CAN1L_GND_R,
   LIN_OPEN,LIN_BAT,LIN_GND,
   LIN_OPEN_R,LIN_BAT_R,LIN_GND_R,
   OFFSET_GND_EN,
   OFFSET_GND_Dis,
   KL30_KL15_OPEN,
   KL30_KL15_OPEN_R,
   CAN1H_CAN1L_OPEN,
   CAN1H_CAN1L_OPEN_R,
   CAN2H_CAN2L_OPEN,
   CAN2H_CAN2L_OPEN_R,
   CAN2H_OPEN,CAN2H_BAT,CAN2H_GND,CAN2H_CAN2L,CAN2L_OPEN,CAN2L_BAT,CAN2L_GND,
   CAN2H_OPEN_R,CAN2H_BAT_R,CAN2H_GND_R,CAN2H_CAN2L_R,CAN2L_OPEN_R,CAN2L_BAT_R,CAN2L_GND_R
  };
  
  qword OperCmd[61]=
  {
    0x0437370000000000LL,0x0400370000000000LL,0x017F000000000000LL,0x0100000000000000LL,0x0307000000000000LL,0x0300000000000000LL,0x027F000000000000LL,0x0200000000000000LL,0x0500000000000000LL,
    0x0401010000000000LL,0x0404040000000000LL,0x0402020000000000LL,0x0420200000000000LL,0x0410100000000000LL,
    0x0400010000000000LL,0x0400040000000000LL,0x0400020000000000LL,0x0400200000000000LL,0x0400100000000000LL,
    0x0101000000000000LL,0x0104000000000000LL,0x0110000000000000LL,0x0140000000000000LL,0x0102000000000000LL,0x0108000000000000LL,0x0120000000000000LL,
    0x0100000000000000LL,0x0100000000000000LL,0x0100000000000000LL,0x0100000000000000LL,0x0100000000000000LL,0x0100000000000000LL,0x0100000000000000LL,
    0x0301000000000000LL,0x0302000000000000LL,0x0304000000000000LL,
    0x0300000000000000LL,0x0300000000000000LL,0x0300000000000000LL,
    0x0408080000000000LL,
    0x0400080000000000LL,
    0x0405050000000000LL,
    0x0400050000000000LL,
    0x0103000000000000LL,
    0x0100000000000000LL,
    0x0203000000000000LL,
    0x0200000000000000LL,
    0x0201000000000000LL,0x0204000000000000LL,0x0210000000000000LL,0x0240000000000000LL,0x0202000000000000LL,0x0208000000000000LL,0x0220000000000000LL,
    0x0200000000000000LL,0x0200000000000000LL,0x0200000000000000LL,0x0200000000000000LL,0x0200000000000000LL,0x0200000000000000LL,0x0200000000000000LL
  };
  
}


void ALL_BOB_Reset()
{
  @sysvar::DeviceControl::BOBs::BOB_Reset=1;
}


void BOBControl(char ECUName[],char Cluster[],enum OperName opername)
{
  dword BOBID;
 
  BOBID=GetBOBId(ECUName,Cluster);
  
  if(BOBID>0)
    write("Set bob id to 0x%x",BOBID);
  else
    testStepFail("Result","Fail-->Set BOB ID failed, please check Network name and ECUName!");
  
  BOB_SendData[3] =(byte)(BOBID>>8);
  BOB_SendData[4] =(byte)BOBID;
  BOB_SendData[5] = (byte)(OperCmd[opername]>>56);
  BOB_SendData[6] = (byte)(OperCmd[opername]>>48);
  BOB_SendData[7] = (byte)(OperCmd[opername]>>40);
  @sysvarMember::DeviceControl::BOBs::BOB_SendData[0]=BOB_SendData[0];
  @sysvarMember::DeviceControl::BOBs::BOB_SendData[1]=BOB_SendData[1];
  @sysvarMember::DeviceControl::BOBs::BOB_SendData[2]=BOB_SendData[2];
  @sysvarMember::DeviceControl::BOBs::BOB_SendData[3]=BOB_SendData[3];
  @sysvarMember::DeviceControl::BOBs::BOB_SendData[4]=BOB_SendData[4];
  @sysvarMember::DeviceControl::BOBs::BOB_SendData[5]=BOB_SendData[5];
  @sysvarMember::DeviceControl::BOBs::BOB_SendData[6]=BOB_SendData[6];
  @sysvarMember::DeviceControl::BOBs::BOB_SendData[7]=BOB_SendData[7];
  @sysvarMember::DeviceControl::BOBs::BOB_SendData[8]=BOB_SendData[8];
  @sysvarMember::DeviceControl::BOBs::BOB_SendData[9]=BOB_SendData[9];
  @sysvarMember::DeviceControl::BOBs::BOB_SendData[10]=BOB_SendData[10];
  @sysvarMember::DeviceControl::BOBs::BOB_SendData[11]=BOB_SendData[11];
  @sysvarMember::DeviceControl::BOBs::BOB_SendData[12]=BOB_SendData[12];
  @sysvar::DeviceControl::BOBs::BOBControl=1;
}

void BOBControl(dword BOBID, enum OperName opername)
{
  if(BOBID>0)
  {
    write("Set bob id to 0x%x",BOBID);
  }
  else
    testStepFail("Result","Fail-->Set BOB ID failed, please check Network name and ECUName!");
  
  BOB_SendData[3] =(byte)(BOBID>>8);
  BOB_SendData[4] =(byte)BOBID;
  BOB_SendData[5] = (byte)(OperCmd[opername]>>56);
  BOB_SendData[6] = (byte)(OperCmd[opername]>>48);
  BOB_SendData[7] = (byte)(OperCmd[opername]>>40);
  @sysvarMember::DeviceControl::BOBs::BOB_SendData[0]=BOB_SendData[0];
  @sysvarMember::DeviceControl::BOBs::BOB_SendData[1]=BOB_SendData[1];
  @sysvarMember::DeviceControl::BOBs::BOB_SendData[2]=BOB_SendData[2];
  @sysvarMember::DeviceControl::BOBs::BOB_SendData[3]=BOB_SendData[3];
  @sysvarMember::DeviceControl::BOBs::BOB_SendData[4]=BOB_SendData[4];
  @sysvarMember::DeviceControl::BOBs::BOB_SendData[5]=BOB_SendData[5];
  @sysvarMember::DeviceControl::BOBs::BOB_SendData[6]=BOB_SendData[6];
  @sysvarMember::DeviceControl::BOBs::BOB_SendData[7]=BOB_SendData[7];
  @sysvarMember::DeviceControl::BOBs::BOB_SendData[8]=BOB_SendData[8];
  @sysvarMember::DeviceControl::BOBs::BOB_SendData[9]=BOB_SendData[9];
  @sysvarMember::DeviceControl::BOBs::BOB_SendData[10]=BOB_SendData[10];
  @sysvarMember::DeviceControl::BOBs::BOB_SendData[11]=BOB_SendData[11];
  @sysvarMember::DeviceControl::BOBs::BOB_SendData[12]=BOB_SendData[12];
  @sysvar::DeviceControl::BOBs::BOBControl=1;
}


dword GetBOBId(char ECUName[],char Cluster[])
{
  dword BOBID;
  
  sysSetVariableString(sysvar::DeviceControl::BOB::Parameters::ECUName,ECUName);
  sysSetVariableString(sysvar::DeviceControl::BOB::Parameters::Cluster,Cluster);
  @sysvar::DeviceControl::BOB::Query::BOBID++;
  BOBID = @sysvar::DeviceControl::BOB::Parameters::BOBID;
  return BOBID;
}


/// <Operation>
void BOBS_CANH2BAT(char ECUName[],char Cluster[],int operate)
{
  int i;
  
  for(i=0;i<NodeMapNum;i++)
  {
    if(strncmp(NodeMap[i].NodeName,ECUName,elcount(ECUName))==0 && strncmp(NodeMap[i].BusName,Cluster,elcount(Cluster))==0)
    {
      if(NodeMap[i].BOBchannel == 1)
      {
        if(operate>0)
        {
          BOBControl(NodeMap[i].BOBID,CAN1H_BAT);
        }
        else
        {
          BOBControl(NodeMap[i].BOBID,CAN1H_BAT_R);
        }
        
      }
      else
      {
        if(operate>0)
        {
          BOBControl(NodeMap[i].BOBID,CAN2H_BAT);
        }
        else
        {
          BOBControl(NodeMap[i].BOBID,CAN2H_BAT_R);
        }  
      }  
    }
  }
}

/// <Operation>
void BOBS_CANL2BAT(char ECUName[],char Cluster[],int operate)
{
  int i;
  
  for(i=0;i<NodeMapNum;i++)
  {
    if(strncmp(NodeMap[i].NodeName,ECUName,elcount(ECUName))==0 && strncmp(NodeMap[i].BusName,Cluster,elcount(Cluster))==0)
    {
      if(NodeMap[i].BOBchannel == 1)
      {
        if(operate>0)
        {
          BOBControl(NodeMap[i].BOBID,CAN1L_BAT);
        }
        else
        {
          BOBControl(NodeMap[i].BOBID,CAN1L_BAT_R);
        }
        
      }
      else
      {
        if(operate>0)
        {
          BOBControl(NodeMap[i].BOBID,CAN2L_BAT);
        }
        else
        {
          BOBControl(NodeMap[i].BOBID,CAN2L_BAT_R);
        }
      }  
    }
  }
}

/// <Operation>
void BOBS_CANH2GND(char ECUName[],char Cluster[],int operate)
{
  int i;
  
  for(i=0;i<NodeMapNum;i++)
  {
    if(strncmp(NodeMap[i].NodeName,ECUName,elcount(ECUName))==0 && strncmp(NodeMap[i].BusName,Cluster,elcount(Cluster))==0)
    {
      if(NodeMap[i].BOBchannel == 1)
      {
        if(operate>0)
        {
          BOBControl(NodeMap[i].BOBID,CAN1H_GND);
        }
        else
        {
          BOBControl(NodeMap[i].BOBID,CAN1H_GND_R);
        }
        
      }
      else
      {
        if(operate>0)
        {
          BOBControl(NodeMap[i].BOBID,CAN2H_GND);
        }
        else
        {
          BOBControl(NodeMap[i].BOBID,CAN2H_GND_R);
        }
      }   
    }
  }
}
  
/// <Operation>
void BOBS_CANL2GND(char ECUName[],char Cluster[],int operate)
{
  int i;
  
  for(i=0;i<NodeMapNum;i++)
  {
    if(strncmp(NodeMap[i].NodeName,ECUName,elcount(ECUName))==0 && strncmp(NodeMap[i].BusName,Cluster,elcount(Cluster))==0)
    {
      if(NodeMap[i].BOBchannel == 1)
      {
        if(operate>0)
        {
          BOBControl(NodeMap[i].BOBID,CAN1L_GND);
        }
        else
        {
          BOBControl(NodeMap[i].BOBID,CAN1L_GND_R);
        }
        
      }
      else
      {
        if(operate>0)
        {
          BOBControl(NodeMap[i].BOBID,CAN2L_GND);
        }
        else
        {
          BOBControl(NodeMap[i].BOBID,CAN2L_GND_R);
        }  
      } 
    }
  }
}
/// <Operation>
void BOBS_CANH2CANL(char ECUName[],char Cluster[],int operate)
{
  int i;
  
  for(i=0;i<NodeMapNum;i++)
  {
    if(strncmp(NodeMap[i].NodeName,ECUName,elcount(ECUName))==0 && strncmp(NodeMap[i].BusName,Cluster,elcount(Cluster))==0)
    {
      if(NodeMap[i].BOBchannel == 1)
      {
        if(operate>0)
        {
          BOBControl(NodeMap[i].BOBID,CAN1H_CAN1L);
        }
        else
        {
          BOBControl(NodeMap[i].BOBID,CAN1H_CAN1L_R);
        }
        
      }
      else
      {
        if(operate>0)
        {
          BOBControl(NodeMap[i].BOBID,CAN2H_CAN2L);
        }
        else
        {
          BOBControl(NodeMap[i].BOBID,CAN2H_CAN2L_R);
        }  
      } 
    }
  }
}

/// <Operation>
void BOBS_CANHOpen(char ECUName[],char Cluster[],int operate)
{
  int i;
  
  for(i=0;i<NodeMapNum;i++)
  {
    if(strncmp(NodeMap[i].NodeName,ECUName,elcount(ECUName))==0 && strncmp(NodeMap[i].BusName,Cluster,elcount(Cluster))==0)
    {
      if(NodeMap[i].BOBchannel == 1)
      {
        if(operate>0)
        {
          BOBControl(NodeMap[i].BOBID,CAN1H_OPEN);
        }
        else
        {
          BOBControl(NodeMap[i].BOBID,CAN1H_OPEN_R);
        }
        
      }
      else
      {
        if(operate>0)
        {
          BOBControl(NodeMap[i].BOBID,CAN2H_OPEN);
        }
        else
        {
          BOBControl(NodeMap[i].BOBID,CAN2H_OPEN_R);
        }  
      } 
    }
  }
}

/// <Operation>
void BOBS_CANLOpen(char ECUName[],char Cluster[],int operate)
{
  int i;
  
  for(i=0;i<NodeMapNum;i++)
  {
    if(strncmp(NodeMap[i].NodeName,ECUName,elcount(ECUName))==0 && strncmp(NodeMap[i].BusName,Cluster,elcount(Cluster))==0)
    {
      if(NodeMap[i].BOBchannel == 1)
      {
        if(operate>0)
        {
          BOBControl(NodeMap[i].BOBID,CAN1L_OPEN);
        }
        else
        {
          BOBControl(NodeMap[i].BOBID,CAN1L_OPEN_R);
        }
        
      }
      else
      {
        if(operate>0)
        {
          BOBControl(NodeMap[i].BOBID,CAN2L_OPEN);
        }
        else
        {
          BOBControl(NodeMap[i].BOBID,CAN2L_OPEN_R);
        }  
      } 
    }
  }
}

/// <Operation>
void BOBS_OFFSET_GND(char ECUName[],char Cluster[],int operate)
{
  int i;
  
  for(i=0;i<NodeMapNum;i++)
  {
    if(strncmp(NodeMap[i].NodeName,ECUName,elcount(ECUName))==0 && strncmp(NodeMap[i].BusName,Cluster,elcount(Cluster))==0)
    {
      if(operate>0)
      {
        BOBControl(NodeMap[i].BOBID,OFFSET_GND_EN);
      }
      else
      {
        BOBControl(NodeMap[i].BOBID,OFFSET_GND_Dis);
      }
    }
  }
}