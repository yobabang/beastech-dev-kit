/*@!Encoding:936*/
/*----------------------------------------------------------------------------
|  File Name: LIN_TP.cin
|  Comment:   LIN network layer functions of ISO15765-2:2016
|-----------------------------------------------------------------------------
|               A U T H O R   I D E N T I T Y
|-----------------------------------------------------------------------------
| Initials           Name                           Company
| --------   -------------------     -----------------------------------------
| LJY              LiJingyao         Polelink Information Technology Co., Ltd.
| SDY              SunDayong         Polelink Information Technology Co., Ltd.
| WRN              WuRuonan          Polelink Information Technology Co., Ltd.
| ZH               ZhangHeng         Polelink Information Technology Co., Ltd.
|-----------------------------------------------------------------------------
|               R E V I S I O N   H I S T O R Y
|-----------------------------------------------------------------------------
| Date         Ver  Author            Description
| ----------   ---  ------            ----------------------------------------
| 20190621     1.0  LJY WRN           Creation
|1.Create first edition;
|-----------------------------------------------------------------------------
|               C O P Y R I G H T
|-----------------------------------------------------------------------------
| Copyright (c) 2010 - 2019 by Polelink Information Technology Co., Ltd.
| All rights reserved.
-----------------------------------------------------------------------------*/

includes
{

}

variables
{
  //enum AddressMode {physical,functional};
  //enum ResponseState {Timeout,Pos,Neg};
   
  //byte gTpRxData[4096];
  //dword TpRxLength;
  long LIN_RequestWasSentFunctionally;
  long gOldScheduleTableIndex;
  long gNodeAddress;
  long gMasterRequestTableIndex=0;
  long gSlaveResponseTableIndex=1;
  msTimer tWaitForResponse;
  Long ChkFunRespIndex;
  long CFIndex,SFIndex;
  const cLIN_FunctionalGroupNAD = 0x7E;
  msTimer TWait,LIN_TP_TesterPresentTimer;
  byte PreCount;
  int SeqCount;
  byte Data_3E[8]={0x7E,0x2,0x3e,0x80,0x7F,0X7F,0X7F,0X7F};
  byte Diag_3E[2]={0x3e,0x80};
  
  int    gBusFlag = 1;//CAN:1 CANFD:2 LIN:3 FlexRay:4 Ethernet:5
  enum   AddressMode {PHYSICAL = 0,FUNCTIONAL = 1};
  byte   gTpRxData[65535];
  dword  gTpRxLength;
  int gUDS_S3Client,gP2StarClient;
  char ECUinfoPath[400];
  char gAbsPath[400];
  
  int  LIN_TP_NAD = 0x51;
  int  LIN_TP_STmin = 20;
  enum BusyFlag {BUSY,IDLE};
  enum BusyFlag LINBusState;
  enum CsType {classic,enhanced,error};
  
  /*  */
  msTimer t_ms_WakeUpLIN;
  int     Flag_WakeUpLIN = 1;
}

void LIN_TP_Release()
{
  
}

on preStart
{
  LINtp_InitAsMaster();
  //linSetChecksumModel(0x3c,0);//石太佳：设置3C用经典校验和
  getAbsFilePath("",gAbsPath,500);
  snprintf(ECUinfoPath,500,"%s\\01_Input\\",gAbsPath);
  setFilePath(ECUinfoPath,2);//初始化ini文件地址
  gP2StarClient=getProfileInt("ECUinfo","P2StarClient",1500,"DiagParameter.ini");
}

on timer tWaitForResponse
{
  if(CFIndex!=1)
      CCILIN_ChangeSchedTable( gMasterRequestTableIndex);
  write("Do not response ");
}

on timer TWait
{
  TestSupplyTextEvent("LINTPreciveData");
}
CCILIN_RestoreTableIndex()
{
  if( gOldScheduleTableIndex >= 0)
  {
    CCILIN_ChangeSchedTable( gOldScheduleTableIndex);
    gOldScheduleTableIndex = -1;
  }
}

void send_lin_3e_80_message()
{
  byte Data[8]={0x7e,0x2,0x3e,0x80,0xff,0xff,0xff,0xff};
  int i;
  linFrame 0x3c linmsg;
  
  //config response
  linmsg.RTR = 0;
      
  linmsg.dlc=8;

  linmsg.msgChannel=1;

  linmsg.id=0x3c;

  
  for(i=0;i<8;i++)
  {
      linmsg.byte(i)=Data[i]; 
    
  }
  
  output(linmsg);
  
  linmsg.rtr=1;
  output(linmsg);
  
  
  
}
on timer LIN_TP_TesterPresentTimer
{
  byte Data[8]={0x7e,0x2,0x3e,0x80,0xff,0xff,0xff,0xff};
  linFrame 0x3c SimReq;
  if(LINBusState==IDLE)
  {
      //LINSendResponse(0x3c,8,Data,classic);
      //LinSendHeader (0x3c);//
    
      //linSetRespCounter (0x3c,-1);
      @Diagnostic::Time_TesterPresentSend = timeNowFloat()/100.0;
//////      write("Send TesterPresent");
  }
  else
  {
    write("LIN bus busy");
  }
	
}

on timer t_ms_WakeUpLIN
{
  Flag_WakeUpLIN = 1;
}

on sysvar_update Diagnostic::TP_TesterPresentSet
{

    if(@this==1)
  	{
  		setTimerCyclic(LIN_TP_TesterPresentTimer,gUDS_S3Client);
      cancelTimer(t_ms_WakeUpLIN);
  	}
  	else if(@this==0)
  	{
  		cancelTimer(LIN_TP_TesterPresentTimer);
      setTimerCyclic(t_ms_WakeUpLIN,1000);
  	}  
 
}

on sysvar_update Diagnostic::LIN_TPparameterInit
{
  @Diagnostic::LIN_Enable=1;
  
  LINtp_SetFillByteValue(0xFF);//0~255
  LINtp_SetMaximumReceiveLength(2048);
  LINtp_SetSTmin(@Diagnostic::LIN_TP_STmin);
  LINtp_SetWaiting(0);
  LIN_RequestWasSentFunctionally=0;
  ChkFunRespIndex=0;
  CFIndex=0;
  SFIndex=0;
  gNodeAddress=@Diagnostic::LIN_TP_NAD;
  gUDS_S3Client=@Diagnostic::S3Client;
  gMasterRequestTableIndex=0;
  gSlaveResponseTableIndex=1; 
}

on sysvar_update Diagnostic::Send_Flag
{
  byte tempdata[4095],ResponseData[4095];
  byte tempAddressmode;
  long Requestlength,Responselength;
  
  if(@this==1)
  {
    tempAddressmode=@Diagnostic::AddressingMode;
    Requestlength=elcount(sysvar::Diagnostic::Send_Data);
    sysGetVariableData(sysvar::Diagnostic::Send_Data,tempdata,Requestlength);
    if(tempAddressmode==0)
    {
      LINBusState=BUSY;
      LIN_TP_Send(tempdata,Requestlength,PHYSICAL);
    }
    else if(tempAddressmode==1)
    {
      LINBusState=BUSY;
      LIN_TP_Send(tempdata,Requestlength,FUNCTIONAL);
    }
      
  }
}

on sysvar_update Diagnostic::LIN_ChangeSchedTable
{
  CCILIN_ChangeSchedTable(gSlaveResponseTableIndex);
}

void LINtp_FCPreTransmit(BYTE  fcData[])
{
  write( "FlowControl to be sent: %02x %02x %02x %02x (%d byte)"
  , fcData[0] , fcData[1] , fcData[2] , fcData[3], elcount(fcData));
}

On linFrame  0x3D
{
  write("Receive 0x3d message!");
  SeqCount=0;
  if(this.byte(0)==gNodeAddress&&this.dir==rx)
  {
    if((this.byte(1)>>4==1)||(this.byte(1)<=0x6))
    {
      TestSupplyTextEvent("LINTPFirstCFrecived");
      @Diagnostic::Receive_ConFirst=1;
      LINBusState=BUSY;
      write("%02x,%02x,%02x",this.byte(0),this.byte(1),this.byte(2));
    }
  }
}

On linFrame 0x3C
{
  PreCount=0;
  if(this.byte(0)==gNodeAddress&&this.dir==tx)
  {
    if((this.byte(1)>>4)==1)
    {
      PreCount=1;
      SeqCount=0;
    }
    else if(this.byte(1)>>4==2)
    {
      
      if((PreCount==1)&&(this.byte(2)<<4==1))
      {
        PreCount=0;
        SeqCount=0;
      }
      else
        SeqCount=SeqCount+1;
    
    }
//    write("SeqCount14:%d",SeqCount);
  }
}

Diag_SendFunctional( BYTE data[],int length)
{
  long currentAddress;

  currentAddress = gNodeAddress;
  gNodeAddress = cLIN_FunctionalGroupNAD;
//////  LIN_RequestWasSentFunctionally = (gNodeAddress == cLIN_FunctionalGroupNAD);
  Diag_DataRequest( data, length);
  gNodeAddress = currentAddress;

}

Diag_DataRequest( BYTE data[], DWORD count)
{
  /* The diagnostics layer transports data via a CAPL callback interface. */
    gOldScheduleTableIndex = -1;
    if( gMasterRequestTableIndex == -1)
    {
       CCILIN_GetTableIndices( gMasterRequestTableIndex, gSlaveResponseTableIndex);
    }
    if( gMasterRequestTableIndex < 0)
    {
      if( gMasterRequestTableIndex == -1)
      {
        writeEx( 1, 3, "\n: Master request table index not set!");
        gMasterRequestTableIndex = -2; // only report the error once!
      }
    }
    else
      gOldScheduleTableIndex =CCILIN_ChangeSchedTable(gMasterRequestTableIndex);

    // Store whether the request was sent to a functional group
//////    if(gNodeAddress == 0x7e)
//////     LIN_RequestWasSentFunctionally=1;
//////    else
//////      LIN_RequestWasSentFunctionally=0;

     gOldScheduleTableIndex = CCILIN_ChangeSchedTable(gMasterRequestTableIndex);
     CCILIN_ChangeSchedTable(gMasterRequestTableIndex); 
     LINtp_DataReq(data, count, gNodeAddress);
}

LINtp_DataCon(long count)
{
    // Since we do not know if a response is expected, simply start P2 (LIN default: 500 ms)
    tWaitForResponse.set( 4000 + 5); // add some slack
    // Switch to the response table for the slave's response, if one is expected
//    if(gRequestWasSentFunctionally==1&&ChkFunRespIndex==0)
   
    if(LIN_RequestWasSentFunctionally==1)
    {
      CCILIN_ChangeSchedTable (gMasterRequestTableIndex);  // no response on functional requests!
    }
    else if(gSlaveResponseTableIndex==1)
    {
      CCILIN_ChangeSchedTable(gSlaveResponseTableIndex); // expect a response on a physical request
      ChkFunRespIndex=0;
    }
    else if( gSlaveResponseTableIndex < 0)
    {
      if( gSlaveResponseTableIndex == -1)
      {
        writeEx( 1, 3, "\n: Slave response table index not set!");
        gSlaveResponseTableIndex = -2; // only report the error once!
      }   
    }
    
    @Diagnostic::Send_Con=1;
    LINBusState=IDLE;
    write( "sent %d byte--Confirm:%f", count,timeNow()/100000.0);
    testSupplyTextEvent("SendMsg");   
}

LINtp_FirstFrameIndication(long sender, long receiver, long announcedLen)
{
  // A response is about to be received, therefore the watchdog timer can be cancelled.
  // When the data has finally arrived, the schedule will be changed too.
  
    tWaitForResponse.cancel();
    CFIndex=1;
    linChangeSchedTable(gSlaveResponseTableIndex);
    LINBusState=BUSY;
}

LINtp_DataInd(long count, DWORD nad)
{
  /* This function forwards the data to the diagnostics layer */
  
  LINtp_GetRxData(gTpRxData, count);
  gTpRxLength=count;
  sysSetVariableData(sysvar::Diagnostic::Receive_Data,gTpRxData,gTpRxLength);
  @Diagnostic::Receive_DataLength=gTpRxLength;
  
  
  @Diagnostic::Receive_ConAll=1;

  tWaitForResponse.cancel();
  if(count == 3 && gTpRxData[0] == 0x7F && gTpRxData[2] == 0x78)
  {
    // A response pending was received, therefore restart the timer with P2ex
//    tWaitForResponse.set(gP2StarClient);
    write( "gSlaveResponseTableIndex3: %d", gSlaveResponseTableIndex);
    CCILIN_ChangeSchedTable( gSlaveResponseTableIndex );
  }
  else
  {
    CCILIN_ChangeSchedTable( gMasterRequestTableIndex );
  }
  TWait.set(2);
  LINBusState=IDLE;
}

LINtp_ErrorInd(int error)
{
  writeEx( 1, 3, "\nCCILIN [%.3f ] LINtp_ErrorInd(%d)", timenow()/100000.0,  error);
}


long CCILIN_ChangeSchedTable(long newTableIndex)
{
  long previousIndex;
  previousIndex = linChangeSchedTable(newTableIndex);
  if( previousIndex != newTableIndex)
  {
    writeDbgLevel( 1,"CCILIN [%.3f] Changing schedule table from %d to %d", timenow()/100000.0,previousIndex, newTableIndex);
  }
  return previousIndex;
}

CCILIN_GetTableIndices( long& masterRequestTableIndex, long& slaveResponseTableIndex)
{
  // In a tester (=LIN master), change these values to the actual table indices!
  // In an ECU simulation (=LIN slave), these values will be ignored.
//  masterRequestTableIndex = -1;
//  slaveResponseTableIndex = -1;
}


int LIN_TP_Send(byte Data[],int length,enum AddressMode Mode)
{
  if(length>elcount(Data))
  {
    if(Mode==PHYSICAL)
    {
       Diag_DataRequest(Data,elCount(Data));
    }
    else
    {
       ChkFunRespIndex=1;
       Diag_SendFunctional(Data,length);
    }
    write("Worning tp send data size small than given length");
  }
  else if(length<elcount(Data))
  {
    if(Mode==PHYSICAL)
    {
       Diag_DataRequest(Data,length);
       
    }
    else
    {
       ChkFunRespIndex=1;
       Diag_SendFunctional(Data,length);
    }
  }
  else
  {
    if(Mode==PHYSICAL)
    {
       Diag_DataRequest(Data,elCount(Data));
    }
    else
    {
       ChkFunRespIndex=1;
       Diag_SendFunctional(Data,length);
    }
    write("Worning tp send data size small than given length");
  }
    
  return 1;
}

void LinSendHeader (byte frameId)
{
  linframe 0x0  tst_Frame;
  tst_Frame.MsgChannel = 1;
  tst_Frame.ID = frameId;
  tst_Frame.RTR=1;    //RTR of lin message?  maybe RTR here is indicate that the master request a response from slave node?
  output(tst_Frame); // set header
}
void LINSendResponse(byte frameId,int dlc, byte mdata[], enum CsType validCs)
{
  int i;
  byte csByte;
  linframe 0x0  tst_Frame;

  linSetRespCounter(frameId, 1);

  tst_Frame.MsgChannel = 1;
  tst_Frame.ID = frameId;
  tst_Frame.DLC = dlc;
  
  //2025-2-17 ，在prestart里 可以直接设置LIN 3C报文用经典校验
  if(validCs==enhanced)
    csByte= linGetProtectedID(frameId);
  else if(validCs==classic)
    csByte=0;
  else
    csByte=frameId;
  for (i=0; i < dlc; ++i)
  {
    tst_Frame.byte(i) = mdata[i];
    if(csByte+mdata[i]>255)
      csByte=csByte+mdata[i]+1;
    else
      csByte=csByte+mdata[i];
  }
  linSetManualChecksum(tst_Frame, ~csByte); // set corrupted checksum (invert 4th bit) //invert the whole byte of csByte?

  tst_Frame.RTR=0;  //lin message RTR?
  output(tst_Frame); // set response
}

void LocalWakeUpCondition()
{
  dword i;

  for(i=0;i<0x1;i++)
  {
//////    setBusContext(getBusNameContext("LIN1"));
    LinSendHeader(i);
    testWaitForTimeout(1000);
  }
//  testStep("Step","Wakeup network!");
}

void MainTest()
{
  setTimerCyclic(t_ms_WakeUpLIN,1000);
  
  while(1)
  {
    if(Flag_WakeUpLIN == 1) { LocalWakeUpCondition(); Flag_WakeUpLIN = 0; }
    testWaitForTimeout(1000);
  }
}


