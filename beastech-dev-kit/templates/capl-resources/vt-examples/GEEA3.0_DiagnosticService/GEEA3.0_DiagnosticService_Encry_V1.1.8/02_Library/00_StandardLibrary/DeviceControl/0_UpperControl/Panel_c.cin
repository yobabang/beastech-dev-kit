/*@!Encoding:936*/

variables
{
  char ENV_cmd[300]="";
  byte OutputCnt=1;
  byte OutputOffsetCnt=1;
  char BOBID[10]="";
//  msTimer T_CAN1_CMD; 
//  msTimer T_CAN2_CMD; 
//  msTimer T_LIN_CMD; 
//  msTimer T_BN_GND_CMD; 
  
  byte CAN1_DATA[13];
  byte CAN2_DATA[13];
  byte LIN_DATA[13];
  byte BN_DATA[13];
}


//
//on timer T_CAN1_CMD
//{
//  SendTcpData_BYTE(CAN1_DATA,TEH_CAN1_Socket);
//  Display();
//}
//
//on timer T_CAN2_CMD
//{
//  SendTcpData_BYTE(CAN2_DATA,TEH_CAN1_Socket);
//  Display();
//}
//
//on timer T_LIN_CMD
//{
//  SendTcpData_BYTE(LIN_DATA,TEH_CAN1_Socket);
//  Display();
//}
//
//on timer T_BN_GND_CMD
//{
//  SendTcpData_BYTE(BN_DATA,TEH_CAN1_Socket);
//  Display();
//}


void Panel_Init()
{ 
//  PMM_Ind_Init();
  PSRB_Ind_Init();
  DRB1_Ind_Init();
  DRB2_Ind_Init();
  DRB3_Ind_Init();
  ENV1_Ind_Init();
//  VH6501_Ind_Init();
//  BOB_Ind_Init();
}

void PSRB_Ind_Init()
{
  @sysvar::Panel::PSRB::Relay1=0;
  @sysvar::Panel::PSRB::Relay2=0;
  @sysvar::Panel::PSRB::Relay3=0;
  @sysvar::Panel::PSRB::Relay4=0;
  @sysvar::Panel::PSRB::Relay5=0;
  @sysvar::Panel::PSRB::Relay6=0;
  @sysvar::Panel::PSRB::Relay7=0;
  @sysvar::Panel::PSRB::Relay8=0;
  @sysvar::Panel::PSRB::Relay9=0;
  @sysvar::Panel::PSRB::Relay10=0;
  @sysvar::Panel::PSRB::Relay11=0;
  @sysvar::Panel::PSRB::Relay12=0;
}

void DRB1_Ind_Init()
{
  @sysvar::Panel::DRB::DRB1_CH1_ECU=0;
  @sysvar::Panel::DRB::DRB1_CH2_ECU=0;
  @sysvar::Panel::DRB::DRB1_CH3_ECU=0;
  @sysvar::Panel::DRB::DRB1_CH4_ECU=0;
  @sysvar::Panel::DRB::DRB1_CH5_ECU=0;
  @sysvar::Panel::DRB::DRB1_CH6_ECU=0;
  @sysvar::Panel::DRB::DRB1_CH7_ECU=0;
  @sysvar::Panel::DRB::DRB1_CH8_ECU=0;
  @sysvar::Panel::DRB::DRB1_CH1_Tester=0;
  @sysvar::Panel::DRB::DRB1_CH2_Tester=0;
  @sysvar::Panel::DRB::DRB1_CH3_Tester=0;
  @sysvar::Panel::DRB::DRB1_CH4_Tester=0;
  @sysvar::Panel::DRB::DRB1_CH5_Tester=0;
  @sysvar::Panel::DRB::DRB1_CH6_Tester=0;
  @sysvar::Panel::DRB::DRB1_CH7_Tester=0;
  @sysvar::Panel::DRB::DRB1_CH8_Tester=0;
  @sysvar::Panel::DRB::DRB1_ENV=0;
  @sysvar::Panel::DRB::DRB1_FIU=0;
  @sysvar::Panel::DRB::DRB1_PCS=0;
  @sysvar::Panel::DRB::DRB1_PMM=0;
  @sysvar::Panel::DRB::DRB1_VH6501=0;
}

void DRB2_Ind_Init()
{
  @sysvar::Panel::DRB::DRB2_CH1_ECU=0;
  @sysvar::Panel::DRB::DRB2_CH2_ECU=0;
  @sysvar::Panel::DRB::DRB2_CH3_ECU=0;
  @sysvar::Panel::DRB::DRB2_CH4_ECU=0;
  @sysvar::Panel::DRB::DRB2_CH5_ECU=0;
  @sysvar::Panel::DRB::DRB2_CH6_ECU=0;
  @sysvar::Panel::DRB::DRB2_CH7_ECU=0;
  @sysvar::Panel::DRB::DRB2_CH8_ECU=0;
  @sysvar::Panel::DRB::DRB2_CH1_Tester=0;
  @sysvar::Panel::DRB::DRB2_CH2_Tester=0;
  @sysvar::Panel::DRB::DRB2_CH3_Tester=0;
  @sysvar::Panel::DRB::DRB2_CH4_Tester=0;
  @sysvar::Panel::DRB::DRB2_CH5_Tester=0;
  @sysvar::Panel::DRB::DRB2_CH6_Tester=0;
  @sysvar::Panel::DRB::DRB2_CH7_Tester=0;
  @sysvar::Panel::DRB::DRB2_CH8_Tester=0;
  @sysvar::Panel::DRB::DRB2_ENV=0;
  @sysvar::Panel::DRB::DRB2_FIU=0;
  @sysvar::Panel::DRB::DRB2_PCS=0;
  @sysvar::Panel::DRB::DRB2_PMM=0;
  @sysvar::Panel::DRB::DRB2_VH6501=0;
}

void DRB3_Ind_Init()
{
  @sysvar::Panel::DRB::DRB3_CH1_ECU=0;
  @sysvar::Panel::DRB::DRB3_CH2_ECU=0;
  @sysvar::Panel::DRB::DRB3_CH3_ECU=0;
  @sysvar::Panel::DRB::DRB3_CH4_ECU=0;
  @sysvar::Panel::DRB::DRB3_CH5_ECU=0;
  @sysvar::Panel::DRB::DRB3_CH6_ECU=0;
  @sysvar::Panel::DRB::DRB3_CH7_ECU=0;
  @sysvar::Panel::DRB::DRB3_CH8_ECU=0;
  @sysvar::Panel::DRB::DRB3_CH1_Tester=0;
  @sysvar::Panel::DRB::DRB3_CH2_Tester=0;
  @sysvar::Panel::DRB::DRB3_CH3_Tester=0;
  @sysvar::Panel::DRB::DRB3_CH4_Tester=0;
  @sysvar::Panel::DRB::DRB3_CH5_Tester=0;
  @sysvar::Panel::DRB::DRB3_CH6_Tester=0;
  @sysvar::Panel::DRB::DRB3_CH7_Tester=0;
  @sysvar::Panel::DRB::DRB3_CH8_Tester=0;
  @sysvar::Panel::DRB::DRB3_ENV=0;
  @sysvar::Panel::DRB::DRB3_FIU=0;
  @sysvar::Panel::DRB::DRB3_PCS=0;
  @sysvar::Panel::DRB::DRB3_PMM=0;
  @sysvar::Panel::DRB::DRB3_VH6501=0;
}

void ENV1_Ind_Init()
{
  @sysvar::Panel::ENV::C1 =0;
  @sysvar::Panel::ENV::C2 =0;
  @sysvar::Panel::ENV::C3 =0;
  @sysvar::Panel::ENV::CANH2BAT =0;
  @sysvar::Panel::ENV::CANH2CANL =0;
  @sysvar::Panel::ENV::CANH2GND =0;
  @sysvar::Panel::ENV::CANHBreak =0;
  @sysvar::Panel::ENV::CANL2BAT =0;
  @sysvar::Panel::ENV::CANL2GND =0;
  @sysvar::Panel::ENV::CANLBreak =0;
  @sysvar::Panel::ENV::CANOUT =0;
  @sysvar::Panel::ENV::Env_Set =0;
  @sysvar::Panel::ENV::R_CANH_CANL =0;
  @sysvar::Panel::ENV::R_Circuit =0;
}

void VH6501_Ind_Init()
{
  @sysvar::Panel::VH6501::CANHShortToBat =0;
  @sysvar::Panel::VH6501::CANHShortToCANL =0;
  @sysvar::Panel::VH6501::CANHShortToGND =0;
  @sysvar::Panel::VH6501::CANLShortToBat =0;
  @sysvar::Panel::VH6501::CANLShortToGND =0;
 
}


void PMM_Ind_Init()
{
  @sysvar::Panel::PMM::RES_Recv=0;
}

//void BOB_Ind_Init()
//{
//  Display();
//}
//
//void Display()
//{
//  @sysvar::BOB::BN0_OPEN_IND=@sysvar::BOB::BN0_OPEN;
//  @sysvar::BOB::BN1_OPEN_IND=@sysvar::BOB::BN1_OPEN;
//  @sysvar::BOB::BN2_OPEN_IND=@sysvar::BOB::BN2_OPEN;
//  @sysvar::BOB::BN3_OPEN_IND=@sysvar::BOB::BN3_OPEN;
//  @sysvar::BOB::CAN1H_BAT_IND=@sysvar::BOB::CAN1H_BAT;
//  @sysvar::BOB::CAN1H_CAN1L_IND=@sysvar::BOB::CAN1H_CAN1L;
//  @sysvar::BOB::CAN1H_GND_IND=@sysvar::BOB::CAN1H_GND;
//  @sysvar::BOB::CAN1H_OPEN_IND=@sysvar::BOB::CAN1H_OPEN;
//  @sysvar::BOB::CAN1L_BAT_IND=@sysvar::BOB::CAN1L_BAT;
//  @sysvar::BOB::CAN1L_GND_IND=@sysvar::BOB::CAN1L_GND;
//  @sysvar::BOB::CAN1L_OPEN_IND=@sysvar::BOB::CAN1L_OPEN;
//  @sysvar::BOB::CAN2H_BAT_IND=@sysvar::BOB::CAN2H_BAT;
//  @sysvar::BOB::CAN2H_CAN2L_IND=@sysvar::BOB::CAN2H_CAN2L;
//  @sysvar::BOB::CAN2H_GND_IND=@sysvar::BOB::CAN2H_GND;
//  @sysvar::BOB::CAN2H_OPEN_IND=@sysvar::BOB::CAN2H_OPEN;
//  @sysvar::BOB::CAN2L_BAT_IND=@sysvar::BOB::CAN2L_BAT;
//  @sysvar::BOB::CAN2L_GND_IND=@sysvar::BOB::CAN2L_GND;
//  @sysvar::BOB::CAN2L_OPEN_IND=@sysvar::BOB::CAN2L_OPEN;
//  @sysvar::BOB::ECU_GND_OPEN_IND=@sysvar::BOB::ECU_GND_OPEN;
//  @sysvar::BOB::LIN1_BAT_IND=@sysvar::BOB::LIN1_BAT;
//  @sysvar::BOB::LIN1_GND_IND=@sysvar::BOB::LIN1_GND;
//  @sysvar::BOB::LIN1_OPEN_IND=@sysvar::BOB::LIN1_OPEN;
//  @sysvar::BOB::OFFSET_GND_EN_IND=@sysvar::BOB::OFFSET_GND_EN;
//}


/// <a.PPS&PSRB>
On sysvar sysvar::Panel::PPS::settingVoltage
{
  PPS_SetVoltage(@sysvar::Panel::PPS::settingVoltage);
}
/// <a.PPS&PSRB>
On sysvar sysvar::Panel::PPS::settingCurrent
{
  //PPS_SetCurrent(@sysvar::Panel::PPS::settingCurrent);
}

/// <a.PPS&PSRB>
On sysvar sysvar::Panel::PPS::output
{
  if(@sysvar::Panel::PPS::output==0)
  {
    OutputCnt=!OutputCnt;
  }
  
  if(OutputCnt==1)
  {
    PPS_Output(1);
    setControlBackColor("ZEEKR_Panel","Main Power Output",makeRGB(255,0,0)); 
  }
  else if(OutputCnt==0)
  {
    PPS_Output(0);
    setControlBackColor("ZEEKR_Panel","Main Power Output",makeRGB(220,220,220));
  }
}

/// <a.PPS&PSRB>
On sysvar sysvar::Panel::SPPS::settingVoltage
{
  SPPS_SetVoltage(@sysvar::Panel::SPPS::settingVoltage);
}
/// <a.PPS&PSRB>
On sysvar sysvar::Panel::SPPS::settingCurrent
{
  //SPPS_SetCurrent(@sysvar::Panel::SPPS::settingCurrent);
}


/// <a.PPS&PSRB>
On sysvar sysvar::Panel::SPPS::output
{
  if(@sysvar::Panel::SPPS::output==0)
  {
    OutputOffsetCnt=!OutputOffsetCnt;
  }

  if(OutputOffsetCnt==1)
  {
    SPPS_Output(1);
    setControlBackColor("ZEEKR_Panel","Offset Power Output",makeRGB(255,0,0));
  }
  else if(OutputOffsetCnt==0)
  {
    SPPS_Output(0);
    setControlBackColor("ZEEKR_Panel","Offset Power Output",makeRGB(220,220,220));
  }
}

/// <a.PPS&PSRB>
on sysvar sysvar::Panel::PSRB::Relay1
{
  if(@this==1)
  {
    PSRB_Relay(1,PSRB_DisConnect); 
  }
  else
  {
    PSRB_Relay(1,PSRB_Connect);  
  } 
}

/// <a.PPS&PSRB>
on sysvar sysvar::Panel::PSRB::Relay2
{
  if(@this==1)
  {
    PSRB_Relay(2,PSRB_DisConnect); 
  }
  else
  {
    PSRB_Relay(2,PSRB_Connect);  
  } 
}

/// <a.PPS&PSRB>
on sysvar sysvar::Panel::PSRB::Relay3
{
  if(@this==1)
  {
    PSRB_Relay(3,PSRB_DisConnect); 
  }
  else
  {
    PSRB_Relay(3,PSRB_Connect);  
  } 
}

/// <a.PPS&PSRB>
on sysvar sysvar::Panel::PSRB::Relay4
{
  if(@this==1)
  {
    PSRB_Relay(4,PSRB_DisConnect); 
  }
  else
  {
    PSRB_Relay(4,PSRB_Connect);  
  } 
}

/// <a.PPS&PSRB>
on sysvar sysvar::Panel::PSRB::Relay5
{
  if(@this==1)
  {
    PSRB_Relay(5,PSRB_DisConnect); 
  }
  else
  {
    PSRB_Relay(5,PSRB_Connect);  
  } 
}

/// <a.PPS&PSRB>
on sysvar sysvar::Panel::PSRB::Relay6
{
  if(@this==1)
  {
    PSRB_Relay(6,PSRB_DisConnect); 
  }
  else
  {
    PSRB_Relay(6,PSRB_Connect);  
  } 
}

/// <a.PPS&PSRB>
on sysvar sysvar::Panel::PSRB::Relay7
{
  if(@this==1)
  {
    PSRB_Relay(7,PSRB_DisConnect); 
  }
  else
  {
    PSRB_Relay(7,PSRB_Connect);  
  } 
}

/// <a.PPS&PSRB>
on sysvar sysvar::Panel::PSRB::Relay8
{
  if(@this==1)
  {
    PSRB_Relay(8,PSRB_DisConnect); 
  }
  else
  {
    PSRB_Relay(8,PSRB_Connect);  
  } 
}

/// <a.PPS&PSRB>
on sysvar sysvar::Panel::PSRB::Relay9
{
  if(@this==1)
  {
    PSRB_Relay(9,PSRB_DisConnect); 
  }
  else
  {
    PSRB_Relay(9,PSRB_Connect);  
  } 
}

/// <a.PPS&PSRB>
on sysvar sysvar::Panel::PSRB::Relay10
{
  if(@this==1)
  {
    PSRB_Relay(10,PSRB_Connect); 
  }
  else
  {
    PSRB_Relay(10,PSRB_DisConnect);  
  } 
}

/// <a.PPS&PSRB>
on sysvar sysvar::Panel::PSRB::Relay11
{
  if(@this==1)
  {
    PSRB_Relay(11,PSRB_DisConnect); 
  }
  else
  {
    PSRB_Relay(11,PSRB_Connect);  
  } 
}

/// <a.PPS&PSRB>
on sysvar sysvar::Panel::PSRB::Relay12
{
  if(@this==1)
  {
    PSRB_Relay(12,PSRB_DisConnect); 
  }
  else
  {
    PSRB_Relay(12,PSRB_Connect);  
  } 
}

/// <a.PPS&PSRB>
on sysvar sysvar::Panel::PSRB::Relay_Reset
{
  if(@this==1)
  {
    PSRB_Ind_Init();
  }
}


////////////DRB1_Panel//////////////
/// <b.DRB>
on sysvar sysvar::Panel::DRB::DRB1_CH1_ECU
{
  if(@this==1)
  {
    DRB_CAN_ECU(1,DRB_Connect);
  }
  else
  {
    DRB_CAN_ECU(1,DRB_DisConnect);
  }
}

/// <b.DRB>
on sysvar sysvar::Panel::DRB::DRB1_CH2_ECU
{
  if(@this==1)
  {
    DRB_CAN_ECU(2,DRB_Connect);
  }
  else
  {
    DRB_CAN_ECU(2,DRB_DisConnect);
  }
}

/// <b.DRB>
on sysvar sysvar::Panel::DRB::DRB1_CH3_ECU
{
  if(@this==1)
  {
    DRB_CAN_ECU(3,DRB_Connect);
  }
  else
  {
    DRB_CAN_ECU(3,DRB_DisConnect);
  }
}

/// <b.DRB>
on sysvar sysvar::Panel::DRB::DRB1_CH4_ECU
{
  if(@this==1)
  {
    DRB_CAN_ECU(4,DRB_Connect);
  }
  else
  {
    DRB_CAN_ECU(4,DRB_DisConnect);
  }
}

/// <b.DRB>
on sysvar sysvar::Panel::DRB::DRB1_CH5_ECU
{
  if(@this==1)
  {
    DRB_CAN_ECU(5,DRB_Connect);
  }
  else
  {
    DRB_CAN_ECU(5,DRB_DisConnect);
  }
}

/// <b.DRB>
on sysvar sysvar::Panel::DRB::DRB1_CH6_ECU
{
  if(@this==1)
  {
    DRB_CAN_ECU(6,DRB_Connect);
  }
  else
  {
    DRB_CAN_ECU(6,DRB_DisConnect);
  }
}

/// <b.DRB>
on sysvar sysvar::Panel::DRB::DRB1_CH7_ECU
{
  if(@this==1)
  {
    DRB_CAN_ECU(7,DRB_Connect);
  }
  else
  {
    DRB_CAN_ECU(7,DRB_DisConnect);
  }
}

/// <b.DRB>
on sysvar sysvar::Panel::DRB::DRB1_CH8_ECU
{
  if(@this==1)
  {
    DRB_CAN_ECU(8,DRB_Connect);
  }
  else
  {
    DRB_CAN_ECU(8,DRB_DisConnect);
  }
}


/// <b.DRB>
on sysvar sysvar::Panel::DRB::DRB1_CH1_Tester
{
  if(@this==1)
  {
    DRB_CAN_Tester(1,DRB_Connect);
  }
  else
  {
    DRB_CAN_Tester(1,DRB_DisConnect);
  }
}

/// <b.DRB>
on sysvar sysvar::Panel::DRB::DRB1_CH2_Tester
{
  if(@this==1)
  {
    DRB_CAN_Tester(2,DRB_Connect);
  }
  else
  {
    DRB_CAN_Tester(2,DRB_DisConnect);
  }
}

/// <b.DRB>
on sysvar sysvar::Panel::DRB::DRB1_CH3_Tester
{
  if(@this==1)
  {
    DRB_CAN_Tester(3,DRB_Connect);
  }
  else
  {
    DRB_CAN_Tester(3,DRB_DisConnect);
  }
}

/// <b.DRB>
on sysvar sysvar::Panel::DRB::DRB1_CH4_Tester
{
  if(@this==1)
  {
    DRB_CAN_Tester(4,DRB_Connect);
  }
  else
  {
    DRB_CAN_Tester(4,DRB_DisConnect);
  }
}

/// <b.DRB>
on sysvar sysvar::Panel::DRB::DRB1_CH5_Tester
{
  if(@this==1)
  {
    DRB_CAN_Tester(5,DRB_Connect);
  }
  else
  {
    DRB_CAN_Tester(5,DRB_DisConnect);
  }
}

/// <b.DRB>
on sysvar sysvar::Panel::DRB::DRB1_CH6_Tester
{
  if(@this==1)
  {
    DRB_CAN_Tester(6,DRB_Connect);
  }
  else
  {
    DRB_CAN_Tester(6,DRB_DisConnect);
  }
}

/// <b.DRB>
on sysvar sysvar::Panel::DRB::DRB1_CH7_Tester
{
  if(@this==1)
  {
    DRB_CAN_Tester(7,DRB_Connect);
  }
  else
  {
    DRB_CAN_Tester(7,DRB_DisConnect);
  }
}

/// <b.DRB>
on sysvar sysvar::Panel::DRB::DRB1_CH8_Tester
{
  if(@this==1)
  {
    DRB_CAN_Tester(8,DRB_Connect);
  }
  else
  {
    DRB_CAN_Tester(8,DRB_DisConnect);
  }
}

/// <b.DRB>
on sysvar sysvar::Panel::DRB::DRB1_PCS            
{
  if(@this==1)
  {
    DRB_CAN_PCS(1,DRB_Connect);
  }
  else
  {
    DRB_CAN_PCS(1,DRB_DisConnect);
  }
}

/// <b.DRB>
on sysvar sysvar::Panel::DRB::DRB1_VH6501
{
  if(@this==1)
  {
    DRB_VH6501(1, DRB_Connect);
  }
  else
  {
    DRB_VH6501(1,DRB_DisConnect);
  }
}


/// <b.DRB>
on sysvar sysvar::Panel::DRB::DRB1_FIU
{
  if(@this==1)
  {
    //DRB_FIU(1, DRB_Connect);
  }
  else
  {
    //DRB_FIU(1,DRB_DisConnect);
  }
}

/// <b.DRB>
on sysvar sysvar::Panel::DRB::DRB1_PMM
{
  if(@this==1)
  {
    DRB_PMM(1, DRB_Connect);
  }
  else
  {
    DRB_PMM(1,DRB_DisConnect);
  }
}

/// <b.DRB>
on sysvar sysvar::Panel::DRB::DRB1_ENV
{
  if(@this==1)
  {
    DRB_CAN_ENV(1, DRB_Connect);
  }
  else
  {
    DRB_CAN_ENV(1,DRB_DisConnect);
  }
}

/// <b.DRB>
on sysvar sysvar::Panel::DRB::DRB1_Reset
{
  if(@this==1)
  {
    DRB_Reset();
    DRB1_Ind_Init();
  }
}

////////////DRB2_Panel//////////////
/// <b.DRB>
on sysvar sysvar::Panel::DRB::DRB2_CH1_ECU
{
  if(@this==1)
  {
    DRB_CAN_ECU(9,DRB_Connect);
  }
  else
  {
    DRB_CAN_ECU(9,DRB_DisConnect);
  }
}

/// <b.DRB>
on sysvar sysvar::Panel::DRB::DRB2_CH2_ECU
{
  if(@this==1)
  {
    DRB_CAN_ECU(10,DRB_Connect);
  }
  else
  {
    DRB_CAN_ECU(10,DRB_DisConnect);
  }
}

/// <b.DRB>
on sysvar sysvar::Panel::DRB::DRB2_CH3_ECU
{
  if(@this==1)
  {
    DRB_CAN_ECU(11,DRB_Connect);
  }
  else
  {
    DRB_CAN_ECU(11,DRB_DisConnect);
  }
}

/// <b.DRB>
on sysvar sysvar::Panel::DRB::DRB2_CH4_ECU
{
  if(@this==1)
  {
    DRB_CAN_ECU(12,DRB_Connect);
  }
  else
  {
    DRB_CAN_ECU(12,DRB_DisConnect);
  }
}

/// <b.DRB>
on sysvar sysvar::Panel::DRB::DRB2_CH5_ECU
{
  if(@this==1)
  {
    DRB_CAN_ECU(13,DRB_Connect);
  }
  else
  {
    DRB_CAN_ECU(13,DRB_DisConnect);
  }
}

/// <b.DRB>
on sysvar sysvar::Panel::DRB::DRB2_CH6_ECU
{
  if(@this==1)
  {
    DRB_CAN_ECU(14,DRB_Connect);
  }
  else
  {
    DRB_CAN_ECU(14,DRB_DisConnect);
  }
}

/// <b.DRB>
on sysvar sysvar::Panel::DRB::DRB2_CH7_ECU
{
  if(@this==1)
  {
    DRB_CAN_ECU(15,DRB_Connect);
  }
  else
  {
    DRB_CAN_ECU(15,DRB_DisConnect);
  }
}

/// <b.DRB>
on sysvar sysvar::Panel::DRB::DRB2_CH8_ECU
{
  if(@this==1)
  {
    DRB_CAN_ECU(16,DRB_Connect);
  }
  else
  {
    DRB_CAN_ECU(16,DRB_DisConnect);
  }
}


/// <b.DRB>
on sysvar sysvar::Panel::DRB::DRB2_CH1_Tester
{
  if(@this==1)
  {
    DRB_CAN_Tester(9,DRB_Connect);
  }
  else
  {
    DRB_CAN_Tester(9,DRB_DisConnect);
  }
}

/// <b.DRB>
on sysvar sysvar::Panel::DRB::DRB2_CH2_Tester
{
  if(@this==1)
  {
    DRB_CAN_Tester(10,DRB_Connect);
  }
  else
  {
    DRB_CAN_Tester(10,DRB_DisConnect);
  }
}

/// <b.DRB>
on sysvar sysvar::Panel::DRB::DRB2_CH3_Tester
{
  if(@this==1)
  {
    DRB_CAN_Tester(11,DRB_Connect);
  }
  else
  {
    DRB_CAN_Tester(11,DRB_DisConnect);
  }
}

/// <b.DRB>
on sysvar sysvar::Panel::DRB::DRB2_CH4_Tester
{
  if(@this==1)
  {
    DRB_CAN_Tester(12,DRB_Connect);
  }
  else
  {
    DRB_CAN_Tester(12,DRB_DisConnect);
  }
}

/// <b.DRB>
on sysvar sysvar::Panel::DRB::DRB2_CH5_Tester
{
  if(@this==1)
  {
    DRB_CAN_Tester(13,DRB_Connect);
  }
  else
  {
    DRB_CAN_Tester(13,DRB_DisConnect);
  }
}

/// <b.DRB>
on sysvar sysvar::Panel::DRB::DRB2_CH6_Tester
{
  if(@this==1)
  {
    DRB_CAN_Tester(14,DRB_Connect);
  }
  else
  {
    DRB_CAN_Tester(14,DRB_DisConnect);
  }
}

/// <b.DRB>
on sysvar sysvar::Panel::DRB::DRB2_CH7_Tester
{
  if(@this==1)
  {
    DRB_CAN_Tester(15,DRB_Connect);
  }
  else
  {
    DRB_CAN_Tester(15,DRB_DisConnect);
  }
}

/// <b.DRB>
on sysvar sysvar::Panel::DRB::DRB2_CH8_Tester
{
  if(@this==1)
  {
    DRB_CAN_Tester(16,DRB_Connect);
  }
  else
  {
    DRB_CAN_Tester(16,DRB_DisConnect);
  }
}

/// <b.DRB>
on sysvar sysvar::Panel::DRB::DRB2_PCS            
{
  if(@this==1)
  {
    DRB_CAN_PCS(9,DRB_Connect);
  }
  else
  {
    DRB_CAN_PCS(9,DRB_DisConnect);
  }
}

/// <b.DRB>
on sysvar sysvar::Panel::DRB::DRB2_VH6501
{
  if(@this==1)
  {
    DRB_VH6501(9, DRB_Connect);
  }
  else
  {
    DRB_VH6501(9,DRB_DisConnect);
  }
}


/// <b.DRB>
on sysvar sysvar::Panel::DRB::DRB2_FIU
{
  if(@this==1)
  {
    //DRB_FIU(9, DRB_Connect);
  }
  else
  {
    //DRB_FIU(9,DRB_DisConnect);
  }
}

/// <b.DRB>
on sysvar sysvar::Panel::DRB::DRB2_PMM
{
  if(@this==1)
  {
    DRB_PMM(9, DRB_Connect);
  }
  else
  {
    DRB_PMM(9,DRB_DisConnect);
  }
}

/// <b.DRB>
on sysvar sysvar::Panel::DRB::DRB2_ENV
{
  if(@this==1)
  {
    DRB_CAN_ENV(9, DRB_Connect);
  }
  else
  {
    DRB_CAN_ENV(9,DRB_DisConnect);
  }
}

/// <b.DRB>
on sysvar sysvar::Panel::DRB::DRB2_Reset
{
  if(@this==1)
  {
    DRB_Reset();
    DRB2_Ind_Init();
  }
}

////////////DRB3_Panel//////////////
/// <b.DRB>
on sysvar sysvar::Panel::DRB::DRB3_CH1_ECU
{
  if(@this==1)
  {
    DRB_FR_ECU(1,DRB_Connect);
  }
  else
  {
    DRB_FR_ECU(1,DRB_DisConnect);
  }
}

/// <b.DRB>
on sysvar sysvar::Panel::DRB::DRB3_CH2_ECU
{
  if(@this==1)
  {
    DRB_FR_ECU(2,DRB_Connect);
  }
  else
  {
    DRB_FR_ECU(2,DRB_DisConnect);
  }
}

/// <b.DRB>
on sysvar sysvar::Panel::DRB::DRB3_CH3_ECU
{
  if(@this==1)
  {
    DRB_LIN_ECU(1,DRB_Connect);
  }
  else
  {
    DRB_LIN_ECU(1,DRB_DisConnect);
  }
}

/// <b.DRB>
on sysvar sysvar::Panel::DRB::DRB3_CH4_ECU
{
  if(@this==1)
  {
    DRB_LIN_ECU(2,DRB_Connect);
  }
  else
  {
    DRB_LIN_ECU(2,DRB_DisConnect);
  }
}

/// <b.DRB>
on sysvar sysvar::Panel::DRB::DRB3_CH5_ECU
{
  if(@this==1)
  {
    DRB_LIN_ECU(3,DRB_Connect);
  }
  else
  {
    DRB_LIN_ECU(3,DRB_DisConnect);
  }
}

/// <b.DRB>
on sysvar sysvar::Panel::DRB::DRB3_CH6_ECU
{
  if(@this==1)
  {
    DRB_LIN_ECU(4,DRB_Connect);
  }
  else
  {
    DRB_LIN_ECU(4,DRB_DisConnect);
  }
}

/// <b.DRB>
on sysvar sysvar::Panel::DRB::DRB3_CH7_ECU
{
  if(@this==1)
  {
    DRB_LIN_ECU(5,DRB_Connect);
  }
  else
  {
    DRB_LIN_ECU(5,DRB_DisConnect);
  }
}


/// <b.DRB>
on sysvar sysvar::Panel::DRB::DRB3_CH1_Tester
{
  if(@this==1)
  {
    DRB_FR_Tester(1,DRB_Connect);
  }
  else
  {
    DRB_FR_Tester(1,DRB_DisConnect);
  }
}

/// <b.DRB>
on sysvar sysvar::Panel::DRB::DRB3_CH2_Tester
{
  if(@this==1)
  {
    DRB_FR_Tester(2,DRB_Connect);
  }
  else
  {
    DRB_FR_Tester(2,DRB_DisConnect);
  }
}

/// <b.DRB>
on sysvar sysvar::Panel::DRB::DRB3_CH3_Tester
{
  if(@this==1)
  {
    DRB_LIN_Tester(1,DRB_Connect);
  }
  else
  {
    DRB_LIN_Tester(1,DRB_DisConnect);
  }
}

/// <b.DRB>
on sysvar sysvar::Panel::DRB::DRB3_CH4_Tester
{
  if(@this==1)
  {
    DRB_LIN_Tester(2,DRB_Connect);
  }
  else
  {
    DRB_LIN_Tester(2,DRB_DisConnect);
  }
}

/// <b.DRB>
on sysvar sysvar::Panel::DRB::DRB3_CH5_Tester
{
  if(@this==1)
  {
    DRB_LIN_Tester(3,DRB_Connect);
  }
  else
  {
    DRB_LIN_Tester(3,DRB_DisConnect);
  }
}

/// <b.DRB>
on sysvar sysvar::Panel::DRB::DRB3_CH6_Tester
{
  if(@this==1)
  {
    DRB_LIN_Tester(4,DRB_Connect);
  }
  else
  {
    DRB_LIN_Tester(4,DRB_DisConnect);
  }
}

/// <b.DRB>
on sysvar sysvar::Panel::DRB::DRB3_CH7_Tester
{
  if(@this==1)
  {
    DRB_LIN_Tester(5,DRB_Connect);
  }
  else
  {
    DRB_LIN_Tester(5,DRB_DisConnect);
  }
}

/// <b.DRB>
on sysvar sysvar::Panel::DRB::DRB3_PCS            
{
  if(@this==1)
  {
    DRB_LIN_PCS(1,DRB_Connect);
  }
  else
  {
    DRB_LIN_PCS(1,DRB_DisConnect);
  }
}

/// <b.DRB>
on sysvar sysvar::Panel::DRB::DRB3_ENV
{
  if(@this==1)
  {
    DRB_LIN_ENV(1, DRB_Connect);
  }
  else
  {
    DRB_LIN_ENV(1,DRB_DisConnect);
  }
}

/// <b.DRB>
on sysvar sysvar::Panel::DRB::DRB3_Reset
{
  if(@this==1)
  {
    DRB_Reset();
    DRB3_Ind_Init();
  }
}

/// <c.ENV>
on sysvar sysvar::Panel::ENV::Env_Set
{
  if(@this==1)
  {
    testsupplyTextEvent("ENV_Set_Env");
  }
}

/// <c.ENV>
On sysvar sysvar::Panel::ENV::CANH2BAT
{
  if(@this==1)
  {
    ENV_CanBusFaultSet(0);
  }
  
}


/// <c.ENV>
on sysvar sysvar::Panel::ENV::CANH2GND
{
  if(@this==1)
  {
    ENV_CanBusFaultSet(1);
  }
}
/// <c.ENV>
on sysvar sysvar::Panel::ENV::CANL2BAT
{
  if(@this==1)
  {
    ENV_CanBusFaultSet(2);
  }
  
}

/// <c.ENV>
on sysvar sysvar::Panel::ENV::CANL2GND
{
  if(@this==1)
  {
    ENV_CanBusFaultSet(3);
  }
  
}

/// <c.ENV>
On sysvar sysvar::Panel::ENV::CANH2CANL
{
  if(@this==1)
  {
    ENV_CanBusFaultSet(4);
  }
}

/// <c.ENV>
on sysvar sysvar::Panel::ENV::CANHBreak
{
  if(@this==1)
  {
    ENV_CanBusFaultSet(5);
  }
}
/// <c.ENV>
on sysvar sysvar::Panel::ENV::CANLBreak
{
  if(@this==1)
  {
    ENV_CanBusFaultSet(6);
  }
}

/// <c.ENV>
on sysvar sysvar::Panel::ENV::CANOUT
{
  if(@this==1)
  {
    ENV_CanBusFaultSet(7);
  }
}

/// <c.ENV>
on sysvar sysvar::Panel::ENV::Reset
{
  if(@this==1)
  {
    @sysvar::Panel::ENV::R_Circuit=0;
    @sysvar::Panel::ENV::R_CANH_CANL=0;
    @sysvar::Panel::ENV::C1=0;
    @sysvar::Panel::ENV::C2=0;
    @sysvar::Panel::ENV::C3=0;
    @sysvar::Panel::ENV::CANOUT=0;
    ENV_Reset();
  }
}


//////////**********VH6501***********
/// <d.VH6501>
On sysvar sysvar::Panel::VH6501::CANHShortToCANL
{
  if(@this==1)
  {
    VH6501_CANBusFaultSet(CANH_ShortTo_CANL);
  }  
  else
  {
    VH6501_Reset();
  }
}

/// <d.VH6501>
On sysvar sysvar::Panel::VH6501::CANHShortToBat
{
  if(@this==1)
  {
    VH6501_CANBusFaultSet(CANH_BAT);
  }
  else
  {
    VH6501_Reset();
  }
}

/// <d.VH6501>
On sysvar sysvar::Panel::VH6501::CANHShortToGND
{
  if(@this==1)
  {
    VH6501_CANBusFaultSet(CANH_GND);
  }
  else
  {
    VH6501_Reset();
  }
}

/// <d.VH6501>
On sysvar sysvar::Panel::VH6501::CANLShortToBat
{
  if(@this==1)
  {
    VH6501_CANBusFaultSet(CANL_BAT);
  }
  else
  {
    VH6501_Reset();
  }
}

/// <d.VH6501>
On sysvar sysvar::Panel::VH6501::CANLShortToGND
{
  if(@this==1)
  {
    VH6501_CANBusFaultSet(CANL_GND);
  }
  else
  {
    VH6501_Reset();
  }
}

/// <d.VH6501>
On sysvar sysvar::Panel::VH6501::Reset
{
  if(@this==1)
  {
    resetCan();
    VH6501_Reset();
    VH6501_Ind_Init();
  }
}


//
///// <e.BOB>
//on sysvar sysvar::BOB::CMD
//{
//  if(@this==1)
//  {
//    int flag;
//    dword BOB_ID;
//    dword BOBID;
//    long BOB_ID1;
//    long BOB_ID2;
//    long BOB_ID3;
//    long BOB_ID4;
//    char CAN1_Cmd_Array[10]="";
//    byte CAN1_Cmd;
//    
//    char CAN2_Cmd_Array[10]="";
//    byte CAN2_Cmd;
//    
//    char LIN_Cmd_Array[10]="";
//    byte LIN_Cmd;
//    
//    char BN_GND_Cmd_Array[10]="";
//    byte BN_GND_Cmd;
//    //CAN1
//    CAN1_Cmd=@sysvar::BOB::CAN1H_OPEN+
//      (@sysvar::BOB::CAN1L_OPEN<<1)+
//      (@sysvar::BOB::CAN1H_BAT<<2)+
//      (@sysvar::BOB::CAN1L_BAT<<3)+
//      (@sysvar::BOB::CAN1H_GND<<4)+
//      (@sysvar::BOB::CAN1L_GND<<5)+
//      (@sysvar::BOB::CAN1H_CAN1L<<6);
//    //CAN2
//    CAN2_Cmd=@sysvar::BOB::CAN2H_OPEN+
//      (@sysvar::BOB::CAN2L_OPEN<<1)+
//      (@sysvar::BOB::CAN2H_BAT<<2)+
//      (@sysvar::BOB::CAN2L_BAT<<3)+
//      (@sysvar::BOB::CAN2H_GND<<4)+
//      (@sysvar::BOB::CAN2L_GND<<5)+
//      (@sysvar::BOB::CAN2H_CAN2L<<6);
//    //LIN
//    LIN_Cmd=@sysvar::BOB::LIN1_OPEN+
//      (@sysvar::BOB::LIN1_BAT<<1)+
//      (@sysvar::BOB::LIN1_GND<<2);
//    //BN+GND
//    BN_GND_Cmd=@sysvar::BOB::BN0_OPEN+
//      (@sysvar::BOB::BN1_OPEN<<2)+
//      (@sysvar::BOB::BN2_OPEN<<1)+
//      (@sysvar::BOB::BN3_OPEN<<5)+
//      (@sysvar::BOB::ECU_GND_OPEN<<4)+
//      (@sysvar::BOB::OFFSET_GND_EN<<3);
//    
//    if(((CAN1_Cmd&0x04)==0x04)&&((CAN1_Cmd&0x10)==0x10))
//    {
//      testWaitForTesterConfirmation("Warning: Battery short to GND");
//      return;
//    }
//    if(((CAN1_Cmd&0x08)==0x08)&&((CAN1_Cmd&0x20)==0x20))
//    {
//      testWaitForTesterConfirmation("Warning: Battery short to GND");
//      return;
//    }
//    if(((CAN1_Cmd&0x04)==0x04)&&((CAN1_Cmd&0x20)==0x20)&&((CAN1_Cmd&0x40)==0x40))
//    {
//      testWaitForTesterConfirmation("Warning: Battery short to GND");
//      return;
//    }
//    if(((CAN1_Cmd&0x10)==0x10)&&((CAN1_Cmd&0x08)==0x08)&&((CAN1_Cmd&0x40)==0x40))
//    {
//      testWaitForTesterConfirmation("Warning: Battery short to GND");
//      return;
//    }
//    
//    if(((CAN2_Cmd&0x04)==0x04)&&((CAN2_Cmd&0x10)==0x10))
//    {
//      testWaitForTesterConfirmation("Warning: Battery short to GND");
//      return;
//    }
//    if(((CAN2_Cmd&0x08)==0x08)&&((CAN2_Cmd&0x20)==0x20))
//    {
//      testWaitForTesterConfirmation("Warning: Battery short to GND");
//      return;
//    }
//    if(((CAN2_Cmd&0x04)==0x04)&&((CAN2_Cmd&0x20)==0x20)&&((CAN2_Cmd&0x40)==0x40))
//    {
//      testWaitForTesterConfirmation("Warning: Battery short to GND");
//      return;
//    }
//    if(((CAN2_Cmd&0x10)==0x10)&&((CAN2_Cmd&0x08)==0x08)&&((CAN2_Cmd&0x40)==0x40))
//    {
//      testWaitForTesterConfirmation("Warning: Battery short to GND");
//      return;
//    }
//    
//    if(((LIN_Cmd&0x02)==0x02)&&((LIN_Cmd&0x04)==0x04))
//    {
//      testWaitForTesterConfirmation("Warning: Battery short to GND");
//      return;
//    }
//    //CAN1 
//  BOB_ID = @sysvar::BOB::eculist;
//
//  CAN1_DATA[0] =0x08;
//  CAN1_DATA[1] =0x00;
//  CAN1_DATA[2] =0x00;
//  CAN1_DATA[3] =(BOB_ID>>8);
//  CAN1_DATA[4] =BOB_ID;
//  CAN1_DATA[8] =0x00;
//  CAN1_DATA[9] =0x00;
//  CAN1_DATA[10] =0x00;
//  CAN1_DATA[11] =0x00;
//  CAN1_DATA[12] =0x00;
//
//  CAN1_DATA[5] = 0x01;
//  CAN1_DATA[6] = CAN1_Cmd;
//  CAN1_DATA[7] = 0xff; 
//  setTimer(T_CAN1_CMD,50); 
////CAN2
// 
//  CAN2_DATA[0] =0x08;
//  CAN2_DATA[1] =0x00;
//  CAN2_DATA[2] =0x00;
//  CAN2_DATA[3] =(byte)(BOB_ID>>8);
//  CAN2_DATA[4] =(byte)BOB_ID;
//  CAN2_DATA[8] =0x00;
//  CAN2_DATA[9] =0x00;
//  CAN2_DATA[10] =0x00;
//  CAN2_DATA[11] =0x00;
//  CAN2_DATA[12] =0x00; 
//  CAN2_DATA[5] = 0x02;
//  CAN2_DATA[6] = CAN2_Cmd;
//  CAN2_DATA[7] = 0xff;
//  setTimer(T_CAN2_CMD,200); 
// //LIN
//
//  LIN_DATA[0] =0x08;
//  LIN_DATA[1] =0x00;
//  LIN_DATA[2] =0x00;
//  LIN_DATA[3] =(byte)(BOB_ID>>8);
//  LIN_DATA[4] =(byte)BOB_ID;
//  LIN_DATA[8] =0x00;
//  LIN_DATA[9] =0x00;
//  LIN_DATA[10] =0x00;
//  LIN_DATA[11] =0x00;
//  LIN_DATA[12] =0x00;
//  LIN_DATA[5] = 0x03;
//  LIN_DATA[6] = LIN_Cmd;
//  LIN_DATA[7] = 0xff;
//   
//  setTimer(T_LIN_CMD,400);  
//  //BN
//
//  BN_DATA[0] =0x08;
//  BN_DATA[1] =0x00;
//  BN_DATA[2] =0x00;
//  BN_DATA[3] =(byte)(BOB_ID>>8);
//  BN_DATA[4] =(byte)BOB_ID;
//  BN_DATA[8] =0x00;
//  BN_DATA[9] =0x00;
//  BN_DATA[10] =0x00;
//  BN_DATA[11] =0x00;
//  BN_DATA[12] =0x00;
//  BN_DATA[5] = 0x04;
//  BN_DATA[6] = BN_GND_Cmd;
//  BN_DATA[7] = 0xff;
//  setTimer(T_BN_GND_CMD,600);
//  }
//}

/// <f.PMM>
On sysvar sysvar::Panel::PMM::RES_MEAS
{
  if(@this==1)
  {
    testSupplyTextEvent("PMM_RESistance_Data_Recv");
  }
  
}

/////////////////////CTR/////////////////////////////////////////////
void Update_Op(long index)
{
  switch(index)
  {
    case 1:
      //Set_Env();
      break;
    case 2:
      //PMM_RESistance_Data_Recv();
      break;
    default:break;
  }
}

void Panel_Cmd()
{
   long index = 0;
    testJoinTextEvent("ENV_Set_Env"); //1
    testJoinTextEvent("PMM_RESistance_Data_Recv");//2
    index = testWaitForAnyJoinedEvent(1000000);
    Update_Op(index );
}