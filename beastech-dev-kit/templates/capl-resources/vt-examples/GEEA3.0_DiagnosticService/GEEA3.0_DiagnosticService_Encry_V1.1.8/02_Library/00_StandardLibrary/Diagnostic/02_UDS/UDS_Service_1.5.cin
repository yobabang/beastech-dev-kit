/*@!Encoding:936*/
/*----------------------------------------------------------------------------
|  File Name: UDS_Service.cin
|  Comment:   Main functions for UDS services in ISO14229-1:2013
|-----------------------------------------------------------------------------
|               A U T H O R   I D E N T I T Y
|-----------------------------------------------------------------------------
| Initials           Name                           Company
| --------   -------------------     -----------------------------------------
| LJY              LiJingyao         Polelink Information Technology Co., Ltd.
| SDY              SunDayong         Polelink Information Technology Co., Ltd.
| ZH               ZhangHeng         Polelink Information Technology Co., Ltd.
| WRN              WuRuonan          Polelink Information Technology Co., Ltd.
| TP               TaoPeng           Polelink Information Technology Co., Ltd.
|-----------------------------------------------------------------------------
|               R E V I S I O N   H I S T O R Y
|-----------------------------------------------------------------------------
| Date         Ver  Author            Description
| ----------   ---  ------            ----------------------------------------
| 20190621     1.0  LJY               Creation
|1.Create first edition;
| 20190924     1.1  LJY               Fix some bugs
|1.Change the number of byte of the SID31_RoutineControl_EraseMemory request;
|2.Change the method to get addressAndLengthFormatIdentifier;
| 20200220     1.2  LJY
|1.Change the naming rule of the variables and functions to adapt to the standardized requirement of Polelink
|2.Change the function 'SID27_SecurityAccess_SendKey' , add a function to contain the arithmetic of calculating the key.
|3.Change the return value of check response functions from void to int;
|4.Add subfunction check in service 0x28;
|5.Change the way to get seed and send key for service 0x27, creat a new function in UDS_Functions.cin to get the key from the seed;
|6.Delete test step pass in the report description;
|7.Add a new overload to the function TPSendRawMessage(byte RawData[],int lenth,enum AddressMode Mode);
|8.Add a new overload to the function SID11_ECUReset(int Subfunction,enum e_SPRMIB Supress,enum AddressMode Mode)
|9.Change the input datatype of the function CheckPosResponse_SID11(int Subfunction,int reqGroup,int reqNum);
|20200707       1.3  LJY
|1.Change the parameter of gAvaliableMask to AvaliableMask in function :CheckPosResponse_SID19_01
|2.Delete DTC and DID related varibles
|20200808       1.4  LJY
|1.对函数参数值，返回值进行统一
|2.添加中文/英文切换功能，对输出至报告的内容进行语言切换
|3.将等待响应的函数从发送请求的函数中调整到检查响应的函数内
|20200908       1.5  TP
|1.Change the function enum e_InputOutputControlParameter {ReturnControlToECU=0x00,ResetToDefault=0x01,FreezeCurrentState=0x02,ShortTermAdjustment=0x03};
|2.Add two function void SID2F_IOControl(byte PID[],enum e_InputOutputControlParameter IOParameter,int Length) and void CheckPosResponse_SID2F(byte inputOutputControlParameter,byte PID[],int Length)
|3.Change the function: int CheckPosResponse_SID31(enum e_RoutineControlType RoutineType,byte RoutineIdentifier[],byte RoutineControlOptionRecord[],int ResponseLength,int reqGroup,int reqNum)
|20201012       1.6  LJY
|1.Change the pring lenth of service 0x27
|20211229       1.7  LJY
|1.Change input data type from int to dword for function: UDS_ParametersSet
|2.Fix some errors
|-----------------------------------------------------------------------------
|               C O P Y R I G H T
|-----------------------------------------------------------------------------
| Copyright (c) 2010 - 2020 by Polelink Information Technology Co., Ltd.
| All rights reserved.
-----------------------------------------------------------------------------*/

includes
{

}

variables
{
	/*
	*函数返回值说明
	1.请求发送函数：无返回值
	2.响应检查函数：int类型返回值
	函数执行成功 = 2
	函数执行失败，低风险 = 1
	函数执行失败，高风险 = -1

	*报告输出说明
	1.对于不做判断的打印内容，可通过参数gUDS_DescriptionExistFlag进行判断是否打印
	2.对于判断为Fail的打印内容，不可配置，必须打印在报告中
	3.对于判断为Pass的打印内容，可通过参数gUDS_DescriptionExistFlag进行判断是否打印
	4.打印时，统一使用“UDS”作为本文件输出的描述
	*/

	//文件输出设置参数
	int gUDS_DescriptionExistFlag = 1;
	int gUDS_LanguageSet = 0;//English = 0;Chinese = 1
	//文件输出设置参数

	//TimingParameters
//	int gUDS_P2Client = 150;
	int gUDS_P2ClientDelay = 5000;
	int gUDS_P6Client = 1000;
	int gUDS_P6ClientDelay = 5000;

	int gUDS_S3Client = 2000;
	int gUDS_S3Server = 5000;
	//TimingParameters

	int gRss;//用以表示收到响应的类型（肯定响应/否定响应/无响应)
	//enum AddressMode {physical,functional};
	enum e_SPRMIB {SPRMIB_TRUE=0x01,SPRMIB_FALSE=0x00};//用以区分肯定响应抑制位是否悬置
	//Service0x10
	enum e_DiagSession {DEFAULTSESSION=0x01,PROGRAMMINGSESSION=0x02,EXTENDEDSESSION=0x03,SAFETYSESSION=0x04,OTASESSION=0x40};//用以切换会话模式
	//Service0x11
	enum e_ResetType {HARDRESET=0x01,SOFTRESET=0x03};//用以区分复位类型
	//int gUnlockflag;
	//Service0x28
	enum e_CommunicationType {NormalCommunicationMessage=0x01,NetworkManagementMessage=0x02,NCMAndNMM=0x03};//用以区分报文类型
	//Service0x2A
	enum e_TransmissionMode {SendAtSlowRate=0x01,SendAtMediumRate=0x02,SendAtFastRate=0x03,StopSending=0x04};

	//Service0x2F
	enum e_InputOutputControlParameter {ReturnControlToECU=0x00,ResetToDefault=0x01,FreezeCurrentState=0x02,ShortTermAdjustment = 0x03};
	//Service0x31
	//enum e_RoutineStatusRecord {CorrectResult=0x00,IncerectResult=0x01};
	enum e_RoutineControlType {StartRoutine=0x01,StopRoutine=0x02,RequestRoutineResult=0x03};
	//Service0x3E

	//Service0x34
	dword gMaxNumberOfBlockLenth;
	//Service0x36
	int gCounter;
	//Service0x37
	int gTransferResponseParameterRecord;
}


void SetUDSDescriptionInReport(int ExistFlag)
{
	gUDS_DescriptionExistFlag = ExistFlag;
	if(gUDS_LanguageSet == 0)
	{
		if(ExistFlag == 1)
		{
			testStep("UDS","Open the description in test report");
		}
		else
		{
			testStep("UDS","Close the description in test report");
		}
	}
	else
	{
		if(ExistFlag == 1)
		{
			testStep("UDS","打开报告描述添加功能");
		}
		else
		{
			testStep("UDS","关闭报告描述添加功能");
		}
	}
}

void SetUDSLanguageInReport(int LanguageFlag)
{
	gUDS_LanguageSet = LanguageFlag;
	if(gUDS_LanguageSet == 0)
	{
		testStep("UDS","Set the report language to English");
	}
	else
	{
		testStep("UDS","设置报告语言为中文");
	}
}

void UDS_ParametersSet(dword P2C_APP,dword P2C_BOOT,dword P2CD,dword P6C,dword P6CD,dword S3C,dword S3S)
{
//	gUDS_P2Client = P2C;
	gUDS_P2ClientDelay = P2CD;
	gUDS_P6Client = P6C;
	gUDS_P6ClientDelay = P6CD;
	gUDS_S3Client = S3C;
	gUDS_S3Server = S3S;
	if(gUDS_DescriptionExistFlag == 1)
	{
		if(gUDS_LanguageSet == 0)
		{
//			testStep("UDS","Parameters configuration:\n  P2Client_APP is %dms\n P2Client_BOOT is %dms\n  P2*Client is %dms\n P4Client is %dms\n   P6Client is %dms\n   S3Client is %dms",gP2Client_APP,gP2Client_BOOT,gP2StarClient,gP4Client,gUDS_P6Client,gUDS_S3Client);
		}
		else
		{
//			testStep("UDS","参数设置:\n  P2Client_APP is %dms\n P2Client_BOOT is %dms\n  P2*Client = %dms\n  P4Client = %dms\n  P6Client = %dms\n S3Client = %dms ",gP2Client_APP,gP2Client_BOOT,gP2StarClient,gP4Client,gUDS_P6Client,gUDS_S3Client);
		}
	}
}



void SID10_DiagnosticSessionControl(int Subfunction,enum AddressMode Mode,enum e_SPRMIB Response)
{
	byte SID10[2];
	SID10[0]=0x10;
	if(Response==0)
		SID10[1]=Subfunction;
	else
		SID10[1]=Subfunction+0x80;

	TP_Send(SID10,Mode);
	if(gUDS_DescriptionExistFlag == 1)
	{
		if(gUDS_LanguageSet == 0)
		{
			PrintPID("UDS","Send Request",SID10,elCount(SID10));
		}
		else
		{
			PrintPID("UDS","发送请求",SID10,elCount(SID10));
		}
	}
}

int CheckPosResponse_SID10(byte Subfunction,int reqGroup,int reqNum)
{
	if((gBusFlag == 1)||(gBusFlag == 2)||(gBusFlag == 3)||(gBusFlag == 4)||(gBusFlag == 5))
  {
    if(SessionFlag==APP)
    {
      gRss=ECU_Response(gP2Client_APP,0x10);
    }
    else if(SessionFlag==BOOT)
    {
      gRss=ECU_Response(gP2Client_BOOT,0x10);
    }
    else
    {
       gRss=ECU_Response(gP2Client_APP,0x10);
    }
  }

	if(gRss!=POS)
	{
		if(gRss==TIMEOUT)
		{
			if(gUDS_LanguageSet == 0)
			{
				snprintf(gDiagResultDescription,4000,"Timeout no response recived when request service0x10");
			}
			else
			{
				snprintf(gDiagResultDescription,4000,"请求超时，控制器对10服务未回复响应");
			}
			Diag_SetReqCheckResult(reqGroup,reqNum,RESULT_FAIL,gDiagResultDescription,"UDS");
			return 1;
		}
		else
		{
			if(gUDS_LanguageSet == 0)
			{
				snprintf(gDiagResultDescription,4000,"ECU gives negative response 0x%02x to the request of service 0x10",gTpRxData[2]);
			}
			else
			{
				snprintf(gDiagResultDescription,4000,"ECU对10服务回复了负响应0x%02x",gTpRxData[2]);
			}
			Diag_SetReqCheckResult(reqGroup,reqNum,RESULT_FAIL,gDiagResultDescription,"UDS");
			return -1;
		}
	}

	if(gTpRxData[0]!=0x50)
	{
		if(gUDS_LanguageSet == 0)
		{
			snprintf(gDiagResultDescription,4000,"ECU gives unexpect positive response service ID 0x%02x to the request of service 0x10",gTpRxData[0]);
		}
		else
		{
			snprintf(gDiagResultDescription,4000,"ECU对10服务回复了非预期的肯定响应0x%02x",gTpRxData[0]);
		}
		Diag_SetReqCheckResult(reqGroup,reqNum,RESULT_FAIL,gDiagResultDescription,"UDS");
		return -1;
	}
	else if(gTpRxData[1]!=Subfunction)
	{
		if(gUDS_LanguageSet == 0)
		{
			snprintf(gDiagResultDescription,4000,"ECU gives unexpect subfunction 0x%02x to the request of service 0x10",gTpRxData[1]);
		}
		else
		{
			snprintf(gDiagResultDescription,4000,"ECU对10服务回复了非预期的子功能0x%02x",gTpRxData[1]);
		}
		Diag_SetReqCheckResult(reqGroup,reqNum,RESULT_FAIL,gDiagResultDescription,"UDS");
		return 1;
	}
	else if(gTpRxLength!=0x06)
	{
		if(gUDS_LanguageSet == 0)
		{
			snprintf(gDiagResultDescription,4000,"ECU response lenth is wrong to the request of service 0x10");
		}
		else
		{
			snprintf(gDiagResultDescription,4000,"ECU对10服务回复了错误的长度");
		}
		Diag_SetReqCheckResult(reqGroup,reqNum,RESULT_FAIL,gDiagResultDescription,"UDS");
		return 1;
	}
	else
	{
		if(gUDS_DescriptionExistFlag == 1)
		{
			if(gUDS_LanguageSet == 0)
			{
				PrintPID("UDS","Pos.Response",gTpRxData,gTpRxLength);
			}
			else
			{
				PrintPID("UDS","肯定响应",gTpRxData,gTpRxLength);
			}
		}
		return 2;
	}
}


int CheckPosResponse_SID10(byte Subfunction,int P2Server,int P2ServerDelay,int reqGroup,int reqNum)
{
	if((gBusFlag == 1)||(gBusFlag == 2)||(gBusFlag == 3)||(gBusFlag == 4)||(gBusFlag == 5))
  {
    if(SessionFlag==APP)
    {
      gRss=ECU_Response(gP2Client_APP,0x10);
    }
    else if(SessionFlag==BOOT)
    {
      gRss=ECU_Response(gP2Client_BOOT,0x10);
    }
    else
    {
       gRss=ECU_Response(gP2Client_APP,0x10);
    }
  }

	if(gRss!=POS)
	{
		if(gRss==TIMEOUT)
		{
			if(gUDS_LanguageSet == 0)
			{
				snprintf(gDiagResultDescription,4000,"Timeout no response recived when request service 0x10");
			}
			else
			{
				snprintf(gDiagResultDescription,4000,"请求超时，控制器对10服务未回复响应");
			}
			Diag_SetReqCheckResult(reqGroup,reqNum,RESULT_FAIL,gDiagResultDescription,"UDS");
			return 1;
		}
		else
		{
			if(gUDS_LanguageSet == 0)
			{
				snprintf(gDiagResultDescription,4000,"ECU gives negative response 0x%02x to the request of service 0x10",gTpRxData[2]);
			}
			else
			{
				snprintf(gDiagResultDescription,4000,"ECU对10服务回复了负响应0x%02x",gTpRxData[2]);
			}
			Diag_SetReqCheckResult(reqGroup,reqNum,RESULT_FAIL,gDiagResultDescription,"UDS");
			return -1;
		}
	}

	if(gTpRxData[0]!=0x50)
	{
		if(gUDS_LanguageSet == 0)
		{
			snprintf(gDiagResultDescription,4000,"ECU gives unexpect positive response service ID 0x%02x to the request of service 0x10",gTpRxData[0]);
		}
		else
		{
			snprintf(gDiagResultDescription,4000,"ECU对10服务回复了非预期的肯定响应0x%02x",gTpRxData[0]);
		}
		if(gUDS_LanguageSet == 0)
		{
			PrintPID("UDS","Pos.Response",gTpRxData,gTpRxLength);
		}
		else
		{
			PrintPID("UDS","肯定响应",gTpRxData,gTpRxLength);
		}
		Diag_SetReqCheckResult(reqGroup,reqNum,RESULT_FAIL,gDiagResultDescription,"UDS");
		return -1;
	}
	else if(gTpRxData[1]!=Subfunction)
	{
		if(gUDS_LanguageSet == 0)
		{
			snprintf(gDiagResultDescription,4000,"ECU gives unexpect subfunction 0x%02x to the request of service 0x10",gTpRxData[1]);
		}
		else
		{
			snprintf(gDiagResultDescription,4000,"ECU对10服务回复了非预期的子功能0x%02x",gTpRxData[1]);
		}
		Diag_SetReqCheckResult(reqGroup,reqNum,RESULT_FAIL,gDiagResultDescription,"UDS");
		return 1;
	}
	else if(gTpRxLength!=0x06)
	{
		if(gUDS_LanguageSet == 0)
		{
			snprintf(gDiagResultDescription,4000,"ECU response lenth is wrong to the request of service 0x10");
		}
		else
		{
			snprintf(gDiagResultDescription,4000,"ECU对10服务回复了错误的长度");
		}
		if(gUDS_LanguageSet == 0)
		{
			PrintPID("UDS","Pos.Response",gTpRxData,gTpRxLength);
		}
		else
		{
			PrintPID("UDS","肯定响应",gTpRxData,gTpRxLength);
		}
		Diag_SetReqCheckResult(reqGroup,reqNum,RESULT_FAIL,gDiagResultDescription,"UDS");
		return 1;
	}
	else if((((gTpRxData[2]<<8)|gTpRxData[3])!=P2Server)||(((gTpRxData[4]<<8)|gTpRxData[5])!=P2ServerDelay))
	{
		if(((gTpRxData[2]<<8)|gTpRxData[3])!=P2Server)
		{
			if(gUDS_LanguageSet == 0)
			{
				snprintf(gDiagResultDescription,4000,"ECU response parameter P2 is wrong to the request of service 0x10 , expect value is %d",P2Server);
			}
			else
			{
				snprintf(gDiagResultDescription,4000,"ECU对10服务响应的参数P2与期望值不一致，期望值为%dms",P2Server);
			}
		}
		if(((gTpRxData[4]<<8)|gTpRxData[5])!=P2ServerDelay)
		{
			if(gUDS_LanguageSet == 0)
			{
				snprintf(gDiagResultDescription,4000,"ECU response parameter P2* is wrong to the request of service 0x10 , expect value is %d",P2ServerDelay);
			}
			else
			{
				snprintf(gDiagResultDescription,4000,"ECU对10服务响应的参数P2*与期望值不一致，期望值为%dms",P2ServerDelay*10);
			}
		}
		if(gUDS_LanguageSet == 0)
		{
			PrintPID("UDS","Pos.Response",gTpRxData,gTpRxLength);
		}
		else
		{
			PrintPID("UDS","肯定响应",gTpRxData,gTpRxLength);
		}
    Diag_SetReqCheckResult(reqGroup,reqNum,RESULT_FAIL,gDiagResultDescription,"UDS");
		return 1;
	}
	else
	{
		if(gUDS_DescriptionExistFlag == 1)
		{
			if(gUDS_LanguageSet == 0)
			{
				PrintPID("UDS","Pos.Response",gTpRxData,gTpRxLength);
			}
			else
			{
				PrintPID("UDS","肯定响应",gTpRxData,gTpRxLength);
			}
		}
		return 2;
	}
}

void SID11_ECUReset(int Subfunction,enum AddressMode Mode,enum e_SPRMIB Supress)
{
	byte SID11[2];
	SID11[0]=0x11;
	if(Supress==0)
		SID11[1]=Subfunction;
	else
		SID11[1]=Subfunction+0x80;

	TP_Send(SID11,Mode);
	if(gUDS_DescriptionExistFlag == 1)
	{
		if(gUDS_LanguageSet == 0)
		{
			PrintPID("UDS","Send Request",SID11,elCount(SID11));
		}
		else
		{
			PrintPID("UDS","发送请求",SID11,elCount(SID11));
		}
	}
}

int CheckPosResponse_SID11(int Subfunction,int reqGroup,int reqNum)
{
	if((gBusFlag == 1)||(gBusFlag == 2)||(gBusFlag == 3)||(gBusFlag == 4)||(gBusFlag == 5))
  {
    if(SessionFlag==APP)
    {
      gRss=ECU_Response(gP2Client_APP,0x11);
    }
    else if(SessionFlag==BOOT)
    {
      gRss=ECU_Response(gP2Client_BOOT,0x11);
    }
    else
    {
       gRss=ECU_Response(gP2Client_APP,0x11);
    }
  }

	if(gRss!=POS)
	{
		if(gRss==TIMEOUT)
		{
			if(gUDS_LanguageSet == 0)
			{
				snprintf(gDiagResultDescription,4000,"Timeout no response recived when request service0x11");
			}
			else
			{
				snprintf(gDiagResultDescription,4000,"请求超时，控制器对11服务未回复响应");
			}
			Diag_SetReqCheckResult(reqGroup,2,RESULT_FAIL,gDiagResultDescription);
			return 0;
		}
		else
		{
			if(gUDS_LanguageSet == 0)
			{
				snprintf(gDiagResultDescription,4000,"ECU gives negative response 0x%02x to the request of service 0x11",gTpRxData[2]);
			}
			else
			{
				snprintf(gDiagResultDescription,4000,"ECU对11服务回复了负响应0x%02x",gTpRxData[2]);
			}
			Diag_SetReqCheckResult(reqGroup,reqNum,RESULT_FAIL,gDiagResultDescription);
			return -1;
		}
	}
	if(gTpRxData[0]!=0x51)
	{
		if(gUDS_LanguageSet == 0)
		{
			snprintf(gDiagResultDescription,4000,"ECU gives unexpect positive response service ID 0x%02x to the request of service 0x11",gTpRxData[0]);
		}
		else
		{
			snprintf(gDiagResultDescription,4000,"ECU对11服务回复了非预期的肯定响应0x%02x",gTpRxData[0]);
		}
		Diag_SetReqCheckResult(reqGroup,reqNum,RESULT_FAIL,gDiagResultDescription);
		return 1;
	}
	if(gTpRxData[1]!=Subfunction)
	{
		if(gUDS_LanguageSet == 0)
		{
			snprintf(gDiagResultDescription,4000,"ECU gives unexpect subfunction 0x%02x to the request of service 0x11",gTpRxData[1]);
		}
		else
		{
			snprintf(gDiagResultDescription,4000,"ECU对11服务回复了非预期的子功能0x%02x",gTpRxData[1]);
		}
		Diag_SetReqCheckResult(reqGroup,reqNum,RESULT_FAIL,gDiagResultDescription);
		return 1;
	}
	if(0x02!=gTpRxLength)
	{
		if(gUDS_LanguageSet == 0)
		{
			snprintf(gDiagResultDescription,4000,"ECU response lenth is wrong to the request of service 0x11");
		}
		else
		{
			snprintf(gDiagResultDescription,4000,"ECU对11服务回复了错误的长度");
		}
		Diag_SetReqCheckResult(reqGroup,reqNum,RESULT_FAIL,gDiagResultDescription);
		return 1;
	}
	else
	{
		if(gUDS_DescriptionExistFlag == 1)
		{
			if(gUDS_LanguageSet == 0)
			{
				PrintPID("UDS","Pos.Response",gTpRxData,gTpRxLength);
			}
			else
			{
				PrintPID("UDS","肯定响应",gTpRxData,gTpRxLength);
			}
		}
		return 2;
	}
}

int CheckPosResponse_SID11(byte Subfunction,int powerDownTime,int reqGroup,int reqNum)
{
	if((gBusFlag == 1)||(gBusFlag == 2)||(gBusFlag == 3)||(gBusFlag == 4)||(gBusFlag == 5))
  {
    if(SessionFlag==APP)
    {
      gRss=ECU_Response(gP2Client_APP,0x11);
    }
    else if(SessionFlag==BOOT)
    {
      gRss=ECU_Response(gP2Client_BOOT,0x11);
    }
    else
    {
       gRss=ECU_Response(gP2Client_APP,0x11);
    }
  }

	if(gRss!=POS)
	{
		if(gRss==TIMEOUT)
		{
			if(gUDS_LanguageSet == 0)
			{
				snprintf(gDiagResultDescription,4000,"Timeout no response recived when request service0x11");
			}
			else
			{
				snprintf(gDiagResultDescription,4000,"请求超时，控制器对11服务未回复响应");
			}
			Diag_SetReqCheckResult(reqGroup,2,RESULT_FAIL,gDiagResultDescription);
			return -1;
		}
		else
		{
			if(gUDS_LanguageSet == 0)
			{
				snprintf(gDiagResultDescription,4000,"ECU gives negative response 0x%02x to the request of service 0x11",gTpRxData[2]);
			}
			else
			{
				snprintf(gDiagResultDescription,4000,"ECU对11服务回复了负响应0x%02x",gTpRxData[2]);
			}
			Diag_SetReqCheckResult(reqGroup,reqNum,RESULT_FAIL,gDiagResultDescription);
			return -1;
		}
	}
	if(gTpRxData[0]!=0x51)
	{
		if(gUDS_LanguageSet == 0)
		{
			snprintf(gDiagResultDescription,4000,"ECU gives unexpect positive response service ID 0x%02x to the request of service 0x11",gTpRxData[0]);
		}
		else
		{
			snprintf(gDiagResultDescription,4000,"ECU对11服务回复了非预期的肯定响应0x%02x",gTpRxData[0]);
		}
		Diag_SetReqCheckResult(reqGroup,reqNum,RESULT_FAIL,gDiagResultDescription);
		return 1;
	}
	if(0x04!=Subfunction)
	{
		if(gUDS_LanguageSet == 0)
		{
			snprintf(gDiagResultDescription,4000,"ECU gives unexpect positive subfunction 0x%02x to the request of service 0x11",gTpRxData[1]);
		}
		else
		{
			snprintf(gDiagResultDescription,4000,"ECU对11服务回复了非预期的子功能0x%02x",gTpRxData[1]);
		}
		Diag_SetReqCheckResult(reqGroup,reqNum,RESULT_FAIL,gDiagResultDescription);
		return 1;
	}
	if(0x03!=gTpRxLength)
	{
		if(gUDS_LanguageSet == 0)
		{
			snprintf(gDiagResultDescription,4000,"ECU response lenth is wrong to the request of service 0x11");
		}
		else
		{
			snprintf(gDiagResultDescription,4000,"ECU对11服务回复了错误的长度");
		}
		Diag_SetReqCheckResult(reqGroup,reqNum,RESULT_FAIL,gDiagResultDescription);
		return 1;
	}
	if(powerDownTime!=gTpRxData[2])
	{
		if(gUDS_LanguageSet == 0)
		{
			snprintf(gDiagResultDescription,4000,"ECU power down time is not correct");
		}
		else
		{
			snprintf(gDiagResultDescription,4000,"ECU响应了错误的Power down time");
		}

		Diag_SetReqCheckResult(reqGroup,reqNum,RESULT_FAIL,gDiagResultDescription);
		return 1;
	}
	else
	{
		if(gUDS_DescriptionExistFlag == 1)
		{
			if(gUDS_LanguageSet == 0)
			{
				PrintPID("UDS","Pos.Response",gTpRxData,gTpRxLength);
			}
			else
			{
				PrintPID("UDS","肯定响应",gTpRxData,gTpRxLength);
			}
		}
		return 2;
	}
}


void SID27_SecurityAccess_RequestSeed(int level,enum AddressMode Mode)
{
	byte SID27[2];
	int  i;
	int  SecurityLevel;

	SID27[0]=0x27;
	SID27[1]=level;
	SecurityLevel=level;
	TP_Send(SID27,Mode);
	if(gUDS_DescriptionExistFlag == 1)
	{
		if(gUDS_LanguageSet == 0)
		{
			PrintPID("UDS","Request ",SID27, elCount(SID27));
		}
		else
		{
			PrintPID("UDS","发送请求 ",SID27, elCount(SID27));
		}
	}
}

void SID27_SecurityAccess_SendKey(int level,byte KeyArray[],enum AddressMode Mode)
{
	byte SID27[34];
	int  k;
	long ActualSize[1];
	byte ChallengeByte[32];
	int  SecurityLevel;
  
  SID27[0] = 0x27;
  SID27[1] = level+1;
  
  memcpy(ChallengeByte,gSeedArray,gSeedLength);
  for(k=0;k<NumOfSecurityLv;k++)
  {
    if(SELevel[k].SElevel==level)
    {
      memcpy_off(ChallengeByte,gSeedLength,SELevel[k].SEconstant,0,gConstLength);
    }
  }
  for(k=0; k<gSeedLength+gConstLength; k++)
	{
		write("ChallengeByte[%d]:0x%02x",k,ChallengeByte[k]);
	}
  
	write("DLLName:%s",DLLName);
  if(AlgorithmVersion_3Seed == 1)
  {
    SKDLL_GenKeyEx(ChallengeByte,gSeedLength+gConstLength,1,"",KeyArray,gSeedLength,ActualSize,DLLName);
  }
  else
  {
    SeedParameter(ChallengeByte,gSeedLength+gConstLength,1);
    GenerateKeyExOpt(KeyArray,gSeedLength,DLLName);
  }
  testWaitForTimeout(5);
  for(k=0;k<gSeedLength;k++) { SID27[2+k]=KeyArray[k]; }
 
	TP_Send(SID27,gSeedLength+2,Mode);
	if(gUDS_DescriptionExistFlag == 1)
	{
		if(gUDS_LanguageSet == 0)
		{
			PrintPID("UDS","Request ",SID27, gSeedLength+2);
		}
		else
		{
			PrintPID("UDS","发送请求 ",SID27, gSeedLength+2);
		}
	}
}

int CheckPosResponse_SID27_ReqSeed(int level,byte SeedArray[],int ByteNumOfSeed,int reqGroup,int reqNum )
{
	int i;
	if((gBusFlag == 1)||(gBusFlag == 2)||(gBusFlag == 3)||(gBusFlag == 4)||(gBusFlag == 5))
  {
    if(SessionFlag==APP)
    {
      gRss=ECU_Response(gP2Client_APP,0x27);
    }
    else if(SessionFlag==BOOT)
    {
      gRss=ECU_Response(gP2Client_BOOT,0x27);
    }
    else
    {
       gRss=ECU_Response(gP2Client_APP,0x27);
    }
  }
	if(gRss==POS)
		for(i=0; i<elcount(SeedArray); i++)
			SeedArray[i]=gTpRxData[i+2];
	if(gRss!=POS)
	{
		if(gRss==TIMEOUT)
		{
			if(gUDS_LanguageSet == 0)
			{
				snprintf(gDiagResultDescription,4000,"Timeout no response recived when request service 0x27");
			}
			else
			{
				snprintf(gDiagResultDescription,4000,"请求超时，控制器对27服务未回复响应");
			}
			Diag_SetReqCheckResult(reqGroup,reqNum,RESULT_FAIL,gDiagResultDescription);
			return -1;
		}
		else
		{
			if(gUDS_LanguageSet == 0)
			{
				snprintf(gDiagResultDescription,4000,"ECU gives negative response 0x%02x to the request of service 0x27",gTpRxData[2]);
			}
			else
			{
				snprintf(gDiagResultDescription,4000,"ECU对27服务回复了负响应0x%02x",gTpRxData[2]);
			}
			Diag_SetReqCheckResult(reqGroup,reqNum,RESULT_FAIL,gDiagResultDescription);
			return -1;
		}
	}
	if(gTpRxData[0]!=0x67)
	{
		if(gUDS_LanguageSet == 0)
		{
			snprintf(gDiagResultDescription,4000,"ECU gives unexpect positive response service ID 0x%02x to the request of service 0x27",gTpRxData[0]);
		}
		else
		{
			snprintf(gDiagResultDescription,4000,"ECU对27服务回复了非预期的肯定响应0x%02x",gTpRxData[0]);
		}
		Diag_SetReqCheckResult(reqGroup,reqNum,RESULT_FAIL,gDiagResultDescription);
		return 1;
	}
	if(gTpRxData[1]!=level)
	{
		if(gUDS_LanguageSet == 0)
		{
			snprintf(gDiagResultDescription,4000,"ECU gives unexpect subfunction 0x%02x to the request of service 0x27",gTpRxData[1]);
		}
		else
		{
			snprintf(gDiagResultDescription,4000,"ECU对27服务回复了非预期的子功能0x%02x",gTpRxData[1]);
		}
		Diag_SetReqCheckResult(reqGroup,reqNum,RESULT_FAIL,gDiagResultDescription);
		return 1;
	}
	if(gTpRxLength!=ByteNumOfSeed+2)
	{
		if(gUDS_LanguageSet == 0)
		{
			snprintf(gDiagResultDescription,4000,"ECU gives unexpect lenth to the request of service 0x27");
		}
		else
		{
			snprintf(gDiagResultDescription,4000,"ECU对27服务回复了错误的长度");
		}
		Diag_SetReqCheckResult(reqGroup,reqNum,RESULT_FAIL,gDiagResultDescription);
		return 1;
	}
	else
	{
		if(gUDS_DescriptionExistFlag == 1)
		{
			if(gUDS_LanguageSet == 0)
			{
				PrintPID("UDS","Pos.Response",gTpRxData,gTpRxLength);
			}
			else
			{
				PrintPID("UDS","肯定响应",gTpRxData,gTpRxLength);
			}
		}
		return 2;
	}
}

int CheckPosResponse_SID27_ReqSeed(int level,int ByteNumOfSeed,byte expectseed[],int reqGroup,int reqNum)
{
	int i;
	int flag;

	if((gBusFlag == 1)||(gBusFlag == 2)||(gBusFlag == 3)||(gBusFlag == 4)||(gBusFlag == 5))
  {
    if(SessionFlag==APP)
    {
      gRss=ECU_Response(gP2Client_APP,0x27);
    }
    else if(SessionFlag==BOOT)
    {
      gRss=ECU_Response(gP2Client_BOOT,0x27);
    }
    else
    {
       gRss=ECU_Response(gP2Client_APP,0x27);
    }
  }
	if(gRss!=POS)
	{
		if(gRss==TIMEOUT)
		{
			if(gUDS_LanguageSet == 0)
			{
				snprintf(gDiagResultDescription,4000,"Timeout no response recived when request service 0x27");
			}
			else
			{
				snprintf(gDiagResultDescription,4000,"请求超时，控制器对27服务未回复响应");
			}
			Diag_SetReqCheckResult(reqGroup,reqNum,RESULT_FAIL,gDiagResultDescription);
			return -1;
		}
		else
		{
			if(gUDS_LanguageSet == 0)
			{
				snprintf(gDiagResultDescription,4000,"ECU gives negative response 0x%02x to the request of service 0x27",gTpRxData[2]);
			}
			else
			{
				snprintf(gDiagResultDescription,4000,"ECU对27服务回复了负响应0x%02x",gTpRxData[2]);
			}
			Diag_SetReqCheckResult(reqGroup,reqNum,RESULT_FAIL,gDiagResultDescription);
			return -1;
		}
	}
	if(gTpRxData[0]!=0x67)
	{
		if(gUDS_LanguageSet == 0)
		{
			snprintf(gDiagResultDescription,4000,"ECU gives unexpect positive response service ID 0x%02x to the request of service 0x27",gTpRxData[0]);
		}
		else
		{
			snprintf(gDiagResultDescription,4000,"ECU对27服务回复了非预期的肯定响应0x%02x",gTpRxData[0]);
		}
		Diag_SetReqCheckResult(reqGroup,reqNum,RESULT_FAIL,gDiagResultDescription);
		return 1;
	}
	if(gTpRxData[1]!=level)
	{
		if(gUDS_LanguageSet == 0)
		{
			snprintf(gDiagResultDescription,4000,"ECU gives unexpect subfunction 0x%02x to the request of service 0x27",gTpRxData[1]);
		}
		else
		{
			snprintf(gDiagResultDescription,4000,"ECU对27服务回复了非预期的子功能0x%02x",gTpRxData[1]);
		}
		Diag_SetReqCheckResult(reqGroup,reqNum,RESULT_FAIL,gDiagResultDescription);
		return 1;
	}
	if(gTpRxLength!=ByteNumOfSeed+2)
	{
		if(gUDS_LanguageSet == 0)
		{
			snprintf(gDiagResultDescription,4000,"ECU gives unexpect lenth to the request of service 0x27");
		}
		else
		{
			snprintf(gDiagResultDescription,4000,"ECU对27服务回复了错误的长度");
		}
		Diag_SetReqCheckResult(reqGroup,reqNum,RESULT_FAIL,gDiagResultDescription);
		return 1;
	}
	for(i=2; i<elCount(expectseed)-1; i++)
	{
		if(gTpRxData[i]!=expectseed[i-2])
			flag = 1;
	}
	if(flag == 1)
	{
		if(gUDS_LanguageSet == 0)
		{
			snprintf(gDiagResultDescription,4000,"The seed is not the expected value");
		}
		else
		{
			snprintf(gDiagResultDescription,4000,"种子与期望值不符");
		}
		Diag_SetReqCheckResult(reqGroup,reqNum,RESULT_FAIL,gDiagResultDescription);
		return 1;
	}
	else
	{
		if(gUDS_DescriptionExistFlag == 1)
		{
			if(gUDS_LanguageSet == 0)
			{
				PrintPID("UDS","Pos.Response",gTpRxData,gTpRxLength);
			}
			else
			{
				PrintPID("UDS","肯定响应",gTpRxData,gTpRxLength);
			}
		}
		return 2;
	}
}

int CheckPosResponse_SID27_SenKey(int level,int reqGroup,int reqNum)
{
	if((gBusFlag == 1)||(gBusFlag == 2)||(gBusFlag == 3)||(gBusFlag == 4)||(gBusFlag == 5))
  {
    if(SessionFlag==APP)
    {
      gRss=ECU_Response(gP2Client_APP,0x27);
    }
    else if(SessionFlag==BOOT)
    {
      gRss=ECU_Response(gP2Client_BOOT,0x27);
    }
    else
    {
       gRss=ECU_Response(gP2Client_APP,0x27);
    }
  }
	if(gRss!=POS)
	{
		if(gRss==TIMEOUT)
		{
			if(gUDS_LanguageSet == 0)
			{
				snprintf(gDiagResultDescription,4000,"Timeout no response recived when request service 0x27");
			}
			else
			{
				snprintf(gDiagResultDescription,4000,"请求超时，控制器对27服务未回复响应");
			}
			Diag_SetReqCheckResult(reqGroup,reqNum,RESULT_FAIL,gDiagResultDescription);
			return -1;
		}
		else
		{
			if(gUDS_LanguageSet == 0)
			{
				snprintf(gDiagResultDescription,4000,"ECU gives negative response 0x%02x to the request of service 0x27",gTpRxData[2]);
			}
			else
			{
				snprintf(gDiagResultDescription,4000,"ECU对27服务回复了负响应0x%02x",gTpRxData[2]);
			}
			Diag_SetReqCheckResult(reqGroup,reqNum,RESULT_FAIL,gDiagResultDescription);
			return -1;
		}
	}
	if(gTpRxData[0]!=0x67)
	{
		if(gUDS_LanguageSet == 0)
		{
			snprintf(gDiagResultDescription,4000,"ECU gives unexpect positive response service ID 0x%02x to the request of service 0x27",gTpRxData[0]);
		}
		else
		{
			snprintf(gDiagResultDescription,4000,"ECU对27服务回复了非预期的肯定响应0x%02x",gTpRxData[0]);
		}
		Diag_SetReqCheckResult(reqGroup,reqNum,RESULT_FAIL,gDiagResultDescription);
		return 1;
	}
	if(gTpRxData[1]!=(level+1))
	{
		if(gUDS_LanguageSet == 0)
		{
			snprintf(gDiagResultDescription,4000,"ECU gives unexpect subfunction 0x%02x to the request of service 0x27",gTpRxData[1]);
		}
		else
		{
			snprintf(gDiagResultDescription,4000,"ECU对27服务回复了非预期的子功能0x%02x",gTpRxData[1]);
		}
		Diag_SetReqCheckResult(reqGroup,reqNum,RESULT_FAIL,gDiagResultDescription);
		return 1;
	}
	if(gTpRxLength!=2)
	{
		if(gUDS_LanguageSet == 0)
		{
			snprintf(gDiagResultDescription,4000,"ECU gives unexpect lenth to the request of service 0x27");
		}
		else
		{
			snprintf(gDiagResultDescription,4000,"ECU对27服务回复了错误的长度");
		}
		Diag_SetReqCheckResult(reqGroup,reqNum,RESULT_FAIL,gDiagResultDescription);
		return 1;
	}
	else
	{
		if(gUDS_DescriptionExistFlag == 1)
		{
			if(gUDS_LanguageSet == 0)
			{
				PrintPID("UDS","Pos.Response",gTpRxData,gTpRxLength);
			}
			else
			{
				PrintPID("UDS","肯定响应",gTpRxData,gTpRxLength);
			}
		}
		return 2;
	}
}

int CheckPosResponse_SID27_SenKey(int level,int ByteNumOfSeed,int reqGroup,int reqNum)
{
	if((gBusFlag == 1)||(gBusFlag == 2)||(gBusFlag == 3)||(gBusFlag == 4)||(gBusFlag == 5))
  {
    if(SessionFlag==APP)
    {
      gRss=ECU_Response(gP2Client_APP,0x27);
    }
    else if(SessionFlag==BOOT)
    {
      gRss=ECU_Response(gP2Client_BOOT,0x27);
    }
    else
    {
       gRss=ECU_Response(gP2Client_APP,0x27);
    }
  }
	if(gRss!=POS)
	{
		if(gRss==TIMEOUT)
		{
			if(gUDS_LanguageSet == 0)
			{
				snprintf(gDiagResultDescription,4000,"Timeout no response recived when request service 0x27");
			}
			else
			{
				snprintf(gDiagResultDescription,4000,"请求超时，控制器对27服务未回复响应");
			}
			Diag_SetReqCheckResult(reqGroup,reqNum,RESULT_FAIL,gDiagResultDescription);
			return -1;
		}
		else
		{
			if(gUDS_LanguageSet == 0)
			{
				snprintf(gDiagResultDescription,4000,"ECU gives negative response 0x%02x to the request of service 0x27",gTpRxData[2]);
			}
			else
			{
				snprintf(gDiagResultDescription,4000,"ECU对27服务回复了负响应0x%02x",gTpRxData[2]);
			}
			Diag_SetReqCheckResult(reqGroup,reqNum,RESULT_FAIL,gDiagResultDescription);
			return -1;
		}
	}
	if(gTpRxData[0]!=0x67)
	{
		if(gUDS_LanguageSet == 0)
		{
			snprintf(gDiagResultDescription,4000,"ECU gives unexpect positive response service ID 0x%02x to the request of service 0x27",gTpRxData[0]);
		}
		else
		{
			snprintf(gDiagResultDescription,4000,"ECU对27服务回复了非预期的肯定响应0x%02x",gTpRxData[0]);
		}
		Diag_SetReqCheckResult(reqGroup,reqNum,RESULT_FAIL,gDiagResultDescription);
		return 1;
	}
	if(gTpRxData[1]!=(level+1))
	{
		if(gUDS_LanguageSet == 0)
		{
			snprintf(gDiagResultDescription,4000,"ECU gives unexpect subfunction 0x%02x to the request of service 0x27",gTpRxData[1]);
		}
		else
		{
			snprintf(gDiagResultDescription,4000,"ECU对27服务回复了非预期的子功能0x%02x",gTpRxData[1]);
		}
		Diag_SetReqCheckResult(reqGroup,reqNum,RESULT_FAIL,gDiagResultDescription);
		return 1;
	}
	if(gTpRxLength!=2)
	{
		if(gUDS_LanguageSet == 0)
		{
			snprintf(gDiagResultDescription,4000,"ECU gives unexpect lenth to the request of service 0x27");
		}
		else
		{
			snprintf(gDiagResultDescription,4000,"ECU对27服务回复了错误的长度");
		}
		Diag_SetReqCheckResult(reqGroup,reqNum,RESULT_FAIL,gDiagResultDescription);
		return 1;
	}
	else
	{
		if(gUDS_DescriptionExistFlag == 1)
		{
			if(gUDS_LanguageSet == 0)
			{
				PrintPID("UDS","Pos.Response",gTpRxData,gTpRxLength);
			}
			else
			{
				PrintPID("UDS","肯定响应",gTpRxData,gTpRxLength);
			}
		}
		return 2;
	}
}



void SID28_CommunicationControl(byte Subfunction,enum e_CommunicationType CommType,enum AddressMode Mode,enum e_SPRMIB Supress)
{
	byte SID28[3];
	SID28[0]=0x28;
	if(Supress==0)
		SID28[1]=Subfunction;
	else
		SID28[1]=Subfunction+0x80;
	SID28[2]=CommType;
	TP_Send(SID28,Mode);
	if(gUDS_DescriptionExistFlag == 1)
	{
		if(gUDS_LanguageSet == 0)
		{
			PrintPID("UDS","Request ",SID28,elCount(SID28));
		}
		else
		{
			PrintPID("UDS","发送请求 ",SID28,elCount(SID28));
		}
	}
}
void SID28_CommunicationControl(byte Subfunction,byte CommType,enum AddressMode Mode,enum e_SPRMIB Supress)
{
	byte SID28[3];
	SID28[0]=0x28;
	if(Supress==0)
		SID28[1]=Subfunction;
	else
		SID28[1]=Subfunction+0x80;
	SID28[2]=CommType;
	TP_Send(SID28,Mode);
	if(gUDS_DescriptionExistFlag == 1)
	{
		if(gUDS_LanguageSet == 0)
		{
			PrintPID("UDS","Request ",SID28,elCount(SID28));
		}
		else
		{
			PrintPID("UDS","发送请求 ",SID28,elCount(SID28));
		}
	}
}

void SID28_CommunicationControl(byte Subfunction,enum e_CommunicationType CommType, byte NodeIdentificationNumber[],enum AddressMode Mode,enum e_SPRMIB Supress)
{
	byte SID28[5];
	SID28[0]=0x28;
	if(Supress==0)
		SID28[1]=Subfunction;
	else
		SID28[1]=Subfunction+0x80;
  SID28[2]=CommType;
	SID28[3]=NodeIdentificationNumber[0];
  SID28[4]=NodeIdentificationNumber[1];
  
	TP_Send(SID28,Mode);
	if(gUDS_DescriptionExistFlag == 1)
	{
		if(gUDS_LanguageSet == 0)
		{
			PrintPID("UDS","Request ",SID28,elCount(SID28));
		}
		else
		{
			PrintPID("UDS","发送请求 ",SID28,elCount(SID28));
		}
	}
}

int CheckPosResponse_SID28(byte Subfunction,int reqGroup,int reqNum)
{
	if((gBusFlag == 1)||(gBusFlag == 2)||(gBusFlag == 3)||(gBusFlag == 4)||(gBusFlag == 5))
  {
    if(SessionFlag==APP)
    {
      gRss=ECU_Response(gP2Client_APP,0x28);
    }
    else if(SessionFlag==BOOT)
    {
      gRss=ECU_Response(gP2Client_BOOT,0x28);
    }
    else
    {
       gRss=ECU_Response(gP2Client_APP,0x28);
    }
  }
	if(gRss!=POS)
	{
		if(gRss==TIMEOUT)
		{
			if(gUDS_LanguageSet == 0)
			{
				snprintf(gDiagResultDescription,4000,"Timeout no response recived when request service 0x28");
			}
			else
			{
				snprintf(gDiagResultDescription,4000,"请求超时，控制器对28服务未回复响应");
			}
			Diag_SetReqCheckResult(reqGroup,reqNum,RESULT_FAIL,gDiagResultDescription);
			return -1;
		}
		else
		{
			if(gUDS_LanguageSet == 0)
			{
				snprintf(gDiagResultDescription,4000,"ECU gives negative response 0x%02x to the request of service 0x28",gTpRxData[2]);
			}
			else
			{
				snprintf(gDiagResultDescription,4000,"ECU对28服务回复了负响应0x%02x",gTpRxData[2]);
			}
			Diag_SetReqCheckResult(reqGroup,reqNum,RESULT_FAIL,gDiagResultDescription);
			return -1;
		}
	}
	if(gTpRxData[0]!=0x68)
	{
		if(gUDS_LanguageSet == 0)
		{
			snprintf(gDiagResultDescription,4000,"ECU gives unexpect positive response service ID 0x%02x to the request of service 0x28",gTpRxData[0]);
		}
		else
		{
			snprintf(gDiagResultDescription,4000,"ECU对28服务回复了非预期的肯定响应0x%02x",gTpRxData[0]);
		}
		Diag_SetReqCheckResult(reqGroup,reqNum,RESULT_FAIL,gDiagResultDescription);
		return 1;
	}
	if(gTpRxData[1]!=Subfunction)
	{
		if(gUDS_LanguageSet == 0)
		{
			snprintf(gDiagResultDescription,4000,"ECU gives unexpect subfunction 0x%02x to the request of service 0x28",gTpRxData[1]);
		}
		else
		{
			snprintf(gDiagResultDescription,4000,"ECU对28服务回复了非预期的子功能0x%02x",gTpRxData[1]);
		}
		Diag_SetReqCheckResult(reqGroup,reqNum,RESULT_FAIL,gDiagResultDescription);
		return 1;
	}
	if(gTpRxLength!=2)
	{
		if(gUDS_LanguageSet == 0)
		{
			snprintf(gDiagResultDescription,4000,"ECU gives unexpect lenth to the request of service 0x28");
		}
		else
		{
			snprintf(gDiagResultDescription,4000,"ECU对28服务回复了错误的长度");
		}
		Diag_SetReqCheckResult(reqGroup,reqNum,RESULT_FAIL,gDiagResultDescription);
		return 1;
	}
	else
	{
		if(gUDS_DescriptionExistFlag == 1)
		{
			if(gUDS_LanguageSet == 0)
			{
				PrintPID("UDS","Pos.Response",gTpRxData,gTpRxLength);
			}
			else
			{
				PrintPID("UDS","肯定响应",gTpRxData,gTpRxLength);
			}
		}
		return 2;
	}
}



Void SID3E_TesterPresent(enum AddressMode Mode,enum e_SPRMIB Supress)
{
	int i;
	byte SID3E[2];
	SID3E[0]=0x3E;
	if(Supress==0)
		SID3E[1]=0x00;
	else
		SID3E[1]=0x80;
	TP_Send(SID3E,Mode);
	if(gUDS_DescriptionExistFlag == 1)
	{
		if(gUDS_LanguageSet == 0)
		{
			PrintPID("UDS","Request ",SID3E,elCount(SID3E));
		}
		else
		{
			PrintPID("UDS","发送请求 ",SID3E,elCount(SID3E));
		}
	}
}



int CheckPosResponse_SID3E(int reqGroup,int reqNum)
{
	if((gBusFlag == 1)||(gBusFlag == 2)||(gBusFlag == 3)||(gBusFlag == 4)||(gBusFlag == 5))
  {
    if(SessionFlag==APP)
    {
      gRss=ECU_Response(gP2Client_APP,0x3E);
    }
    else if(SessionFlag==BOOT)
    {
      gRss=ECU_Response(gP2Client_BOOT,0x3E);
    }
    else
    {
       gRss=ECU_Response(gP2Client_APP,0x3E);
    }
  }
	if(gRss!=POS)
	{
		if(gRss==TIMEOUT)
		{
			if(gUDS_LanguageSet == 0)
			{
				snprintf(gDiagResultDescription,4000,"Timeout no response recived when request service 0x3E");
			}
			else
			{
				snprintf(gDiagResultDescription,4000,"请求超时，控制器对3E服务未回复响应");
			}
			Diag_SetReqCheckResult(reqGroup,reqNum,RESULT_FAIL,gDiagResultDescription);
			return -1;
		}
		else
		{
			if(gUDS_LanguageSet == 0)
			{
				snprintf(gDiagResultDescription,4000,"ECU gives negative response 0x%02x to the request of service 0x3E",gTpRxData[2]);
			}
			else
			{
				snprintf(gDiagResultDescription,4000,"ECU对3E服务回复了负响应0x%02x",gTpRxData[2]);
			}
			Diag_SetReqCheckResult(reqGroup,reqNum,RESULT_FAIL,gDiagResultDescription);
			return -1;
		}
	}
	if(gTpRxData[0]!=0x7E)
	{
		if(gUDS_LanguageSet == 0)
		{
			snprintf(gDiagResultDescription,4000,"ECU gives unexpect positive response service ID 0x%02x to the request of service 0x3E",gTpRxData[0]);
		}
		else
		{
			snprintf(gDiagResultDescription,4000,"ECU对3E服务回复了非预期的肯定响应0x%02x",gTpRxData[0]);
		}
		Diag_SetReqCheckResult(reqGroup,reqNum,RESULT_FAIL,gDiagResultDescription);
		return 1;
	}
	else if(gTpRxLength!=2)
	{
		if(gUDS_LanguageSet == 0)
		{
			snprintf(gDiagResultDescription,4000,"ECU gives unexpect lenth to the request of service 0x3E");
		}
		else
		{
			snprintf(gDiagResultDescription,4000,"ECU对3E服务回复了错误的长度");
		}
		Diag_SetReqCheckResult(reqGroup,reqNum,RESULT_FAIL,gDiagResultDescription);
		return 1;
	}
	else
	{
		if(gUDS_DescriptionExistFlag == 1)
		{
			if(gUDS_LanguageSet == 0)
			{
				PrintPID("UDS","Pos.Response",gTpRxData,gTpRxLength);
			}
			else
			{
				PrintPID("UDS","肯定响应",gTpRxData,gTpRxLength);
			}
		}
		return 2;
	}
}

void SID85_ControlDTCSetting(byte Subfunction,char DTC[],enum AddressMode Mode,enum e_SPRMIB Supress)
{
	byte SID85[10];
	int  i;

	SID85[0]=0x85;
	if(Supress==0)
		SID85[1]=Subfunction;
	else
		SID85[1]=Subfunction+0x80;
	for(i=0; i<elCount(DTC); i++)
		SID85[i+2]=DTC[i];
	TP_Send(SID85,elCount(DTC),Mode);
	if(gUDS_DescriptionExistFlag == 1)
	{
		if(gUDS_LanguageSet == 0)
		{
			PrintPID("UDS","Request ",SID85,elCount(SID85));
		}
		else
		{
			PrintPID("UDS","发送请求 ",SID85,elCount(SID85));
		}
	}
}

void SID85_ControlDTCSetting(byte Subfunction,enum AddressMode Mode,enum e_SPRMIB Supress)
{
	byte SID85[2];
	SID85[0]=0x85;
	if(Supress==0)
		SID85[1]=Subfunction;
	else
		SID85[1]=Subfunction+0x80;
	TP_Send(SID85,Mode);
	if(gUDS_DescriptionExistFlag == 1)
	{
		if(gUDS_LanguageSet == 0)
		{
			PrintPID("UDS","Request ",SID85,elCount(SID85));
		}
		else
		{
			PrintPID("UDS","发送请求 ",SID85,elCount(SID85));
		}
	}
}

int CheckPosResponse_SID85(byte Subfunction,int reqGroup,int reqNum)
{
	if((gBusFlag == 1)||(gBusFlag == 2)||(gBusFlag == 3)||(gBusFlag == 4)||(gBusFlag == 5))
  {
    if(SessionFlag==APP)
    {
      gRss=ECU_Response(gP2Client_APP,0x85);
    }
    else if(SessionFlag==BOOT)
    {
      gRss=ECU_Response(gP2Client_BOOT,0x85);
    }
    else
    {
       gRss=ECU_Response(gP2Client_APP,0x85);
    }
  }
	if(gRss!=POS)
	{
		if(gRss==TIMEOUT)
		{
			if(gUDS_LanguageSet == 0)
			{
				snprintf(gDiagResultDescription,4000,"Timeout no response recived when request service 0x85");
			}
			else
			{
				snprintf(gDiagResultDescription,4000,"请求超时，控制器对85服务未回复响应");
			}
			Diag_SetReqCheckResult(reqGroup,reqNum,RESULT_FAIL,gDiagResultDescription);
			return -1;
		}
		else
		{
			if(gUDS_LanguageSet == 0)
			{
				snprintf(gDiagResultDescription,4000,"ECU gives negative response 0x%02x to the request of service 0x85",gTpRxData[2]);
			}
			else
			{
				snprintf(gDiagResultDescription,4000,"ECU对85服务回复了负响应0x%02x",gTpRxData[2]);
			}
			Diag_SetReqCheckResult(reqGroup,reqNum,RESULT_FAIL,gDiagResultDescription);
			return -1;
		}
	}
	if(gTpRxData[0]!=0xC5)
	{
		if(gUDS_LanguageSet == 0)
		{
			snprintf(gDiagResultDescription,4000,"ECU gives unexpect positive response service ID 0x%02x to the request of service 0x28",gTpRxData[0]);
		}
		else
		{
			snprintf(gDiagResultDescription,4000,"ECU对85服务回复了非预期的肯定响应0x%02x",gTpRxData[0]);
		}
		Diag_SetReqCheckResult(reqGroup,reqNum,RESULT_FAIL,gDiagResultDescription);
		return 1;
	}
	if(gTpRxData[1]!=Subfunction)
	{
		if(gUDS_LanguageSet == 0)
		{
			snprintf(gDiagResultDescription,4000,"ECU gives unexpect subfunction 0x%02x to the request of service 0x85",gTpRxData[1]);
		}
		else
		{
			snprintf(gDiagResultDescription,4000,"ECU对85服务回复了非预期的子功能0x%02x",gTpRxData[1]);
		}
		Diag_SetReqCheckResult(reqGroup,reqNum,RESULT_FAIL,gDiagResultDescription);
		return 1;
	}
	if(gTpRxLength!=2)
	{
		if(gUDS_LanguageSet == 0)
		{
			snprintf(gDiagResultDescription,4000,"ECU gives unexpect lenth to the request of service 0x85");
		}
		else
		{
			snprintf(gDiagResultDescription,4000,"ECU对85服务回复了错误的长度");
		}
		Diag_SetReqCheckResult(reqGroup,reqNum,RESULT_FAIL,gDiagResultDescription);
		return 1;
	}
	else
	{
		if(gUDS_DescriptionExistFlag == 1)
		{
			if(gUDS_LanguageSet == 0)
			{
				PrintPID("UDS","Pos.Response",gTpRxData,gTpRxLength);
			}
			else
			{
				PrintPID("UDS","肯定响应",gTpRxData,gTpRxLength);
			}
		}
		return 2;
	}
}



void SID22_ReadDataByIdentifier(byte PID[],enum AddressMode Mode)
{
	byte SID22[3];
	SID22[0]=0x22;
	SID22[1]=PID[0];
	SID22[2]=PID[1];
	TP_Send(SID22, Mode);
	if(gUDS_DescriptionExistFlag == 1)
	{
		if(gUDS_LanguageSet == 0)
		{
			PrintPID("UDS","Request ",SID22,elCount(SID22));
		}
		else
		{
			PrintPID("UDS","发送请求 ",SID22,elCount(SID22));
		}
	}
}

void SID22_ReadDataByIdentifier(long PID,enum AddressMode Mode)
{
	byte SID22[3];
	SID22[0]=0x22;
	SID22[1]=PID>>8;
	SID22[2]=PID&0xFF;
	TP_Send(SID22, Mode);
	if(gUDS_DescriptionExistFlag == 1)
	{
		if(gUDS_LanguageSet == 0)
		{
			PrintPID("UDS","Request ",SID22,elCount(SID22));
		}
		else
		{
			PrintPID("UDS","发送请求 ",SID22,elCount(SID22));
		}
	}
}

//void SID22_ReadDataByIdentifier(byte PIDList[],int NumOfDID,enum AddressMode Mode)
//{
//	byte SID22[50];
//	int  i;
//	SID22[0]=0x22;
//	for(i=0; i<elCount(PIDList); i++)
//		SID22[i+1]=PIDList[i];
//	TP_Send(SID22,elCount(PIDList), Mode);
//	if(gUDS_DescriptionExistFlag == 1)
//	{
//		if(gUDS_LanguageSet == 0)
//		{
//			PrintPID("UDS","Request ",SID22,elCount(SID22));
//		}
//		else
//		{
//			PrintPID("UDS","发送请求 ",SID22,elCount(SID22));
//		}
//	}
//}

int CheckPosResponse_SID22(byte PID[],int ExpectLength,int reqGroup,int reqNum)
{
	if((gBusFlag == 1)||(gBusFlag == 2)||(gBusFlag == 3)||(gBusFlag == 4)||(gBusFlag == 5))
  {
    if(SessionFlag==APP)
    {
      gRss=ECU_Response(gP2Client_APP,0x22);
    }
    else if(SessionFlag==BOOT)
    {
      gRss=ECU_Response(gP2Client_BOOT,0x22);
    }
    else
    {
       gRss=ECU_Response(gP2Client_APP,0x22);
    }
  }

	if(gRss!=POS)
	{
		if(gRss==TIMEOUT)
		{
			if(gUDS_LanguageSet == 0)
			{
				snprintf(gDiagResultDescription,4000,"ECU gives no response to supported DID %02x %02x of service 22",PID[0],PID[1]);
			}
			else
			{
				snprintf(gDiagResultDescription,4000,"请求超时，控制器对22服务如下DID未回复响应 ：%02x %02x",PID[0],PID[1]);
			}
			Diag_SetReqCheckResult(reqGroup,reqNum,RESULT_FAIL,gDiagResultDescription);
			return -1;
		}
		else
		{
			if(gUDS_LanguageSet == 0)
			{
				snprintf(gDiagResultDescription,4000,"ECU gives negative response 0x%02x to the request of service 0x22",gTpRxData[2]);
			}
			else
			{
				snprintf(gDiagResultDescription,4000,"控制器对22服务如下DID回复了负响应%02x ：%02x %02x",gTpRxData[2],PID[0],PID[1]);
			}
			Diag_SetReqCheckResult(reqGroup,reqNum,RESULT_FAIL,gDiagResultDescription);
			return -1;
		}
	}
	if(gTpRxData[0]!=0x62)
	{
		if(gUDS_LanguageSet == 0)
		{
			snprintf(gDiagResultDescription,4000,"ECU gives unexpect positive response service ID 0x%02x to the request of service 0x22",gTpRxData[0]);
		}
		else
		{
			snprintf(gDiagResultDescription,4000,"ECU对22服务回复了非预期的肯定响应0x%02x",gTpRxData[0]);
		}
		Diag_SetReqCheckResult(reqGroup,reqNum,RESULT_FAIL,gDiagResultDescription);
		return 1;
	}
	if(gTpRxData[1]!=PID[0] || gTpRxData[2]!=PID[1])
	{
		if(gUDS_LanguageSet == 0)
		{
			snprintf(gDiagResultDescription,4000,"ECU gives posotive response, but the response DID is wrong");
		}
		else
		{
			snprintf(gDiagResultDescription,4000,"ECU对22服务回复了错误的DID");
		}
		Diag_SetReqCheckResult(reqGroup,reqNum,RESULT_FAIL,gDiagResultDescription);
		return 1;
	}
	if(ExpectLength!=gTpRxLength-3)
	{
		if(gUDS_LanguageSet == 0)
		{
			snprintf(gDiagResultDescription,4000,"ECU gives unexpect lenth to the request of service 0x22");
		}
		else
		{
			snprintf(gDiagResultDescription,4000,"ECU对22服务回复了错误的长度");
		}
		Diag_SetReqCheckResult(reqGroup,reqNum,RESULT_FAIL,gDiagResultDescription);
		return 1;
	}
	else
	{
		if(gUDS_DescriptionExistFlag == 1)
		{
			if(gUDS_LanguageSet == 0)
			{
				PrintPID("UDS","Pos.Response",gTpRxData,gTpRxLength);
			}
			else
			{
				PrintPID("UDS","肯定响应",gTpRxData,gTpRxLength);
			}
		}
		return 2;
	}
}

int CheckPosResponse_SID22(long PID,int ExpectLength,int reqGroup,int reqNum)
{
	if((gBusFlag == 1)||(gBusFlag == 2)||(gBusFlag == 3)||(gBusFlag == 4)||(gBusFlag == 5))
  {
    if(SessionFlag==APP)
    {
      gRss=ECU_Response(gP2Client_APP,0x22);
    }
    else if(SessionFlag==BOOT)
    {
      gRss=ECU_Response(gP2Client_BOOT,0x22);
    }
    else
    {
       gRss=ECU_Response(gP2Client_APP,0x22);
    }
  }

	if(gRss!=POS)
	{
		if(gRss==TIMEOUT)
		{
			if(gUDS_LanguageSet == 0)
			{
				snprintf(gDiagResultDescription,4000,"ECU gives no response to supported DID 0x%04X of service 22",PID);
			}
			else
			{
				snprintf(gDiagResultDescription,4000,"请求超时，控制器对22服务如下DID未回复响应 ：0x%04X",PID);
			}
			Diag_SetReqCheckResult(reqGroup,reqNum,RESULT_FAIL,gDiagResultDescription);
			return -1;
		}
		else
		{
			if(gUDS_LanguageSet == 0)
			{
				snprintf(gDiagResultDescription,4000,"ECU gives negative response 0x%02x to the request of service 0x22",gTpRxData[2]);
			}
			else
			{
				snprintf(gDiagResultDescription,4000,"控制器对22服务如下DID回复了负响应%02x ：0x%04X",gTpRxData[2],PID);
			}
			Diag_SetReqCheckResult(reqGroup,reqNum,RESULT_FAIL,gDiagResultDescription);
			return -1;
		}
	}
	if(gTpRxData[0]!=0x62)
	{
		if(gUDS_LanguageSet == 0)
		{
			snprintf(gDiagResultDescription,4000,"ECU gives unexpect positive response service ID 0x%02x to the request of service 0x22",gTpRxData[0]);
		}
		else
		{
			snprintf(gDiagResultDescription,4000,"ECU对22服务回复了非预期的肯定响应0x%02x",gTpRxData[0]);
		}
		Diag_SetReqCheckResult(reqGroup,reqNum,RESULT_FAIL,gDiagResultDescription);
		return 1;
	}
	if((gTpRxData[1]!=PID>>8) || (gTpRxData[2]!=PID&0xFF))
	{
		if(gUDS_LanguageSet == 0)
		{
			snprintf(gDiagResultDescription,4000,"ECU gives posotive response, but the response DID is wrong");
		}
		else
		{
			snprintf(gDiagResultDescription,4000,"ECU对22服务回复了错误的DID");
		}
		Diag_SetReqCheckResult(reqGroup,reqNum,RESULT_FAIL,gDiagResultDescription);
		return 1;
	}
	if(ExpectLength!=gTpRxLength-3)
	{
		if(gUDS_LanguageSet == 0)
		{
			snprintf(gDiagResultDescription,4000,"ECU gives unexpect lenth to the request of service 0x22");
		}
		else
		{
			snprintf(gDiagResultDescription,4000,"ECU对22服务回复了错误的长度");
		}
		Diag_SetReqCheckResult(reqGroup,reqNum,RESULT_FAIL,gDiagResultDescription);
		return 1;
	}
	else
	{
		if(gUDS_DescriptionExistFlag == 1)
		{
			if(gUDS_LanguageSet == 0)
			{
				PrintPID("UDS","Pos.Response",gTpRxData,gTpRxLength);
			}
			else
			{
				PrintPID("UDS","肯定响应",gTpRxData,gTpRxLength);
			}
		}
		return 2;
	}
}

int CheckPosResponse_SID22(byte PID[],int reqGroup,int reqNum)
{
	if((gBusFlag == 1)||(gBusFlag == 2)||(gBusFlag == 3)||(gBusFlag == 4)||(gBusFlag == 5))
  {
    if(SessionFlag==APP)
    {
      gRss=ECU_Response(gP2Client_APP,0x22);
    }
    else if(SessionFlag==BOOT)
    {
      gRss=ECU_Response(gP2Client_BOOT,0x22);
    }
    else
    {
       gRss=ECU_Response(gP2Client_APP,0x22);
    }
  }
	if(gRss!=POS)
	{
		if(gRss==TIMEOUT)
		{
			if(gUDS_LanguageSet == 0)
			{
				snprintf(gDiagResultDescription,4000,"ECU gives no response to supported DID %02x %02x of service 22",PID[0],PID[1]);
			}
			else
			{
				snprintf(gDiagResultDescription,4000,"请求超时，控制器对22服务如下DID未回复响应 ：%02x %02x",PID[0],PID[1]);
			}
			Diag_SetReqCheckResult(reqGroup,reqNum,RESULT_FAIL,gDiagResultDescription);
			return -1;
		}
		else
		{
			if(gUDS_LanguageSet == 0)
			{
				snprintf(gDiagResultDescription,4000,"ECU gives negative response 0x%02x to the request of service 0x28",gTpRxData[2]);
			}
			else
			{
				snprintf(gDiagResultDescription,4000,"控制器对22服务如下DID回复了负响应%02x ：%02x %02x",gTpRxData[2],PID[0],PID[1]);
			}
			Diag_SetReqCheckResult(reqGroup,reqNum,RESULT_FAIL,gDiagResultDescription);
			return -1;
		}
	}
	if(gTpRxData[0]!=0x62)
	{
		if(gUDS_LanguageSet == 0)
		{
			snprintf(gDiagResultDescription,4000,"ECU gives unexpect positive response service ID 0x%02x to the request of service 0x22",gTpRxData[0]);
		}
		else
		{
			snprintf(gDiagResultDescription,4000,"ECU对22服务回复了非预期的肯定响应0x%02x",gTpRxData[0]);
		}
		Diag_SetReqCheckResult(reqGroup,reqNum,RESULT_FAIL,gDiagResultDescription);
		return 1;
	}
	if(gTpRxData[1]!=PID[0] || gTpRxData[2]!=PID[1])
	{
		if(gUDS_LanguageSet == 0)
		{
			snprintf(gDiagResultDescription,4000,"ECU gives posotive response, but the response DID is wrong");
		}
		else
		{
			snprintf(gDiagResultDescription,4000,"ECU对22服务回复了错误的DID");
		}
		Diag_SetReqCheckResult(reqGroup,reqNum,RESULT_FAIL,gDiagResultDescription);
		return 1;
	}
	else
	{
		if(gUDS_DescriptionExistFlag == 1)
		{
			if(gUDS_LanguageSet == 0)
			{
				PrintPID("UDS","Pos.Response",gTpRxData,gTpRxLength);
			}
			else
			{
				PrintPID("UDS","肯定响应",gTpRxData,gTpRxLength);
			}
		}
		return 2;
	}
}

int CheckPosResponse_SID22(byte PID[])
{
	if((gBusFlag == 1)||(gBusFlag == 2)||(gBusFlag == 3)||(gBusFlag == 4)||(gBusFlag == 5))
  {
    if(SessionFlag==APP)
    {
      gRss=ECU_Response(gP2Client_APP,0x22);
    }
    else if(SessionFlag==BOOT)
    {
      gRss=ECU_Response(gP2Client_BOOT,0x22);
    }
    else
    {
       gRss=ECU_Response(gP2Client_APP,0x22);
    }
  }
	if(gRss!=POS)
	{
		if(gRss==TIMEOUT)
		{
			if(gUDS_LanguageSet == 0)
			{
				TestStep("UDS","ECU gives no response to supported DID %02x %02x of service 22",PID[0],PID[1]);
			}
			else
			{
				TestStep("UDS","请求超时，控制器对22服务如下DID未回复响应 ：%02x %02x",PID[0],PID[1]);
			}
			return -1;
		}
		else
		{
			if(gUDS_LanguageSet == 0)
			{
				TestStep("UDS","ECU gives negative response 0x%02x to the request of service 0x22",gTpRxData[2]);
			}
			else
			{
				TestStep("UDS","控制器对22服务如下DID回复了负响应%02x ：%02x %02x",gTpRxData[2],PID[0],PID[1]);
			}
			return -1;
		}
	}
	if(gTpRxData[0]!=0x62)
	{
		if(gUDS_LanguageSet == 0)
		{
			TestStep("UDS","ECU gives unexpect positive response service ID 0x%02x to the request of service 0x22",gTpRxData[0]);
		}
		else
		{
			TestStep("UDS","ECU对22服务回复了非预期的肯定响应0x%02x",gTpRxData[0]);
		}
		return 1;
	}
	if(gTpRxData[1]!=PID[0] || gTpRxData[2]!=PID[1])
	{
		if(gUDS_LanguageSet == 0)
		{
			TestStep("UDS","ECU gives posotive response, but the response DID is wrong");
		}
		else
		{
			TestStep("UDS","ECU对22服务回复了错误的DID");
		}
		return 1;
	}
	else
	{
		if(gUDS_DescriptionExistFlag == 1)
		{
			if(gUDS_LanguageSet == 0)
			{
				TestStep("UDS","Pos.Response");
			}
			else
			{
				TestStep("UDS","肯定响应");
			}
		}
		return 2;
	}
}

Void SID23_ReadMemoryByAdress(byte addressAndLengthFormatIdentifier,byte MemoryAddress[],byte MemorySize[],enum AddressMode Mode)
{
	int i,length;
	byte SID23[15];
	int  LenthOfADD;
	int  LenthOfSize;
	SID23[0]=0x23;
	SID23[1]=addressAndLengthFormatIdentifier;
	LenthOfSize=addressAndLengthFormatIdentifier>>4;
	LenthOfADD=addressAndLengthFormatIdentifier&0x0F;
	for(i=0; i<LenthOfADD; i++)
		SID23[i+2]=MemoryAddress[i];
	for(i=0; i<LenthOfSize; i++)
		SID23[i+2+LenthOfADD]=MemorySize[i];
	TP_Send(SID23,LenthOfADD+LenthOfSize+2,Mode);
	if(gUDS_DescriptionExistFlag == 1)
	{
		if(gUDS_LanguageSet == 0)
		{
			PrintPID("UDS","Request ",SID23,LenthOfADD+LenthOfSize+2);
		}
		else
		{
			PrintPID("UDS","发送请求 ",SID23,LenthOfADD+LenthOfSize+2);
		}
	}
}

int CheckPosResponse_SID23(int ExpectLength,int reqGroup,int reqNum)
{
	if((gBusFlag == 1)||(gBusFlag == 2)||(gBusFlag == 3)||(gBusFlag == 4)||(gBusFlag == 5))
  {
    if(SessionFlag==APP)
    {
      gRss=ECU_Response(gP2Client_APP,0x23);
    }
    else if(SessionFlag==BOOT)
    {
      gRss=ECU_Response(gP2Client_BOOT,0x23);
    }
    else
    {
       gRss=ECU_Response(gP2Client_APP,0x23);
    }
  }
	if(gRss!=POS)
	{
		if(gRss==TIMEOUT)
		{
			if(gUDS_LanguageSet == 0)
			{
				snprintf(gDiagResultDescription,4000,"Timeout no response recived when request service 0x23");
			}
			else
			{
				snprintf(gDiagResultDescription,4000,"请求超时，控制器对23服务未回复响应");
			}
			Diag_SetReqCheckResult(reqGroup,reqNum,RESULT_FAIL,gDiagResultDescription);
			return -1;
		}
		else
		{
			if(gUDS_LanguageSet == 0)
			{
				snprintf(gDiagResultDescription,4000,"ECU gives negative response 0x%02x to the request of service 0x23",gTpRxData[2]);
			}
			else
			{
				snprintf(gDiagResultDescription,4000,"ECU对23服务回复了负响应0x%02x",gTpRxData[2]);
			}
			Diag_SetReqCheckResult(reqGroup,reqNum,RESULT_FAIL,gDiagResultDescription);
			return -1;
		}
	}
	if(gTpRxData[0]!=0x63)
	{
		if(gUDS_LanguageSet == 0)
		{
			snprintf(gDiagResultDescription,4000,"ECU gives unexpect positive response service ID 0x%02x to the request of service 0x23",gTpRxData[0]);
		}
		else
		{
			snprintf(gDiagResultDescription,4000,"ECU对23服务回复了非预期的肯定响应0x%02x",gTpRxData[0]);
		}
		Diag_SetReqCheckResult(reqGroup,reqNum,RESULT_FAIL,gDiagResultDescription);
		return 1;
	}
	else if(ExpectLength!=gTpRxLength-1)
	{
		if(gUDS_LanguageSet == 0)
		{
			snprintf(gDiagResultDescription,4000,"ECU gives unexpect lenth to the request of service 0x23");
		}
		else
		{
			snprintf(gDiagResultDescription,4000,"ECU对23服务回复了错误的长度");
		}
		Diag_SetReqCheckResult(reqGroup,reqNum,RESULT_FAIL,gDiagResultDescription);
		return 1;
	}
	else
	{
		if(gUDS_DescriptionExistFlag == 1)
		{
			if(gUDS_LanguageSet == 0)
			{
				PrintPID("UDS","Pos.Response",gTpRxData,gTpRxLength);
			}
			else
			{
				PrintPID("UDS","肯定响应",gTpRxData,gTpRxLength);
			}
		}
		return 2;
	}
}

int CheckPosResponse_SID23(int reqGroup,int reqNum)
{
	if((gBusFlag == 1)||(gBusFlag == 2)||(gBusFlag == 3)||(gBusFlag == 4)||(gBusFlag == 5))
  {
    if(SessionFlag==APP)
    {
      gRss=ECU_Response(gP2Client_APP,0x23);
    }
    else if(SessionFlag==BOOT)
    {
      gRss=ECU_Response(gP2Client_BOOT,0x23);
    }
    else
    {
       gRss=ECU_Response(gP2Client_APP,0x23);
    }
  }
	if(gRss!=POS)
	{
		if(gRss==TIMEOUT)
		{
			if(gUDS_LanguageSet == 0)
			{
				snprintf(gDiagResultDescription,4000,"Timeout no response recived when request service 0x23");
			}
			else
			{
				snprintf(gDiagResultDescription,4000,"请求超时，控制器对23服务未回复响应");
			}
			Diag_SetReqCheckResult(reqGroup,reqNum,RESULT_FAIL,gDiagResultDescription);
			return -1;
		}
		else
		{
			if(gUDS_LanguageSet == 0)
			{
				snprintf(gDiagResultDescription,4000,"ECU gives negative response 0x%02x to the request of service 0x23",gTpRxData[2]);
			}
			else
			{
				snprintf(gDiagResultDescription,4000,"ECU对23服务回复了负响应0x%02x",gTpRxData[2]);
			}
			Diag_SetReqCheckResult(reqGroup,reqNum,RESULT_FAIL,gDiagResultDescription);
			return -1;
		}
	}
	if(gTpRxData[0]!=0x63)
	{
		if(gUDS_LanguageSet == 0)
		{
			snprintf(gDiagResultDescription,4000,"ECU gives unexpect positive response service ID 0x%02x to the request of service 0x23",gTpRxData[0]);
		}
		else
		{
			snprintf(gDiagResultDescription,4000,"ECU对23服务回复了非预期的肯定响应0x%02x",gTpRxData[0]);
		}
		Diag_SetReqCheckResult(reqGroup,reqNum,RESULT_FAIL,gDiagResultDescription);
		return 1;
	}
	else
	{
		if(gUDS_DescriptionExistFlag == 1)
		{
			if(gUDS_LanguageSet == 0)
			{
				PrintPID("UDS","Pos.Response",gTpRxData,gTpRxLength);
			}
			else
			{
				PrintPID("UDS","肯定响应",gTpRxData,gTpRxLength);
			}
		}
		return 2;
	}
}

void SID2A_ReadDataByPeriodicIdentifier(enum e_TransmissionMode TMode,byte PID[],enum AddressMode Mode)
{
	byte SID2A[20];
	int  i;
	SID2A[0]=0x2A;
	SID2A[1]=TMode;
	for(i=0; i<elCount(PID); i++)
		SID2A[i+2]=PID[i];
	TP_Send(SID2A,elCount(PID)+2,Mode);
	if(gUDS_DescriptionExistFlag == 1)
	{
		if(gUDS_LanguageSet == 0)
		{
			PrintPID("UDS","Request ",SID2A,elCount(SID2A));
		}
		else
		{
			PrintPID("UDS","发送请求 ",SID2A,elCount(SID2A));
		}
	}
}

void SID2A_ReadDataByPeriodicIdentifier_Stop(enum AddressMode Mode)
{
	byte SID2A[2];
	SID2A[0]=0x2A;
	SID2A[1]=0x04;
	TP_Send(SID2A,Mode);
	if(gUDS_DescriptionExistFlag == 1)
	{
		if(gUDS_LanguageSet == 0)
		{
			PrintPID("UDS","Request ",SID2A,elCount(SID2A));
		}
		else
		{
			PrintPID("UDS","发送请求 ",SID2A,elCount(SID2A));
		}
	}
}

int CheckPosResponse_SID2A(int reqGroup,int reqNum)
{
	if((gBusFlag == 1)||(gBusFlag == 2)||(gBusFlag == 3)||(gBusFlag == 4)||(gBusFlag == 5))
  {
    if(SessionFlag==APP)
    {
      gRss=ECU_Response(gP2Client_APP,0x2A);
    }
    else if(SessionFlag==BOOT)
    {
      gRss=ECU_Response(gP2Client_BOOT,0x2A);
    }
    else
    {
       gRss=ECU_Response(gP2Client_APP,0x2A);
    }
  }
	if(gRss!=POS)
	{
		if(gRss==TIMEOUT)
		{
			if(gUDS_LanguageSet == 0)
			{
				snprintf(gDiagResultDescription,4000,"Timeout no response recived when request service 0x2A");
			}
			else
			{
				snprintf(gDiagResultDescription,4000,"请求超时，控制器对2A服务未回复响应");
			}
			Diag_SetReqCheckResult(reqGroup,reqNum,RESULT_FAIL,gDiagResultDescription);
			return -1;
		}
		else
		{
			if(gUDS_LanguageSet == 0)
			{
				snprintf(gDiagResultDescription,4000,"ECU gives negative response 0x%02x to the request of service 0x2A",gTpRxData[2]);
			}
			else
			{
				snprintf(gDiagResultDescription,4000,"ECU对2A服务回复了负响应0x%02x",gTpRxData[2]);
			}
			Diag_SetReqCheckResult(reqGroup,reqNum,RESULT_FAIL,gDiagResultDescription);
			return -1;
		}
	}
	if(gTpRxData[0]!=0x6A)
	{
		if(gUDS_LanguageSet == 0)
		{
			snprintf(gDiagResultDescription,4000,"ECU gives unexpect positive response service ID 0x%02x to the request of service 0x2A",gTpRxData[0]);
		}
		else
		{
			snprintf(gDiagResultDescription,4000,"ECU对2A服务回复了非预期的肯定响应0x%02x",gTpRxData[0]);
		}
		Diag_SetReqCheckResult(reqGroup,reqNum,RESULT_FAIL,gDiagResultDescription);
		return 1;
	}
	else
	{
		if(gUDS_DescriptionExistFlag == 1)
		{
			if(gUDS_LanguageSet == 0)
			{
				PrintPID("UDS","Pos.Response",gTpRxData,gTpRxLength);
			}
			else
			{
				PrintPID("UDS","肯定响应",gTpRxData,gTpRxLength);
			}
		}
		return 2;
	}
}



void SID2E_WriteDataByIdentifier(byte PID[],byte RawData[],enum AddressMode Mode)
{
	byte SID2E[4096];
	int  i;
	SID2E[0]=0x2E;
	SID2E[1]=PID[0];
	SID2E[2]=PID[1];
	for(i=0; i<elCount(RawData); i++)
		SID2E[i+3]=RawData[i];
	TP_Send(SID2E,elCount(RawData)+3,Mode);
	if(gUDS_DescriptionExistFlag == 1)
	{
		if(gUDS_LanguageSet == 0)
		{
			PrintPID("UDS","Request ",SID2E,elCount(RawData)+3);
		}
		else
		{
			PrintPID("UDS","发送请求 ",SID2E,elCount(RawData)+3);
		}
	}
}

void SID2E_WriteDataByIdentifier(byte PID[],byte RawData[],int lenth,enum AddressMode Mode)
{
	byte SID2E[4096];
	int  i;
	SID2E[0]=0x2E;
	SID2E[1]=PID[0];
	SID2E[2]=PID[1];
	for(i=0; i<lenth; i++)
		SID2E[i+3]=RawData[i];
	TP_Send(SID2E,lenth+3,Mode);
	if(gUDS_DescriptionExistFlag == 1)
	{
		if(gUDS_LanguageSet == 0)
		{
			PrintPID("UDS","Request ",SID2E,lenth+3);
		}
		else
		{
			PrintPID("UDS","发送请求 ",SID2E,lenth+3);
		}
	}
}

int CheckPosResponse_SID2E(byte PID[],int reqGroup,int reqNum)
{
	if((gBusFlag == 1)||(gBusFlag == 2)||(gBusFlag == 3)||(gBusFlag == 4)||(gBusFlag == 5))
  {
    if(SessionFlag==APP)
    {
      gRss=ECU_Response(gP2Client_APP,0x2E);
    }
    else if(SessionFlag==BOOT)
    {
      gRss=ECU_Response(gP2Client_BOOT,0x2E);
    }
    else
    {
       gRss=ECU_Response(gP2Client_APP,0x2E);
    }
  }
	if(gRss!=POS)
	{
		if(gRss==TIMEOUT)
		{
			if(gUDS_LanguageSet == 0)
			{
				snprintf(gDiagResultDescription,4000,"ECU gives no response to supported DID %02x %02x of service 2E",PID[0],PID[1]);
			}
			else
			{
				snprintf(gDiagResultDescription,4000,"请求超时，控制器对2E服务如下DID未回复响应 ：%02x %02x",PID[0],PID[1]);
			}
			Diag_SetReqCheckResult(reqGroup,reqNum,RESULT_FAIL,gDiagResultDescription);
			return -1;
		}
		else
		{
			if(gUDS_LanguageSet == 0)
			{
				snprintf(gDiagResultDescription,4000,"ECU gives negative response 0x%02x to the request of service 0x2E",gTpRxData[2]);
			}
			else
			{
				snprintf(gDiagResultDescription,4000,"请求超时，控制器对2E服务如下DID回复了负响应%02x ：%02x %02x",gTpRxData[2],PID[0],PID[1]);
			}
			Diag_SetReqCheckResult(reqGroup,reqNum,RESULT_FAIL,gDiagResultDescription);
			return -1;
		}
	}
	if(gTpRxData[0]!=0x6E)
	{
		if(gUDS_LanguageSet == 0)
		{
			snprintf(gDiagResultDescription,4000,"ECU gives unexpect positive response service ID 0x%02x to the request of service 0x2E",gTpRxData[0]);
		}
		else
		{
			snprintf(gDiagResultDescription,4000,"ECU对2E服务回复了非预期的肯定响应0x%02x",gTpRxData[0]);
		}
		Diag_SetReqCheckResult(reqGroup,reqNum,RESULT_FAIL,gDiagResultDescription);
		return 1;
	}
	if(gTpRxData[1]!=PID[0] && gTpRxData[2]!=PID[1])
	{
		if(gUDS_LanguageSet == 0)
		{
			snprintf(gDiagResultDescription,4000,"ECU gives posotive response, but the response DID is wrong");
		}
		else
		{
			snprintf(gDiagResultDescription,4000,"ECU对2E服务回复了错误的DID");
		}
		Diag_SetReqCheckResult(reqGroup,reqNum,RESULT_FAIL,gDiagResultDescription);
		return 1;
	}
	if(3!=gTpRxLength)
	{
		if(gUDS_LanguageSet == 0)
		{
			snprintf(gDiagResultDescription,4000,"ECU gives unexpect lenth to the request of service 0x2E");
		}
		else
		{
			snprintf(gDiagResultDescription,4000,"ECU对2E服务回复了错误的长度");
		}
		Diag_SetReqCheckResult(reqGroup,reqNum,RESULT_FAIL,gDiagResultDescription);
		return 1;
	}
	else
	{
		if(gUDS_DescriptionExistFlag == 1)
		{
			if(gUDS_LanguageSet == 0)
			{
				PrintPID("UDS","Pos.Response",gTpRxData,gTpRxLength);
			}
			else
			{
				PrintPID("UDS","肯定响应",gTpRxData,gTpRxLength);
			}
		}
		return 2;
	}
}



void SID14_ClearDTC(byte DTC[],enum AddressMode Mode)
{
	byte SID14[4];
	SID14[0]=0x14;
	SID14[1]=DTC[0];
	SID14[2]=DTC[1];
	SID14[3]=DTC[2];
	TP_Send(SID14,Mode);
	if(gUDS_DescriptionExistFlag == 1)
	{
		if(gUDS_LanguageSet == 0)
		{
			PrintPID("UDS","Request ",SID14,elCount(SID14));
		}
		else
		{
			PrintPID("UDS","发送请求 ",SID14,elCount(SID14));
		}
	}
}

int CheckPosResponse_SID14(int reqGroup,int reqNum)
{
	if((gBusFlag == 1)||(gBusFlag == 2)||(gBusFlag == 3)||(gBusFlag == 4)||(gBusFlag == 5))
  {
    if(SessionFlag==APP)
    {
      gRss=ECU_Response(gP2Client_APP,0x14);
    }
    else if(SessionFlag==BOOT)
    {
      gRss=ECU_Response(gP2Client_BOOT,0x14);
    }
    else
    {
       gRss=ECU_Response(gP2Client_APP,0x14);
    }
  }
	if(gRss!=POS)
	{
		if(gRss==TIMEOUT)
		{
			if(gUDS_LanguageSet == 0)
			{
				snprintf(gDiagResultDescription,4000,"Timeout no response recived when request service 0x14");
			}
			else
			{
				snprintf(gDiagResultDescription,4000,"请求超时，控制器对14服务未回复响应");
			}
			Diag_SetReqCheckResult(reqGroup,reqNum,RESULT_FAIL,gDiagResultDescription);
			return -1;
		}
		else
		{
			if(gUDS_LanguageSet == 0)
			{
				snprintf(gDiagResultDescription,4000,"ECU gives negative response 0x%02x to the request of service 0x14",gTpRxData[2]);
			}
			else
			{
				snprintf(gDiagResultDescription,4000,"ECU对14服务回复了负响应0x%02x",gTpRxData[2]);
			}
			Diag_SetReqCheckResult(reqGroup,reqNum,RESULT_FAIL,gDiagResultDescription);
			return -1;
		}
	}
	if(gTpRxData[0]!=0x54)
	{
		if(gUDS_LanguageSet == 0)
		{
			snprintf(gDiagResultDescription,4000,"ECU gives unexpect positive response service ID 0x%02x to the request of service 0x14",gTpRxData[0]);
		}
		else
		{
			snprintf(gDiagResultDescription,4000,"ECU对14服务回复了非预期的肯定响应0x%02x",gTpRxData[0]);
		}
		Diag_SetReqCheckResult(reqGroup,reqNum,RESULT_FAIL,gDiagResultDescription);
		return 1;
	}
	else if(1!=gTpRxLength)
	{
		if(gUDS_LanguageSet == 0)
		{
			snprintf(gDiagResultDescription,4000,"ECU gives unexpect lenth to the request of service 0x14");
		}
		else
		{
			snprintf(gDiagResultDescription,4000,"ECU对14服务回复了错误的长度");
		}
		Diag_SetReqCheckResult(reqGroup,reqNum,RESULT_FAIL,gDiagResultDescription);
		return 1;
	}
	else
	{
		if(gUDS_DescriptionExistFlag == 1)
		{
			if(gUDS_LanguageSet == 0)
			{
				PrintPID("UDS","Pos.Response",gTpRxData,gTpRxLength);
			}
			else
			{
				PrintPID("UDS","肯定响应",gTpRxData,gTpRxLength);
			}
		}
		return 2;
	}
}



void SID19_Sub01_ReportNumOfDTCByStatusMask(Byte Mask,enum AddressMode Mode)
{
	byte SID19[3];
	SID19[0]=0x19;
	SID19[1]=0x01;
	SID19[2]=Mask;
	TP_Send(SID19,Mode);
	if(gUDS_DescriptionExistFlag == 1)
	{
		if(gUDS_LanguageSet == 0)
		{
			PrintPID("UDS","Request ",SID19,elCount(SID19));
		}
		else
		{
			PrintPID("UDS","发送请求 ",SID19,elCount(SID19));
		}
	}
}

int CheckPosResponse_SID19_01(byte AvaliableMask,byte DTCFormatIdentifer,int reqGroup,int reqNum)
{
	if((gBusFlag == 1)||(gBusFlag == 2)||(gBusFlag == 3)||(gBusFlag == 4)||(gBusFlag == 5))
  {
    if(SessionFlag==APP)
    {
      gRss=ECU_Response(gP2Client_APP,0x19);
    }
    else if(SessionFlag==BOOT)
    {
      gRss=ECU_Response(gP2Client_BOOT,0x19);
    }
    else
    {
       gRss=ECU_Response(gP2Client_APP,0x19);
    }
  }
	if(gRss!=POS)
	{
		if(gRss==TIMEOUT)
		{
			if(gUDS_LanguageSet == 0)
			{
				snprintf(gDiagResultDescription,4000,"Timeout no response recived when request service 0x19");
			}
			else
			{
				snprintf(gDiagResultDescription,4000,"请求超时，控制器对19服务未回复响应");
			}
			Diag_SetReqCheckResult(reqGroup,reqNum,RESULT_FAIL,gDiagResultDescription);
			return -1;
		}
		else
		{
			if(gUDS_LanguageSet == 0)
			{
				snprintf(gDiagResultDescription,4000,"ECU gives negative response 0x%02x to the request of service 0x19",gTpRxData[2]);
			}
			else
			{
				snprintf(gDiagResultDescription,4000,"ECU对19服务回复了负响应0x%02x",gTpRxData[2]);
			}
			Diag_SetReqCheckResult(reqGroup,reqNum,RESULT_FAIL,gDiagResultDescription);
			return -1;
		}
	}
	if(gTpRxData[0]!=0x59)
	{
		if(gUDS_LanguageSet == 0)
		{
			snprintf(gDiagResultDescription,4000,"ECU gives unexpect positive response service ID 0x%02x to the request of service 0x19",gTpRxData[0]);
		}
		else
		{
			snprintf(gDiagResultDescription,4000,"ECU对19服务回复了非预期的肯定响应0x%02x",gTpRxData[0]);
		}
		Diag_SetReqCheckResult(reqGroup,reqNum,RESULT_FAIL,gDiagResultDescription);
		return 1;
	}
	if(gTpRxData[1]!=0x01)
	{
		if(gUDS_LanguageSet == 0)
		{
			snprintf(gDiagResultDescription,4000,"ECU gives unexpect subfunction 0x%02x to the request of service 0x19",gTpRxData[1]);
		}
		else
		{
			snprintf(gDiagResultDescription,4000,"ECU对19服务回复了非预期的子功能0x%02x",gTpRxData[1]);
		}
		Diag_SetReqCheckResult(reqGroup,reqNum,RESULT_FAIL,gDiagResultDescription);
		return 1;
	}
	if(gTpRxData[2]!=AvaliableMask)
	{
		if(gUDS_LanguageSet == 0)
		{
			snprintf(gDiagResultDescription,4000,"ECU gives unexpect Avaliable Mask 0x%02x to the request of service 0x19",gTpRxData[2]);
		}
		else
		{
			snprintf(gDiagResultDescription,4000,"ECU对19服务响应了非预期的有效掩码%02x",gTpRxData[2]);
		}
		Diag_SetReqCheckResult(reqGroup,reqNum,RESULT_FAIL,gDiagResultDescription);
		return 1;
	}
	if(gTpRxData[3]!=DTCFormatIdentifer)
	{
		if(gUDS_LanguageSet == 0)
		{
			snprintf(gDiagResultDescription,4000,"ECU gives unexpect DTC format identifer 0x%02x to the request of service 0x19",gTpRxData[3]);
		}
		else
		{
			snprintf(gDiagResultDescription,4000,"ECU对19服务响应了非预期的DTC类型标识符%02x",gTpRxData[3]);
		}
		Diag_SetReqCheckResult(reqGroup,reqNum,RESULT_FAIL,gDiagResultDescription);
		return 1;
	}
	else
	{
		if(gUDS_DescriptionExistFlag == 1)
		{
			if(gUDS_LanguageSet == 0)
			{
				PrintPID("UDS","Pos.Response",gTpRxData,gTpRxLength);
			}
			else
			{
				PrintPID("UDS","肯定响应",gTpRxData,gTpRxLength);
			}
		}
		return 2;
	}
}


void SID19_Sub02_ReportDTCByStatusMask(Byte Mask,enum AddressMode Mode)
{
	byte SID19[3];
	SID19[0]=0x19;
	SID19[1]=0x02;
	SID19[2]=Mask;
	TP_Send(SID19,Mode);
	if(gUDS_DescriptionExistFlag == 1)
	{
		if(gUDS_LanguageSet == 0)
		{
			PrintPID("UDS","Request ",SID19,elCount(SID19));
		}
		else
		{
			PrintPID("UDS","发送请求 ",SID19,elCount(SID19));
		}
	}
}

int CheckPosResponse_SID19_02(byte AvaliableMask,int reqGroup,int reqNum)
{
	if((gBusFlag == 1)||(gBusFlag == 2)||(gBusFlag == 3)||(gBusFlag == 4)||(gBusFlag == 5))
  {
    if(SessionFlag==APP)
    {
      gRss=ECU_Response(gP2Client_APP,0x19);
    }
    else if(SessionFlag==BOOT)
    {
      gRss=ECU_Response(gP2Client_BOOT,0x19);
    }
    else
    {
       gRss=ECU_Response(gP2Client_APP,0x19);
    }
  }
	if(gRss!=POS)
	{
		if(gRss==TIMEOUT)
		{
			if(gUDS_LanguageSet == 0)
			{
				snprintf(gDiagResultDescription,4000,"Timeout no response recived when request service 0x19");
			}
			else
			{
				snprintf(gDiagResultDescription,4000,"请求超时，控制器对19服务未回复响应");
			}
			Diag_SetReqCheckResult(reqGroup,reqNum,RESULT_FAIL,gDiagResultDescription);
			return -1;
		}
		else
		{
			if(gUDS_LanguageSet == 0)
			{
				snprintf(gDiagResultDescription,4000,"ECU gives negative response 0x%02x to the request of service 0x19",gTpRxData[2]);
			}
			else
			{
				snprintf(gDiagResultDescription,4000,"ECU对19服务回复了负响应0x%02x",gTpRxData[2]);
			}
			Diag_SetReqCheckResult(reqGroup,reqNum,RESULT_FAIL,gDiagResultDescription);
			return -1;
		}
	}
	if(gTpRxData[0]!=0x59)
	{
		if(gUDS_LanguageSet == 0)
		{
			snprintf(gDiagResultDescription,4000,"ECU gives unexpect positive response service ID 0x%02x to the request of service 0x19",gTpRxData[0]);
		}
		else
		{
			snprintf(gDiagResultDescription,4000,"ECU对19服务回复了非预期的肯定响应0x%02x",gTpRxData[0]);
		}
		Diag_SetReqCheckResult(reqGroup,reqNum,RESULT_FAIL,gDiagResultDescription);
		return 1;
	}
	if(gTpRxData[1]!=0x02)
	{
		if(gUDS_LanguageSet == 0)
		{
			snprintf(gDiagResultDescription,4000,"ECU gives unexpect subfunction 0x%02x to the request of service 0x19",gTpRxData[1]);
		}
		else
		{
			snprintf(gDiagResultDescription,4000,"ECU对19服务回复了非预期的子功能0x%02x",gTpRxData[1]);
		}
		Diag_SetReqCheckResult(reqGroup,reqNum,RESULT_FAIL,gDiagResultDescription);
		return 1;
	}
	if(gTpRxData[2]!=AvaliableMask)
	{
		if(gUDS_LanguageSet == 0)
		{
			snprintf(gDiagResultDescription,4000,"ECU gives unexpect Avaliable Mask 0x%02x to the request of service 0x19",gTpRxData[2]);
		}
		else
		{
			snprintf(gDiagResultDescription,4000,"ECU对19服务响应了非预期的有效掩码%02x",gTpRxData[2]);
		}
		Diag_SetReqCheckResult(reqGroup,reqNum,RESULT_FAIL,gDiagResultDescription);
		return 1;
	}
	if(3!=(gTpRxLength%4))
	{
		if(gUDS_LanguageSet == 0)
		{
			snprintf(gDiagResultDescription,4000,"ECU gives unexpect lenth to the request of service 0x19");
		}
		else
		{
			snprintf(gDiagResultDescription,4000,"ECU对19服务回复了错误的长度");
		}
		Diag_SetReqCheckResult(reqGroup,reqNum,RESULT_FAIL,gDiagResultDescription);
		return 1;
	}
	else
	{
		if(gUDS_DescriptionExistFlag == 1)
		{
			if(gUDS_LanguageSet == 0)
			{
				PrintPID("UDS","Pos.Response",gTpRxData,gTpRxLength);
			}
			else
			{
				PrintPID("UDS","肯定响应",gTpRxData,gTpRxLength);
			}
		}
		return 2;
	}

}

int CheckPosResponse_SID19_02(int reqGroup,int reqNum)
{
	if((gBusFlag == 1)||(gBusFlag == 2)||(gBusFlag == 3)||(gBusFlag == 4)||(gBusFlag == 5))
  {
    if(SessionFlag==APP)
    {
      gRss=ECU_Response(gP2Client_APP,0x19);
    }
    else if(SessionFlag==BOOT)
    {
      gRss=ECU_Response(gP2Client_BOOT,0x19);
    }
    else
    {
       gRss=ECU_Response(gP2Client_APP,0x19);
    }
  }
	if(gRss!=POS)
	{
		if(gRss==TIMEOUT)
		{
			if(gUDS_LanguageSet == 0)
			{
				snprintf(gDiagResultDescription,4000,"Timeout no response recived when request service 0x19");
			}
			else
			{
				snprintf(gDiagResultDescription,4000,"请求超时，控制器对19服务未回复响应");
			}
			Diag_SetReqCheckResult(reqGroup,reqNum,RESULT_FAIL,gDiagResultDescription);
			return -1;
		}
		else
		{
			if(gUDS_LanguageSet == 0)
			{
				snprintf(gDiagResultDescription,4000,"ECU gives negative response 0x%02x to the request of service 0x19",gTpRxData[2]);
			}
			else
			{
				snprintf(gDiagResultDescription,4000,"ECU对19服务回复了负响应0x%02x",gTpRxData[2]);
			}
			Diag_SetReqCheckResult(reqGroup,reqNum,RESULT_FAIL,gDiagResultDescription);
			return -1;
		}
	}
	if(gTpRxData[0]!=0x59)
	{
		if(gUDS_LanguageSet == 0)
		{
			snprintf(gDiagResultDescription,4000,"ECU gives unexpect positive response service ID 0x%02x to the request of service 0x19",gTpRxData[0]);
		}
		else
		{
			snprintf(gDiagResultDescription,4000,"ECU对19服务回复了非预期的肯定响应0x%02x",gTpRxData[0]);
		}
		Diag_SetReqCheckResult(reqGroup,reqNum,RESULT_FAIL,gDiagResultDescription);
		return 1;
	}
	if(gTpRxData[1]!=0x02)
	{
		if(gUDS_LanguageSet == 0)
		{
			snprintf(gDiagResultDescription,4000,"ECU gives unexpect subfunction 0x%02x to the request of service 0x19",gTpRxData[1]);
		}
		else
		{
			snprintf(gDiagResultDescription,4000,"ECU对19服务回复了非预期的子功能0x%02x",gTpRxData[1]);
		}
		Diag_SetReqCheckResult(reqGroup,reqNum,RESULT_FAIL,gDiagResultDescription);
		return 1;
	}
	if(3!=(gTpRxLength%4))
	{
		if(gUDS_LanguageSet == 0)
		{
			snprintf(gDiagResultDescription,4000,"ECU gives unexpect lenth to the request of service 0x19");
		}
		else
		{
			snprintf(gDiagResultDescription,4000,"ECU对19服务回复了错误的长度");
		}
		Diag_SetReqCheckResult(reqGroup,reqNum,RESULT_FAIL,gDiagResultDescription);
		return 1;
	}
	else
	{
		if(gUDS_DescriptionExistFlag == 1)
		{
			if(gUDS_LanguageSet == 0)
			{
				PrintPID("UDS","Pos.Response",gTpRxData,gTpRxLength);
			}
			else
			{
				PrintPID("UDS","肯定响应",gTpRxData,gTpRxLength);
			}
		}
		return 2;
	}

}

void SID19_Sub55(Byte group,enum AddressMode Mode)
{
	byte SID19[3];
	SID19[0]=0x19;
	SID19[1]=0x55;
	SID19[2]=group;
	TP_Send(SID19,Mode);
	if(gUDS_DescriptionExistFlag == 1)
	{
		if(gUDS_LanguageSet == 0)
		{
			PrintPID("UDS","Request ",SID19,elCount(SID19));
		}
		else
		{
			PrintPID("UDS","发送请求 ",SID19,elCount(SID19));
		}
	}
}

int CheckPosResponse_SID19_55(byte AvaliableMask,byte group)
{
	if((gBusFlag == 1)||(gBusFlag == 2)||(gBusFlag == 3)||(gBusFlag == 4)||(gBusFlag == 5))
  {
    if(SessionFlag==APP)
    {
      gRss=ECU_Response(gP2Client_APP,0x19);
    }
    else if(SessionFlag==BOOT)
    {
      gRss=ECU_Response(gP2Client_BOOT,0x19);
    }
    else
    {
       gRss=ECU_Response(gP2Client_APP,0x19);
    }
  }
	if(gRss!=POS)
	{
		if(gRss==TIMEOUT)
		{
			if(gUDS_LanguageSet == 0)
			{
				snprintf(gDiagResultDescription,4000,"Timeout no response recived when request service 0x19");
			}
			else
			{
				snprintf(gDiagResultDescription,4000,"请求超时，控制器对19服务未回复响应");
			}
			testStepFail("CHK",gDiagResultDescription);
			return -1;
		}
		else
		{
      PrintPID("UDS","Response",gTpRxData,gTpRxLength);
			if(gUDS_LanguageSet == 0)
			{
				snprintf(gDiagResultDescription,4000,"ECU gives negative response 0x%02x to the request of service 0x19",gTpRxData[2]);
			}
			else
			{
				snprintf(gDiagResultDescription,4000,"ECU对19服务回复了负响应0x%02x",gTpRxData[2]);
			}
			testStepFail("CHK",gDiagResultDescription);
			return -1;
		}
	}
  PrintPID("UDS","Response",gTpRxData,gTpRxLength);
	if(gTpRxData[0]!=0x59)
	{
		if(gUDS_LanguageSet == 0)
		{
			snprintf(gDiagResultDescription,4000,"ECU gives unexpect positive response service ID 0x%02x to the request of service 0x19",gTpRxData[0]);
		}
		else
		{
			snprintf(gDiagResultDescription,4000,"ECU对19服务回复了非预期的肯定响应0x%02x",gTpRxData[0]);
		}
		testStepFail("CHK",gDiagResultDescription);
		return 1;
	}
	if(gTpRxData[1]!=0x55)
	{
		if(gUDS_LanguageSet == 0)
		{
			snprintf(gDiagResultDescription,4000,"ECU gives unexpect subfunction 0x%02x to the request of service 0x19",gTpRxData[1]);
		}
		else
		{
			snprintf(gDiagResultDescription,4000,"ECU对19服务回复了非预期的子功能0x%02x",gTpRxData[1]);
		}
		testStepFail("CHK",gDiagResultDescription);
		return 1;
	}
  
  if(gTpRxData[2]!=group)
	{
		if(gUDS_LanguageSet == 0)
		{
			snprintf(gDiagResultDescription,4000,"ECU gives unexpect FunctionalGroupIdentifier 0x%02x to the request of service 0x19",gTpRxData[2]);
		}
		else
		{
			snprintf(gDiagResultDescription,4000,"ECU对19服务响应了非预期的有效FunctionalGroupIdentifier%02x",gTpRxData[2]);
		}
		testStepFail("CHK",gDiagResultDescription);
		return 1;
	}
  
	if(gTpRxData[3]!=AvaliableMask)
	{
		if(gUDS_LanguageSet == 0)
		{
			snprintf(gDiagResultDescription,4000,"ECU gives unexpect Avaliable Mask 0x%02x to the request of service 0x19",gTpRxData[2]);
		}
		else
		{
			snprintf(gDiagResultDescription,4000,"ECU对19服务响应了非预期的有效掩码%02x",gTpRxData[2]);
		}
		testStepFail("CHK",gDiagResultDescription);
		return 1;
	}
  
  if(gTpRxData[4]!=0x04 && gTpRxData[4]!=0x02)
	{
		if(gUDS_LanguageSet == 0)
		{
			snprintf(gDiagResultDescription,4000,"ECU gives unexpect DTCFormatIdentifier 0x%02x to the request of service 0x19",gTpRxData[2]);
		}
		else
		{
			snprintf(gDiagResultDescription,4000,"ECU对19服务响应了非预期的有效DTCFormatIdentifier %02x",gTpRxData[2]);
		}
		testStepFail("CHK",gDiagResultDescription);
		return 1;
	}
  teststep("","gTpRxLength=%d",gTpRxLength);
	if((gTpRxLength-5)%4 != 0)
	{
		if(gUDS_LanguageSet == 0)
		{
			snprintf(gDiagResultDescription,4000,"ECU gives unexpect lenth to the request of service 0x19");
		}
		else
		{
			snprintf(gDiagResultDescription,4000,"ECU对19服务回复了错误的长度");
		}
		testStepFail("CHK",gDiagResultDescription);
		return 1;
	}
	else
	{
//		if(gUDS_DescriptionExistFlag == 1)
//		{
//			if(gUDS_LanguageSet == 0)
//			{
//				PrintPID("UDS","Pos.Response",gTpRxData,gTpRxLength);
//			}
//			else
//			{
//				PrintPID("UDS","肯定响应",gTpRxData,gTpRxLength);
//			}
//		}
		return 2;
	}

}

//
Void SID19_Sub03_ReportDTCSnapshotIdentification(enum AddressMode Mode)
{
	byte SID19[2];
	SID19[0]=0x19;
	SID19[1]=0x03;
	TP_Send(SID19,Mode);
	if(gUDS_DescriptionExistFlag == 1)
	{
		if(gUDS_LanguageSet == 0)
		{
			PrintPID("UDS","Request ",SID19,elCount(SID19));
		}
		else
		{
			PrintPID("UDS","发送请求 ",SID19,elCount(SID19));
		}
	}
}
//
int CheckPosResponse_SID19_03(int reqGroup,int reqNum)
{
	if((gBusFlag == 1)||(gBusFlag == 2)||(gBusFlag == 3)||(gBusFlag == 4)||(gBusFlag == 5))
  {
    if(SessionFlag==APP)
    {
      gRss=ECU_Response(gP2Client_APP,0x19);
    }
    else if(SessionFlag==BOOT)
    {
      gRss=ECU_Response(gP2Client_BOOT,0x19);
    }
    else
    {
       gRss=ECU_Response(gP2Client_APP,0x19);
    }
  }
	if(gRss!=POS)
	{
		if(gRss==TIMEOUT)
		{
			if(gUDS_LanguageSet == 0)
			{
				snprintf(gDiagResultDescription,4000,"Timeout no response recived when request service 0x19");
			}
			else
			{
				snprintf(gDiagResultDescription,4000,"请求超时，控制器对19服务未回复响应");
			}
			Diag_SetReqCheckResult(reqGroup,reqNum,RESULT_FAIL,gDiagResultDescription);
			return -1;
		}
		else
		{
			if(gUDS_LanguageSet == 0)
			{
				snprintf(gDiagResultDescription,4000,"ECU gives negative response 0x%02x to the request of service 0x19",gTpRxData[2]);
			}
			else
			{
				snprintf(gDiagResultDescription,4000,"ECU对19服务回复了负响应0x%02x",gTpRxData[2]);
			}
			Diag_SetReqCheckResult(reqGroup,reqNum,RESULT_FAIL,gDiagResultDescription);
			return -1;
		}
	}
	if(gTpRxData[0]!=0x59)
	{
		if(gUDS_LanguageSet == 0)
		{
			snprintf(gDiagResultDescription,4000,"ECU gives unexpect positive response service ID 0x%02x to the request of service 0x19",gTpRxData[0]);
		}
		else
		{
			snprintf(gDiagResultDescription,4000,"ECU对19服务回复了非预期的肯定响应0x%02x",gTpRxData[0]);
		}
		Diag_SetReqCheckResult(reqGroup,reqNum,RESULT_FAIL,gDiagResultDescription);
		return 1;
	}
	if(gTpRxData[1]!=0x03)
	{
		if(gUDS_LanguageSet == 0)
		{
			snprintf(gDiagResultDescription,4000,"ECU gives unexpect subfunction 0x%02x to the request of service 0x19",gTpRxData[1]);
		}
		else
		{
			snprintf(gDiagResultDescription,4000,"ECU对19服务回复了非预期的子功能0x%02x",gTpRxData[1]);
		}
		Diag_SetReqCheckResult(reqGroup,reqNum,RESULT_FAIL,gDiagResultDescription);
		return 1;
	}
	if(2!=(gTpRxLength%4))
	{
		if(gUDS_LanguageSet == 0)
		{
			snprintf(gDiagResultDescription,4000,"ECU gives unexpect lenth to the request of service 0x19");
		}
		else
		{
			snprintf(gDiagResultDescription,4000,"ECU对19服务回复了错误的长度");
		}
		Diag_SetReqCheckResult(reqGroup,reqNum,RESULT_FAIL,gDiagResultDescription);
		return 1;
	}
	else
	{
		if(gUDS_DescriptionExistFlag == 1)
		{
			if(gUDS_LanguageSet == 0)
			{
				PrintPID("UDS","Pos.Response",gTpRxData,gTpRxLength);
			}
			else
			{
				PrintPID("UDS","肯定响应",gTpRxData,gTpRxLength);
			}
		}
		return 2;
	}
}
//
void SID19_Sub04_ReportDTCSnapshotRecordByDTCNumber(Byte DTC[],Byte DTCSnapshotRecordNumber,enum AddressMode Mode)
{
	byte SID19[6];
	SID19[0]=0x19;
	SID19[1]=0x04;
	SID19[2]=DTC[0];
	SID19[3]=DTC[1];
	SID19[4]=DTC[2];
	SID19[5]=DTCSnapshotRecordNumber;
	TP_Send(SID19,Mode);
	if(gUDS_DescriptionExistFlag == 1)
	{
		if(gUDS_LanguageSet == 0)
		{
			PrintPID("UDS","Request ",SID19,elCount(SID19));
		}
		else
		{
			PrintPID("UDS","发送请求 ",SID19,elCount(SID19));
		}
	}
}
//
int CheckPosResponse_SID19_04(byte DTC[],int reqGroup,int reqNum)
{
	if((gBusFlag == 1)||(gBusFlag == 2)||(gBusFlag == 3)||(gBusFlag == 4)||(gBusFlag == 5))
  {
    if(SessionFlag==APP)
    {
      gRss=ECU_Response(gP2Client_APP,0x19);
    }
    else if(SessionFlag==BOOT)
    {
      gRss=ECU_Response(gP2Client_BOOT,0x19);
    }
    else
    {
       gRss=ECU_Response(gP2Client_APP,0x19);
    }
  }
	if(gRss!=POS)
	{
		if(gRss==TIMEOUT)
		{
			if(gUDS_LanguageSet == 0)
			{
				snprintf(gDiagResultDescription,4000,"Timeout no response recived when request service 0x19");
			}
			else
			{
				snprintf(gDiagResultDescription,4000,"请求超时，控制器对19服务未回复响应");
			}
			Diag_SetReqCheckResult(reqGroup,reqNum,RESULT_FAIL,gDiagResultDescription);
			return -1;
		}
		else
		{
			if(gUDS_LanguageSet == 0)
			{
				snprintf(gDiagResultDescription,4000,"ECU gives negative response 0x%02x to the request of service 0x19",gTpRxData[2]);
			}
			else
			{
				snprintf(gDiagResultDescription,4000,"ECU对19服务回复了负响应0x%02x",gTpRxData[2]);
			}
			Diag_SetReqCheckResult(reqGroup,reqNum,RESULT_FAIL,gDiagResultDescription);
			return -1;
		}
	}
	if(gTpRxData[0]!=0x59)
	{
		if(gUDS_LanguageSet == 0)
		{
			snprintf(gDiagResultDescription,4000,"ECU gives unexpect positive response service ID 0x%02x to the request of service 0x19",gTpRxData[0]);
		}
		else
		{
			snprintf(gDiagResultDescription,4000,"ECU对19服务回复了非预期的肯定响应0x%02x",gTpRxData[0]);
		}
		Diag_SetReqCheckResult(reqGroup,reqNum,RESULT_FAIL,gDiagResultDescription);
		return 1;
	}
	if(gTpRxData[1]!=0x04)
	{
		if(gUDS_LanguageSet == 0)
		{
			snprintf(gDiagResultDescription,4000,"ECU gives unexpect subfunction 0x%02x to the request of service 0x19",gTpRxData[1]);
		}
		else
		{
			snprintf(gDiagResultDescription,4000,"ECU对19服务回复了非预期的子功能0x%02x",gTpRxData[1]);
		}
		Diag_SetReqCheckResult(reqGroup,reqNum,RESULT_FAIL,gDiagResultDescription);
		return 1;
	}
	if((DTC[0]!=gTpRxData[2])||(DTC[1]!=gTpRxData[3])||(DTC[2]!=gTpRxData[4]))
	{
		if(gUDS_LanguageSet == 0)
		{
			snprintf(gDiagResultDescription,4000,"ECU gives unexpect DTC 0x%02x 0x%02x 0x%02x to the request of service 0x19 04",gTpRxData[2],gTpRxData[3],gTpRxData[4]);
		}
		else
		{
			snprintf(gDiagResultDescription,4000,"ECU对19服务响应了错误的DTC： 0x%02x 0x%02x 0x%02x",gTpRxData[2],gTpRxData[3],gTpRxData[4]);
		}
		Diag_SetReqCheckResult(reqGroup,reqNum,RESULT_FAIL,gDiagResultDescription);
		return 1;
	}
	else
	{
		if(gUDS_DescriptionExistFlag == 1)
		{
			if(gUDS_LanguageSet == 0)
			{
				PrintPID("UDS","Pos.Response",gTpRxData,gTpRxLength);
			}
			else
			{
				PrintPID("UDS","肯定响应",gTpRxData,gTpRxLength);
			}
		}
		return 2;
	}
}


//
void SID19_Sub06_ReportDTCExtendedDataRecordByDTCNumber(Byte DTC[],Byte DTCExtendedDataRecordNumber,enum AddressMode Mode)
{
	byte SID19[6];
	SID19[0]=0x19;
	SID19[1]=0x06;
	SID19[2]=DTC[0];
	SID19[3]=DTC[1];
	SID19[4]=DTC[2];
	SID19[5]=DTCExtendedDataRecordNumber;
	TP_Send(SID19,Mode);
	if(gUDS_DescriptionExistFlag == 1)
	{
		if(gUDS_LanguageSet == 0)
		{
			PrintPID("UDS","Request ",SID19,elCount(SID19));
		}
		else
		{
			PrintPID("UDS","发送请求 ",SID19,elCount(SID19));
		}
	}
}
//
int CheckPosResponse_SID19_06(byte DTC[],int reqGroup,int reqNum)
{
	if((gBusFlag == 1)||(gBusFlag == 2)||(gBusFlag == 3)||(gBusFlag == 4)||(gBusFlag == 5))
  {
    if(SessionFlag==APP)
    {
      gRss=ECU_Response(gP2Client_APP,0x19);
    }
    else if(SessionFlag==BOOT)
    {
      gRss=ECU_Response(gP2Client_BOOT,0x19);
    }
    else
    {
       gRss=ECU_Response(gP2Client_APP,0x19);
    }
  }
	if(gRss!=POS)
	{
		if(gRss==TIMEOUT)
		{
			if(gUDS_LanguageSet == 0)
			{
				snprintf(gDiagResultDescription,4000,"Timeout no response recived when request service 0x19");
			}
			else
			{
				snprintf(gDiagResultDescription,4000,"请求超时，控制器对19服务未回复响应");
			}
			Diag_SetReqCheckResult(reqGroup,reqNum,RESULT_FAIL,gDiagResultDescription);
			return -1;
		}
		else
		{
			if(gUDS_LanguageSet == 0)
			{
				snprintf(gDiagResultDescription,4000,"ECU gives negative response 0x%02x to the request of service 0x19",gTpRxData[2]);
			}
			else
			{
				snprintf(gDiagResultDescription,4000,"ECU对19服务回复了负响应0x%02x",gTpRxData[2]);
			}
			Diag_SetReqCheckResult(reqGroup,reqNum,RESULT_FAIL,gDiagResultDescription);
			return -1;
		}
	}
	if(gTpRxData[0]!=0x59)
	{
		if(gUDS_LanguageSet == 0)
		{
			snprintf(gDiagResultDescription,4000,"ECU gives unexpect positive response service ID 0x%02x to the request of service 0x19",gTpRxData[0]);
		}
		else
		{
			snprintf(gDiagResultDescription,4000,"ECU对19服务回复了非预期的肯定响应0x%02x",gTpRxData[0]);
		}
		Diag_SetReqCheckResult(reqGroup,reqNum,RESULT_FAIL,gDiagResultDescription);
		return 1;
	}
	if(gTpRxData[1]!=0x06)
	{
		if(gUDS_LanguageSet == 0)
		{
			snprintf(gDiagResultDescription,4000,"ECU gives unexpect subfunction 0x%02x to the request of service 0x19",gTpRxData[1]);
		}
		else
		{
			snprintf(gDiagResultDescription,4000,"ECU对19服务回复了非预期的子功能0x%02x",gTpRxData[1]);
		}
		Diag_SetReqCheckResult(reqGroup,reqNum,RESULT_FAIL,gDiagResultDescription);
		return 1;
	}
	if((DTC[0]!=gTpRxData[2])||(DTC[1]!=gTpRxData[3])||(DTC[2]!=gTpRxData[4]))
	{
		if(gUDS_LanguageSet == 0)
		{
			snprintf(gDiagResultDescription,4000,"ECU gives unexpect DTC 0x%02x 0x%02x 0x%02x to the request of service 0x19 04",gTpRxData[2],gTpRxData[3],gTpRxData[4]);
		}
		else
		{
			snprintf(gDiagResultDescription,4000,"ECU对19服务响应了错误的DTC： 0x%02x 0x%02x 0x%02x",gTpRxData[2],gTpRxData[3],gTpRxData[4]);
		}
		Diag_SetReqCheckResult(reqGroup,reqNum,RESULT_FAIL,gDiagResultDescription);
		return 1;
	}
	else
	{
		if(gUDS_DescriptionExistFlag == 1)
		{
			if(gUDS_LanguageSet == 0)
			{
				PrintPID("UDS","Pos.Response",gTpRxData,gTpRxLength);
			}
			else
			{
				PrintPID("UDS","肯定响应",gTpRxData,gTpRxLength);
			}
		}
		return 2;
	}
}

void SID19_Sub0A_ReportSupportDTC(enum AddressMode Mode)
{
	byte SID19[2];
	SID19[0]=0x19;
	SID19[1]=0x0A;
	TP_Send(SID19,Mode);
	if(gUDS_DescriptionExistFlag == 1)
	{
		if(gUDS_LanguageSet == 0)
		{
			PrintPID("UDS","Request ",SID19,elCount(SID19));
		}
		else
		{
			PrintPID("UDS","发送请求 ",SID19,elCount(SID19));
		}
	}
}


int CheckPosResponse_SID19_0A(byte AvailiableMask,int reqGroup,int reqNum)
{
	if((gBusFlag == 1)||(gBusFlag == 2)||(gBusFlag == 3)||(gBusFlag == 4)||(gBusFlag == 5))
  {
    if(SessionFlag==APP)
    {
      gRss=ECU_Response(gP2Client_APP,0x19);
    }
    else if(SessionFlag==BOOT)
    {
      gRss=ECU_Response(gP2Client_BOOT,0x19);
    }
    else
    {
       gRss=ECU_Response(gP2Client_APP,0x19);
    }
  }
	if(gRss!=POS)
	{
		if(gRss==TIMEOUT)
		{
			if(gUDS_LanguageSet == 0)
			{
				snprintf(gDiagResultDescription,4000,"Timeout no response recived when request service 0x19");
			}
			else
			{
				snprintf(gDiagResultDescription,4000,"请求超时，控制器对19服务未回复响应");
			}
			Diag_SetReqCheckResult(reqGroup,reqNum,RESULT_FAIL,gDiagResultDescription);
			return -1;
		}
		else
		{
			if(gUDS_LanguageSet == 0)
			{
				snprintf(gDiagResultDescription,4000,"ECU gives negative response 0x%02x to the request of service 0x19",gTpRxData[2]);
			}
			else
			{
				snprintf(gDiagResultDescription,4000,"ECU对19服务回复了负响应0x%02x",gTpRxData[2]);
			}
			Diag_SetReqCheckResult(reqGroup,reqNum,RESULT_FAIL,gDiagResultDescription);
			return -1;
		}
	}
	if(gTpRxData[0]!=0x59)
	{
		if(gUDS_LanguageSet == 0)
		{
			snprintf(gDiagResultDescription,4000,"ECU gives unexpect positive response service ID 0x%02x to the request of service 0x19",gTpRxData[0]);
		}
		else
		{
			snprintf(gDiagResultDescription,4000,"ECU对19服务回复了非预期的肯定响应0x%02x",gTpRxData[0]);
		}
		Diag_SetReqCheckResult(reqGroup,reqNum,RESULT_FAIL,gDiagResultDescription);
		return 1;
	}
	if(gTpRxData[1]!=0x0A)
	{
		if(gUDS_LanguageSet == 0)
		{
			snprintf(gDiagResultDescription,4000,"ECU gives unexpect subfunction 0x%02x to the request of service 0x19",gTpRxData[1]);
		}
		else
		{
			snprintf(gDiagResultDescription,4000,"ECU对19服务回复了非预期的子功能0x%02x",gTpRxData[1]);
		}
		Diag_SetReqCheckResult(reqGroup,reqNum,RESULT_FAIL,gDiagResultDescription);
		return 1;
	}
	if(gTpRxData[2]!=AvailiableMask)
	{
		if(gUDS_LanguageSet == 0)
		{
			snprintf(gDiagResultDescription,4000,"ECU gives unexpect Avaliable Mask 0x%02x to the request of service 0x19",gTpRxData[2]);
		}
		else
		{
			snprintf(gDiagResultDescription,4000,"ECU对19服务响应了非预期的有效掩码%02x",gTpRxData[2]);
		}
		Diag_SetReqCheckResult(reqGroup,reqNum,RESULT_FAIL,gDiagResultDescription);
		return 1;
	}
	if(3!=(gTpRxLength%4))
	{
		if(gUDS_LanguageSet == 0)
		{
			snprintf(gDiagResultDescription,4000,"ECU gives unexpect lenth to the request of service 0x19");
		}
		else
		{
			snprintf(gDiagResultDescription,4000,"ECU对19服务回复了错误的长度");
		}
		Diag_SetReqCheckResult(reqGroup,reqNum,RESULT_FAIL,gDiagResultDescription);
		return 1;
	}
	else
	{
		if(gUDS_DescriptionExistFlag == 1)
		{
			if(gUDS_LanguageSet == 0)
			{
				PrintPID("UDS","Pos.Response",gTpRxData,gTpRxLength);
			}
			else
			{
				PrintPID("UDS","肯定响应",gTpRxData,gTpRxLength);
			}
		}
		return 2;
	}
}


Void SID19_Sub15_ReportDTCWithPermanentStatus(enum AddressMode Mode)
{
	byte SID19[2];
	SID19[0]=0x19;
	SID19[1]=0x15;
	TP_Send(SID19,Mode);
	if(gUDS_DescriptionExistFlag == 1)
	{
		if(gUDS_LanguageSet == 0)
		{
			PrintPID("UDS","Request ",SID19,elCount(SID19));
		}
		else
		{
			PrintPID("UDS","发送请求 ",SID19,elCount(SID19));
		}
	}
}
//
int CheckPosResponse_SID19_15(byte AvailiableMask,int reqGroup,int reqNum)
{
	if((gBusFlag == 1)||(gBusFlag == 2)||(gBusFlag == 3)||(gBusFlag == 4)||(gBusFlag == 5))
  {
    if(SessionFlag==APP)
    {
      gRss=ECU_Response(gP2Client_APP,0x19);
    }
    else if(SessionFlag==BOOT)
    {
      gRss=ECU_Response(gP2Client_BOOT,0x19);
    }
    else
    {
       gRss=ECU_Response(gP2Client_APP,0x19);
    }
  }
	if(gRss!=POS)
	{
		if(gRss==TIMEOUT)
		{
			if(gUDS_LanguageSet == 0)
			{
				snprintf(gDiagResultDescription,4000,"Timeout no response recived when request service 0x19");
			}
			else
			{
				snprintf(gDiagResultDescription,4000,"请求超时，控制器对19服务未回复响应");
			}
			Diag_SetReqCheckResult(reqGroup,reqNum,RESULT_FAIL,gDiagResultDescription);
			return -1;
		}
		else
		{
			if(gUDS_LanguageSet == 0)
			{
				snprintf(gDiagResultDescription,4000,"ECU gives negative response 0x%02x to the request of service 0x19",gTpRxData[2]);
			}
			else
			{
				snprintf(gDiagResultDescription,4000,"ECU对19服务回复了负响应0x%02x",gTpRxData[2]);
			}
			Diag_SetReqCheckResult(reqGroup,reqNum,RESULT_FAIL,gDiagResultDescription);
			return -1;
		}
	}
	if(gTpRxData[0]!=0x59)
	{
		if(gUDS_LanguageSet == 0)
		{
			snprintf(gDiagResultDescription,4000,"ECU gives unexpect positive response service ID 0x%02x to the request of service 0x19",gTpRxData[0]);
		}
		else
		{
			snprintf(gDiagResultDescription,4000,"ECU对19服务回复了非预期的肯定响应0x%02x",gTpRxData[0]);
		}
		Diag_SetReqCheckResult(reqGroup,reqNum,RESULT_FAIL,gDiagResultDescription);
		return 1;
	}
	if(gTpRxData[1]!=0x15)
	{
		if(gUDS_LanguageSet == 0)
		{
			snprintf(gDiagResultDescription,4000,"ECU gives unexpect subfunction 0x%02x to the request of service 0x19",gTpRxData[1]);
		}
		else
		{
			snprintf(gDiagResultDescription,4000,"ECU对19服务回复了非预期的子功能0x%02x",gTpRxData[1]);
		}
		Diag_SetReqCheckResult(reqGroup,reqNum,RESULT_FAIL,gDiagResultDescription);
		return 1;
	}
	if(gTpRxData[2]!=AvailiableMask)
	{
		if(gUDS_LanguageSet == 0)
		{
			snprintf(gDiagResultDescription,4000,"ECU gives unexpect Avaliable Mask 0x%02x to the request of service 0x19",gTpRxData[2]);
		}
		else
		{
			snprintf(gDiagResultDescription,4000,"ECU对19服务响应了非预期的有效掩码%02x",gTpRxData[2]);
		}
		Diag_SetReqCheckResult(reqGroup,reqNum,RESULT_FAIL,gDiagResultDescription);
		return 1;
	}
	if(3!=(gTpRxLength%4))
	{
		if(gUDS_LanguageSet == 0)
		{
			snprintf(gDiagResultDescription,4000,"ECU gives unexpect lenth to the request of service 0x19");
		}
		else
		{
			snprintf(gDiagResultDescription,4000,"ECU对19服务回复了错误的长度");
		}
		Diag_SetReqCheckResult(reqGroup,reqNum,RESULT_FAIL,gDiagResultDescription);
		return 1;
	}
	else
	{
		if(gUDS_DescriptionExistFlag == 1)
		{
			if(gUDS_LanguageSet == 0)
			{
				PrintPID("UDS","Pos.Response",gTpRxData,gTpRxLength);
			}
			else
			{
				PrintPID("UDS","肯定响应",gTpRxData,gTpRxLength);
			}
		}
		return 2;
	}
}

Void SIDAF_Sub04_ReportGenericSnapshotByDTCNumber(Byte DTC[],Byte DTCSnapshotRecordNumber,enum AddressMode Mode)
{
  int i,length;
	byte SIDAF[6];
	SIDAF[0]=0xAF;
	SIDAF[1]=0x04;
	SIDAF[2]=DTC[0];
	SIDAF[3]=DTC[1];
	SIDAF[4]=DTC[2];
	SIDAF[5]=DTCSnapshotRecordNumber;
  
	TP_Send(SIDAF,Mode);
	if(gUDS_DescriptionExistFlag == 1)
	{
		if(gUDS_LanguageSet == 0)
		{
			PrintPID("UDS","Request ",SIDAF,length);
		}
		else
		{
			PrintPID("UDS","发送请求 ",SIDAF,length);
		}
	}
}

int CheckPosResponse_SIDAF_04(byte DTC[],int reqGroup,int reqNum)
{
  if((gBusFlag == 1)||(gBusFlag == 2)||(gBusFlag == 3)||(gBusFlag == 4)||(gBusFlag == 5))
  {
    if(SessionFlag==APP)
    {
      gRss=ECU_Response(gP2Client_APP,0xAF);
    }
    else if(SessionFlag==BOOT)
    {
      gRss=ECU_Response(gP2Client_BOOT,0xAF);
    }
    else
    {
       gRss=ECU_Response(gP2Client_APP,0xAF);
    }
  }
	if(gRss!=POS)
	{
		if(gRss==TIMEOUT)
		{
			if(gUDS_LanguageSet == 0)
			{
				snprintf(gDiagResultDescription,4000,"Timeout no response recived when request service 0xAF");
			}
			else
			{
				snprintf(gDiagResultDescription,4000,"请求超时，控制器对AF服务未回复响应");
			}
			Diag_SetReqCheckResult(reqGroup,reqNum,RESULT_FAIL,gDiagResultDescription);
			return -1;
		}
		else
		{
			if(gUDS_LanguageSet == 0)
			{
				snprintf(gDiagResultDescription,4000,"ECU gives negative response 0x%02x to the request of service 0xAF",gTpRxData[2]);
			}
			else
			{
				snprintf(gDiagResultDescription,4000,"ECU对AF服务回复了负响应0x%02x",gTpRxData[2]);
			}
			Diag_SetReqCheckResult(reqGroup,reqNum,RESULT_FAIL,gDiagResultDescription);
			return -1;
		}
	}
	if(gTpRxData[0]!=0xEF)
	{
		if(gUDS_LanguageSet == 0)
		{
			snprintf(gDiagResultDescription,4000,"ECU gives unexpect positive response service ID 0x%02x to the request of service 0xAF",gTpRxData[0]);
		}
		else
		{
			snprintf(gDiagResultDescription,4000,"ECU对AF服务回复了非预期的肯定响应0x%02x",gTpRxData[0]);
		}
		Diag_SetReqCheckResult(reqGroup,reqNum,RESULT_FAIL,gDiagResultDescription);
		return 1;
	}
	if(gTpRxData[1]!=0x04)
	{
		if(gUDS_LanguageSet == 0)
		{
			snprintf(gDiagResultDescription,4000,"ECU gives unexpect subfunction 0x%02x to the request of service 0xAF",gTpRxData[1]);
		}
		else
		{
			snprintf(gDiagResultDescription,4000,"ECU对AF服务回复了非预期的子功能0x%02x",gTpRxData[1]);
		}
		Diag_SetReqCheckResult(reqGroup,reqNum,RESULT_FAIL,gDiagResultDescription);
		return 1;
	}
	if((DTC[0]!=gTpRxData[2])||(DTC[1]!=gTpRxData[3])||(DTC[2]!=gTpRxData[4]))
	{
		if(gUDS_LanguageSet == 0)
		{
			snprintf(gDiagResultDescription,4000,"ECU gives unexpect DTC 0x%02x 0x%02x 0x%02x to the request of service 0xAF 04",gTpRxData[2],gTpRxData[3],gTpRxData[4]);
		}
		else
		{
			snprintf(gDiagResultDescription,4000,"ECU对AF服务响应了错误的DTC： 0x%02x 0x%02x 0x%02x",gTpRxData[2],gTpRxData[3],gTpRxData[4]);
		}
		Diag_SetReqCheckResult(reqGroup,reqNum,RESULT_FAIL,gDiagResultDescription);
		return 1;
	}
	else
	{
		if(gUDS_DescriptionExistFlag == 1)
		{
			if(gUDS_LanguageSet == 0)
			{
				PrintPID("UDS","Pos.Response",gTpRxData,gTpRxLength);
			}
			else
			{
				PrintPID("UDS","肯定响应",gTpRxData,gTpRxLength);
			}
		}
		return 2;
	}
}

Void SIDAF_Sub06_ReportGenericExtendedDataByDTCNumber(Byte DTC[],Byte DTCExtendedDataRecordNumber,enum AddressMode Mode)
{
  int i,length;
	byte SIDAF[6];
	SIDAF[0]=0xAF;
	SIDAF[1]=0x06;
	SIDAF[2]=DTC[0];
	SIDAF[3]=DTC[1];
	SIDAF[4]=DTC[2];
	SIDAF[5]=DTCExtendedDataRecordNumber;
	TP_Send(SIDAF,Mode);
	if(gUDS_DescriptionExistFlag == 1)
	{
		if(gUDS_LanguageSet == 0)
		{
			PrintPID("UDS","Request ",SIDAF,length);
		}
		else
		{
			PrintPID("UDS","发送请求 ",SIDAF,length);
		}
	}
}

int CheckPosResponse_SIDAF_06(byte DTC[],int reqGroup,int reqNum)
{
  if((gBusFlag == 1)||(gBusFlag == 2)||(gBusFlag == 3)||(gBusFlag == 4)||(gBusFlag == 5))
  {
    if(SessionFlag==APP)
    {
      gRss=ECU_Response(gP2Client_APP,0xAF);
    }
    else if(SessionFlag==BOOT)
    {
      gRss=ECU_Response(gP2Client_BOOT,0xAF);
    }
    else
    {
       gRss=ECU_Response(gP2Client_APP,0xAF);
    }
  }
	if(gRss!=POS)
	{
		if(gRss==TIMEOUT)
		{
			if(gUDS_LanguageSet == 0)
			{
				snprintf(gDiagResultDescription,4000,"Timeout no response recived when request service 0xAF");
			}
			else
			{
				snprintf(gDiagResultDescription,4000,"请求超时，控制器对AF服务未回复响应");
			}
			Diag_SetReqCheckResult(reqGroup,reqNum,RESULT_FAIL,gDiagResultDescription);
			return -1;
		}
		else
		{
			if(gUDS_LanguageSet == 0)
			{
				snprintf(gDiagResultDescription,4000,"ECU gives negative response 0x%02x to the request of service 0xAF",gTpRxData[2]);
			}
			else
			{
				snprintf(gDiagResultDescription,4000,"ECU对AF服务回复了负响应0x%02x",gTpRxData[2]);
			}
			Diag_SetReqCheckResult(reqGroup,reqNum,RESULT_FAIL,gDiagResultDescription);
			return -1;
		}
	}
	if(gTpRxData[0]!=0xEF)
	{
		if(gUDS_LanguageSet == 0)
		{
			snprintf(gDiagResultDescription,4000,"ECU gives unexpect positive response service ID 0x%02x to the request of service 0xAF",gTpRxData[0]);
		}
		else
		{
			snprintf(gDiagResultDescription,4000,"ECU对AF服务回复了非预期的肯定响应0x%02x",gTpRxData[0]);
		}
		Diag_SetReqCheckResult(reqGroup,reqNum,RESULT_FAIL,gDiagResultDescription);
		return 1;
	}
	if(gTpRxData[1]!=0x06)
	{
		if(gUDS_LanguageSet == 0)
		{
			snprintf(gDiagResultDescription,4000,"ECU gives unexpect subfunction 0x%02x to the request of service 0xAF",gTpRxData[1]);
		}
		else
		{
			snprintf(gDiagResultDescription,4000,"ECU对AF服务回复了非预期的子功能0x%02x",gTpRxData[1]);
		}
		Diag_SetReqCheckResult(reqGroup,reqNum,RESULT_FAIL,gDiagResultDescription);
		return 1;
	}
	if((DTC[0]!=gTpRxData[2])||(DTC[1]!=gTpRxData[3])||(DTC[2]!=gTpRxData[4]))
	{
		if(gUDS_LanguageSet == 0)
		{
			snprintf(gDiagResultDescription,4000,"ECU gives unexpect DTC 0x%02x 0x%02x 0x%02x to the request of service 0xAF 06",gTpRxData[2],gTpRxData[3],gTpRxData[4]);
		}
		else
		{
			snprintf(gDiagResultDescription,4000,"ECU对AF服务响应了错误的DTC： 0x%02x 0x%02x 0x%02x",gTpRxData[2],gTpRxData[3],gTpRxData[4]);
		}
		Diag_SetReqCheckResult(reqGroup,reqNum,RESULT_FAIL,gDiagResultDescription);
		return 1;
	}
	else
	{
		if(gUDS_DescriptionExistFlag == 1)
		{
			if(gUDS_LanguageSet == 0)
			{
				PrintPID("UDS","Pos.Response",gTpRxData,gTpRxLength);
			}
			else
			{
				PrintPID("UDS","肯定响应",gTpRxData,gTpRxLength);
			}
		}
		return 2;
	}
}


void SID2F_IOControl(byte PID[],byte inputOutputControlParameter,byte ControlState[],byte CSLength,byte ControlEnableMaskRecord[],byte CEMLength,enum AddressMode Mode)
{
	int i,length;
	byte SID2F[30000];
	SID2F[0]=0x2F;
	SID2F[1]=PID[0];
	SID2F[2]=PID[1];
	SID2F[3]=inputOutputControlParameter;
	for(i=0; i<CSLength; i++)
	{
		SID2F[i+4]=ControlState[i];
	}
	for(i=0; i<CEMLength; i++)
	{
		SID2F[i+4+CSLength]=ControlEnableMaskRecord[i];
	}
  
	length=4+CSLength+CEMLength;

	TP_Send(SID2F,length,Mode);
	if(gUDS_DescriptionExistFlag == 1)
	{
		if(gUDS_LanguageSet == 0)
		{
			PrintPID("UDS","Request ",SID2F,length);
		}
		else
		{
			PrintPID("UDS","发送请求 ",SID2F,length);
		}
	}
}

void SID2F_IOControl(byte PID[],byte ControlOptionRecord[],enum AddressMode Mode)
{
	int i,length;
	byte SID2F[30000];
	SID2F[0]=0x2F;
	SID2F[1]=PID[0];
	SID2F[2]=PID[1];
	SID2F[3]=0x03;
	for(i=0; i<elcount(ControlOptionRecord); i++)
	{
		SID2F[i+4]=ControlOptionRecord[i];
	}
	length=4+elCount(ControlOptionRecord);

	TP_Send(SID2F,length,Mode);
	if(gUDS_DescriptionExistFlag == 1)
	{
		if(gUDS_LanguageSet == 0)
		{
			PrintPID("UDS","Request ",SID2F,length);
		}
		else
		{
			PrintPID("UDS","发送请求 ",SID2F,length);
		}
	}
}

void SID2F_IOControl(byte PID[],enum e_InputOutputControlParameter IOParameter,enum AddressMode Mode)
{
	int i;
	byte SID2F[4];
	SID2F[0]=0x2F;
	SID2F[1]=PID[0];
	SID2F[2]=PID[1];
	SID2F[3]=IOParameter;
	TP_Send(SID2F, Mode);
	if(gUDS_DescriptionExistFlag == 1)
	{
		if(gUDS_LanguageSet == 0)
		{
			PrintPID("UDS","Request ",SID2F,elCount(SID2F));
		}
		else
		{
			PrintPID("UDS","发送请求 ",SID2F,elCount(SID2F));
		}
	}
}

void SID2F_IOControl(byte PID[],enum e_InputOutputControlParameter IOParameter,int Length)
{
	int i,len,j;
	byte SID2F[30000];
  len=4+Length;
	SID2F[0]=0x2F;
	SID2F[1]=PID[0];
	SID2F[2]=PID[1];
	SID2F[3]=IOParameter;
  
  if(len==4)
  {
    
  }
  else
  {
    for(j=4;j<len;j++)
    {
      SID2F[j]=0x00;
    }
  }
  
	TP_Send(SID2F,len, PHYSICAL);
  if(gUDS_DescriptionExistFlag == 1)
	{
		if(gUDS_LanguageSet == 0)
		{
			PrintPID("UDS","Request ",SID2F,elCount(SID2F));
		}
		else
		{
			PrintPID("UDS","发送请求 ",SID2F,elCount(SID2F));
		}
	}
}

//void SID2F_IOControl_Demo(byte PID[], enum e_InputOutputControlParameter IOParameter,byte ControlState[],int ControlStatesLength, byte ControlEnableMaskRecord[],int ControlEnableMaskRecordLength,int RequestLength,enum AddressMode Mode)
//{
//  byte RawData[0xFFFF];
//  int  RawDataLength;
//  int i;
//  
//  RawData[0] = 0x2F;
//  RawData[1] = PID[0];
//  RawData[2] = PID[1];
//  RawData[3] = IOParameter;
//  
//  RawDataLength = 4;
//  
//  for(i=0;i<ControlStatesLength;i++)           { RawData[RawDataLength+i] = ControlState[i]; }
//  RawDataLength = RawDataLength + ControlStatesLength;
//  for(i=0;i<ControlEnableMaskRecordLength;i++) { RawData[RawDataLength+i] = ControlEnableMaskRecord[i]; }
//  RawDataLength = RawDataLength + ControlEnableMaskRecordLength;
//  
//  // NRC13
//  if(RequestLength != 0 && RequestLength <= 4) { RawDataLength = RequestLength; }
//  
//  TPSendRawMessage(RawData,RawDataLength,Mode);
//}

int CheckPosResponse_SID2F(byte inputOutputControlParameter,byte PID[],int reqGroup,int reqNum)
{
	if((gBusFlag == 1)||(gBusFlag == 2)||(gBusFlag == 3)||(gBusFlag == 4)||(gBusFlag == 5))
  {
    if(SessionFlag==APP)
    {
      gRss=ECU_Response(gP2Client_APP,0x2F);
    }
    else if(SessionFlag==BOOT)
    {
      gRss=ECU_Response(gP2Client_BOOT,0x2F);
    }
    else
    {
       gRss=ECU_Response(gP2Client_APP,0x2F);
    }
  }
	if(gRss!=POS)
	{
		if(gRss==TIMEOUT)
		{
			if(gUDS_LanguageSet == 0)
			{
				snprintf(gDiagResultDescription,4000,"Timeout no response recived when request service 0x2F");
			}
			else
			{
				snprintf(gDiagResultDescription,4000,"请求超时，控制器对2F服务未回复响应");
			}
			Diag_SetReqCheckResult(reqGroup,reqNum,RESULT_FAIL,gDiagResultDescription);
			return -1;
		}
		else
		{
			if(gUDS_LanguageSet == 0)
			{
				snprintf(gDiagResultDescription,4000,"ECU gives negative response 0x%02x to the request of service 0x2F",gTpRxData[2]);
			}
			else
			{
				snprintf(gDiagResultDescription,4000,"ECU对2F服务回复了负响应0x%02x",gTpRxData[2]);
			}
			Diag_SetReqCheckResult(reqGroup,reqNum,RESULT_FAIL,gDiagResultDescription);
			return -1;
		}
	}
	if(gTpRxData[0]!=0x6F)
	{
		if(gUDS_LanguageSet == 0)
		{
			snprintf(gDiagResultDescription,4000,"ECU gives unexpect positive response service ID 0x%02x to the request of service 0x2F",gTpRxData[0]);
		}
		else
		{
			snprintf(gDiagResultDescription,4000,"ECU对2F服务回复了非预期的肯定响应0x%02x",gTpRxData[0]);
		}
		Diag_SetReqCheckResult(reqGroup,reqNum,RESULT_FAIL,gDiagResultDescription);
		return 1;
	}
	if(gTpRxData[1]!=PID[0] &&gTpRxData[2]!=PID[1])
	{
		if(gUDS_LanguageSet == 0)
		{
			snprintf(gDiagResultDescription,4000,"ECU gives posotive response, but the response DID is wrong");
		}
		else
		{
			snprintf(gDiagResultDescription,4000,"ECU对2F服务回复了错误的DID");
		}
		Diag_SetReqCheckResult(reqGroup,reqNum,RESULT_FAIL,gDiagResultDescription);
		return 1;
	}
	if(gTpRxData[3]!=inputOutputControlParameter)
	{
		if(gUDS_LanguageSet == 0)
		{
			snprintf(gDiagResultDescription,4000,"ECU gives posotive response, but the response DID is wrong");
		}
		else
		{
			snprintf(gDiagResultDescription,4000,"ECU对2F服务回复了错误的inputOutputControlParameter");
		}
		Diag_SetReqCheckResult(reqGroup,reqNum,RESULT_FAIL,gDiagResultDescription);
		return 1;
	}
	else
	{
		if(gUDS_DescriptionExistFlag == 1)
		{
			if(gUDS_LanguageSet == 0)
			{
				PrintPID("UDS","Pos.Response",gTpRxData,gTpRxLength);
			}
			else
			{
				PrintPID("UDS","肯定响应",gTpRxData,gTpRxLength);
			}
		}
		return 2;
	}
}

int CheckPosResponse_SID2F(byte inputOutputControlParameter,byte PID[],int lenth,int reqGroup,int reqNum)
{
	if((gBusFlag == 1)||(gBusFlag == 2)||(gBusFlag == 3)||(gBusFlag == 4)||(gBusFlag == 5))
  {
    if(SessionFlag==APP)
    {
      gRss=ECU_Response(gP2Client_APP,0x2F);
    }
    else if(SessionFlag==BOOT)
    {
      gRss=ECU_Response(gP2Client_BOOT,0x2F);
    }
    else
    {
       gRss=ECU_Response(gP2Client_APP,0x2F);
    }
  }
	if(gRss!=POS)
	{
		if(gRss==TIMEOUT)
		{
			if(gUDS_LanguageSet == 0)
			{
				snprintf(gDiagResultDescription,4000,"Timeout no response recived when request service 0x2F");
			}
			else
			{
				snprintf(gDiagResultDescription,4000,"请求超时，控制器对2F服务未回复响应");
			}
			Diag_SetReqCheckResult(reqGroup,reqNum,RESULT_FAIL,gDiagResultDescription);
			return -1;
		}
		else
		{
			if(gUDS_LanguageSet == 0)
			{
				snprintf(gDiagResultDescription,4000,"ECU gives negative response 0x%02x to the request of service 0x2F",gTpRxData[2]);
			}
			else
			{
				snprintf(gDiagResultDescription,4000,"ECU对2F服务回复了负响应0x%02x",gTpRxData[2]);
			}
			Diag_SetReqCheckResult(reqGroup,reqNum,RESULT_FAIL,gDiagResultDescription);
			return -1;
		}
	}
	if(gTpRxData[0]!=0x6F)
	{
		if(gUDS_LanguageSet == 0)
		{
			snprintf(gDiagResultDescription,4000,"ECU gives unexpect positive response service ID 0x%02x to the request of service 0x2F",gTpRxData[0]);
		}
		else
		{
			snprintf(gDiagResultDescription,4000,"ECU对2F服务回复了非预期的肯定响应0x%02x",gTpRxData[0]);
		}
		Diag_SetReqCheckResult(reqGroup,reqNum,RESULT_FAIL,gDiagResultDescription);
		return 1;
	}
	if(gTpRxData[1]!=PID[0] &&gTpRxData[2]!=PID[1])
	{
		if(gUDS_LanguageSet == 0)
		{
			snprintf(gDiagResultDescription,4000,"ECU gives posotive response, but the response DID is wrong");
		}
		else
		{
			snprintf(gDiagResultDescription,4000,"ECU对2F服务回复了错误的DID");
		}
		Diag_SetReqCheckResult(reqGroup,reqNum,RESULT_FAIL,gDiagResultDescription);
		return 1;
	}
	if(gTpRxData[3]!=inputOutputControlParameter)
	{
		if(gUDS_LanguageSet == 0)
		{
			snprintf(gDiagResultDescription,4000,"ECU gives posotive response, but the response DID is wrong");
		}
		else
		{
			snprintf(gDiagResultDescription,4000,"ECU对2F服务回复了错误的inputOutputControlParameter");
		}
		Diag_SetReqCheckResult(reqGroup,reqNum,RESULT_FAIL,gDiagResultDescription);
		return 1;
	}
  if(gTpRxLength!=lenth)
	{
    if(gUDS_LanguageSet == 0)
		{
			snprintf(gDiagResultDescription,4000,"ECU gives posotive response, but the lenth is wrong");
		}
		else
		{
			snprintf(gDiagResultDescription,4000,"ECU对2F服务回复了肯定响应，但响应长度错误");
		}
		Diag_SetReqCheckResult(reqGroup,reqNum,RESULT_FAIL,gDiagResultDescription);
		return 1;
  }
	else
	{
		if(gUDS_DescriptionExistFlag == 1)
		{
			if(gUDS_LanguageSet == 0)
			{
				PrintPID("UDS","Pos.Response",gTpRxData,gTpRxLength);
			}
			else
			{
				PrintPID("UDS","肯定响应",gTpRxData,gTpRxLength);
			}
		}
		return 2;
	}
}

void SID31_RoutineControl(enum e_RoutineControlType RoutineType,byte RoutineIdentifier[],byte RoutineControlOptionRecord[],int RecordLenth,enum AddressMode Mode,enum e_SPRMIB Supress)
{
	int i,length;
	byte SID31[1000];
	SID31[0]=0x31;
  if(Supress==0)
		SID31[1]=RoutineType;
	else
		SID31[1]=RoutineType+0x80;

	SID31[2]=RoutineIdentifier[0];
	SID31[3]=RoutineIdentifier[1];
	for(i=0; i<RecordLenth; i++)
	{
		SID31[i+4]=RoutineControlOptionRecord[i];
	}
	length=4+RecordLenth;
	TP_Send(SID31,length,Mode);
	if(gUDS_DescriptionExistFlag == 1)
	{
		if(gUDS_LanguageSet == 0)
		{
      if(length<30)
      {
			  PrintPID("UDS","Request ",SID31,length);
      }
      else
      {
        PrintPID("UDS","Request ",SID31,30);
      }
		}
		else
		{
      if(length<30)
      {
			  PrintPID("UDS","发送请求 ",SID31,length);
      }
      else
      {
			  PrintPID("UDS","发送请求 ",SID31,30);
      }
		}
	}
}

void SID31_RoutineControl_WithResponse(enum e_RoutineControlType RoutineType,byte RoutineIdentifier[],byte RoutineControlOptionRecord[],int RecordLenth,enum AddressMode Mode,enum e_SPRMIB Supress)
{
	int i,length;
	byte SID31[1000];
	SID31[0]=0x31;
  if(Supress==0)
		SID31[1]=RoutineType;
	else
		SID31[1]=RoutineType+0x80;

	SID31[2]=RoutineIdentifier[0];
	SID31[3]=RoutineIdentifier[1];
	for(i=0; i<RecordLenth; i++)
	{
		SID31[i+4]=RoutineControlOptionRecord[i];
	}
	length=4+RecordLenth;
	TP_Send(SID31,length,Mode);
	if(gUDS_DescriptionExistFlag == 1)
	{
		if(gUDS_LanguageSet == 0)
		{
      if(length<30)
      {
			  PrintPID("UDS","Request ",SID31,length);
      }
      else
      {
        PrintPID("UDS","Request ",SID31,30);
      }
		}
		else
		{
      if(length<30)
      {
			  PrintPID("UDS","发送请求 ",SID31,length);
      }
      else
      {
			  PrintPID("UDS","发送请求 ",SID31,30);
      }
		}
	}
  
  if((gBusFlag == 1)||(gBusFlag == 2)||(gBusFlag == 3)||(gBusFlag == 4)||(gBusFlag == 5))
  {
    if(SessionFlag==APP)
    {
      gRss=ECU_Response(gP2Client_APP,0x31);
    }
    else if(SessionFlag==BOOT)
    {
      gRss=ECU_Response(gP2Client_BOOT,0x31);
    }
    else
    {
       gRss=ECU_Response(gP2Client_APP,0x31);
    }
  }
}

int CheckPosResponse_SID31(enum e_RoutineControlType RoutineType,byte RoutineIdentifier[],int reqGroup,int reqNum)
{
	int i;
	if((gBusFlag == 1)||(gBusFlag == 2)||(gBusFlag == 3)||(gBusFlag == 4)||(gBusFlag == 5))
  {
    if(SessionFlag==APP)
    {
      gRss=ECU_Response(gP2Client_APP,0x31);
    }
    else if(SessionFlag==BOOT)
    {
      gRss=ECU_Response(gP2Client_BOOT,0x31);
    }
    else
    {
       gRss=ECU_Response(gP2Client_APP,0x31);
    }
  }
	if(gRss!=POS)
	{
		if(gRss==TIMEOUT)
		{
			if(gUDS_LanguageSet == 0)
			{
				snprintf(gDiagResultDescription,4000,"Timeout no response recived when request service 0x31");
			}
			else
			{
				snprintf(gDiagResultDescription,4000,"请求超时，控制器对31服务未回复响应");
			}
			Diag_SetReqCheckResult(reqGroup,reqNum,RESULT_FAIL,gDiagResultDescription);
			return -1;
		}
		else
		{
			if(gUDS_LanguageSet == 0)
			{
				snprintf(gDiagResultDescription,4000,"ECU gives negative response 0x%02x to the request of service 0x31",gTpRxData[2]);
			}
			else
			{
				snprintf(gDiagResultDescription,4000,"ECU对31服务回复了负响应0x%02x",gTpRxData[2]);
			}
			Diag_SetReqCheckResult(reqGroup,reqNum,RESULT_FAIL,gDiagResultDescription);
			return -1;
		}
	}
	if(gTpRxData[0]!=0x71)
	{
		if(gUDS_LanguageSet == 0)
		{
			snprintf(gDiagResultDescription,4000,"ECU gives unexpect positive response service ID 0x%02x to the request of service 0x31",gTpRxData[0]);
		}
		else
		{
			snprintf(gDiagResultDescription,4000,"ECU对31服务回复了非预期的肯定响应0x%02x",gTpRxData[0]);
		}
		Diag_SetReqCheckResult(reqGroup,reqNum,RESULT_FAIL,gDiagResultDescription);
		return 1;
	}
	if(gTpRxData[1]!=RoutineType)
	{
		if(gUDS_LanguageSet == 0)
		{
			snprintf(gDiagResultDescription,4000,"ECU gives unexpected routine type 0x%02x to the service 0x31",gTpRxData[1]);
		}
		else
		{
			snprintf(gDiagResultDescription,4000,"ECU对31服务回复了错误的例程类型");
		}
		Diag_SetReqCheckResult(reqGroup,reqNum,RESULT_FAIL,gDiagResultDescription);
		return 1;
	}
	if((gTpRxData[2]!=RoutineIdentifier[0]) || (gTpRxData[3]!=RoutineIdentifier[1]))
	{
		if(gUDS_LanguageSet == 0)
		{
			snprintf(gDiagResultDescription,4000,"ECU gives posotive response, but the response RoutineIdentifer is wrong");
		}
		else
		{
			snprintf(gDiagResultDescription,4000,"ECU对31服务回复了错误的例程标识符");
		}
		Diag_SetReqCheckResult(reqGroup,reqNum,RESULT_FAIL,gDiagResultDescription);
		return 1;
	}


	if(gUDS_DescriptionExistFlag == 1)
	{
		if(gUDS_LanguageSet == 0)
		{
			PrintPID("UDS","Pos.Response",gTpRxData,gTpRxLength);
		}
		else
		{
			PrintPID("UDS","肯定响应",gTpRxData,gTpRxLength);
		}
	}
	return 2;

}

int CheckPosResponse_SID31_WithoutResponse(enum e_RoutineControlType RoutineType,byte RoutineIdentifier[],int reqGroup,int reqNum)
{
	int i;
	if(gRss!=POS)
	{
		if(gRss==TIMEOUT)
		{
			if(gUDS_LanguageSet == 0)
			{
				snprintf(gDiagResultDescription,4000,"Timeout no response recived when request service 0x31");
			}
			else
			{
				snprintf(gDiagResultDescription,4000,"请求超时，控制器对31服务未回复响应");
			}
			Diag_SetReqCheckResult(reqGroup,reqNum,RESULT_FAIL,gDiagResultDescription);
			return -1;
		}
		else
		{
			if(gUDS_LanguageSet == 0)
			{
				snprintf(gDiagResultDescription,4000,"ECU gives negative response 0x%02x to the request of service 0x31",gTpRxData[2]);
			}
			else
			{
				snprintf(gDiagResultDescription,4000,"ECU对31服务回复了负响应0x%02x",gTpRxData[2]);
			}
			Diag_SetReqCheckResult(reqGroup,reqNum,RESULT_FAIL,gDiagResultDescription);
			return -1;
		}
	}
	if(gTpRxData[0]!=0x71)
	{
		if(gUDS_LanguageSet == 0)
		{
			snprintf(gDiagResultDescription,4000,"ECU gives unexpect positive response service ID 0x%02x to the request of service 0x31",gTpRxData[0]);
		}
		else
		{
			snprintf(gDiagResultDescription,4000,"ECU对31服务回复了非预期的肯定响应0x%02x",gTpRxData[0]);
		}
		Diag_SetReqCheckResult(reqGroup,reqNum,RESULT_FAIL,gDiagResultDescription);
		return 1;
	}
	if(gTpRxData[1]!=RoutineType)
	{
		if(gUDS_LanguageSet == 0)
		{
			snprintf(gDiagResultDescription,4000,"ECU gives unexpected routine type 0x%02x to the service 0x31",gTpRxData[1]);
		}
		else
		{
			snprintf(gDiagResultDescription,4000,"ECU对31服务回复了错误的例程类型");
		}
		Diag_SetReqCheckResult(reqGroup,reqNum,RESULT_FAIL,gDiagResultDescription);
		return 1;
	}
	if((gTpRxData[2]!=RoutineIdentifier[0]) || (gTpRxData[3]!=RoutineIdentifier[1]))
	{
		if(gUDS_LanguageSet == 0)
		{
			snprintf(gDiagResultDescription,4000,"ECU gives posotive response, but the response RoutineIdentifer is wrong");
		}
		else
		{
			snprintf(gDiagResultDescription,4000,"ECU对31服务回复了错误的例程标识符");
		}
		Diag_SetReqCheckResult(reqGroup,reqNum,RESULT_FAIL,gDiagResultDescription);
		return 1;
	}


	if(gUDS_DescriptionExistFlag == 1)
	{
		if(gUDS_LanguageSet == 0)
		{
			PrintPID("UDS","Pos.Response",gTpRxData,gTpRxLength);
		}
		else
		{
			PrintPID("UDS","肯定响应",gTpRxData,gTpRxLength);
		}
	}
	return 2;

}

int CheckPosResponse_SID31(enum e_RoutineControlType RoutineType,byte RoutineIdentifier[],byte RoutineControlOptionRecord[],int RecordLenth,int reqGroup,int reqNum)
{
	int i;
	if((gBusFlag == 1)||(gBusFlag == 2)||(gBusFlag == 3)||(gBusFlag == 4)||(gBusFlag == 5))
  {
    if(SessionFlag==APP)
    {
      gRss=ECU_Response(gP2Client_APP,0x31);
    }
    else if(SessionFlag==BOOT)
    {
      gRss=ECU_Response(gP2Client_BOOT,0x31);
    }
    else
    {
       gRss=ECU_Response(gP2Client_APP,0x31);
    }
  }
	if(gRss!=POS)
	{
		if(gRss==TIMEOUT)
		{
			if(gUDS_LanguageSet == 0)
			{
				snprintf(gDiagResultDescription,4000,"Timeout no response recived when request service 0x31");
			}
			else
			{
				snprintf(gDiagResultDescription,4000,"请求超时，控制器对31服务未回复响应");
			}
			Diag_SetReqCheckResult(reqGroup,reqNum,RESULT_FAIL,gDiagResultDescription);
			return -1;
		}
		else
		{
			if(gUDS_LanguageSet == 0)
			{
				snprintf(gDiagResultDescription,4000,"ECU gives negative response 0x%02x to the request of service 0x31",gTpRxData[2]);
			}
			else
			{
				snprintf(gDiagResultDescription,4000,"ECU对31服务回复了负响应0x%02x",gTpRxData[2]);
			}
			Diag_SetReqCheckResult(reqGroup,reqNum,RESULT_FAIL,gDiagResultDescription);
			return -1;
		}
	}
	if(gTpRxData[0]!=0x71)
	{
		if(gUDS_LanguageSet == 0)
		{
			snprintf(gDiagResultDescription,4000,"ECU gives unexpect positive response service ID 0x%02x to the request of service 0x31",gTpRxData[0]);
		}
		else
		{
			snprintf(gDiagResultDescription,4000,"ECU对31服务回复了非预期的肯定响应0x%02x",gTpRxData[0]);
		}
		Diag_SetReqCheckResult(reqGroup,reqNum,RESULT_FAIL,gDiagResultDescription);
		return 1;
	}
	if(gTpRxData[1]!=RoutineType)
	{
		if(gUDS_LanguageSet == 0)
		{
			snprintf(gDiagResultDescription,4000,"ECU gives unexpected routine type 0x%02x to the service 0x31",gTpRxData[1]);
		}
		else
		{
			snprintf(gDiagResultDescription,4000,"ECU对31服务回复了错误的例程类型");
		}
		Diag_SetReqCheckResult(reqGroup,reqNum,RESULT_FAIL,gDiagResultDescription);
		return 1;
	}
	if((gTpRxData[2]!=RoutineIdentifier[0]) || (gTpRxData[3]!=RoutineIdentifier[1]))
	{
		if(gUDS_LanguageSet == 0)
		{
			snprintf(gDiagResultDescription,4000,"ECU gives posotive response, but the response RoutineIdentifer is wrong");
		}
		else
		{
			snprintf(gDiagResultDescription,4000,"ECU对31服务回复了错误的例程标识符");
		}
		Diag_SetReqCheckResult(reqGroup,reqNum,RESULT_FAIL,gDiagResultDescription);
		return 1;
	}
	if(RecordLenth+4!=gTpRxLength)
	{
		if(gUDS_LanguageSet == 0)
		{
			snprintf(gDiagResultDescription,4000,"ECU gives unexpect lenth to the request of service 0x31");
		}
		else
		{
			snprintf(gDiagResultDescription,4000,"ECU对31服务回复了错误的长度");
		}
		Diag_SetReqCheckResult(reqGroup,reqNum,RESULT_FAIL,gDiagResultDescription);
		return 1;
	}
	else
	{
		for(i=0; i<RecordLenth; i++)
		{
			RoutineControlOptionRecord[i] = gTpRxData[i+4];
		}
		if(gUDS_DescriptionExistFlag == 1)
		{
			if(gUDS_LanguageSet == 0)
			{
				PrintPID("UDS","Pos.Response",gTpRxData,gTpRxLength);
			}
			else
			{
				PrintPID("UDS","肯定响应",gTpRxData,gTpRxLength);
			}
		}
		return 2;
	}
}



void SID3D_WriteMemoryByAdress_14(byte MemoryAddress[],byte MemorySize[],byte dataRecord[],enum AddressMode Mode)
{
	int i,length;
	byte SID3D[100];
	SID3D[0]=0x3D;
	SID3D[1]=0x14;
	SID3D[2]=MemoryAddress[0];
	SID3D[3]=MemoryAddress[1];
	SID3D[4]=MemoryAddress[2];
	SID3D[5]=MemoryAddress[3];
	SID3D[6]=MemorySize[0];
	for(i=0; i<elcount(dataRecord); i++)
	{
		SID3D[i+7]=dataRecord[i];
	}
	length=7+elCount(dataRecord);

	TP_Send(SID3D,length,Mode);
	if(gUDS_DescriptionExistFlag == 1)
	{
		if(gUDS_LanguageSet == 0)
		{
			PrintPID("UDS","Request ",SID3D,length);
		}
		else
		{
			PrintPID("UDS","发送请求 ",SID3D,length);
		}
	}
}

int CheckPosResponse_SID3D(byte MemoryAddress[],byte MemorySize[],int reqGroup,int reqNum)
{
	if((gBusFlag == 1)||(gBusFlag == 2)||(gBusFlag == 3)||(gBusFlag == 4)||(gBusFlag == 5))
  {
    if(SessionFlag==APP)
    {
      gRss=ECU_Response(gP2Client_APP,0x3D);
    }
    else if(SessionFlag==BOOT)
    {
      gRss=ECU_Response(gP2Client_BOOT,0x3D);
    }
    else
    {
       gRss=ECU_Response(gP2Client_APP,0x3D);
    }
  }
	if(gRss!=POS)
	{
		if(gRss==TIMEOUT)
		{
			if(gUDS_LanguageSet == 0)
			{
				snprintf(gDiagResultDescription,4000,"Timeout no response recived when request service 0x3D");
			}
			else
			{
				snprintf(gDiagResultDescription,4000,"请求超时，控制器对3D服务未回复响应");
			}
			Diag_SetReqCheckResult(reqGroup,reqNum,RESULT_FAIL,gDiagResultDescription);
			return -1;
		}
		else
		{
			if(gUDS_LanguageSet == 0)
			{
				snprintf(gDiagResultDescription,4000,"ECU gives negative response 0x%02x to the request of service 0x3D",gTpRxData[2]);
			}
			else
			{
				snprintf(gDiagResultDescription,4000,"ECU对3D服务回复了负响应0x%02x",gTpRxData[2]);
			}
			Diag_SetReqCheckResult(reqGroup,reqNum,RESULT_FAIL,gDiagResultDescription);
			return -1;
		}
	}
	if(gTpRxData[0]!=0x7D)
	{
		if(gUDS_LanguageSet == 0)
		{
			snprintf(gDiagResultDescription,4000,"ECU gives unexpect positive response service ID 0x%02x to the request of service 0x3D",gTpRxData[0]);
		}
		else
		{
			snprintf(gDiagResultDescription,4000,"ECU对3D服务回复了非预期的肯定响应0x%02x",gTpRxData[0]);
		}
		Diag_SetReqCheckResult(reqGroup,reqNum,RESULT_FAIL,gDiagResultDescription);
		return 1;
	}
	else
	{
		if(gUDS_DescriptionExistFlag == 1)
		{
			if(gUDS_LanguageSet == 0)
			{
				PrintPID("UDS","Pos.Response",gTpRxData,gTpRxLength);
			}
			else
			{
				PrintPID("UDS","肯定响应",gTpRxData,gTpRxLength);
			}
		}
		return 2;
	}
}

void SID2C_DynamicallyDefinedDataIdentifier_Identifier(byte DynamicallyDefinedDataIdentifier[],byte sourceDataIdentifier[],int positionInSourceDataRecord,int memorySize,enum AddressMode Mode)
{
	byte SID2C[8];
	SID2C[0]=0x2C;
	SID2C[1]=0x01;
	SID2C[2]=DynamicallyDefinedDataIdentifier[0];
	SID2C[3]=DynamicallyDefinedDataIdentifier[1];
	SID2C[4]=sourceDataIdentifier[0];
	SID2C[5]=sourceDataIdentifier[1];
	SID2C[6]=positionInSourceDataRecord;
	SID2C[7]=memorySize;
	TP_Send(SID2C,Mode);
	if(gUDS_DescriptionExistFlag == 1)
	{
		if(gUDS_LanguageSet == 0)
		{
			PrintPID("UDS","Request ",SID2C,elCount(SID2C));
		}
		else
		{
			PrintPID("UDS","发送请求 ",SID2C,elCount(SID2C));
		}
	}
}

int CheckPosResponse_SID2C_Identifier(byte PID[],int reqGroup,int reqNum)
{
	if((gBusFlag == 1)||(gBusFlag == 2)||(gBusFlag == 3)||(gBusFlag == 4)||(gBusFlag == 5))
  {
    if(SessionFlag==APP)
    {
      gRss=ECU_Response(gP2Client_APP,0x2C);
    }
    else if(SessionFlag==BOOT)
    {
      gRss=ECU_Response(gP2Client_BOOT,0x2C);
    }
    else
    {
       gRss=ECU_Response(gP2Client_APP,0x2C);
    }
  }
	if(gRss!=POS)
	{
		if(gRss==TIMEOUT)
		{
			if(gUDS_LanguageSet == 0)
			{
				snprintf(gDiagResultDescription,4000,"Timeout no response recived when request service 0x2C");
			}
			else
			{
				snprintf(gDiagResultDescription,4000,"请求超时，控制器对2C服务未回复响应");
			}
			Diag_SetReqCheckResult(reqGroup,reqNum,RESULT_FAIL,gDiagResultDescription);
			return -1;
		}
		else
		{
			if(gUDS_LanguageSet == 0)
			{
				snprintf(gDiagResultDescription,4000,"ECU gives negative response 0x%02x to the request of service 0x2C",gTpRxData[2]);
			}
			else
			{
				snprintf(gDiagResultDescription,4000,"ECU对2C服务回复了负响应0x%02x",gTpRxData[2]);
			}
			Diag_SetReqCheckResult(reqGroup,reqNum,RESULT_FAIL,gDiagResultDescription);
			return -1;
		}
	}
	if(gTpRxData[0]!=0x6C)
	{
		if(gUDS_LanguageSet == 0)
		{
			snprintf(gDiagResultDescription,4000,"ECU gives unexpect positive response service ID 0x%02x to the request of service 0x2C",gTpRxData[0]);
		}
		else
		{
			snprintf(gDiagResultDescription,4000,"ECU对2C服务回复了非预期的肯定响应0x%02x",gTpRxData[0]);
		}
		Diag_SetReqCheckResult(reqGroup,reqNum,RESULT_FAIL,gDiagResultDescription);
		return 1;
	}
	if(gTpRxData[1]!=0x01)
	{
		if(gUDS_LanguageSet == 0)
		{
			snprintf(gDiagResultDescription,4000,"ECU gives unexpected subfunction 0x%02x to the service 0x2C",gTpRxData[1]);
		}
		else
		{
			snprintf(gDiagResultDescription,4000,"ECU对2C服务回复了错误的子功能");
		}
		Diag_SetReqCheckResult(reqGroup,reqNum,RESULT_FAIL,gDiagResultDescription);
		return 1;
	}
	if(gTpRxData[2]!=PID[0] && gTpRxData[3]!=PID[1])
	{
		if(gUDS_LanguageSet == 0)
		{
			snprintf(gDiagResultDescription,4000,"ECU gives posotive response, but the response DID is wrong");
		}
		else
		{
			snprintf(gDiagResultDescription,4000,"ECU对2F服务回复了错误的DID");
		}
		Diag_SetReqCheckResult(reqGroup,reqNum,RESULT_FAIL,gDiagResultDescription);
		return 1;
	}
	if(4!=gTpRxLength)
	{
		if(gUDS_LanguageSet == 0)
		{
			snprintf(gDiagResultDescription,4000,"ECU gives unexpect lenth to the request of service 0x2C");
		}
		else
		{
			snprintf(gDiagResultDescription,4000,"ECU对2C服务回复了错误的长度");
		}
		Diag_SetReqCheckResult(reqGroup,reqNum,RESULT_FAIL,gDiagResultDescription);
		return 1;
	}
	else
	{
		if(gUDS_DescriptionExistFlag == 1)
		{
			if(gUDS_LanguageSet == 0)
			{
				PrintPID("UDS","Pos.Response",gTpRxData,gTpRxLength);
			}
			else
			{
				PrintPID("UDS","肯定响应",gTpRxData,gTpRxLength);
			}
		}
		return 2;
	}
}

Void SID2C_DynamicallyDefinedDataIdentifier_Address_14(byte DynamicallyDefinedDataIdentifier[],byte MemoryAdddress[],int memorySize,enum AddressMode Mode)
{
	byte SID2C[10];
	SID2C[0]=0x2C;
	SID2C[1]=0x02;
	SID2C[2]=DynamicallyDefinedDataIdentifier[0];
	SID2C[3]=DynamicallyDefinedDataIdentifier[1];
	SID2C[4]=0x14;
	SID2C[5]=MemoryAdddress[0];
	SID2C[6]=MemoryAdddress[1];
	SID2C[7]=MemoryAdddress[2];
	SID2C[8]=MemoryAdddress[3];
	SID2C[9]=memorySize;

	TP_Send(SID2C,Mode);
	if(gUDS_DescriptionExistFlag == 1)
	{
		if(gUDS_LanguageSet == 0)
		{
			PrintPID("UDS","Request ",SID2C,elCount(SID2C));
		}
		else
		{
			PrintPID("UDS","发送请求 ",SID2C,elCount(SID2C));
		}
	}
}

int CheckPosResponse_SID2C_Address_14(byte PID[],int reqGroup,int reqNum)
{
	if((gBusFlag == 1)||(gBusFlag == 2)||(gBusFlag == 3)||(gBusFlag == 4)||(gBusFlag == 5))
  {
    if(SessionFlag==APP)
    {
      gRss=ECU_Response(gP2Client_APP,0x2C);
    }
    else if(SessionFlag==BOOT)
    {
      gRss=ECU_Response(gP2Client_BOOT,0x2C);
    }
    else
    {
       gRss=ECU_Response(gP2Client_APP,0x2C);
    }
  }
	if(gRss!=POS)
	{
		if(gRss==TIMEOUT)
		{
			if(gUDS_LanguageSet == 0)
			{
				snprintf(gDiagResultDescription,4000,"Timeout no response recived when request service 0x2C");
			}
			else
			{
				snprintf(gDiagResultDescription,4000,"请求超时，控制器对2C服务未回复响应");
			}
			Diag_SetReqCheckResult(reqGroup,reqNum,RESULT_FAIL,gDiagResultDescription);
			return -1;
		}
		else
		{
			if(gUDS_LanguageSet == 0)
			{
				snprintf(gDiagResultDescription,4000,"ECU gives negative response 0x%02x to the request of service 0x2C",gTpRxData[2]);
			}
			else
			{
				snprintf(gDiagResultDescription,4000,"ECU对2C服务回复了负响应0x%02x",gTpRxData[2]);
			}
			Diag_SetReqCheckResult(reqGroup,reqNum,RESULT_FAIL,gDiagResultDescription);
			return -1;
		}
	}
	if(gTpRxData[0]!=0x6C)
	{
		if(gUDS_LanguageSet == 0)
		{
			snprintf(gDiagResultDescription,4000,"ECU gives unexpect positive response service ID 0x%02x to the request of service 0x2C",gTpRxData[0]);
		}
		else
		{
			snprintf(gDiagResultDescription,4000,"ECU对2C服务回复了非预期的肯定响应0x%02x",gTpRxData[0]);
		}
		Diag_SetReqCheckResult(reqGroup,reqNum,RESULT_FAIL,gDiagResultDescription);
		return 1;
	}
	if(gTpRxData[1]!=0x02)
	{
		if(gUDS_LanguageSet == 0)
		{
			snprintf(gDiagResultDescription,4000,"ECU gives unexpected subfunction 0x%02x to the service 0x2C",gTpRxData[1]);
		}
		else
		{
			snprintf(gDiagResultDescription,4000,"ECU对2C服务回复了错误的子功能");
		}
		Diag_SetReqCheckResult(reqGroup,reqNum,RESULT_FAIL,gDiagResultDescription);
		return 1;
	}
	if(gTpRxData[2]!=PID[0] && gTpRxData[3]!=PID[1])
	{
		if(gUDS_LanguageSet == 0)
		{
			snprintf(gDiagResultDescription,4000,"ECU gives posotive response, but the response DID is wrong");
		}
		else
		{
			snprintf(gDiagResultDescription,4000,"ECU对2C服务回复了错误的DID");
		}
		Diag_SetReqCheckResult(reqGroup,reqNum,RESULT_FAIL,gDiagResultDescription);
		return 1;
	}
	if(4!=gTpRxLength)
	{
		if(gUDS_LanguageSet == 0)
		{
			snprintf(gDiagResultDescription,4000,"ECU gives unexpect lenth to the request of service 0x2C");
		}
		else
		{
			snprintf(gDiagResultDescription,4000,"ECU对2C服务回复了错误的长度");
		}
		Diag_SetReqCheckResult(reqGroup,reqNum,RESULT_FAIL,gDiagResultDescription);
		return 1;
	}
	else
	{
		if(gUDS_DescriptionExistFlag == 1)
		{
			if(gUDS_LanguageSet == 0)
			{
				PrintPID("UDS","Pos.Response",gTpRxData,gTpRxLength);
			}
			else
			{
				PrintPID("UDS","肯定响应",gTpRxData,gTpRxLength);
			}
		}
		return 2;
	}
}



Void SID2C_DynamicallyDefinedDataIdentifier_Address_24(byte DynamicallyDefinedDataIdentifier[],byte MemoryAdddress[],byte memorySize[],enum AddressMode Mode)
{
	byte SID2C[11];
	SID2C[0]=0x2C;
	SID2C[1]=0x02;
	SID2C[2]=DynamicallyDefinedDataIdentifier[0];
	SID2C[3]=DynamicallyDefinedDataIdentifier[1];
	SID2C[4]=0x14;
	SID2C[5]=MemoryAdddress[0];
	SID2C[6]=MemoryAdddress[1];
	SID2C[7]=MemoryAdddress[2];
	SID2C[8]=MemoryAdddress[3];
	SID2C[9]=memorySize[0];
	SID2C[10]=memorySize[1];

	TP_Send(SID2C,Mode);
	if(gUDS_DescriptionExistFlag == 1)
	{
		if(gUDS_LanguageSet == 0)
		{
			PrintPID("UDS","Request ",SID2C,elCount(SID2C));
		}
		else
		{
			PrintPID("UDS","发送请求 ",SID2C,elCount(SID2C));
		}
	}
}

int CheckPosResponse_SID2C_Address_24(byte PID[],int reqGroup,int reqNum)
{
	if((gBusFlag == 1)||(gBusFlag == 2)||(gBusFlag == 3)||(gBusFlag == 4)||(gBusFlag == 5))
  {
    if(SessionFlag==APP)
    {
      gRss=ECU_Response(gP2Client_APP,0x2C);
    }
    else if(SessionFlag==BOOT)
    {
      gRss=ECU_Response(gP2Client_BOOT,0x2C);
    }
    else
    {
       gRss=ECU_Response(gP2Client_APP,0x2C);
    }
  }
	if(gRss!=POS)
	{
		if(gRss==TIMEOUT)
		{
			if(gUDS_LanguageSet == 0)
			{
				snprintf(gDiagResultDescription,4000,"Timeout no response recived when request service 0x2C");
			}
			else
			{
				snprintf(gDiagResultDescription,4000,"请求超时，控制器对2C服务未回复响应");
			}
			Diag_SetReqCheckResult(reqGroup,reqNum,RESULT_FAIL,gDiagResultDescription);
			return -1;
		}
		else
		{
			if(gUDS_LanguageSet == 0)
			{
				snprintf(gDiagResultDescription,4000,"ECU gives negative response 0x%02x to the request of service 0x2C",gTpRxData[2]);
			}
			else
			{
				snprintf(gDiagResultDescription,4000,"ECU对2C服务回复了负响应0x%02x",gTpRxData[2]);
			}
			Diag_SetReqCheckResult(reqGroup,reqNum,RESULT_FAIL,gDiagResultDescription);
			return -1;
		}
	}
	if(gTpRxData[0]!=0x6C)
	{
		if(gUDS_LanguageSet == 0)
		{
			snprintf(gDiagResultDescription,4000,"ECU gives unexpect positive response service ID 0x%02x to the request of service 0x2C",gTpRxData[0]);
		}
		else
		{
			snprintf(gDiagResultDescription,4000,"ECU对2C服务回复了非预期的肯定响应0x%02x",gTpRxData[0]);
		}
		Diag_SetReqCheckResult(reqGroup,reqNum,RESULT_FAIL,gDiagResultDescription);
		return 1;
	}
	if(gTpRxData[1]!=0x02)
	{
		if(gUDS_LanguageSet == 0)
		{
			snprintf(gDiagResultDescription,4000,"ECU gives unexpected subfunction 0x%02x to the service 0x2C",gTpRxData[1]);
		}
		else
		{
			snprintf(gDiagResultDescription,4000,"ECU对2C服务回复了错误的子功能");
		}
		Diag_SetReqCheckResult(reqGroup,reqNum,RESULT_FAIL,gDiagResultDescription);
		return 1;
	}
	if(gTpRxData[2]!=PID[0] && gTpRxData[3]!=PID[1])
	{
		if(gUDS_LanguageSet == 0)
		{
			snprintf(gDiagResultDescription,4000,"ECU gives posotive response, but the response DID is wrong");
		}
		else
		{
			snprintf(gDiagResultDescription,4000,"ECU对2C服务回复了错误的DID");
		}
		Diag_SetReqCheckResult(reqGroup,reqNum,RESULT_FAIL,gDiagResultDescription);
		return 1;
	}
	if(4!=gTpRxLength)
	{
		if(gUDS_LanguageSet == 0)
		{
			snprintf(gDiagResultDescription,4000,"ECU gives unexpect lenth to the request of service 0x2C");
		}
		else
		{
			snprintf(gDiagResultDescription,4000,"ECU对2C服务回复了错误的长度");
		}
		Diag_SetReqCheckResult(reqGroup,reqNum,RESULT_FAIL,gDiagResultDescription);
		return 1;
	}
	else
	{
		if(gUDS_DescriptionExistFlag == 1)
		{
			if(gUDS_LanguageSet == 0)
			{
				PrintPID("UDS","Pos.Response",gTpRxData,gTpRxLength);
			}
			else
			{
				PrintPID("UDS","肯定响应",gTpRxData,gTpRxLength);
			}
		}
		return 2;
	}
}


Void SID2C_ClearDynamicallyDefinedDataIdentifier(enum AddressMode Mode)
{
	byte SID2C[2];
	SID2C[0]=0x2C;
	SID2C[1]=0x03;

	TP_Send(SID2C,Mode);
	if(gUDS_DescriptionExistFlag == 1)
	{
		if(gUDS_LanguageSet == 0)
		{
			PrintPID("UDS","Request ",SID2C,elCount(SID2C));
		}
		else
		{
			PrintPID("UDS","发送请求 ",SID2C,elCount(SID2C));
		}
	}
}

int CheckPosResponse_SID2C_Clear(int reqGroup,int reqNum)
{
	if((gBusFlag == 1)||(gBusFlag == 2)||(gBusFlag == 3)||(gBusFlag == 4)||(gBusFlag == 5))
  {
    if(SessionFlag==APP)
    {
      gRss=ECU_Response(gP2Client_APP,0x2C);
    }
    else if(SessionFlag==BOOT)
    {
      gRss=ECU_Response(gP2Client_BOOT,0x2C);
    }
    else
    {
       gRss=ECU_Response(gP2Client_APP,0x2C);
    }
  }
	if(gRss!=POS)
	{
		if(gRss==TIMEOUT)
		{
			if(gUDS_LanguageSet == 0)
			{
				snprintf(gDiagResultDescription,4000,"Timeout no response recived when request service 0x2C");
			}
			else
			{
				snprintf(gDiagResultDescription,4000,"请求超时，控制器对2C服务未回复响应");
			}
			Diag_SetReqCheckResult(reqGroup,reqNum,RESULT_FAIL,gDiagResultDescription);
			return -1;
		}
		else
		{
			if(gUDS_LanguageSet == 0)
			{
				snprintf(gDiagResultDescription,4000,"ECU gives negative response 0x%02x to the request of service 0x2C",gTpRxData[2]);
			}
			else
			{
				snprintf(gDiagResultDescription,4000,"ECU对2C服务回复了负响应0x%02x",gTpRxData[2]);
			}
			Diag_SetReqCheckResult(reqGroup,reqNum,RESULT_FAIL,gDiagResultDescription);
			return -1;
		}
	}
	if(gTpRxData[0]!=0x6C)
	{
		if(gUDS_LanguageSet == 0)
		{
			snprintf(gDiagResultDescription,4000,"ECU gives unexpect positive response service ID 0x%02x to the request of service 0x2C",gTpRxData[0]);
		}
		else
		{
			snprintf(gDiagResultDescription,4000,"ECU对2C服务回复了非预期的肯定响应0x%02x",gTpRxData[0]);
		}
		Diag_SetReqCheckResult(reqGroup,reqNum,RESULT_FAIL,gDiagResultDescription);
		return 1;
	}
	if(gTpRxData[1]!=0x03)
	{
		if(gUDS_LanguageSet == 0)
		{
			snprintf(gDiagResultDescription,4000,"ECU gives unexpected subfunction 0x%02x to the service 0x2C",gTpRxData[1]);
		}
		else
		{
			snprintf(gDiagResultDescription,4000,"ECU对2C服务回复了错误的子功能");
		}
		Diag_SetReqCheckResult(reqGroup,reqNum,RESULT_FAIL,gDiagResultDescription);
		return 1;
	}
	if(2!=gTpRxLength)
	{
		if(gUDS_LanguageSet == 0)
		{
			snprintf(gDiagResultDescription,4000,"ECU gives unexpect lenth to the request of service 0x2C");
		}
		else
		{
			snprintf(gDiagResultDescription,4000,"ECU对2C服务回复了错误的长度");
		}
		Diag_SetReqCheckResult(reqGroup,reqNum,RESULT_FAIL,gDiagResultDescription);
		return 1;
	}
	else
	{
		if(gUDS_DescriptionExistFlag == 1)
		{
			if(gUDS_LanguageSet == 0)
			{
				PrintPID("UDS","Pos.Response",gTpRxData,gTpRxLength);
			}
			else
			{
				PrintPID("UDS","肯定响应",gTpRxData,gTpRxLength);
			}
		}
		return 2;
	}
}


Void SID2C_ClearDynamicallyDefinedDataIdentifier_withDID(byte DynamicallyDefinedDataIdentifier[],enum AddressMode Mode)
{
	byte SID2C[4];
	SID2C[0]=0x2C;
	SID2C[1]=0x03;
	SID2C[2]=DynamicallyDefinedDataIdentifier[0];
	SID2C[3]=DynamicallyDefinedDataIdentifier[1];

	TP_Send(SID2C,Mode);
	if(gUDS_DescriptionExistFlag == 1)
	{
		if(gUDS_LanguageSet == 0)
		{
			PrintPID("UDS","Request ",SID2C,elCount(SID2C));
		}
		else
		{
			PrintPID("UDS","发送请求 ",SID2C,elCount(SID2C));
		}
	}
}

int CheckPosResponse_SID2C_ClearwithDID(byte PID[],int reqGroup,int reqNum)
{
	if((gBusFlag == 1)||(gBusFlag == 2)||(gBusFlag == 3)||(gBusFlag == 4)||(gBusFlag == 5))
  {
    if(SessionFlag==APP)
    {
      gRss=ECU_Response(gP2Client_APP,0x2C);
    }
    else if(SessionFlag==BOOT)
    {
      gRss=ECU_Response(gP2Client_BOOT,0x2C);
    }
    else
    {
       gRss=ECU_Response(gP2Client_APP,0x2C);
    }
  }
	if(gRss!=POS)
	{
		if(gRss==TIMEOUT)
		{
			if(gUDS_LanguageSet == 0)
			{
				snprintf(gDiagResultDescription,4000,"Timeout no response recived when request service 0x2C");
			}
			else
			{
				snprintf(gDiagResultDescription,4000,"请求超时，控制器对2C服务未回复响应");
			}
			Diag_SetReqCheckResult(reqGroup,reqNum,RESULT_FAIL,gDiagResultDescription);
			return -1;
		}
		else
		{
			if(gUDS_LanguageSet == 0)
			{
				snprintf(gDiagResultDescription,4000,"ECU gives negative response 0x%02x to the request of service 0x2C",gTpRxData[2]);
			}
			else
			{
				snprintf(gDiagResultDescription,4000,"ECU对2C服务回复了负响应0x%02x",gTpRxData[2]);
			}
			Diag_SetReqCheckResult(reqGroup,reqNum,RESULT_FAIL,gDiagResultDescription);
			return -1;
		}
	}
	if(gTpRxData[0]!=0x6C)
	{
		if(gUDS_LanguageSet == 0)
		{
			snprintf(gDiagResultDescription,4000,"ECU gives unexpect positive response service ID 0x%02x to the request of service 0x2C",gTpRxData[0]);
		}
		else
		{
			snprintf(gDiagResultDescription,4000,"ECU对2C服务回复了非预期的肯定响应0x%02x",gTpRxData[0]);
		}
		Diag_SetReqCheckResult(reqGroup,reqNum,RESULT_FAIL,gDiagResultDescription);
		return 1;
	}
	if(gTpRxData[1]!=0x03)
	{
		if(gUDS_LanguageSet == 0)
		{
			snprintf(gDiagResultDescription,4000,"ECU gives unexpected subfunction 0x%02x to the service 0x2C",gTpRxData[1]);
		}
		else
		{
			snprintf(gDiagResultDescription,4000,"ECU对2C服务回复了错误的子功能");
		}
		Diag_SetReqCheckResult(reqGroup,reqNum,RESULT_FAIL,gDiagResultDescription);
		return 1;
	}
	if(gTpRxData[2]!=PID[0] && gTpRxData[3]!=PID[1])
	{
		if(gUDS_LanguageSet == 0)
		{
			snprintf(gDiagResultDescription,4000,"ECU gives posotive response, but the response DID is wrong");
		}
		else
		{
			snprintf(gDiagResultDescription,4000,"ECU对2C服务回复了错误的DID");
		}
		Diag_SetReqCheckResult(reqGroup,reqNum,RESULT_FAIL,gDiagResultDescription);
		return 1;
	}
	if(4!=gTpRxLength)
	{
		if(gUDS_LanguageSet == 0)
		{
			snprintf(gDiagResultDescription,4000,"ECU gives unexpect lenth to the request of service 0x2C");
		}
		else
		{
			snprintf(gDiagResultDescription,4000,"ECU对2C服务回复了错误的长度");
		}
		Diag_SetReqCheckResult(reqGroup,reqNum,RESULT_FAIL,gDiagResultDescription);
		return 1;
	}
	else
	{
		if(gUDS_DescriptionExistFlag == 1)
		{
			if(gUDS_LanguageSet == 0)
			{
				PrintPID("UDS","Pos.Response",gTpRxData,gTpRxLength);
			}
			else
			{
				PrintPID("UDS","肯定响应",gTpRxData,gTpRxLength);
			}
		}
		return 2;
	}
}

void SID34_RequestDownload(int dataFormatIdentifier,byte addressAndLengthFormatIdentifier,byte memoryaddress[],byte memorysize[],enum AddressMode Mode)
{
	byte SID34[11];
	int  i,Size,Address;
	SID34[0]  = 0x34;
	SID34[1]  = dataFormatIdentifier;
	SID34[2]  = addressAndLengthFormatIdentifier;
	Size=addressAndLengthFormatIdentifier>>4;
	Address=addressAndLengthFormatIdentifier&0x0F;
	/////MemoryAddress//////
	for(i=0; i<Address; i++)
		SID34[i+3]  = memoryaddress[i];
	/////MemorySize/////////
	for(i=0; i<Size; i++)
		SID34[i+3+Address]  = memorysize[i];
	TP_Send(SID34,Mode);
	if(gUDS_DescriptionExistFlag == 1)
	{
		if(gUDS_LanguageSet == 0)
		{
			PrintPID("UDS","Request ",SID34,elCount(SID34));
		}
		else
		{
			PrintPID("UDS","发送请求 ",SID34,elCount(SID34));
		}
	}
}


int CheckPosResponse_SID34_RequestDownload(byte lengthFormatIdentifier,int reqGroup,int reqNum)
{
	int MaxNumberOfBlockLenth;
  int tempLength,j;
	if((gBusFlag == 1)||(gBusFlag == 2)||(gBusFlag == 3)||(gBusFlag == 4)||(gBusFlag == 5))
  {
    if(SessionFlag==APP)
    {
      gRss=ECU_Response(gP2Client_APP,0x34);
    }
    else if(SessionFlag==BOOT)
    {
      gRss=ECU_Response(gP2Client_BOOT,0x34);
    }
    else
    {
       gRss=ECU_Response(gP2Client_APP,0x34);
    }
  }
	if(gRss!=POS)
	{
		if(gRss==TIMEOUT)
		{
			if(gUDS_LanguageSet == 0)
			{
				snprintf(gDiagResultDescription,4000,"Timeout no response recived when request service 0x34");
			}
			else
			{
				snprintf(gDiagResultDescription,4000,"请求超时，控制器对34服务未回复响应");
			}
			Diag_SetReqCheckResult(reqGroup,reqNum,RESULT_FAIL,gDiagResultDescription);
			return -1;
		}
		else
		{
			if(gUDS_LanguageSet == 0)
			{
				snprintf(gDiagResultDescription,4000,"ECU gives negative response 0x%02x to the request of service 0x34",gTpRxData[2]);
			}
			else
			{
				snprintf(gDiagResultDescription,4000,"ECU对34服务回复了负响应0x%02x",gTpRxData[2]);
			}
			Diag_SetReqCheckResult(reqGroup,reqNum,RESULT_FAIL,gDiagResultDescription);
			return -1;
		}
	}
	if(gTpRxData[0]!=0x74)
	{
		if(gUDS_LanguageSet == 0)
		{
			snprintf(gDiagResultDescription,4000,"ECU gives unexpect positive response service ID 0x%02x to the request of service 0x34",gTpRxData[0]);
		}
		else
		{
			snprintf(gDiagResultDescription,4000,"ECU对34服务回复了非预期的肯定响应0x%02x",gTpRxData[0]);
		}
		Diag_SetReqCheckResult(reqGroup,reqNum,RESULT_FAIL,gDiagResultDescription);
		return 1;
	}
	if(gTpRxData[1]!=lengthFormatIdentifier)
	{
		if(gUDS_LanguageSet == 0)
		{
			snprintf(gDiagResultDescription,4000,"ECU gives unexpect lengthFormatIdentifier 0x%02x in the request of service 0x34",gTpRxData[1]);
		}
		else
		{
			snprintf(gDiagResultDescription,4000,"ECU对34服务响应了错误的lengthFormatIdentifier",gTpRxData[1]);
		}
		Diag_SetReqCheckResult(reqGroup,reqNum,RESULT_FAIL,gDiagResultDescription);
		return 1;
	}
  tempLength = gTpRxData[1]>>4;
	if((tempLength + 2)!=gTpRxLength)
	{
		if(gUDS_LanguageSet == 0)
		{
			snprintf(gDiagResultDescription,4000,"ECU gives unexpect lenth to the request of service 0x34");
		}
		else
		{
			snprintf(gDiagResultDescription,4000,"ECU对34服务回复了错误的长度");
		}
		Diag_SetReqCheckResult(reqGroup,reqNum,RESULT_FAIL,gDiagResultDescription);
		return 1;
	}
	else
	{
    gMaxNumberOfBlockLenth = 0;
    for(j=0;j<tempLength;j++)
    {
      gMaxNumberOfBlockLenth = gMaxNumberOfBlockLenth + (gTpRxData[j+2]<<(8*(tempLength-1-j)));
    }
		gMaxNumberOfBlockLenth = gMaxNumberOfBlockLenth - 2;
		if(gUDS_DescriptionExistFlag == 1)
		{
			if(gUDS_LanguageSet == 0)
			{
				PrintPID("UDS","Pos.Response",gTpRxData,gTpRxLength);
			}
			else
			{
				PrintPID("UDS","肯定响应",gTpRxData,gTpRxLength);
			}
		}
		return 2;
	}
}


void SID35_RequestUpload(int dataFormatIdentifier,byte addressAndLengthFormatIdentifier,byte memoryaddress[],byte memorysize[],enum AddressMode Mode)
{
	byte SID35[11];
	int  i,Size,Address;
	SID35[0]  = 0x35;
	SID35[1]  = dataFormatIdentifier;
	SID35[2]  = addressAndLengthFormatIdentifier;
	Size=addressAndLengthFormatIdentifier>>4;
	Address=addressAndLengthFormatIdentifier&0xF;
	/////MemoryAddress//////
	for(i=0; i<Address; i++)
		SID35[i+3]  = memoryaddress[i];
	/////MemorySize/////////
	for(i=0; i<Size; i++)
		SID35[i+3+Address]  = memorysize[i];
	TP_Send(SID35,Mode);
	if(gUDS_DescriptionExistFlag == 1)
	{
		if(gUDS_LanguageSet == 0)
		{
			PrintPID("UDS","Request ",SID35,elCount(SID35));
		}
		else
		{
			PrintPID("UDS","发送请求 ",SID35,elCount(SID35));
		}
	}
}

int CheckPosResponse_SID35_RequestUpload(byte lengthFormatIdentifier,int reqGroup,int reqNum)
{
	int MaxNumberOfBlockLenth;
	if((gBusFlag == 1)||(gBusFlag == 2)||(gBusFlag == 3)||(gBusFlag == 4)||(gBusFlag == 5))
  {
    if(SessionFlag==APP)
    {
      gRss=ECU_Response(gP2Client_APP,0x35);
    }
    else if(SessionFlag==BOOT)
    {
      gRss=ECU_Response(gP2Client_BOOT,0x35);
    }
    else
    {
       gRss=ECU_Response(gP2Client_APP,0x35);
    }
  }
	if(gRss!=POS)
	{
		if(gRss==TIMEOUT)
		{
			if(gUDS_LanguageSet == 0)
			{
				snprintf(gDiagResultDescription,4000,"Timeout no response recived when request service 0x35");
			}
			else
			{
				snprintf(gDiagResultDescription,4000,"请求超时，控制器对35服务未回复响应");
			}
			Diag_SetReqCheckResult(reqGroup,reqNum,RESULT_FAIL,gDiagResultDescription);
			return -1;
		}
		else
		{
			if(gUDS_LanguageSet == 0)
			{
				snprintf(gDiagResultDescription,4000,"ECU gives negative response 0x%02x to the request of service 0x35",gTpRxData[2]);
			}
			else
			{
				snprintf(gDiagResultDescription,4000,"ECU对35服务回复了负响应0x%02x",gTpRxData[2]);
			}
			Diag_SetReqCheckResult(reqGroup,reqNum,RESULT_FAIL,gDiagResultDescription);
			return -1;
		}
	}
	if(gTpRxData[0]!=0x75)
	{
		if(gUDS_LanguageSet == 0)
		{
			snprintf(gDiagResultDescription,4000,"ECU gives unexpect positive response service ID 0x%02x to the request of service 0x35",gTpRxData[0]);
		}
		else
		{
			snprintf(gDiagResultDescription,4000,"ECU对35服务回复了非预期的肯定响应0x%02x",gTpRxData[0]);
		}
		Diag_SetReqCheckResult(reqGroup,reqNum,RESULT_FAIL,gDiagResultDescription);
		return 1;
	}
	if(gTpRxData[1]!=lengthFormatIdentifier)
	{
		if(gUDS_LanguageSet == 0)
		{
			snprintf(gDiagResultDescription,4000,"ECU gives unexpect lengthFormatIdentifier 0x%02x in the request of service 0x35",gTpRxData[1]);
		}
		else
		{
			snprintf(gDiagResultDescription,4000,"ECU对35服务响应了错误的lengthFormatIdentifier",gTpRxData[1]);
		}
		Diag_SetReqCheckResult(reqGroup,reqNum,RESULT_FAIL,gDiagResultDescription);
		return 1;
	}
	if(4!=gTpRxLength)
	{
		if(gUDS_LanguageSet == 0)
		{
			snprintf(gDiagResultDescription,4000,"ECU gives unexpect lenth to the request of service 0x35");
		}
		else
		{
			snprintf(gDiagResultDescription,4000,"ECU对35服务回复了错误的长度");
		}
		Diag_SetReqCheckResult(reqGroup,reqNum,RESULT_FAIL,gDiagResultDescription);
		return 1;
	}
	else
	{
		gMaxNumberOfBlockLenth = (gTpRxData[2]<<8) + gTpRxData[3] - 2;
		if(gUDS_DescriptionExistFlag == 1)
		{
			if(gUDS_LanguageSet == 0)
			{
				PrintPID("UDS","Pos.Response",gTpRxData,gTpRxLength);
			}
			else
			{
				PrintPID("UDS","肯定响应",gTpRxData,gTpRxLength);
			}
		}
		return 2;
	}
}


void SID36_TransferData(byte Data[],long length,int Counter,enum AddressMode Mode)
{
	byte SID36[65536];
	dword n;
	SID36[0]=0x36;
	SID36[1]=Counter;
	//testStep("Chk 0x36","Transfer data. Send Counter=%d,SID36[1]=%d",Counter,SID36[1]);
	for(n=0; n<length; n++)
	{
		SID36[n+2]=Data[n];
	}

	if(gBusFlag != 4)
	{
		TP_Send(SID36,length+2,Mode);
	}

	if(gUDS_DescriptionExistFlag == 1)
	{
		if(gUDS_LanguageSet == 0)
		{
			PrintPID("UDS","Request ",SID36,20);
		}
		else
		{
			PrintPID("UDS","发送请求 ",SID36,20);
		}
	}
}

void SID36_TransferData(int Counter,enum AddressMode Mode)
{
	byte SID36[2];
	SID36[0]=0x36;
	SID36[1]=Counter;
	TP_Send(SID36,2,Mode);
	//writeLineEx(4,1,"%s-%f: Send $36 data",timeBuf,(timeNow()/100000.0));
	if(gUDS_DescriptionExistFlag == 1)
	{
		if(gUDS_LanguageSet == 0)
		{
			PrintPID("UDS","Request ",SID36,elCount(SID36));
		}
		else
		{
			PrintPID("UDS","发送请求 ",SID36,elCount(SID36));
		}
	}
}

int CheckPosResponse_SID36_TransferData(int Counter,int reqGroup,int reqNum)
{
	if((gBusFlag == 1)||(gBusFlag == 2)||(gBusFlag == 3)||(gBusFlag == 4)||(gBusFlag == 5))
  {
    if(SessionFlag==APP)
    {
      gRss=ECU_Response(gP2Client_APP,0x36);
    }
    else if(SessionFlag==BOOT)
    {
      gRss=ECU_Response(gP2Client_BOOT,0x36);
    }
    else
    {
       gRss=ECU_Response(gP2Client_APP,0x36);
    }
  }
	if(gBusFlag != 4)
	{
		if(gRss!=POS)
		{
			if(gRss==TIMEOUT)
			{
				if(gUDS_LanguageSet == 0)
				{
					snprintf(gDiagResultDescription,4000,"Timeout no response recived when request service 0x36");
				}
				else
				{
					snprintf(gDiagResultDescription,4000,"请求超时，控制器对36服务未回复响应");
				}
				Diag_SetReqCheckResult(reqGroup,reqNum,RESULT_FAIL,gDiagResultDescription);
				return -1;
			}
			else
			{
				if(gUDS_LanguageSet == 0)
				{
					snprintf(gDiagResultDescription,4000,"ECU gives negative response 0x%02x to the request of service 0x36",gTpRxData[2]);
				}
				else
				{
					snprintf(gDiagResultDescription,4000,"ECU对36服务回复了负响应0x%02x",gTpRxData[2]);
				}
				Diag_SetReqCheckResult(reqGroup,reqNum,RESULT_FAIL,gDiagResultDescription);
				return -1;
			}
		}
		if(gTpRxData[0]!=0x76)
		{
			if(gUDS_LanguageSet == 0)
			{
				snprintf(gDiagResultDescription,4000,"ECU gives unexpect positive response service ID 0x%02x to the request of service 0x36",gTpRxData[0]);
			}
			else
			{
				snprintf(gDiagResultDescription,4000,"ECU对36服务回复了非预期的肯定响应0x%02x",gTpRxData[0]);
			}
			Diag_SetReqCheckResult(reqGroup,reqNum,RESULT_FAIL,gDiagResultDescription);
			return 1;
		}
		if(gTpRxData[1]!=Counter)
		{
			if(gUDS_LanguageSet == 0)
			{
				snprintf(gDiagResultDescription,4000,"Wrong block sequence counter 0x%02x",gTpRxData[1]);
			}
			else
			{
				snprintf(gDiagResultDescription,4000,"ECU响应了错误的Counter值",gTpRxData[1]);
			}
			Diag_SetReqCheckResult(reqGroup,reqNum,RESULT_FAIL,gDiagResultDescription);
			return 1;
		}
		if(2!=gTpRxLength)
		{
			if(gUDS_LanguageSet == 0)
			{
				snprintf(gDiagResultDescription,4000,"ECU gives unexpect lenth to the request of service 0x36");
			}
			else
			{
				snprintf(gDiagResultDescription,4000,"ECU对36服务回复了错误的长度");
			}
			Diag_SetReqCheckResult(reqGroup,reqNum,RESULT_FAIL,gDiagResultDescription);
			return 1;
		}
		else
		{
			if(gUDS_DescriptionExistFlag == 1)
			{
				if(gUDS_LanguageSet == 0)
				{
					PrintPID("UDS","Pos.Response",gTpRxData,gTpRxLength);
				}
				else
				{
					PrintPID("UDS","肯定响应",gTpRxData,gTpRxLength);
				}
			}
			return 2;
		}
	}
  return 2;
}

int CheckPosResponse_SID36_TransferData(int Counter,int Lenth,int reqGroup,int reqNum)
{
	if((gBusFlag == 1)||(gBusFlag == 2)||(gBusFlag == 3)||(gBusFlag == 4)||(gBusFlag == 5))
  {
    if(SessionFlag==APP)
    {
      gRss=ECU_Response(gP2Client_APP,0x36);
    }
    else if(SessionFlag==BOOT)
    {
      gRss=ECU_Response(gP2Client_BOOT,0x36);
    }
    else
    {
       gRss=ECU_Response(gP2Client_APP,0x36);
    }
  }
	if(gRss!=POS)
	{
		if(gRss==TIMEOUT)
		{
			if(gUDS_LanguageSet == 0)
			{
				snprintf(gDiagResultDescription,4000,"Timeout no response recived when request service 0x36");
			}
			else
			{
				snprintf(gDiagResultDescription,4000,"请求超时，控制器对36服务未回复响应");
			}
			Diag_SetReqCheckResult(reqGroup,reqNum,RESULT_FAIL,gDiagResultDescription);
			return -1;
		}
		else
		{
			if(gUDS_LanguageSet == 0)
			{
				snprintf(gDiagResultDescription,4000,"ECU gives negative response 0x%02x to the request of service 0x36",gTpRxData[2]);
			}
			else
			{
				snprintf(gDiagResultDescription,4000,"ECU对36服务回复了负响应0x%02x",gTpRxData[2]);
			}
			Diag_SetReqCheckResult(reqGroup,reqNum,RESULT_FAIL,gDiagResultDescription);
			return -1;
		}
	}
	if(gTpRxData[0]!=0x76)
	{
		if(gUDS_LanguageSet == 0)
		{
			snprintf(gDiagResultDescription,4000,"ECU gives unexpect positive response service ID 0x%02x to the request of service 0x36",gTpRxData[0]);
		}
		else
		{
			snprintf(gDiagResultDescription,4000,"ECU对36服务回复了非预期的肯定响应0x%02x",gTpRxData[0]);
		}
		Diag_SetReqCheckResult(reqGroup,reqNum,RESULT_FAIL,gDiagResultDescription);
		return 1;
	}
	if(gTpRxData[1]!=Counter)
	{
		if(gUDS_LanguageSet == 0)
		{
			snprintf(gDiagResultDescription,4000,"Wrong block sequence counter 0x%02x",gTpRxData[1]);
		}
		else
		{
			snprintf(gDiagResultDescription,4000,"ECU响应了错误的Counter值",gTpRxData[1]);
		}
		Diag_SetReqCheckResult(reqGroup,reqNum,RESULT_FAIL,gDiagResultDescription);
		return 1;
	}
	if(Lenth!=gTpRxLength)
	{
		if(gUDS_LanguageSet == 0)
		{
			snprintf(gDiagResultDescription,4000,"ECU gives unexpect lenth to the request of service 0x36");
		}
		else
		{
			snprintf(gDiagResultDescription,4000,"ECU对36服务回复了错误的长度");
		}
		Diag_SetReqCheckResult(reqGroup,reqNum,RESULT_FAIL,gDiagResultDescription);
		return 1;
	}
	else
	{
		if(gUDS_DescriptionExistFlag == 1)
		{
			if(gUDS_LanguageSet == 0)
			{
				PrintPID("UDS","Pos.Response",gTpRxData,gTpRxLength);
			}
			else
			{
				PrintPID("UDS","肯定响应",gTpRxData,gTpRxLength);
			}
		}
		return 2;
	}
}


void SID37_RequestTransferExit(enum AddressMode Mode)
{
	byte SID37[1];
	SID37[0]=0x37;
	TP_Send(SID37,Mode);
	if(gUDS_DescriptionExistFlag == 1)
	{
		if(gUDS_LanguageSet == 0)
		{
			PrintPID("UDS","Request ",SID37,elCount(SID37));
		}
		else
		{
			PrintPID("UDS","发送请求 ",SID37,elCount(SID37));
		}
	}
}

void SID37_RequestTransferExit(byte TransferRequestParameterRecord[],enum AddressMode Mode)
{
	byte SID37[10];
	int  i;
	SID37[0]=0x37;
	for(i=0; i<elCount(TransferRequestParameterRecord); i++)
		SID37[i+1]=TransferRequestParameterRecord[i];
	TP_Send(SID37,elCount(TransferRequestParameterRecord)+1,Mode);
	if(gUDS_DescriptionExistFlag == 1)
	{
		if(gUDS_LanguageSet == 0)
		{
			PrintPID("UDS","Request ",SID37,elCount(TransferRequestParameterRecord)+1);
		}
		else
		{
			PrintPID("UDS","发送请求 ",SID37,elCount(TransferRequestParameterRecord)+1);
		}
	}
}

int CheckPosResponse_SID37_RequestTransferExit(int reqGroup,int reqNum)
{
	if((gBusFlag == 1)||(gBusFlag == 2)||(gBusFlag == 3)||(gBusFlag == 4)||(gBusFlag == 5))
  {
    if(SessionFlag==APP)
    {
      gRss=ECU_Response(gP2Client_APP,0x37);
    }
    else if(SessionFlag==BOOT)
    {
      gRss=ECU_Response(gP2Client_BOOT,0x37);
    }
    else
    {
       gRss=ECU_Response(gP2Client_APP,0x37);
    }
  }
	if(gRss!=POS)
	{
		if(gRss==TIMEOUT)
		{
			if(gUDS_LanguageSet == 0)
			{
				snprintf(gDiagResultDescription,4000,"Timeout no response recived when request service 0x37");
			}
			else
			{
				snprintf(gDiagResultDescription,4000,"请求超时，控制器对37服务未回复响应");
			}
			Diag_SetReqCheckResult(reqGroup,reqNum,RESULT_FAIL,gDiagResultDescription);
			return -1;
		}
		else
		{
			if(gUDS_LanguageSet == 0)
			{
				snprintf(gDiagResultDescription,4000,"ECU gives negative response 0x%02x to the request of service 0x37",gTpRxData[2]);
			}
			else
			{
				snprintf(gDiagResultDescription,4000,"ECU对37服务回复了负响应0x%02x",gTpRxData[2]);
			}
			Diag_SetReqCheckResult(reqGroup,reqNum,RESULT_FAIL,gDiagResultDescription);
			return -1;
		}
	}
	if(gTpRxData[0]!=0x77)
	{
		if(gUDS_LanguageSet == 0)
		{
			snprintf(gDiagResultDescription,4000,"ECU gives unexpect positive response service ID 0x%02x to the request of service 0x37",gTpRxData[0]);
		}
		else
		{
			snprintf(gDiagResultDescription,4000,"ECU对37服务回复了非预期的肯定响应0x%02x",gTpRxData[0]);
		}
		Diag_SetReqCheckResult(reqGroup,reqNum,RESULT_FAIL,gDiagResultDescription);
		return 1;
	}
	if(1!=gTpRxLength)
	{
		if(gUDS_LanguageSet == 0)
		{
			snprintf(gDiagResultDescription,4000,"ECU gives unexpect lenth to the request of service 0x37");
		}
		else
		{
			snprintf(gDiagResultDescription,4000,"ECU对37服务回复了错误的长度");
		}
		Diag_SetReqCheckResult(reqGroup,reqNum,RESULT_FAIL,gDiagResultDescription);
		return 1;
	}
	else
	{
		if(gUDS_DescriptionExistFlag == 1)
		{
			if(gUDS_LanguageSet == 0)
			{
				PrintPID("UDS","Pos.Response",gTpRxData,gTpRxLength);
			}
			else
			{
				PrintPID("UDS","肯定响应",gTpRxData,gTpRxLength);
			}
		}
		return 2;
	}
}

int CheckPosResponse_SID37_RequestTransferExit(int LenthOfRecord,int reqGroup,int reqNum)
{
	if((gBusFlag == 1)||(gBusFlag == 2)||(gBusFlag == 3)||(gBusFlag == 4)||(gBusFlag == 5))
  {
    if(SessionFlag==APP)
    {
      gRss=ECU_Response(gP2Client_APP,0x37);
    }
    else if(SessionFlag==BOOT)
    {
      gRss=ECU_Response(gP2Client_BOOT,0x37);
    }
    else
    {
       gRss=ECU_Response(gP2Client_APP,0x37);
    }
  }
	if(gRss!=POS)
	{
		if(gRss==TIMEOUT)
		{
			if(gUDS_LanguageSet == 0)
			{
				snprintf(gDiagResultDescription,4000,"Timeout no response recived when request service 0x37");
			}
			else
			{
				snprintf(gDiagResultDescription,4000,"请求超时，控制器对37服务未回复响应");
			}
			Diag_SetReqCheckResult(reqGroup,reqNum,RESULT_FAIL,gDiagResultDescription);
			return -1;
		}
		else
		{
			if(gUDS_LanguageSet == 0)
			{
				snprintf(gDiagResultDescription,4000,"ECU gives negative response 0x%02x to the request of service 0x37",gTpRxData[2]);
			}
			else
			{
				snprintf(gDiagResultDescription,4000,"ECU对37服务回复了负响应0x%02x",gTpRxData[2]);
			}
			Diag_SetReqCheckResult(reqGroup,reqNum,RESULT_FAIL,gDiagResultDescription);
			return -1;
		}
	}
	if(gTpRxData[0]!=0x77)
	{
		if(gUDS_LanguageSet == 0)
		{
			snprintf(gDiagResultDescription,4000,"ECU gives unexpect positive response service ID 0x%02x to the request of service 0x37",gTpRxData[0]);
		}
		else
		{
			snprintf(gDiagResultDescription,4000,"ECU对37服务回复了非预期的肯定响应0x%02x",gTpRxData[0]);
		}
		Diag_SetReqCheckResult(reqGroup,reqNum,RESULT_FAIL,gDiagResultDescription);
		return 1;
	}
	if(LenthOfRecord!=gTpRxLength)
	{
		if(gUDS_LanguageSet == 0)
		{
			snprintf(gDiagResultDescription,4000,"ECU gives unexpect lenth to the request of service 0x37");
		}
		else
		{
			snprintf(gDiagResultDescription,4000,"ECU对37服务回复了错误的长度");
		}
		Diag_SetReqCheckResult(reqGroup,reqNum,RESULT_FAIL,gDiagResultDescription);
		return 1;
	}
	else
	{
		if(gUDS_DescriptionExistFlag == 1)
		{
			if(gUDS_LanguageSet == 0)
			{
				PrintPID("UDS","Pos.Response",gTpRxData,gTpRxLength);
			}
			else
			{
				PrintPID("UDS","肯定响应",gTpRxData,gTpRxLength);
			}
		}
		return 2;
	}
}
void SID29_Authentication_verifyCertificateUnidirectional(byte communicationConfiguration,word lengthOfCertificateClient,byte certificateClient[],word lengthOfChallengeClient,enum AddressMode Mode)
{
	byte SID29[2048];
	int  i;
	SID29[0]=0x29;
  SID29[1]=0x01;
  SID29[2]=communicationConfiguration;
  SID29[3]=lengthOfCertificateClient>>8;
  SID29[4]=lengthOfCertificateClient;
	for(i=0; i<lengthOfCertificateClient; i++)
  {
 		SID29[i+5]=certificateClient[i];
//    Teststep("","SID29[%d+5]=%x",i,certificateClient[i]);
  }

  testWaitForTimeout(1);
  SID29[i+5]=0;
  SID29[i+6]=0;


//  write("=================%x",SID29[i+5]);
//  write("=================%x",SID29[i+6]);
//  write("=================%x",SID29[i+7]);
//  PrintPID("UDS","Cert: ",certificateClient,lengthOfCertificateClient);
	TP_Send(SID29,lengthOfCertificateClient+7,Mode);
	if(gUDS_DescriptionExistFlag == 1)
	{
		if(gUDS_LanguageSet == 0)
		{
			PrintPID("UDS","Request ",SID29,lengthOfCertificateClient+7);
		}
		else
		{
			PrintPID("UDS","发送请求 ",SID29,lengthOfCertificateClient+7);
		}
	}
}

int CheckPosResponse_SID29_verifyCertificateUnidirectional(byte authenticationReturnParameter,word lengthOfChallengeServer,byte challengeServer[],word lengthOfEphemeralPublicKeyServer,int reqGroup,int reqNum)
{
  int i=0;

	if((gBusFlag == 1)||(gBusFlag == 2)||(gBusFlag == 3)||(gBusFlag == 4)||(gBusFlag == 5))
  {
    if(SessionFlag==APP)
    {
      gRss=ECU_Response(gP2Client_APP,0x29);
    }
    else if(SessionFlag==BOOT)
    {
      gRss=ECU_Response(gP2Client_BOOT,0x29);
    }
    else
    {
       gRss=ECU_Response(gP2Client_APP,0x29);
    }
  }
	if(gRss!=POS)
	{
		if(gRss==TIMEOUT)
		{
			if(gUDS_LanguageSet == 0)
			{
				snprintf(gDiagResultDescription,4000,"Timeout no response recived when request service 0x29");
			}
			else
			{
				snprintf(gDiagResultDescription,4000,"请求超时，控制器对29服务未回复响应");
			}
			Diag_SetReqCheckResult(reqGroup,reqNum,RESULT_FAIL,gDiagResultDescription);
			return -1;
		}
		else
		{
			if(gUDS_LanguageSet == 0)
			{
				snprintf(gDiagResultDescription,4000,"ECU gives negative response 0x%02x to the request of service 0x29",gTpRxData[2]);
			}
			else
			{
				snprintf(gDiagResultDescription,4000,"ECU对29服务回复了负响应0x%02x",gTpRxData[2]);
			}
			Diag_SetReqCheckResult(reqGroup,reqNum,RESULT_FAIL,gDiagResultDescription);
			return -1;
		}
	}
	if(gTpRxData[0]!=0x69)
	{
		if(gUDS_LanguageSet == 0)
		{
			snprintf(gDiagResultDescription,4000,"ECU gives unexpect positive response service ID 0x%02x to the request of service 0x29",gTpRxData[0]);
		}
		else
		{
			snprintf(gDiagResultDescription,4000,"ECU对29服务回复了非预期的肯定响应0x%02x",gTpRxData[0]);
		}
		Diag_SetReqCheckResult(reqGroup,reqNum,RESULT_FAIL,gDiagResultDescription);
		return 1;
	}
	if((7+lengthOfChallengeServer)!=gTpRxLength)
	{
		if(gUDS_LanguageSet == 0)
		{
			snprintf(gDiagResultDescription,4000,"ECU gives unexpect lenth to the request of service 0x29");
		}
		else
		{
			snprintf(gDiagResultDescription,4000,"ECU对29服务回复了错误的长度");
		}
		Diag_SetReqCheckResult(reqGroup,reqNum,RESULT_FAIL,gDiagResultDescription);
		return 1;
	}
	else
	{
		if(gUDS_DescriptionExistFlag == 1)
		{
			if(gUDS_LanguageSet == 0)
			{
				PrintPID("UDS","Pos.Response",gTpRxData,gTpRxLength);
			}
			else
			{
				PrintPID("UDS","肯定响应",gTpRxData,gTpRxLength);
			}
    if(gTpRxData[1]!=1)
    {
      TeststepFail("Fail","Dut response subfunction error,expect:%x,real:%x",1,gTpRxData[1]);
    }
    if(gTpRxData[2]!=authenticationReturnParameter)
    {
      TeststepFail("Fail","Dut response authenticationReturnParameter error,expect:%x,real:%x",authenticationReturnParameter,gTpRxData[2]);
    }
    if(((gTpRxData[3]>>8)+gTpRxData[4]) !=lengthOfChallengeServer)
    {
      TeststepFail("Fail","Dut response lengthOfChallengeServer error,expect:%x,real:%x",lengthOfChallengeServer,((gTpRxData[3]>>8)+gTpRxData[4]));
    }
    for(i=0;i<lengthOfChallengeServer;i++)
    {
      challengeServer[i]=gTpRxData[5+i];
    }
		}
		return 2;
	}
}
void SID29_Authentication_proofOfOwnership(word lengthOfProofOfOwnershipClient,byte proofOfOwnershipClient[],word lengthOfEphemeralPublicKeyClient,enum AddressMode Mode)
{
	byte SID29[2048];
	int  i;
	SID29[0]=0x29;
  SID29[1]=0x03;
  SID29[2]=lengthOfProofOfOwnershipClient>>8;
  SID29[3]=lengthOfProofOfOwnershipClient;
	for(i=0; i<lengthOfProofOfOwnershipClient; i++)
		SID29[i+4]=proofOfOwnershipClient[i];
  SID29[i+5]=0;
  SID29[i+6]=0;
  
	TP_Send(SID29,lengthOfProofOfOwnershipClient+6,Mode);
	if(gUDS_DescriptionExistFlag == 1)
	{
		if(gUDS_LanguageSet == 0)
		{
			PrintPID("UDS","Request ",SID29,lengthOfProofOfOwnershipClient+6);
		}
		else
		{
			PrintPID("UDS","发送请求 ",SID29,lengthOfProofOfOwnershipClient+6);
		}
	}
}

int CheckPosResponse_SID29_proofOfOwnership(byte authenticationReturnParameter,int reqGroup,int reqNum)
{

	if((gBusFlag == 1)||(gBusFlag == 2)||(gBusFlag == 3)||(gBusFlag == 4)||(gBusFlag == 5))
  {
    if(SessionFlag==APP)
    {
      gRss=ECU_Response(gP2Client_APP,0x29);
    }
    else if(SessionFlag==BOOT)
    {
      gRss=ECU_Response(gP2Client_BOOT,0x29);
    }
    else
    {
       gRss=ECU_Response(gP2Client_APP,0x29);
    }
  }
	if(gRss!=POS)
	{
		if(gRss==TIMEOUT)
		{
			if(gUDS_LanguageSet == 0)
			{
				snprintf(gDiagResultDescription,4000,"Timeout no response recived when request service 0x29");
			}
			else
			{
				snprintf(gDiagResultDescription,4000,"请求超时，控制器对29服务未回复响应");
			}
			Diag_SetReqCheckResult(reqGroup,reqNum,RESULT_FAIL,gDiagResultDescription);
			return -1;
		}
		else
		{
			if(gUDS_LanguageSet == 0)
			{
				snprintf(gDiagResultDescription,4000,"ECU gives negative response 0x%02x to the request of service 0x29",gTpRxData[2]);
			}
			else
			{
				snprintf(gDiagResultDescription,4000,"ECU对29服务回复了负响应0x%02x",gTpRxData[2]);
			}
			Diag_SetReqCheckResult(reqGroup,reqNum,RESULT_FAIL,gDiagResultDescription);
			return -1;
		}
	}
	if(gTpRxData[0]!=0x69)
	{
		if(gUDS_LanguageSet == 0)
		{
			snprintf(gDiagResultDescription,4000,"ECU gives unexpect positive response service ID 0x%02x to the request of service 0x29",gTpRxData[0]);
		}
		else
		{
			snprintf(gDiagResultDescription,4000,"ECU对29服务回复了非预期的肯定响应0x%02x",gTpRxData[0]);
		}
		Diag_SetReqCheckResult(reqGroup,reqNum,RESULT_FAIL,gDiagResultDescription);
		return 1;
	}
	if((5)!=gTpRxLength)
	{
		if(gUDS_LanguageSet == 0)
		{
			snprintf(gDiagResultDescription,4000,"ECU gives unexpect lenth to the request of service 0x29");
		}
		else
		{
			snprintf(gDiagResultDescription,4000,"ECU对29服务回复了错误的长度");
		}
		Diag_SetReqCheckResult(reqGroup,reqNum,RESULT_FAIL,gDiagResultDescription);
		return 1;
	}
	else
	{
		if(gUDS_DescriptionExistFlag == 1)
		{
			if(gUDS_LanguageSet == 0)
			{
				PrintPID("UDS","Pos.Response",gTpRxData,gTpRxLength);
			}
			else
			{
				PrintPID("UDS","肯定响应",gTpRxData,gTpRxLength);
			}
      if(gTpRxData[1]!=3)
      {
        TeststepFail("Fail","Dut response subfunction error,expect:%x,real:%x",3,gTpRxData[1]);
      }
      if(gTpRxData[2]!=authenticationReturnParameter)
      {
        TeststepFail("Fail","Dut response authenticationReturnParameter error,expect:%x,real:%x",authenticationReturnParameter,gTpRxData[2]);
      }
      
		}
		return 2;
	}
}

void SID29_Authentication_authenticationConfiguration(enum AddressMode Mode)
{
	byte SID29[2];
	int  i;
	SID29[0]=0x29;
  SID29[1]=0x08;

	TP_Send(SID29,2,Mode);
	if(gUDS_DescriptionExistFlag == 1)
	{
		if(gUDS_LanguageSet == 0)
		{
			PrintPID("UDS","Request ",SID29,2);
		}
		else
		{
			PrintPID("UDS","发送请求 ",SID29,2);
		}
	}
}

int CheckPosResponse_SID29_authenticationConfiguration(byte authenticationReturnParameter,int reqGroup,int reqNum)
{

	if((gBusFlag == 1)||(gBusFlag == 2)||(gBusFlag == 3)||(gBusFlag == 4)||(gBusFlag == 5))
  {
    if(SessionFlag==APP)
    {
      gRss=ECU_Response(gP2Client_APP,0x29);
    }
    else if(SessionFlag==BOOT)
    {
      gRss=ECU_Response(gP2Client_BOOT,0x29);
    }
    else
    {
       gRss=ECU_Response(gP2Client_APP,0x29);
    }
  }
	if(gRss!=POS)
	{
		if(gRss==TIMEOUT)
		{
			if(gUDS_LanguageSet == 0)
			{
				snprintf(gDiagResultDescription,4000,"Timeout no response recived when request service 0x29");
			}
			else
			{
				snprintf(gDiagResultDescription,4000,"请求超时，控制器对29服务未回复响应");
			}
			Diag_SetReqCheckResult(reqGroup,reqNum,RESULT_FAIL,gDiagResultDescription);
			return -1;
		}
		else
		{
			if(gUDS_LanguageSet == 0)
			{
				snprintf(gDiagResultDescription,4000,"ECU gives negative response 0x%02x to the request of service 0x29",gTpRxData[2]);
			}
			else
			{
				snprintf(gDiagResultDescription,4000,"ECU对29服务回复了负响应0x%02x",gTpRxData[2]);
			}
			Diag_SetReqCheckResult(reqGroup,reqNum,RESULT_FAIL,gDiagResultDescription);
			return -1;
		}
	}
	if(gTpRxData[0]!=0x69)
	{
		if(gUDS_LanguageSet == 0)
		{
			snprintf(gDiagResultDescription,4000,"ECU gives unexpect positive response service ID 0x%02x to the request of service 0x29",gTpRxData[0]);
		}
		else
		{
			snprintf(gDiagResultDescription,4000,"ECU对29服务回复了非预期的肯定响应0x%02x",gTpRxData[0]);
		}
		Diag_SetReqCheckResult(reqGroup,reqNum,RESULT_FAIL,gDiagResultDescription);
		return 1;
	}
	if((3)!=gTpRxLength)
	{
		if(gUDS_LanguageSet == 0)
		{
			snprintf(gDiagResultDescription,4000,"ECU gives unexpect lenth to the request of service 0x29");
		}
		else
		{
			snprintf(gDiagResultDescription,4000,"ECU对29服务回复了错误的长度");
		}
		Diag_SetReqCheckResult(reqGroup,reqNum,RESULT_FAIL,gDiagResultDescription);
		return 1;
	}
	else
	{
		if(gUDS_DescriptionExistFlag == 1)
		{
			if(gUDS_LanguageSet == 0)
			{
				PrintPID("UDS","Pos.Response",gTpRxData,gTpRxLength);
			}
			else
			{
				PrintPID("UDS","肯定响应",gTpRxData,gTpRxLength);
			}
      if(gTpRxData[1]!=8)
      {
        TeststepFail("Fail","Dut response subfunction error,expect:%x,real:%x",8,gTpRxData[1]);
      }
      if(gTpRxData[2]!=authenticationReturnParameter)
      {
        TeststepFail("Fail","Dut response authenticationReturnParameter error,expect:%x,real:%x",authenticationReturnParameter,gTpRxData[2]);
      }
		}
		return 2;
	}
}
void SID29_Authentication_deAuthenticate(enum AddressMode Mode)
{
	byte SID29[2];
	int  i;
	SID29[0]=0x29;
  SID29[1]=0x00;

	TP_Send(SID29,2,Mode);
	if(gUDS_DescriptionExistFlag == 1)
	{
		if(gUDS_LanguageSet == 0)
		{
			PrintPID("UDS","Request ",SID29,2);
		}
		else
		{
			PrintPID("UDS","发送请求 ",SID29,2);
		}
	}
}

int CheckPosResponse_SID29_deAuthenticate(byte authenticationReturnParameter,int reqGroup,int reqNum)
{

	if((gBusFlag == 1)||(gBusFlag == 2)||(gBusFlag == 3)||(gBusFlag == 4)||(gBusFlag == 5))
  {
    if(SessionFlag==APP)
    {
      gRss=ECU_Response(gP2Client_APP,0x29);
    }
    else if(SessionFlag==BOOT)
    {
      gRss=ECU_Response(gP2Client_BOOT,0x29);
    }
    else
    {
       gRss=ECU_Response(gP2Client_APP,0x29);
    }
  }
	if(gRss!=POS)
	{
		if(gRss==TIMEOUT)
		{
			if(gUDS_LanguageSet == 0)
			{
				snprintf(gDiagResultDescription,4000,"Timeout no response recived when request service 0x29");
			}
			else
			{
				snprintf(gDiagResultDescription,4000,"请求超时，控制器对29服务未回复响应");
			}
			Diag_SetReqCheckResult(reqGroup,reqNum,RESULT_FAIL,gDiagResultDescription);
			return -1;
		}
		else
		{
			if(gUDS_LanguageSet == 0)
			{
				snprintf(gDiagResultDescription,4000,"ECU gives negative response 0x%02x to the request of service 0x29",gTpRxData[2]);
			}
			else
			{
				snprintf(gDiagResultDescription,4000,"ECU对29服务回复了负响应0x%02x",gTpRxData[2]);
			}
			Diag_SetReqCheckResult(reqGroup,reqNum,RESULT_FAIL,gDiagResultDescription);
			return -1;
		}
	}
	if(gTpRxData[0]!=0x69)
	{
		if(gUDS_LanguageSet == 0)
		{
			snprintf(gDiagResultDescription,4000,"ECU gives unexpect positive response service ID 0x%02x to the request of service 0x29",gTpRxData[0]);
		}
		else
		{
			snprintf(gDiagResultDescription,4000,"ECU对29服务回复了非预期的肯定响应0x%02x",gTpRxData[0]);
		}
		Diag_SetReqCheckResult(reqGroup,reqNum,RESULT_FAIL,gDiagResultDescription);
		return 1;
	}
	if((3)!=gTpRxLength)
	{
		if(gUDS_LanguageSet == 0)
		{
			snprintf(gDiagResultDescription,4000,"ECU gives unexpect lenth to the request of service 0x29");
		}
		else
		{
			snprintf(gDiagResultDescription,4000,"ECU对29服务回复了错误的长度");
		}
		Diag_SetReqCheckResult(reqGroup,reqNum,RESULT_FAIL,gDiagResultDescription);
		return 1;
	}
	else
	{
		if(gUDS_DescriptionExistFlag == 1)
		{
			if(gUDS_LanguageSet == 0)
			{
				PrintPID("UDS","Pos.Response",gTpRxData,gTpRxLength);
			}
			else
			{
				PrintPID("UDS","肯定响应",gTpRxData,gTpRxLength);
			}
      if(gTpRxData[1]!=0)
      {
        TeststepFail("Fail","Dut response subfunction error,expect:%x,real:%x",0,gTpRxData[1]);
      }
      if(gTpRxData[2]!=authenticationReturnParameter)
      {
        TeststepFail("Fail","Dut response authenticationReturnParameter error,expect:%x,real:%x",authenticationReturnParameter,gTpRxData[2]);
      }
		}
		return 2;
	}
}
Void SID38_RequestFileTransfer(int modeOfOperation,byte filePathAndNameLength[],int filePathAndName,int dataFormatIdentifier,byte fileSizeparameterLength[],byte fileSizeUncompressed[],byte filesizeCompressed[],enum AddressMode Mode)
{
	byte SID38[12];
	SID38[0]  = 0x38;
	SID38[1]  = modeOfOperation;
	SID38[2]  = filePathAndNameLength[0];
	SID38[3]  = filePathAndNameLength[1];
	SID38[4]  = filePathAndName;
	SID38[5]  = dataFormatIdentifier;
	SID38[6]  = fileSizeparameterLength[0];
	SID38[7]  = fileSizeparameterLength[1];
	SID38[8]  = fileSizeUncompressed[0];
	SID38[9]  = fileSizeUncompressed[1];
	SID38[10] = filesizeCompressed[0];
	SID38[11] = filesizeCompressed[1];
	TP_Send(SID38,Mode);
	if(gUDS_DescriptionExistFlag == 1)
	{
		if(gUDS_LanguageSet == 0)
		{
			PrintPID("UDS","Request ",SID38,elCount(SID38));
		}
		else
		{
			PrintPID("UDS","发送请求 ",SID38,elCount(SID38));
		}
	}
}

int CheckPosResponse_SID38_RequestFileTransfer(int modeOfOperation,int reqGroup,int reqNum)
{
	if((gBusFlag == 1)||(gBusFlag == 2)||(gBusFlag == 3)||(gBusFlag == 4)||(gBusFlag == 5))
  {
    if(SessionFlag==APP)
    {
      gRss=ECU_Response(gP2Client_APP,0x38);
    }
    else if(SessionFlag==BOOT)
    {
      gRss=ECU_Response(gP2Client_BOOT,0x38);
    }
    else
    {
       gRss=ECU_Response(gP2Client_APP,0x38);
    }
  }
	if(gRss!=POS)
	{
		if(gRss==TIMEOUT)
		{
			if(gUDS_LanguageSet == 0)
			{
				snprintf(gDiagResultDescription,4000,"Timeout no response recived when request service 0x38");
			}
			else
			{
				snprintf(gDiagResultDescription,4000,"请求超时，控制器对38服务未回复响应");
			}
			Diag_SetReqCheckResult(reqGroup,reqNum,RESULT_FAIL,gDiagResultDescription);
			return -1;
		}
		else
		{
			if(gUDS_LanguageSet == 0)
			{
				snprintf(gDiagResultDescription,4000,"ECU gives negative response 0x%02x to the request of service 0x38",gTpRxData[2]);
			}
			else
			{
				snprintf(gDiagResultDescription,4000,"ECU对38服务回复了负响应0x%02x",gTpRxData[2]);
			}
			Diag_SetReqCheckResult(reqGroup,reqNum,RESULT_FAIL,gDiagResultDescription);
			return -1;
		}
	}
	if(gTpRxData[0]!=0x78)
	{
		if(gUDS_LanguageSet == 0)
		{
			snprintf(gDiagResultDescription,4000,"ECU gives unexpect positive response service ID 0x%02x to the request of service 0x38",gTpRxData[0]);
		}
		else
		{
			snprintf(gDiagResultDescription,4000,"ECU对38服务回复了非预期的肯定响应0x%02x",gTpRxData[0]);
		}
		Diag_SetReqCheckResult(reqGroup,reqNum,RESULT_FAIL,gDiagResultDescription);
		return 1;
	}
	if(gTpRxData[1]!=modeOfOperation)
	{
		if(gUDS_LanguageSet == 0)
		{
			snprintf(gDiagResultDescription,4000,"ECU gives unexpect modeOfOperation 0x%02x to the request of service 0x38",gTpRxData[1]);
		}
		else
		{
			snprintf(gDiagResultDescription,4000,"ECU对38服务回复了非预期的modeOfOperation值0x%02x",gTpRxData[1]);
		}
		Diag_SetReqCheckResult(reqGroup,reqNum,RESULT_FAIL,gDiagResultDescription);
		return 1;
	}
	else
	{
		if(gUDS_DescriptionExistFlag == 1)
		{
			if(gUDS_LanguageSet == 0)
			{
				PrintPID("UDS","Pos.Response",gTpRxData,gTpRxLength);
			}
			else
			{
				PrintPID("UDS","肯定响应",gTpRxData,gTpRxLength);
			}
		}
		return 2;
	}
}

void TPSendRawMessage(byte RawData[],enum AddressMode Mode)
{
	TP_Send(RawData,Mode);
	if(gUDS_DescriptionExistFlag == 1)
	{
		if(gUDS_LanguageSet == 0)
		{
			PrintPID("UDS","Request ",RawData,elCount(RawData));
		}
		else
		{
			PrintPID("UDS","发送请求 ",RawData,elCount(RawData));
		}
	}
}

void TPSendRawMessage(byte RawData[],dword lenth,enum AddressMode Mode)
{
	TP_Send(RawData,lenth,Mode);
	if(gUDS_DescriptionExistFlag == 1)
	{
		if(gUDS_LanguageSet == 0)
		{
			PrintPID("UDS","Request ",RawData,lenth);
		}
		else
		{
			PrintPID("UDS","发送请求 ",RawData,lenth);
		}
	}
}


int CheckPosResponse(byte SID,int ExpectLength,int reqGroup,int reqNum)
{
	if((gBusFlag == 1)||(gBusFlag == 2)||(gBusFlag == 3)||(gBusFlag == 4)||(gBusFlag == 5))
  {
    if(SessionFlag==APP)
    {
      gRss=ECU_Response(gP2Client_APP,SID);
    }
    else if(SessionFlag==BOOT)
    {
      gRss=ECU_Response(gP2Client_BOOT,SID);
    }
    else
    {
       gRss=ECU_Response(gP2Client_APP,SID);
    }
  }
	if(gRss!=POS)
	{
		if(gRss==TIMEOUT)
		{
			if(gUDS_LanguageSet == 0)
			{
				snprintf(gDiagResultDescription,4000,"Timeout no response recived when request service %02x",SID);
			}
			else
			{
				snprintf(gDiagResultDescription,4000,"请求超时，控制器对%02x服务未回复响应",SID);
			}
			Diag_SetReqCheckResult(reqGroup,reqNum,RESULT_FAIL,gDiagResultDescription);
			return -1;
		}
		else
		{
			if(gUDS_LanguageSet == 0)
			{
				snprintf(gDiagResultDescription,4000,"ECU gives negative response 0x%02x to the request of service %02x",gTpRxData[2],SID);
			}
			else
			{
				snprintf(gDiagResultDescription,4000,"ECU对%02x服务回复了负响应0x%02x",SID,gTpRxData[2]);
			}
			Diag_SetReqCheckResult(reqGroup,reqNum,RESULT_FAIL,gDiagResultDescription);
			return -1;
		}
	}
	if(gTpRxData[0]!=(SID+0x40))
	{
		if(gUDS_LanguageSet == 0)
		{
			snprintf(gDiagResultDescription,4000,"ECU gives unexpect positive response service ID 0x%02x to the request of service %02x",gTpRxData[0],SID);
		}
		else
		{
			snprintf(gDiagResultDescription,4000,"ECU对%02x服务回复了非预期的肯定响应0x%02x",SID,gTpRxData[0]);
		}
		Diag_SetReqCheckResult(reqGroup,reqNum,RESULT_FAIL,gDiagResultDescription);
		return 1;
	}
	if(ExpectLength!=gTpRxLength)
	{
		if(gUDS_LanguageSet == 0)
		{
			snprintf(gDiagResultDescription,4000,"ECU gives unexpect lenth to the request of service %02x",SID);
		}
		else
		{
			snprintf(gDiagResultDescription,4000,"ECU对%02x服务回复了错误的长度",SID);
		}
		Diag_SetReqCheckResult(reqGroup,reqNum,RESULT_FAIL,gDiagResultDescription);
		return 1;
	}
	else
	{
		if(gUDS_DescriptionExistFlag == 1)
		{
			if(gUDS_LanguageSet == 0)
			{
				PrintPID("UDS","Pos.Response",gTpRxData,gTpRxLength);
			}
			else
			{
				PrintPID("UDS","肯定响应",gTpRxData,gTpRxLength);
			}
		}
		return 2;
	}
}


int CheckPosResponse(byte SID,int reqGroup,int reqNum)
{
	if((gBusFlag == 1)||(gBusFlag == 2)||(gBusFlag == 3)||(gBusFlag == 4)||(gBusFlag == 5))
  {
    if(SessionFlag==APP)
    {
      gRss=ECU_Response(gP2Client_APP,SID);
    }
    else if(SessionFlag==BOOT)
    {
      gRss=ECU_Response(gP2Client_BOOT,SID);
    }
    else
    {
       gRss=ECU_Response(gP2Client_APP,SID);
    }
  }
	if(gRss!=POS)
	{
		if(gRss==TIMEOUT)
		{
			if(gUDS_LanguageSet == 0)
			{
				snprintf(gDiagResultDescription,4000,"Timeout no response recived when request service %02x",SID);
			}
			else
			{
				snprintf(gDiagResultDescription,4000,"请求超时，控制器对%02x服务未回复响应",SID);
			}
			Diag_SetReqCheckResult(reqGroup,reqNum,RESULT_FAIL,gDiagResultDescription);
			return -1;
		}
		else
		{
			if(gUDS_LanguageSet == 0)
			{
				snprintf(gDiagResultDescription,4000,"ECU gives negative response 0x%02x to the request of service %02x",gTpRxData[2],SID);
			}
			else
			{
				snprintf(gDiagResultDescription,4000,"ECU对%02x服务回复了负响应0x%02x",SID,gTpRxData[2]);
			}
			Diag_SetReqCheckResult(reqGroup,reqNum,RESULT_FAIL,gDiagResultDescription);
			return -1;
		}
	}
	if(gTpRxData[0]!=(SID+0X40))
	{
		if(gUDS_LanguageSet == 0)
		{
			snprintf(gDiagResultDescription,4000,"ECU gives unexpect positive response service ID 0x%02x to the request of service %02x",gTpRxData[0],SID);
		}
		else
		{
			snprintf(gDiagResultDescription,4000,"ECU对%02x服务回复了非预期的肯定响应0x%02x",SID,gTpRxData[0]);
		}
		Diag_SetReqCheckResult(reqGroup,reqNum,RESULT_FAIL,gDiagResultDescription);
		return 1;
	}
	else
	{
		if(gUDS_DescriptionExistFlag == 1)
		{
			if(gUDS_LanguageSet == 0)
			{
				PrintPID("UDS","Pos.Response",gTpRxData,gTpRxLength);
			}
			else
			{
				PrintPID("UDS","肯定响应",gTpRxData,gTpRxLength);
			}
		}
		return 2;
	}
}

int CheckPosOrNegResponse(int expectNRC,int reqGroup,int reqNum)
{
	if((gBusFlag == 1)||(gBusFlag == 2)||(gBusFlag == 3)||(gBusFlag == 4)||(gBusFlag == 5))
  {
    if(SessionFlag==APP)
    {
      gRss=ECU_Response(gP2Client_APP,0x00);
    }
    else if(SessionFlag==BOOT)
    {
      gRss=ECU_Response(gP2Client_BOOT,0x00);
    }
    else
    {
       gRss=ECU_Response(gP2Client_APP,0x00);
    }
  }
	if(gRss!=NEG)
	{
		if(gRss==TIMEOUT)
		{
			if(gUDS_LanguageSet == 0)
			{
				snprintf(gDiagResultDescription,4000,"Expect Nr.Response 0x%02X but Timeout no response recived",expectNRC);
			}
			else
			{
				snprintf(gDiagResultDescription,4000,"期望否定响应 0x%02X 但控制器未回复响应",expectNRC);
			}
			Diag_SetReqCheckResult(reqGroup,reqNum,RESULT_FAIL,gDiagResultDescription);
			return -1;
		}
		else
		{
			if(gUDS_LanguageSet == 0)
			{
				snprintf(gDiagResultDescription,4000,"Expect Nr.Response 0x%02x or Pos.Response, get Pos.Response 0x%02x",expectNRC,gTpRxData[0]);
			}
			else
			{
				snprintf(gDiagResultDescription,4000,"期望否定响应 0x%02x 或者正响应， 但得到了肯定响应 0x%02x",expectNRC,gTpRxData[0]);
			}
			Diag_SetReqCheckResult(reqGroup,reqNum,RESULT_PASS,gDiagResultDescription);
			return 2;
		}
	}
	if(expectNRC != gTpRxData[2])
	{
		if(gUDS_LanguageSet == 0)
		{
			snprintf(gDiagResultDescription,4000,"Expect Nr.Response 0x%02x but get Nr.Response 0x%02x",expectNRC,gTpRxData[2]);
		}
		else
		{
			snprintf(gDiagResultDescription,4000,"期望否定响应 0x%02x 但得到了否定响应 0x%02x",expectNRC,gTpRxData[2]);
		}
		Diag_SetReqCheckResult(reqGroup,reqNum,RESULT_FAIL,gDiagResultDescription);
		return 1;
	}
	else
	{
		if(gUDS_DescriptionExistFlag == 1)
		{
			if(gUDS_LanguageSet == 0)
			{
				PrintPID("UDS_Ser","Neg.Response: ",gTpRxData,gTpRxLength);
			}
			else
			{
				PrintPID("UDS","否定响应",gTpRxData,gTpRxLength);
			}
		}
		return 2;
	}
}

int CheckNegResponse(int expectNRC,int reqGroup,int reqNum)
{
	if((gBusFlag == 1)||(gBusFlag == 2)||(gBusFlag == 3)||(gBusFlag == 4)||(gBusFlag == 5))
  {
    if(SessionFlag==APP)
    {
      gRss=ECU_Response(gP2Client_APP,0x00);
    }
    else if(SessionFlag==BOOT)
    {
      gRss=ECU_Response(gP2Client_BOOT,0x00);
    }
    else
    {
       gRss=ECU_Response(gP2Client_APP,0x00);
    }
  }
	if(gRss!=NEG)
	{
		if(gRss==TIMEOUT)
		{
			if(gUDS_LanguageSet == 0)
			{
				snprintf(gDiagResultDescription,4000,"Expect Nr.Response 0x%02X but Timeout no response recived",expectNRC);
			}
			else
			{
				snprintf(gDiagResultDescription,4000,"期望否定响应 0x%02X 但控制器未回复响应",expectNRC);
			}
			Diag_SetReqCheckResult(reqGroup,reqNum,RESULT_FAIL,gDiagResultDescription);
			return -1;
		}
		else
		{
			if(gUDS_LanguageSet == 0)
			{
				snprintf(gDiagResultDescription,4000,"Expect Nr.Response 0x%02x but get Pos.Response 0x%02x",expectNRC,gTpRxData[0]);
			}
			else
			{
				snprintf(gDiagResultDescription,4000,"期望否定响应 0x%02x 但得到了肯定响应 0x%02x",expectNRC,gTpRxData[0]);
			}
			Diag_SetReqCheckResult(reqGroup,reqNum,RESULT_FAIL,gDiagResultDescription);
			return 1;
		}
	}
	if(expectNRC != gTpRxData[2])
	{
		if(gUDS_LanguageSet == 0)
		{
			snprintf(gDiagResultDescription,4000,"Expect Nr.Response 0x%02x but get Nr.Response 0x%02x",expectNRC,gTpRxData[2]);
		}
		else
		{
			snprintf(gDiagResultDescription,4000,"期望否定响应 0x%02x 但得到了否定响应 0x%02x",expectNRC,gTpRxData[2]);
		}
		Diag_SetReqCheckResult(reqGroup,reqNum,RESULT_FAIL,gDiagResultDescription);
		return 1;
	}
	else
	{
		if(gUDS_DescriptionExistFlag == 1)
		{
			if(gUDS_LanguageSet == 0)
			{
				PrintPID("UDS_Ser","Neg.Response: ",gTpRxData,gTpRxLength);
			}
			else
			{
				PrintPID("UDS","否定响应",gTpRxData,gTpRxLength);
			}
		}
		return 2;
	}
}

int CheckNegResponse_WithoutResponse(int expectNRC,int reqGroup,int reqNum)
{
	if(gRss!=NEG)
	{
		if(gRss==TIMEOUT)
		{
			if(gUDS_LanguageSet == 0)
			{
				snprintf(gDiagResultDescription,4000,"Expect Nr.Response 0x%02x but Timeout no response recived",expectNRC);
			}
			else
			{
				snprintf(gDiagResultDescription,4000,"期望否定响应 0x%02x 但控制器未回复响应");
			}
			Diag_SetReqCheckResult(reqGroup,reqNum,RESULT_FAIL,gDiagResultDescription);
			return -1;
		}
		else
		{
			if(gUDS_LanguageSet == 0)
			{
				snprintf(gDiagResultDescription,4000,"Expect Nr.Response 0x%02x but get Pos.Response 0x%02x",expectNRC,gTpRxData[0]);
			}
			else
			{
				snprintf(gDiagResultDescription,4000,"期望否定响应 0x%02x 但得到了肯定响应 0x%02x",expectNRC,gTpRxData[0]);
			}
			Diag_SetReqCheckResult(reqGroup,reqNum,RESULT_FAIL,gDiagResultDescription);
			return 1;
		}
	}
	if(expectNRC != gTpRxData[2])
	{
		if(gUDS_LanguageSet == 0)
		{
			snprintf(gDiagResultDescription,4000,"Expect Nr.Response 0x%02x but get Nr.Response 0x%02x",expectNRC,gTpRxData[2]);
		}
		else
		{
			snprintf(gDiagResultDescription,4000,"期望否定响应 0x%02x 但得到了否定响应 0x%02x",expectNRC,gTpRxData[2]);
		}
		Diag_SetReqCheckResult(reqGroup,reqNum,RESULT_FAIL,gDiagResultDescription);
		return 1;
	}
	else
	{
		if(gUDS_DescriptionExistFlag == 1)
		{
			if(gUDS_LanguageSet == 0)
			{
				PrintPID("UDS_Ser","Neg.Response: ",gTpRxData,gTpRxLength);
			}
			else
			{
				PrintPID("UDS","否定响应",gTpRxData,gTpRxLength);
			}
		}
		return 2;
	}
}

int CheckNegResponse(byte ExpectNRC[],int PosFlag,int NonFlag,int reqGroup,int reqNum)
{
	int i;
	int NRCFlag=0;
  NRCFlag=0;
	if((gBusFlag == 1)||(gBusFlag == 2)||(gBusFlag == 3)||(gBusFlag == 4)||(gBusFlag == 5))
  {
    if(SessionFlag==APP)
    {
      gRss=ECU_Response(gP2Client_APP,0x00);
    }
    else if(SessionFlag==BOOT)
    {
      gRss=ECU_Response(gP2Client_BOOT,0x00);
    }
    else
    {
       gRss=ECU_Response(gP2Client_APP,0x00);
    }
  }
	if(gRss!=NEG)
	{
		if(gRss==TIMEOUT)
		{
			if(NonFlag==0)
			{
				if(gUDS_LanguageSet == 0)
				{
					snprintf(gDiagResultDescription,4000,"Timeout no response recived");
				}
				else
				{
					snprintf(gDiagResultDescription,4000,"请求超时，控制器未回复响应");
				}
				Diag_SetReqCheckResult(reqGroup,reqNum,RESULT_FAIL,gDiagResultDescription);
				return -1;
			}
			else
			{
				if(gUDS_DescriptionExistFlag == 1)
				{
					if(gUDS_LanguageSet == 0)
					{
						PrintPID("UDS_Ser","No response: ",gTpRxData,gTpRxLength);
					}
					else
					{
						PrintPID("UDS","无响应",gTpRxData,gTpRxLength);
					}
				}
				return 2;
			}

		}
		else
		{
			if(PosFlag==0)
			{
				if(gUDS_LanguageSet == 0)
				{
					snprintf(gDiagResultDescription,4000,"Get Pos.Response 0x%02x",gTpRxData[0]);
				}
				else
				{
					snprintf(gDiagResultDescription,4000,"得到了肯定响应 0x%02x",gTpRxData[0]);
				}
				Diag_SetReqCheckResult(reqGroup,reqNum,RESULT_FAIL,gDiagResultDescription);
				return 1;
			}
			else
			{
				if(gUDS_DescriptionExistFlag == 1)
				{
					if(gUDS_LanguageSet == 0)
					{
						PrintPID("UDS","Pos.Response",gTpRxData,gTpRxLength);
					}
					else
					{
						PrintPID("UDS","肯定响应",gTpRxData,gTpRxLength);
					}
				}
				return 2;
			}
		}
	}
	for(i=0; i<elCount(ExpectNRC); i++)
	{
		if(ExpectNRC[i]==gTpRxData[2])
			NRCFlag=1;
	}
	if(NRCFlag==1)
	{
		if(gUDS_DescriptionExistFlag == 1)
		{
			if(gUDS_LanguageSet == 0)
			{
				PrintPID("UDS_Ser","Neg.Response: ",gTpRxData,gTpRxLength);
			}
			else
			{
				PrintPID("UDS","否定响应",gTpRxData,gTpRxLength);
			}
		}
		return 2;
	}
	else
	{
		if(gUDS_LanguageSet == 0)
		{
			snprintf(gDiagResultDescription,4000,"Get uncepected Nr.Response 0x%02x instead of 0x%2x or  ...",gTpRxData[2],ExpectNRC[0]);
		}
		else
		{
			snprintf(gDiagResultDescription,4000,"期望否定响应 0x%02x,实际得到了否定响应 0x%02x",ExpectNRC[0],gTpRxData[2]);
		}
		Diag_SetReqCheckResult(reqGroup,reqNum,RESULT_FAIL,gDiagResultDescription);
		return 1;
	}
}

int CheckNegResponse_WithoutResponse(byte ExpectNRC[],int PosFlag,int NonFlag,int reqGroup,int reqNum)
{
	int i;
	int NRCFlag=0;
  NRCFlag=0;
	if(gRss!=NEG)
	{
		if(gRss==TIMEOUT)
		{
			if(NonFlag==0)
			{
				if(gUDS_LanguageSet == 0)
				{
					snprintf(gDiagResultDescription,4000,"Timeout no response recived");
				}
				else
				{
					snprintf(gDiagResultDescription,4000,"请求超时，控制器未回复响应");
				}
				Diag_SetReqCheckResult(reqGroup,reqNum,RESULT_FAIL,gDiagResultDescription);
				return -1;
			}
			else
			{
				if(gUDS_DescriptionExistFlag == 1)
				{
					if(gUDS_LanguageSet == 0)
					{
						PrintPID("UDS_Ser","No response: ",gTpRxData,gTpRxLength);
					}
					else
					{
						PrintPID("UDS","无响应",gTpRxData,gTpRxLength);
					}
				}
				return 2;
			}

		}
		else
		{
			if(PosFlag==0)
			{
				if(gUDS_LanguageSet == 0)
				{
					snprintf(gDiagResultDescription,4000,"Get Pos.Response 0x%02x",gTpRxData[0]);
				}
				else
				{
					snprintf(gDiagResultDescription,4000,"得到了肯定响应 0x%02x",gTpRxData[0]);
				}
				Diag_SetReqCheckResult(reqGroup,reqNum,RESULT_FAIL,gDiagResultDescription);
				return 1;
			}
			else
			{
				if(gUDS_DescriptionExistFlag == 1)
				{
					if(gUDS_LanguageSet == 0)
					{
						PrintPID("UDS","Pos.Response",gTpRxData,gTpRxLength);
					}
					else
					{
						PrintPID("UDS","肯定响应",gTpRxData,gTpRxLength);
					}
				}
				return 2;
			}
		}
	}
	for(i=0; i<elCount(ExpectNRC); i++)
	{
		if(ExpectNRC[i]==gTpRxData[2])
			NRCFlag=1;
	}
	if(NRCFlag==1)
	{
		if(gUDS_DescriptionExistFlag == 1)
		{
			if(gUDS_LanguageSet == 0)
			{
				PrintPID("UDS_Ser","Neg.Response: ",gTpRxData,gTpRxLength);
			}
			else
			{
				PrintPID("UDS","否定响应",gTpRxData,gTpRxLength);
			}
		}
		return 2;
	}
	else
	{
		if(gUDS_LanguageSet == 0)
		{
			snprintf(gDiagResultDescription,4000,"Get uncepected Nr.Response 0x%02x instead of 0x%2x or  ...",gTpRxData[2],ExpectNRC[0]);
		}
		else
		{
			snprintf(gDiagResultDescription,4000,"期望否定响应 0x%02x,实际得到了否定响应 0x%02x",ExpectNRC[0],gTpRxData[2]);
		}
		Diag_SetReqCheckResult(reqGroup,reqNum,RESULT_FAIL,gDiagResultDescription);
		return 1;
	}
}

int CheckNonResponse(int reqGroup,int reqNum)
{
	if((gBusFlag == 1)||(gBusFlag == 2)||(gBusFlag == 3)||(gBusFlag == 4)||(gBusFlag == 5))
  {
    if(SessionFlag==APP)
    {
      gRss=ECU_Response(gP2Client_APP,0x00);
    }
    else if(SessionFlag==BOOT)
    {
      gRss=ECU_Response(gP2Client_BOOT,0x00);
    }
    else
    {
       gRss=ECU_Response(gP2Client_APP,0x00);
    }
  }
	if(gRss!=TIMEOUT)
	{
		if(gRss==NEG)
		{
			if(gUDS_LanguageSet == 0)
			{
				snprintf(gDiagResultDescription,4000,"Expect No response received but get Neg.Response 0x%02x",gTpRxData[2]);
			}
			else
			{
				snprintf(gDiagResultDescription,4000,"期望无响应但得到了否定响应 0x%02x",gTpRxData[2]);
			}
			Diag_SetReqCheckResult(reqGroup,reqNum,RESULT_FAIL,gDiagResultDescription);
			return 1;
		}
		else
		{
			if(gUDS_LanguageSet == 0)
			{
				snprintf(gDiagResultDescription,4000,"Expect No response received but get Pos.Response 0x%02x",gTpRxData[0]);
			}
			else
			{
				snprintf(gDiagResultDescription,4000,"期望无响应但的到了肯定响应 0x%02x",gTpRxData[0]);
			}
			Diag_SetReqCheckResult(reqGroup,reqNum,RESULT_FAIL,gDiagResultDescription);
			return 0;
		}
	}
	else
	{
		if(gUDS_DescriptionExistFlag == 1)
		{
			if(gUDS_LanguageSet == 0)
			{
				testStep("UDS_Ser","No Response ");
			}
			else
			{
				testStep("UDS","无响应");
			}
		}
		return 2;
	}
}

int CheckNonResponse_WithoutResponse(int reqGroup,int reqNum)
{
	if(gRss!=TIMEOUT)
	{
		if(gRss==NEG)
		{
			if(gUDS_LanguageSet == 0)
			{
				snprintf(gDiagResultDescription,4000,"Expect No response received but get Neg.Response 0x%02x",gTpRxData[2]);
			}
			else
			{
				snprintf(gDiagResultDescription,4000,"期望无响应但得到了否定响应 0x%02x",gTpRxData[2]);
			}
			Diag_SetReqCheckResult(reqGroup,reqNum,RESULT_FAIL,gDiagResultDescription);
			return 1;
		}
		else
		{
			if(gUDS_LanguageSet == 0)
			{
				snprintf(gDiagResultDescription,4000,"Expect No response received but get Pos.Response 0x%02x",gTpRxData[0]);
			}
			else
			{
				snprintf(gDiagResultDescription,4000,"期望无响应但的到了肯定响应 0x%02x",gTpRxData[0]);
			}
			Diag_SetReqCheckResult(reqGroup,reqNum,RESULT_FAIL,gDiagResultDescription);
			return 0;
		}
	}
	else
	{
		if(gUDS_DescriptionExistFlag == 1)
		{
			if(gUDS_LanguageSet == 0)
			{
				testStep("UDS_Ser","No Response ");
			}
			else
			{
				testStep("UDS","无响应");
			}
		}
		return 2;
	}
}

int CheckNotNegResponse(int exceptNRC,int reqGroup,int reqNum)
{
  if((gBusFlag == 1)||(gBusFlag == 2)||(gBusFlag == 3)||(gBusFlag == 4)||(gBusFlag == 5))
  {
    if(SessionFlag==APP)
    {
      gRss=ECU_Response(gP2Client_APP,0x29);
    }
    else if(SessionFlag==BOOT)
    {
      gRss=ECU_Response(gP2Client_BOOT,0x29);
    }
    else
    {
       gRss=ECU_Response(gP2Client_APP,0x29);
    }
  }
  
	if(gRss!=NEG)
	{
		if(gRss==TIMEOUT)
		{
			if(gUDS_LanguageSet == 0)
			{
				snprintf(gDiagResultDescription,4000,"Timeout No Response Received!");
			}
			else
			{
				snprintf(gDiagResultDescription,4000,"超时无响应");
			}
			Diag_SetReqCheckResult(reqGroup,reqNum,RESULT_FAIL,gDiagResultDescription);
			return 1;
		}
		else
		{
      if(gUDS_DescriptionExistFlag == 1)
  		{
  			if(gUDS_LanguageSet == 0)
  			{
  				PrintPID("UDS","Pos.Response",gTpRxData,gTpRxLength);
  			}
  			else
  			{
  				PrintPID("UDS","肯定响应",gTpRxData,gTpRxLength);
  			}
  		}
  		return 2;
		}
	}
	if(exceptNRC == gTpRxData[2])
	{
		PrintPID("Chk","Neg.Response: ",gTpRxData,gTpRxLength);
		testStepFail("Chk","Doesn't Expect NegativeResponseCode 0x%2x",gTpRxData[2]);
    if(gUDS_LanguageSet == 0)
		{
			snprintf(gDiagResultDescription,4000,"Doesn't Expect NegativeResponseCode 0x%2X",gTpRxData[2]);
		}
		else
		{
			snprintf(gDiagResultDescription,4000,"非预期的否定响应0x%02X",gTpRxData[2]);
		}
		Diag_SetReqCheckResult(reqGroup,reqNum,RESULT_FAIL,gDiagResultDescription);
    return 1;
	}
  else 
  {
    if(gUDS_DescriptionExistFlag == 1)
		{
			if(gUDS_LanguageSet == 0)
			{
				PrintPID("UDS","Neg.Response",gTpRxData,gTpRxLength);
			}
			else
			{
				PrintPID("UDS","否定响应",gTpRxData,gTpRxLength);
			}
		}
		return 2;
  }
  return 2;
}

int GetECUResponse()
{
	if((gBusFlag == 1)||(gBusFlag == 2)||(gBusFlag == 3)||(gBusFlag == 4)||(gBusFlag == 5))
  {
    if(SessionFlag==APP)
    {
      gRss=ECU_Response(gP2Client_APP,0x00);
    }
    else if(SessionFlag==BOOT)
    {
      gRss=ECU_Response(gP2Client_BOOT,0x00);
    }
    else
    {
       gRss=ECU_Response(gP2Client_APP,0x00);
    }
  }
  return gRss;
}


int CheckCurrentSession(byte expectSession,enum AddressMode Mode,int reqGroup,int reqNum)
{
	int result;
	byte SID22_F186[3]= {0x22,0xf1,0x86};
  teststep("UDS","Send Request[22 F1 86]");
	TP_Send(SID22_F186,Mode);
	if((gBusFlag == 1)||(gBusFlag == 2)||(gBusFlag == 3)||(gBusFlag == 4)||(gBusFlag == 5))
  {
    if(SessionFlag==APP)
    {
      gRss=ECU_Response(gP2Client_APP,0x22);
    }
    else if(SessionFlag==BOOT)
    {
      gRss=ECU_Response(gP2Client_BOOT,0x22);
    }
    else
    {
       gRss=ECU_Response(gP2Client_APP,0x22);
    }
  }
	switch(gRss)
	{
	case POS:
    PrintPID("UDS","Pos.Response",gTpRxData,gTpRxLength);
		if(expectSession==gTpRxData[3])
		{
			if(gUDS_DescriptionExistFlag == 1)
			{
				if(gUDS_LanguageSet == 0)
				{
					testStepPass("UDS","Current Session [0x%2x]",gTpRxData[3]);
				}
				else
				{
					testStepPass("UDS","当前会话 [0x%2x]",gTpRxData[3]);
				}
			}
			result = 2;
		}
		else
		{
			if(gUDS_LanguageSet == 0)
			{
				snprintf(gDiagResultDescription,4000,"Unexpected session 0x%02x when request current session",gTpRxData[3]);
			}
			else
			{
				snprintf(gDiagResultDescription,4000,"请求当前会话时响应当前会话为 0x%02x",gTpRxData[3]);
			}
			Diag_SetReqCheckResult(reqGroup,reqNum,RESULT_FAIL,gDiagResultDescription);
			result = -1;
		}
		break;
	case TIMEOUT:
		if(gUDS_LanguageSet == 0)
		{
			snprintf(gDiagResultDescription,4000,"Timeout no response recived when request current session");
		}
		else
		{
			snprintf(gDiagResultDescription,4000,"请求当前会话模式时控制器超时未响应");
		}
		Diag_SetReqCheckResult(reqGroup,reqNum,RESULT_FAIL,gDiagResultDescription);
		result = 1;
		break;
	default:
    PrintPID("UDS","Neg.Response",gTpRxData,gTpRxLength);
		if(gUDS_LanguageSet == 0)
		{
			snprintf(gDiagResultDescription,4000,"Timeout negative response 0x%02x recived when request current session",gTpRxData[2]);
		}
		else
		{
			snprintf(gDiagResultDescription,4000,"请求当前会话时控制器响应否定响应 0x%02x",gTpRxData[2]);
		}
		Diag_SetReqCheckResult(reqGroup,reqNum,RESULT_FAIL,gDiagResultDescription);
		result = 1;
		break;
	}

	return result;
}


void PrintPID(char stepTile[],char Info[],byte Data[],int len)
{
	int i;
	char PrintData[102400];
	for(i=0; i<len; i++)
	{
		if((Data[i]>>4)<10)
			PrintData[i*3]=((Data[i]>>4)+0x30);
		else
			PrintData[i*3]=((Data[i]>>4)+0x37);
		if((Data[i]&0x0F)<10)
			PrintData[i*3+1]=((Data[i]&0x0F)+0x30);
		else
			PrintData[i*3+1]=((Data[i]&0x0F)+0x37);
		PrintData[i*3+2]=0x20;
	}
	PrintData[len*3]='\0';
	testStep(stepTile,"%s [%s]",Info,PrintData);
}

int CheckRxLength(dword length)
{
	if(gTpRxLength>length)
	{
		return 1;
	}
	else if(gTpRxLength==length)
	{
		return 2;
	}
	else
	{
		return -1;
	}
}

dword GetRxLength()
{
	dword lenth;

	lenth = gTpRxLength;
	return lenth;
}

int CompareByte(byte Data1[],byte Data2[],dword lenth)
{
	int Flag;
	dword RealLenth;
	int i;
	Flag = 2;
	RealLenth = elCount(Data1);
	if(RealLenth>elCount(Data2))
	{
		RealLenth = elCount(Data2);
	}
	if(RealLenth>lenth)
	{
		for(i = 0; i<lenth; i++)
		{
			if(Data1[i] != Data2[i])
			{

				Flag = 0;
			}
		}
	}
	else
	{
		for(i = 0; i<RealLenth; i++)
		{
			if(Data1[i] != Data2[i])
			{
				Flag = 0;
			}
		}
	}

	return Flag;


}

void GetReceivedData(byte InputData[])
{
	int GRDa;

	if(gTpRxLength>elcount(InputData))
	{
		for(GRDa = 0; GRDa <elcount(InputData); GRDa++)
		{
			InputData[GRDa] = gTpRxData[GRDa];
		}
		testStepWarning("","Can't get all the received data,please use larger data receiver");
	}
	else
	{
		for(GRDa = 0; GRDa <gTpRxLength; GRDa++)
		{
			InputData[GRDa] = gTpRxData[GRDa];
		}
	}
}

void GetReceivedData(byte InputData[],dword StartPos,dword lenth)
{
	dword GRDa;

	if(gTpRxLength>=(lenth+StartPos))
	{
		for(GRDa = StartPos; GRDa <lenth+StartPos; GRDa++)
		{
			InputData[GRDa-StartPos] = gTpRxData[GRDa];
		}
	}
	else
	{
		for(GRDa = StartPos; GRDa <(gTpRxLength-StartPos); GRDa++)
		{
			InputData[GRDa-StartPos] = gTpRxData[GRDa];
		}
	}
}

void NRC_Info(byte nrc)
{
	switch(nrc)
	{
	case 0x11:
		testStep("NRC","Get NRC(0x%2x) serviceNotSupported",nrc);
		break;
	case 0x12:
		testStep("NRC","Get NRC(0x%2x) subFunctionNotSupported",nrc);
		break;
	case 0x13:
		testStep("NRC","Get NRC(0x%2x) incorrectMessageLength",nrc);
		break;
	case 0x14:
		testStep("NRC","Get NRC(0x%2x) responseTooLong",nrc);
		break;
	case 0x22:
		testStep("NRC","Get NRC(0x%2x) conditionsNotCorrect",nrc);
		break;
	case 0x24:
		testStep("NRC","Get NRC(0x%2x) requestSequenceError",nrc);
		break;
	case 0x31:
		testStep("NRC","Get NRC(0x%2x) requestOutOfRange",nrc);
		break;
	case 0x33:
		testStep("NRC","Get NRC(0x%2x) securityAccessDenied",nrc);
		break;
	case 0x35:
		testStep("NRC","Get NRC(0x%2x) invalidKey",nrc);
		break;
	case 0x36:
		testStep("NRC","Get NRC(0x%2x) exceedNumberOfAttempts",nrc);
		break;
	case 0x37:
		testStep("NRC","Get NRC(0x%2x) requiredTimeDelayNotExpired",nrc);
		break;
	case 0x70:
		testStep("NRC","Get NRC(0x%2x) uploadDownloadNotAccepted",nrc);
		break;
	case 0x71:
		testStep("NRC","Get NRC(0x%2x) transferDataSuspended",nrc);
		break;
	case 0x72:
		testStep("NRC","Get NRC(0x%2x) generalProgrammingFailure",nrc);
		break;
	case 0x73:
		testStep("NRC","Get NRC(0x%2x) wrongBlockSequenceCounter",nrc);
		break;
	case 0x78:
		testStep("NRC","Get NRC(0x%2x) requestCorrectlyReceived-ResponsePending",nrc);
		break;
	case 0x7e:
		testStep("NRC","Get NRC(0x%2x) subfunctionNotSupportinActiveSession-ResponsePending",nrc);
		break;
	case 0x7f:
		testStep("NRC","Get NRC(0x%2x) serviceNotSupportedInActiveSession",nrc);
		break;
	case 0x83:
		testStep("NRC","Get NRC(0x%2x) engineIsRunning",nrc);
		break;
	case 0x84:
		testStep("NRC","Get NRC(0x%2x) engineIsNotRunning",nrc);
		break;
	case 0x85:
		testStep("NRC","Get NRC(0x%2x) engineRunTimeTooLow",nrc);
		break;
	case 0x92:
		testStep("NRC","Get NRC(0x%2x) voltageTooHigh",nrc);
		break;
	case 0x93:
		testStep("NRC","Get NRC(0x%2x) voltageTooLow",nrc);
		break;
	default:
		testStepFail("NRC","Get NRC(0x%2x) Undefined Reason",nrc);
		break;
	}
}


