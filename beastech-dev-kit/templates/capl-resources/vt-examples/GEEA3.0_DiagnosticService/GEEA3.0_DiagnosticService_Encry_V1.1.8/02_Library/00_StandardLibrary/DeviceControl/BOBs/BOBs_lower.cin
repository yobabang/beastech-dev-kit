/*@!Encoding:936*/

variables
{
  dword BOB_Socket ;
  
  char BOBID[10]="";
  char cmd[300]="";
  char cmd2[300]="";
  char cmd3[300]="";
  char cmd4[300]="";
  
  
  byte BOB_SendData[13] = {0x08,0x00,0x00,0x00,0x00,0x00,0x00,0x00,0x00,0x00,0x00,0x00,0x00} ;

  enum OperName 
  {
   BN_OPEN,BN_RESET,CAN1_ALL,CAN1_RESET,LIN_ALL,LIN_RESET,COM_ALL,COM_RESET,ALL_RESET,//BN_Open短路，
   BN0_OPEN,BN1_OPEN,BN2_OPEN,BN3_OPEN,ECU_GND_OPEN,
   BN0_OPEN_R,BN1_OPEN_R,BN2_OPEN_R,BN3_OPEN_R,ECU_GND_OPEN_R,
   CAN1H_OPEN,CAN1H_BAT,CAN1H_GND,CAN1H_CAN1L,CAN1L_OPEN,CAN1L_BAT,CAN1L_GND,
   CAN1H_OPEN_R,CAN1H_BAT_R,CAN1H_GND_R,CAN1H_CAN1L_R,CAN1L_OPEN_R,CAN1L_BAT_R,CAN1L_GND_R,
   LIN_OPEN,LIN_BAT,LIN_GND,
   LIN_OPEN_R,LIN_BAT_R,LIN_GND_R,
   OFFSET_GND_EN,
   OFFSET_GND_Dis,
   KL30_KL15_OPEN,
   KL30_KL15_OPEN_R,
   CAN1H_CAN1L_OPEN,
   CAN1H_CAN1L_OPEN_R,
   CAN2H_CAN2L_OPEN,
   CAN2H_CAN2L_OPEN_R,
   CAN2H_OPEN,CAN2H_BAT,CAN2H_GND,CAN2H_CAN2L,CAN2L_OPEN,CAN2L_BAT,CAN2L_GND,
   CAN2H_OPEN_R,CAN2H_BAT_R,CAN2H_GND_R,CAN2H_CAN2L_R,CAN2L_OPEN_R,CAN2L_BAT_R,CAN2L_GND_R
  };
  
  qword OperCmd[61]=
  {
    0x0437370000000000LL,0x0400370000000000LL,0x017F000000000000LL,0x0100000000000000LL,0x0307000000000000LL,0x0300000000000000LL,0x027F000000000000LL,0x0200000000000000LL,0x0500000000000000LL,
    0x0401010000000000LL,0x0404040000000000LL,0x0402020000000000LL,0x0420200000000000LL,0x0410100000000000LL,
    0x0400010000000000LL,0x0400040000000000LL,0x0400020000000000LL,0x0400200000000000LL,0x0400100000000000LL,
    0x0101000000000000LL,0x0104000000000000LL,0x0110000000000000LL,0x0140000000000000LL,0x0102000000000000LL,0x0108000000000000LL,0x0120000000000000LL,
    0x0100000000000000LL,0x0100000000000000LL,0x0100000000000000LL,0x0100000000000000LL,0x0100000000000000LL,0x0100000000000000LL,0x0100000000000000LL,
    0x0301000000000000LL,0x0302000000000000LL,0x0304000000000000LL,
    0x0300000000000000LL,0x0300000000000000LL,0x0300000000000000LL,
    0x0408080000000000LL,
    0x0400080000000000LL,
    0x0405050000000000LL,
    0x0400050000000000LL,
    0x0103000000000000LL,
    0x0100000000000000LL,
    0x0203000000000000LL,
    0x0200000000000000LL,
    0x0201000000000000LL,0x0204000000000000LL,0x0210000000000000LL,0x0240000000000000LL,0x0202000000000000LL,0x0208000000000000LL,0x0220000000000000LL,
    0x0200000000000000LL,0x0200000000000000LL,0x0200000000000000LL,0x0200000000000000LL,0x0200000000000000LL,0x0200000000000000LL,0x0200000000000000LL
  };
}

void SendTcpData_BYTE()
{
  @sysvar::DeviceControl::IPClient::SendEvent::TCPHandle = @sysvar::DeviceControl::IPClient::Sockets::ETH_CAN1_Socket;//使用的socket
  sysSetVariableData(sysvar::DeviceControl::IPClient::SendEvent::SendDataByte, BOB_SendData, elcount(BOB_SendData));//发送的数据
  @sysvar::DeviceControl::IPClient::SendEvent::TCPSend_Byte = elcount(BOB_SendData);//发送数据的长度，也是触发的事件
}

void ALL_BOB_Reset()
{
  BOB_SendData[0] =0x08;
  BOB_SendData[1] =0x00;
  BOB_SendData[2] =0x00;
  BOB_SendData[3] =0x07;
  BOB_SendData[4] =0xfe;
  BOB_SendData[5] =0x01;
  BOB_SendData[6] =0x00;
  BOB_SendData[7] =0x00;
  BOB_SendData[8] =0x00;
  BOB_SendData[9] =0x00;
  BOB_SendData[10] =0x00;
  BOB_SendData[11] =0x00;
  BOB_SendData[12] =0x00;
  SendTcpData_BYTE();
}

void BOB_Ctr(dword BOB_ID,enum OperName opername)//
{
  BOB_SendData[3] =(byte)(BOB_ID>>8);
  BOB_SendData[4] =(byte)BOB_ID;
  BOB_SendData[5] = (byte)(OperCmd[opername]>>56);
  BOB_SendData[6] = (byte)(OperCmd[opername]>>48);
  BOB_SendData[7] = (byte)(OperCmd[opername]>>40);
  SendTcpData_BYTE();
}



