/*@!Encoding:936*/
includes
{
  #include "onSysvar_ENV.cin"
}

void MainTest ()
{
  ENV();
}

testcase ENV()
{
  while(1)
  {
    testWaitForTimeout(10000000);
  }
}
