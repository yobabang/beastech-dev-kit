
    includes
    {
        //此cin非北汇sddbparser.exe工具生成
        //模板版本：2025-09-10
    }

    variables
    {
        
        char TestPhase[10]="TT";//测试阶段
      
        char ECUName[20]="ZCUP";//测试ECU的名称

        char Supply[20]="Supplier";//供应商名称
        dword ECUAddress_Temp=0x1d02;
    char BusType[20]="CANFD";
        int ECUIniTime=2500;//
        int Flag_ExtendedSessionAPP = 1;
        int Flag_ExtendedSessionPBL = 0;
        int Flag_OBDNode = 1;
    
        int service_APP_Num =13;
      
        byte service_APP[13]={0x10,0x11,0x14,0x19,0x22,0x23,0x27,0x28,0x2e,0x2f,0x31,0x3e,0x85};
        

        int service_PBL_Num  =10;
      
        byte service_PBL[10]={0x10,0x11,0x22,0x27,0x2e,0x31,0x34,0x36,0x37,0x3e};
        struct SecurityLevel
        {
            int SElevel;
            int SEFlagAPP;
            int SEFlagPBL;
            byte SEconstant[16];
        };
        struct SecurityLevel SELevel[4]={
    {0x5,1,0,{0x57,0xEA,0xFE,0xD7,0x93,0xDE,0x70,0xA8,0x87,0xF3,0xB8,0x09,0x1A,0xDD,0xFA,0x75}},
    {0x11,1,0,{0xFF,0xFF,0xFF,0xFF,0xFF,0xFF,0xFF,0xFF,0xFF,0xFF,0xFF,0xFF,0xFF,0xFF,0xFF,0xFF}},
    {0x19,1,0,{0xFF,0xFF,0xFF,0xFF,0xFF,0xFF,0xFF,0xFF,0xFF,0xFF,0xFF,0xFF,0xFF,0xFF,0xFF,0xFF}},
    {0x1,0,1,{0xFF,0xFF,0xFF,0xFF,0xFF,0xFF,0xFF,0xFF,0xFF,0xFF,0xFF,0xFF,0xFF,0xFF,0xFF,0xFF}}
    };
    int NumOfSecurityLv = 4;

        int  gMaxNumberOfDIDsForReadDID_Default=10;
        int  gMaxNumberOfDIDsForReadDID_Extended=10;
       
        byte Service_22_DataIdentifer_1[2]={0xED,0xA0};//
        int  Service_22_DataIdentifer_1_Lenth=50;//
      
         int  gMaxNumberOfDIDsForReadDID_Programming=1;
        
        
        int  Service_23_For14_SupAdds;//23服务支持的地址数目
        int  Service_23_For24_SupAdds;
        int  Service_2C_SupDIDs;//2C服务支持的DID数目
        byte Service_2C_DataIdentifer[2]={0xF0,0x00};//2C服务动态定义的DID
        byte Service_2A_DataIdentifer=0x00;//2A服务定义的DID
        int  Service_3D_For14_SupAdds;//3D服务支持的地址数目
        byte CyrrentSession[2]={0xF1,0X86};

        //2C服务
        int  Flag_Ser0x2C_Sub0x01=1;
        int  Flag_Ser0x2C_Sub0x02=0;
        int  Flag_Ser0x2C_Sub0x03=1;
        
        struct DataIdentifer_0x2C
        {
        byte DID[2];
        };
        
        struct DataIdentifer_0x2C DID_0x2C[100]={
        {{0xDF,0x00}}
        };
        
        int    NumOfDID2C=1;
        struct Address_0x2C_0x14
        {
        byte Address[4];
        int  AddressLenth;
        };
        struct Address_0x2C_0x14 Add_0x14[10];
        
        
        struct Address_0x2C_0x24
        {
        byte Address[4];
        byte  AddressLenth[2];
        };
        struct Address_0x2C_0x24 Add_0x24[10];
        int    NumOfAddSup;
      
      
        //22 2E服务
        struct group
        {
        int StartPosition;
        int lenth;
        int CodingType;
        };
        struct DataIdentifer
        {
            dword DID;
            int  Lenth;
            int  Flag_Default;
            int  Flag_Extended;
            int  Flag_Programming;
            int  SecuLevel;
            int  AuthenticationFlag;
            int  NumOfGroup;
            struct group Group[5000];
            byte requestData[5000];
        };
        //22 服务参数
    const int NumOfReadDIDAPP=393;
    struct DataIdentifer DIDOfReadAPP[NumOfReadDIDAPP]={
        {0x0696,1,1,1,0,0xFF,0,1,{    {0x00,0x01,0x01}},{0}},
        {0x213B,1,1,1,0,0xFF,0,1,{    {0x00,0x01,0x02}},{0}},
        {0x213D,1,1,1,0,0xFF,0,1,{    {0x00,0x01,0x02}},{0}},
        {0x213E,1,1,1,0,0xFF,0,1,{    {0x00,0x01,0x02}},{0}},
        {0x4003,1,1,1,0,0xFF,0,1,{    {0x00,0x01,0x02}},{0}},
        {0x4004,1,1,1,0,0xFF,0,1,{    {0x00,0x01,0x01}},{0}},
        {0x4025,2,1,1,0,0xFF,0,1,{    {0x00,0x02,0x01}},{0}},
        {0x4026,2,1,1,0,0xFF,0,1,{    {0x00,0x02,0x01}},{0}},
        {0x4027,2,1,1,0,0xFF,0,1,{    {0x00,0x02,0x01}},{0}},
        {0x4028,2,1,1,0,0xFF,0,1,{    {0x00,0x02,0x01}},{0}},
        {0x4029,2,1,1,0,0xFF,0,1,{    {0x00,0x02,0x01}},{0}},
        {0x402A,1,1,1,0,0xFF,0,1,{    {0x00,0x01,0x01}},{0}},
        {0x4036,1,1,1,0,0xFF,0,1,{    {0x00,0x01,0x02}},{0}},
        {0x403B,1,1,1,0,0xFF,0,1,{    {0x00,0x01,0x02}},{0}},
        {0x403D,1,1,1,0,0xFF,0,1,{    {0x00,0x01,0x02}},{0}},
        {0x403F,1,1,1,0,0xFF,0,1,{    {0x00,0x01,0x02}},{0}},
        {0x4040,1,1,1,0,0xFF,0,1,{    {0x00,0x01,0x02}},{0}},
        {0x4041,1,1,1,0,0xFF,0,1,{    {0x00,0x01,0x02}},{0}},
        {0x4045,1,1,1,0,0xFF,0,1,{    {0x00,0x01,0x02}},{0}},
        {0x4046,1,1,1,0,0xFF,0,1,{    {0x00,0x01,0x02}},{0}},
        {0x4047,2,1,1,0,0xFF,0,2,{    {0x00,0x01,0x02},    {0x01,0x01,0x02}},{0}},
        {0x4048,2,1,1,0,0xFF,0,2,{    {0x00,0x01,0x02},    {0x01,0x01,0x02}},{0}},
        {0x4052,1,1,1,0,0xFF,0,1,{    {0x00,0x01,0x02}},{0}},
        {0x4053,1,1,1,0,0xFF,0,1,{    {0x00,0x01,0x02}},{0}},
        {0x4054,1,1,1,0,0xFF,0,1,{    {0x00,0x01,0x02}},{0}},
        {0x4055,1,1,1,0,0xFF,0,1,{    {0x00,0x01,0x02}},{0}},
        {0x4056,1,1,1,0,0xFF,0,1,{    {0x00,0x01,0x02}},{0}},
        {0x4057,1,1,1,0,0xFF,0,1,{    {0x00,0x01,0x02}},{0}},
        {0x4058,1,1,1,0,0xFF,0,1,{    {0x00,0x01,0x01}},{0}},
        {0x4059,1,1,1,0,0xFF,0,1,{    {0x00,0x01,0x01}},{0}},
        {0x405A,1,1,1,0,0xFF,0,1,{    {0x00,0x01,0x01}},{0}},
        {0x405B,1,1,1,0,0xFF,0,1,{    {0x00,0x01,0x01}},{0}},
        {0x4072,1,1,1,0,0xFF,0,1,{    {0x00,0x01,0x01}},{0}},
        {0x407F,1,1,1,0,0xFF,0,1,{    {0x00,0x01,0x01}},{0}},
        {0x4082,2,1,1,0,0xFF,0,1,{    {0x00,0x02,0x01}},{0}},
        {0x4083,2,1,1,0,0xFF,0,1,{    {0x00,0x02,0x01}},{0}},
        {0x4087,2,1,1,0,0xFF,0,1,{    {0x00,0x02,0x01}},{0}},
        {0x4088,2,1,1,0,0xFF,0,1,{    {0x00,0x02,0x01}},{0}},
        {0x4090,2,1,1,0,0xFF,0,1,{    {0x00,0x02,0x01}},{0}},
        {0x4094,12,1,1,0,0xFF,0,6,{    {0x00,0x02,0x01},    {0x02,0x02,0x01},    {0x04,0x02,0x01},    {0x06,0x02,0x01},    {0x08,0x02,0x01},    {0x0A,0x02,0x01}},{0}},
        {0x4096,2,1,1,0,0xFF,0,1,{    {0x00,0x02,0x01}},{0}},
        {0x409D,2,1,1,0,0xFF,0,1,{    {0x00,0x02,0x01}},{0}},
        {0x40A2,12,1,1,0,0xFF,0,6,{    {0x00,0x02,0x01},    {0x02,0x02,0x01},    {0x04,0x02,0x01},    {0x06,0x02,0x01},    {0x08,0x02,0x01},    {0x0A,0x02,0x01}},{0}},
        {0x40A3,28,1,1,0,0xFF,0,14,{    {0x00,0x02,0x01},    {0x02,0x02,0x01},    {0x04,0x02,0x01},    {0x06,0x02,0x01},    {0x08,0x02,0x01},    {0x0A,0x02,0x01},    {0x0C,0x02,0x01},    {0x0E,0x02,0x01},    {0x10,0x02,0x01},    {0x12,0x02,0x01},    {0x14,0x02,0x01},    {0x16,0x02,0x01},    {0x18,0x02,0x01},    {0x1A,0x02,0x01}},{0}},
        {0x40A8,12,1,1,0,0xFF,0,6,{    {0x00,0x01,0x02},    {0x01,0x01,0x02},    {0x02,0x01,0x02},    {0x03,0x01,0x02},    {0x04,0x01,0x02},    {0x05,0x07,0x02}},{0}},
        {0x40B0,1,1,1,0,0xFF,0,1,{    {0x00,0x01,0x01}},{0}},
        {0x40B9,1,1,1,0,0xFF,0,1,{    {0x00,0x01,0x02}},{0}},
        {0x40BA,1,1,1,0,0xFF,0,1,{    {0x00,0x01,0x02}},{0}},
        {0x40CA,2,1,1,0,0xFF,0,2,{    {0x00,0x01,0x01},    {0x01,0x01,0x01}},{0}},
        {0x40CB,1,1,1,0,0xFF,0,1,{    {0x00,0x01,0x02}},{0}},
        {0x40CC,1,1,1,0,0xFF,0,1,{    {0x00,0x01,0x01}},{0}},
        {0x40CD,2,1,1,0,0xFF,0,1,{    {0x00,0x02,0x01}},{0}},
        {0x40CE,2,1,1,0,0xFF,0,1,{    {0x00,0x02,0x01}},{0}},
        {0x40CF,2,1,1,0,0xFF,0,1,{    {0x00,0x02,0x01}},{0}},
        {0x40D0,2,1,1,0,0xFF,0,1,{    {0x00,0x02,0x01}},{0}},
        {0x40D1,1,1,1,0,0xFF,0,1,{    {0x00,0x01,0x02}},{0}},
        {0x40D7,20,1,1,0,0xFF,0,10,{    {0x00,0x02,0x01},    {0x02,0x02,0x01},    {0x04,0x02,0x01},    {0x06,0x02,0x01},    {0x08,0x02,0x01},    {0x0A,0x02,0x01},    {0x0C,0x02,0x01},    {0x0E,0x02,0x01},    {0x10,0x02,0x01},    {0x12,0x02,0x01}},{0}},
        {0x40E2,2,1,1,0,0xFF,0,1,{    {0x00,0x02,0x01}},{0}},
        {0x40E4,15,1,1,0,0xFF,0,15,{    {0x00,0x01,0x01},    {0x01,0x01,0x01},    {0x02,0x01,0x01},    {0x03,0x01,0x01},    {0x04,0x01,0x01},    {0x05,0x01,0x01},    {0x06,0x01,0x01},    {0x07,0x01,0x01},    {0x08,0x01,0x01},    {0x09,0x01,0x01},    {0x0A,0x01,0x01},    {0x0B,0x01,0x01},    {0x0C,0x01,0x01},    {0x0D,0x01,0x01},    {0x0E,0x01,0x02}},{0}},
        {0x40E5,1,1,1,0,0xFF,0,1,{    {0x00,0x01,0x02}},{0}},
        {0x40FC,3,1,1,0,0xFF,0,3,{    {0x00,0x01,0x01},    {0x01,0x01,0x01},    {0x02,0x01,0x01}},{0}},
        {0x4104,1,1,1,0,0xFF,0,1,{    {0x00,0x01,0x01}},{0}},
        {0x411D,1,1,1,0,0xFF,0,1,{    {0x00,0x01,0x01}},{0}},
        {0x4148,4,1,1,0,0xFF,0,2,{    {0x00,0x02,0x01},    {0x02,0x02,0x01}},{0}},
        {0x414B,26,1,1,0,0xFF,0,13,{    {0x00,0x02,0x01},    {0x02,0x02,0x01},    {0x04,0x02,0x01},    {0x06,0x02,0x01},    {0x08,0x02,0x01},    {0x0A,0x02,0x01},    {0x0C,0x02,0x01},    {0x0E,0x02,0x01},    {0x10,0x02,0x01},    {0x12,0x02,0x01},    {0x14,0x02,0x01},    {0x16,0x02,0x01},    {0x18,0x02,0x01}},{0}},
        {0x414E,2,1,1,0,0xFF,0,1,{    {0x00,0x02,0x01}},{0}},
        {0x414F,2,1,1,0,0xFF,0,1,{    {0x00,0x02,0x01}},{0}},
        {0x4150,1,1,1,0,0xFF,0,1,{    {0x00,0x01,0x01}},{0}},
        {0x417C,2,1,1,0,0xFF,0,1,{    {0x00,0x02,0x01}},{0}},
        {0x417D,1,1,1,0,0xFF,0,1,{    {0x00,0x01,0x01}},{0}},
        {0x4181,3,1,1,0,0xFF,0,3,{    {0x00,0x01,0x02},    {0x01,0x01,0x02},    {0x02,0x01,0x02}},{0}},
        {0x4187,2,1,1,0,0xFF,0,2,{    {0x00,0x01,0x01},    {0x01,0x01,0x01}},{0}},
        {0x4189,3,1,1,0,0xFF,0,3,{    {0x00,0x01,0x02},    {0x01,0x01,0x02},    {0x02,0x01,0x02}},{0}},
        {0x4198,1,1,1,0,0xFF,0,1,{    {0x00,0x01,0x02}},{0}},
        {0x4199,1,1,1,0,0xFF,0,1,{    {0x00,0x01,0x02}},{0}},
        {0x419A,2,1,1,0,0xFF,0,1,{    {0x00,0x02,0x01}},{0}},
        {0x419D,2,1,1,0,0xFF,0,1,{    {0x00,0x02,0x01}},{0}},
        {0x419E,2,1,1,0,0xFF,0,1,{    {0x00,0x02,0x01}},{0}},
        {0x419F,2,1,1,0,0xFF,0,1,{    {0x00,0x02,0x01}},{0}},
        {0x41A0,1,1,1,0,0xFF,0,1,{    {0x00,0x01,0x01}},{0}},
        {0x41A6,1,1,1,0,0xFF,0,1,{    {0x00,0x01,0x02}},{0}},
        {0x41A7,1,1,1,0,0xFF,0,1,{    {0x00,0x01,0x02}},{0}},
        {0x41CE,1,1,1,0,0xFF,0,1,{    {0x00,0x01,0x01}},{0}},
        {0x41EF,1,1,1,0,0xFF,0,1,{    {0x00,0x01,0x02}},{0}},
        {0x41F4,1,1,1,0,0xFF,0,1,{    {0x00,0x01,0x01}},{0}},
        {0x41F5,1,1,1,0,0xFF,0,1,{    {0x00,0x01,0x01}},{0}},
        {0x41F6,1,1,1,0,0xFF,0,1,{    {0x00,0x01,0x01}},{0}},
        {0x4219,1,1,1,0,0xFF,0,1,{    {0x00,0x01,0x02}},{0}},
        {0x421A,1,1,1,0,0xFF,0,1,{    {0x00,0x01,0x02}},{0}},
        {0x421B,4,1,1,0,0xFF,0,4,{    {0x00,0x01,0x01},    {0x01,0x01,0x01},    {0x02,0x01,0x01},    {0x03,0x01,0x01}},{0}},
        {0x4221,1,1,1,0,0xFF,0,1,{    {0x00,0x01,0x02}},{0}},
        {0x4224,1,1,1,0,0xFF,0,1,{    {0x00,0x01,0x01}},{0}},
        {0x42A1,1,1,1,0,0xFF,0,1,{    {0x00,0x01,0x01}},{0}},
        {0x42A4,4,1,1,0,0xFF,0,1,{    {0x00,0x04,0x01}},{0}},
        {0x42A5,1,1,1,0,0xFF,0,1,{    {0x00,0x01,0x01}},{0}},
        {0x42A6,1,1,1,0,0xFF,0,1,{    {0x00,0x01,0x01}},{0}},
        {0x42BA,1,1,1,0,0xFF,0,1,{    {0x00,0x01,0x01}},{0}},
        {0x42C3,2,1,1,0,0xFF,0,1,{    {0x00,0x02,0x01}},{0}},
        {0x42C4,2,1,1,0,0xFF,0,1,{    {0x00,0x02,0x01}},{0}},
        {0x42C5,2,1,1,0,0xFF,0,1,{    {0x00,0x02,0x01}},{0}},
        {0x42C6,2,1,1,0,0xFF,0,1,{    {0x00,0x02,0x01}},{0}},
        {0x42C7,1,1,1,0,0xFF,0,1,{    {0x00,0x01,0x01}},{0}},
        {0x42C8,1,1,1,0,0xFF,0,1,{    {0x00,0x01,0x01}},{0}},
        {0x42CD,20,1,1,0,0xFF,0,10,{    {0x00,0x02,0x01},    {0x02,0x02,0x01},    {0x04,0x02,0x01},    {0x06,0x02,0x01},    {0x08,0x02,0x01},    {0x0A,0x02,0x01},    {0x0C,0x02,0x01},    {0x0E,0x02,0x01},    {0x10,0x02,0x01},    {0x12,0x02,0x01}},{0}},
        {0x42CF,5,1,1,0,0xFF,0,8,{    {0x00,0x01,0x01},    {0x00,0x02,0x01},    {0x01,0x01,0x01},    {0x01,0x02,0x01},    {0x02,0x01,0x01},    {0x03,0x01,0x01},    {0x03,0x02,0x01},    {0x04,0x01,0x01}},{0}},
        {0x42D1,22,1,1,0,0xFF,0,11,{    {0x00,0x02,0x01},    {0x02,0x02,0x01},    {0x04,0x02,0x01},    {0x06,0x02,0x01},    {0x08,0x02,0x01},    {0x0A,0x02,0x01},    {0x0C,0x02,0x01},    {0x0E,0x02,0x01},    {0x10,0x02,0x01},    {0x12,0x02,0x01},    {0x14,0x02,0x01}},{0}},
        {0x42D2,22,1,1,0,0xFF,0,11,{    {0x00,0x02,0x01},    {0x02,0x02,0x01},    {0x04,0x02,0x01},    {0x06,0x02,0x01},    {0x08,0x02,0x01},    {0x0A,0x02,0x01},    {0x0C,0x02,0x01},    {0x0E,0x02,0x01},    {0x10,0x02,0x01},    {0x12,0x02,0x01},    {0x14,0x02,0x01}},{0}},
        {0x42D3,10,1,1,0,0xFF,0,10,{    {0x00,0x01,0x01},    {0x01,0x01,0x01},    {0x02,0x01,0x01},    {0x03,0x01,0x01},    {0x04,0x01,0x01},    {0x05,0x01,0x01},    {0x06,0x01,0x01},    {0x07,0x01,0x01},    {0x08,0x01,0x01},    {0x09,0x01,0x01}},{0}},
        {0x42DA,1,1,1,0,0xFF,0,1,{    {0x00,0x01,0x01}},{0}},
        {0x42DF,2,1,1,0,0xFF,0,1,{    {0x00,0x02,0x01}},{0}},
        {0x42E3,2,1,1,0,0xFF,0,1,{    {0x00,0x02,0x01}},{0}},
        {0x42E4,2,1,1,0,0xFF,0,1,{    {0x00,0x02,0x01}},{0}},
        {0x4307,1,1,1,0,0xFF,0,1,{    {0x00,0x01,0x02}},{0}},
        {0x4308,1,1,1,0,0xFF,0,1,{    {0x00,0x01,0x02}},{0}},
        {0x4311,2,1,1,0,0xFF,0,1,{    {0x00,0x02,0x01}},{0}},
        {0x432A,1,1,1,0,0xFF,0,1,{    {0x00,0x01,0x02}},{0}},
        {0x432B,1,1,1,0,0xFF,0,1,{    {0x00,0x01,0x02}},{0}},
        {0x433E,1,1,1,0,0xFF,0,1,{    {0x00,0x01,0x02}},{0}},
        {0x437F,1,1,1,0,0xFF,0,1,{    {0x00,0x01,0x02}},{0}},
        {0x438B,2,1,1,0,0xFF,0,1,{    {0x00,0x02,0x01}},{0}},
        {0x439F,2,1,1,0,0xFF,0,2,{    {0x00,0x01,0x01},    {0x01,0x01,0x01}},{0}},
        {0x43B3,2,1,1,0,0xFF,0,2,{    {0x00,0x01,0x01},    {0x01,0x01,0x01}},{0}},
        {0x4447,1,1,1,0,0xFF,0,1,{    {0x00,0x01,0x01}},{0}},
        {0x4514,2,1,1,0,0xFF,0,1,{    {0x00,0x02,0x01}},{0}},
        {0x4516,1,1,1,0,0xFF,0,1,{    {0x00,0x01,0x02}},{0}},
        {0x4517,1,1,1,0,0xFF,0,1,{    {0x00,0x01,0x02}},{0}},
        {0x4519,8,1,1,0,0xFF,0,8,{    {0x00,0x01,0x02},    {0x01,0x01,0x02},    {0x02,0x01,0x02},    {0x03,0x01,0x02},    {0x04,0x01,0x02},    {0x05,0x01,0x02},    {0x06,0x01,0x02},    {0x07,0x01,0x02}},{0}},
        {0x451A,8,1,1,0,0xFF,0,8,{    {0x00,0x01,0x02},    {0x01,0x01,0x02},    {0x02,0x01,0x02},    {0x03,0x01,0x02},    {0x04,0x01,0x02},    {0x05,0x01,0x02},    {0x06,0x01,0x02},    {0x07,0x01,0x02}},{0}},
        {0x4558,1,1,1,0,0xFF,0,1,{    {0x00,0x01,0x02}},{0}},
        {0x4569,4,1,1,0,0xFF,0,2,{    {0x00,0x02,0x01},    {0x02,0x02,0x01}},{0}},
        {0x4571,1,1,1,0,0xFF,0,1,{    {0x00,0x01,0x01}},{0}},
        {0x4577,3,1,1,0,0xFF,0,2,{    {0x00,0x02,0x01},    {0x02,0x01,0x02}},{0}},
        {0x4578,3,1,1,0,0xFF,0,2,{    {0x00,0x02,0x01},    {0x02,0x01,0x02}},{0}},
        {0x4579,3,1,1,0,0xFF,0,2,{    {0x00,0x02,0x01},    {0x02,0x01,0x02}},{0}},
        {0x457A,3,1,1,0,0xFF,0,2,{    {0x00,0x02,0x01},    {0x02,0x01,0x02}},{0}},
        {0x457B,3,1,1,0,0xFF,0,2,{    {0x00,0x02,0x01},    {0x02,0x01,0x02}},{0}},
        {0x45BC,2,1,1,0,0xFF,0,2,{    {0x00,0x01,0x01},    {0x01,0x01,0x01}},{0}},
        {0x45C6,16,1,1,0,0xFF,0,16,{    {0x00,0x01,0x02},    {0x01,0x01,0x02},    {0x02,0x01,0x02},    {0x03,0x01,0x02},    {0x04,0x01,0x02},    {0x05,0x01,0x02},    {0x06,0x01,0x02},    {0x07,0x01,0x02},    {0x08,0x01,0x02},    {0x09,0x01,0x02},    {0x0A,0x01,0x02},    {0x0B,0x01,0x02},    {0x0C,0x01,0x02},    {0x0D,0x01,0x02},    {0x0E,0x01,0x02},    {0x0F,0x01,0x02}},{0}},
        {0x45C7,16,1,1,0,0xFF,0,16,{    {0x00,0x01,0x02},    {0x01,0x01,0x02},    {0x02,0x01,0x02},    {0x03,0x01,0x02},    {0x04,0x01,0x02},    {0x05,0x01,0x02},    {0x06,0x01,0x02},    {0x07,0x01,0x02},    {0x08,0x01,0x02},    {0x09,0x01,0x02},    {0x0A,0x01,0x02},    {0x0B,0x01,0x02},    {0x0C,0x01,0x02},    {0x0D,0x01,0x02},    {0x0E,0x01,0x02},    {0x0F,0x01,0x02}},{0}},
        {0x45E4,1,1,1,0,0xFF,0,1,{    {0x00,0x01,0x01}},{0}},
        {0x45E5,1,1,1,0,0xFF,0,1,{    {0x00,0x01,0x01}},{0}},
        {0x4726,1,1,1,0,0xFF,0,1,{    {0x00,0x01,0x01}},{0}},
        {0x473B,7,1,1,0,0xFF,0,5,{    {0x00,0x02,0x01},    {0x01,0x03,0x01},    {0x03,0x02,0x01},    {0x04,0x03,0x01},    {0x06,0x01,0x04}},{0}},
        {0x473C,4,1,1,0,0xFF,0,4,{    {0x00,0x02,0x01},    {0x01,0x02,0x01},    {0x02,0x02,0x01},    {0x03,0x01,0x01}},{0}},
        {0x473D,5,1,1,0,0xFF,0,4,{    {0x00,0x02,0x01},    {0x01,0x02,0x01},    {0x02,0x02,0x01},    {0x03,0x02,0x01}},{0}},
        {0x473E,1,1,1,0,0xFF,0,1,{    {0x00,0x01,0x02}},{0}},
        {0x4756,4,1,1,0,0xFF,0,2,{    {0x00,0x02,0x01},    {0x02,0x02,0x01}},{0}},
        {0x4759,2,1,1,0,0xFF,0,2,{    {0x00,0x01,0x01},    {0x01,0x01,0x01}},{0}},
        {0x4762,8,1,1,0,0xFF,0,8,{    {0x00,0x01,0x01},    {0x01,0x01,0x01},    {0x02,0x01,0x01},    {0x03,0x01,0x01},    {0x04,0x01,0x01},    {0x05,0x01,0x01},    {0x06,0x01,0x01},    {0x07,0x01,0x01}},{0}},
        {0x4775,257,1,1,0,0xFF,0,156,{    {0x00,0x01,0x01},    {0x01,0x01,0x01},    {0x02,0x01,0x01},    {0x03,0x01,0x01},    {0x04,0x04,0x01},    {0x08,0x01,0x01},    {0x09,0x01,0x01},    {0x0A,0x01,0x01},    {0x0B,0x01,0x01},    {0x0C,0x04,0x01},    {0x10,0x01,0x01},    {0x11,0x01,0x01},    {0x12,0x01,0x01},    {0x13,0x01,0x01},    {0x14,0x04,0x01},    {0x18,0x01,0x01},    {0x19,0x01,0x01},    {0x1A,0x01,0x01},    {0x1B,0x01,0x01},    {0x1C,0x04,0x01},    {0x20,0x01,0x01},    {0x21,0x01,0x01},    {0x22,0x01,0x01},    {0x23,0x01,0x01},    {0x24,0x04,0x01},    {0x28,0x01,0x01},    {0x29,0x01,0x01},    {0x2A,0x01,0x01},    {0x2B,0x01,0x01},    {0x2C,0x04,0x01},    {0x30,0x01,0x01},    {0x31,0x01,0x01},    {0x32,0x01,0x01},    {0x33,0x01,0x01},    {0x34,0x04,0x01},    {0x38,0x01,0x01},    {0x39,0x01,0x01},    {0x3A,0x01,0x01},    {0x3B,0x01,0x01},    {0x3C,0x04,0x01},    {0x40,0x01,0x01},    {0x41,0x01,0x01},    {0x42,0x01,0x01},    {0x43,0x01,0x01},    {0x44,0x04,0x01},    {0x48,0x01,0x01},    {0x49,0x01,0x01},    {0x4A,0x01,0x01},    {0x4B,0x01,0x01},    {0x4C,0x04,0x01},    {0x50,0x01,0x01},    {0x51,0x01,0x01},    {0x52,0x01,0x01},    {0x53,0x04,0x01},    {0x57,0x01,0x01},    {0x58,0x01,0x01},    {0x59,0x01,0x01},    {0x5A,0x04,0x01},    {0x5E,0x01,0x01},    {0x5F,0x01,0x01},    {0x60,0x01,0x01},    {0x61,0x04,0x01},    {0x65,0x01,0x01},    {0x66,0x01,0x01},    {0x67,0x01,0x01},    {0x68,0x04,0x01},    {0x6C,0x01,0x01},    {0x6D,0x01,0x01},    {0x6E,0x01,0x01},    {0x6F,0x04,0x01},    {0x73,0x01,0x01},    {0x74,0x01,0x01},    {0x75,0x01,0x01},    {0x76,0x04,0x01},    {0x7A,0x01,0x01},    {0x7B,0x01,0x01},    {0x7C,0x01,0x01},    {0x7D,0x04,0x01},    {0x81,0x01,0x01},    {0x82,0x01,0x01},    {0x83,0x01,0x01},    {0x84,0x04,0x01},    {0x88,0x01,0x01},    {0x89,0x01,0x01},    {0x8A,0x01,0x01},    {0x8B,0x04,0x01},    {0x8F,0x01,0x01},    {0x90,0x01,0x01},    {0x91,0x01,0x01},    {0x92,0x04,0x01},    {0x96,0x01,0x01},    {0x97,0x01,0x01},    {0x98,0x01,0x01},    {0x99,0x04,0x01},    {0x9D,0x01,0x01},    {0x9E,0x01,0x01},    {0x9F,0x01,0x01},    {0xA0,0x04,0x01},    {0xA4,0x01,0x01},    {0xA5,0x01,0x01},    {0xA6,0x01,0x01},    {0xA7,0x04,0x01},    {0xAB,0x01,0x01},    {0xAC,0x01,0x01},    {0xAD,0x01,0x01},    {0xAE,0x04,0x01},    {0xB2,0x01,0x01},    {0xB3,0x01,0x01},    {0xB4,0x01,0x01},    {0xB5,0x04,0x01},    {0xB9,0x01,0x01},    {0xBA,0x01,0x01},    {0xBB,0x01,0x01},    {0xBC,0x04,0x01},    {0xC0,0x01,0x01},    {0xC1,0x01,0x01},    {0xC2,0x01,0x01},    {0xC3,0x04,0x01},    {0xC7,0x01,0x01},    {0xC8,0x01,0x01},    {0xC9,0x01,0x01},    {0xCA,0x04,0x01},    {0xCE,0x01,0x01},    {0xCF,0x01,0x01},    {0xD0,0x01,0x01},    {0xD1,0x04,0x01},    {0xD5,0x01,0x01},    {0xD6,0x01,0x01},    {0xD7,0x01,0x01},    {0xD8,0x04,0x01},    {0xDC,0x01,0x01},    {0xDD,0x04,0x01},    {0xE1,0x01,0x01},    {0xE2,0x01,0x01},    {0xE3,0x01,0x01},    {0xE4,0x01,0x01},    {0xE5,0x01,0x01},    {0xE6,0x02,0x01},    {0xE8,0x01,0x01},    {0xE9,0x01,0x01},    {0xEA,0x02,0x01},    {0xEC,0x01,0x01},    {0xED,0x01,0x01},    {0xEE,0x01,0x01},    {0xEF,0x01,0x01},    {0xF0,0x01,0x01},    {0xF1,0x01,0x01},    {0xF2,0x04,0x01},    {0xF6,0x01,0x01},    {0xF7,0x01,0x01},    {0xF8,0x01,0x01},    {0xF9,0x01,0x01},    {0xFA,0x01,0x01},    {0xFB,0x01,0x01},    {0xFC,0x01,0x01},    {0xFD,0x04,0x01}},{0}},
        {0x4776,257,1,1,0,0xFF,0,156,{    {0x00,0x01,0x01},    {0x01,0x01,0x01},    {0x02,0x01,0x01},    {0x03,0x01,0x01},    {0x04,0x04,0x01},    {0x08,0x01,0x01},    {0x09,0x01,0x01},    {0x0A,0x01,0x01},    {0x0B,0x01,0x01},    {0x0C,0x04,0x01},    {0x10,0x01,0x01},    {0x11,0x01,0x01},    {0x12,0x01,0x01},    {0x13,0x01,0x01},    {0x14,0x04,0x01},    {0x18,0x01,0x01},    {0x19,0x01,0x01},    {0x1A,0x01,0x01},    {0x1B,0x01,0x01},    {0x1C,0x04,0x01},    {0x20,0x01,0x01},    {0x21,0x01,0x01},    {0x22,0x01,0x01},    {0x23,0x01,0x01},    {0x24,0x04,0x01},    {0x28,0x01,0x01},    {0x29,0x01,0x01},    {0x2A,0x01,0x01},    {0x2B,0x01,0x01},    {0x2C,0x04,0x01},    {0x30,0x01,0x01},    {0x31,0x01,0x01},    {0x32,0x01,0x01},    {0x33,0x01,0x01},    {0x34,0x04,0x01},    {0x38,0x01,0x01},    {0x39,0x01,0x01},    {0x3A,0x01,0x01},    {0x3B,0x01,0x01},    {0x3C,0x04,0x01},    {0x40,0x01,0x01},    {0x41,0x01,0x01},    {0x42,0x01,0x01},    {0x43,0x01,0x01},    {0x44,0x04,0x01},    {0x48,0x01,0x01},    {0x49,0x01,0x01},    {0x4A,0x01,0x01},    {0x4B,0x01,0x01},    {0x4C,0x04,0x01},    {0x50,0x01,0x01},    {0x51,0x01,0x01},    {0x52,0x01,0x01},    {0x53,0x04,0x01},    {0x57,0x01,0x01},    {0x58,0x01,0x01},    {0x59,0x01,0x01},    {0x5A,0x04,0x01},    {0x5E,0x01,0x01},    {0x5F,0x01,0x01},    {0x60,0x01,0x01},    {0x61,0x04,0x01},    {0x65,0x01,0x01},    {0x66,0x01,0x01},    {0x67,0x01,0x01},    {0x68,0x04,0x01},    {0x6C,0x01,0x01},    {0x6D,0x01,0x01},    {0x6E,0x01,0x01},    {0x6F,0x04,0x01},    {0x73,0x01,0x01},    {0x74,0x01,0x01},    {0x75,0x01,0x01},    {0x76,0x04,0x01},    {0x7A,0x01,0x01},    {0x7B,0x01,0x01},    {0x7C,0x01,0x01},    {0x7D,0x04,0x01},    {0x81,0x01,0x01},    {0x82,0x01,0x01},    {0x83,0x01,0x01},    {0x84,0x04,0x01},    {0x88,0x01,0x01},    {0x89,0x01,0x01},    {0x8A,0x01,0x01},    {0x8B,0x04,0x01},    {0x8F,0x01,0x01},    {0x90,0x01,0x01},    {0x91,0x01,0x01},    {0x92,0x04,0x01},    {0x96,0x01,0x01},    {0x97,0x01,0x01},    {0x98,0x01,0x01},    {0x99,0x04,0x01},    {0x9D,0x01,0x01},    {0x9E,0x01,0x01},    {0x9F,0x01,0x01},    {0xA0,0x04,0x01},    {0xA4,0x01,0x01},    {0xA5,0x01,0x01},    {0xA6,0x01,0x01},    {0xA7,0x04,0x01},    {0xAB,0x01,0x01},    {0xAC,0x01,0x01},    {0xAD,0x01,0x01},    {0xAE,0x04,0x01},    {0xB2,0x01,0x01},    {0xB3,0x01,0x01},    {0xB4,0x01,0x01},    {0xB5,0x04,0x01},    {0xB9,0x01,0x01},    {0xBA,0x01,0x01},    {0xBB,0x01,0x01},    {0xBC,0x04,0x01},    {0xC0,0x01,0x01},    {0xC1,0x01,0x01},    {0xC2,0x01,0x01},    {0xC3,0x04,0x01},    {0xC7,0x01,0x01},    {0xC8,0x01,0x01},    {0xC9,0x01,0x01},    {0xCA,0x04,0x01},    {0xCE,0x01,0x01},    {0xCF,0x01,0x01},    {0xD0,0x01,0x01},    {0xD1,0x04,0x01},    {0xD5,0x01,0x01},    {0xD6,0x01,0x01},    {0xD7,0x01,0x01},    {0xD8,0x04,0x01},    {0xDC,0x01,0x01},    {0xDD,0x04,0x01},    {0xE1,0x01,0x01},    {0xE2,0x01,0x01},    {0xE3,0x01,0x01},    {0xE4,0x01,0x01},    {0xE5,0x01,0x01},    {0xE6,0x02,0x01},    {0xE8,0x01,0x01},    {0xE9,0x01,0x01},    {0xEA,0x02,0x01},    {0xEC,0x01,0x01},    {0xED,0x01,0x01},    {0xEE,0x01,0x01},    {0xEF,0x01,0x01},    {0xF0,0x01,0x01},    {0xF1,0x01,0x01},    {0xF2,0x04,0x01},    {0xF6,0x01,0x01},    {0xF7,0x01,0x01},    {0xF8,0x01,0x01},    {0xF9,0x01,0x01},    {0xFA,0x01,0x01},    {0xFB,0x01,0x01},    {0xFC,0x01,0x01},    {0xFD,0x04,0x01}},{0}},
        {0x477E,6,1,1,0,0xFF,0,2,{    {0x00,0x02,0x01},    {0x02,0x04,0x01}},{0}},
        {0x477F,3,1,1,0,0xFF,0,3,{    {0x00,0x01,0x01},    {0x01,0x01,0x01},    {0x02,0x01,0x02}},{0}},
        {0x4780,6,1,1,0,0xFF,0,2,{    {0x00,0x02,0x01},    {0x02,0x04,0x01}},{0}},
        {0x4781,3,1,1,0,0xFF,0,3,{    {0x00,0x01,0x01},    {0x01,0x01,0x01},    {0x02,0x01,0x02}},{0}},
        {0x4782,6,1,1,0,0xFF,0,2,{    {0x00,0x02,0x01},    {0x02,0x04,0x01}},{0}},
        {0x4783,3,1,1,0,0xFF,0,3,{    {0x00,0x01,0x01},    {0x01,0x01,0x01},    {0x02,0x01,0x02}},{0}},
        {0x4784,6,1,1,0,0xFF,0,2,{    {0x00,0x02,0x01},    {0x02,0x04,0x01}},{0}},
        {0x4785,3,1,1,0,0xFF,0,3,{    {0x00,0x01,0x01},    {0x01,0x01,0x01},    {0x02,0x01,0x02}},{0}},
        {0x4786,6,1,1,0,0xFF,0,2,{    {0x00,0x02,0x02},    {0x02,0x04,0x01}},{0}},
        {0x4787,3,1,1,0,0xFF,0,3,{    {0x00,0x01,0x01},    {0x01,0x01,0x01},    {0x02,0x01,0x02}},{0}},
        {0x4788,6,1,1,0,0xFF,0,2,{    {0x00,0x02,0x01},    {0x02,0x04,0x02}},{0}},
        {0x4789,3,1,1,0,0xFF,0,3,{    {0x00,0x01,0x01},    {0x01,0x01,0x01},    {0x02,0x01,0x02}},{0}},
        {0x478A,6,1,1,0,0xFF,0,2,{    {0x00,0x02,0x01},    {0x02,0x04,0x01}},{0}},
        {0x478B,3,1,1,0,0xFF,0,3,{    {0x00,0x01,0x01},    {0x01,0x01,0x01},    {0x02,0x01,0x02}},{0}},
        {0x478C,6,1,1,0,0xFF,0,2,{    {0x00,0x02,0x01},    {0x02,0x04,0x01}},{0}},
        {0x478D,3,1,1,0,0xFF,0,3,{    {0x00,0x01,0x01},    {0x01,0x01,0x01},    {0x02,0x01,0x02}},{0}},
        {0x478E,6,1,1,0,0xFF,0,2,{    {0x00,0x02,0x01},    {0x02,0x04,0x01}},{0}},
        {0x478F,3,1,1,0,0xFF,0,3,{    {0x00,0x01,0x01},    {0x01,0x01,0x01},    {0x02,0x01,0x02}},{0}},
        {0x4790,6,1,1,0,0xFF,0,2,{    {0x00,0x02,0x01},    {0x02,0x04,0x01}},{0}},
        {0x4791,3,1,1,0,0xFF,0,3,{    {0x00,0x01,0x01},    {0x01,0x01,0x01},    {0x02,0x01,0x02}},{0}},
        {0x4792,6,1,1,0,0xFF,0,2,{    {0x00,0x02,0x01},    {0x02,0x04,0x01}},{0}},
        {0x4793,3,1,1,0,0xFF,0,3,{    {0x00,0x01,0x01},    {0x01,0x01,0x02},    {0x02,0x01,0x02}},{0}},
        {0x4794,6,1,1,0,0xFF,0,2,{    {0x00,0x02,0x01},    {0x02,0x04,0x01}},{0}},
        {0x4795,3,1,1,0,0xFF,0,3,{    {0x00,0x01,0x01},    {0x01,0x01,0x01},    {0x02,0x01,0x02}},{0}},
        {0x4796,6,1,1,0,0xFF,0,2,{    {0x00,0x02,0x02},    {0x02,0x04,0x01}},{0}},
        {0x4797,3,1,1,0,0xFF,0,3,{    {0x00,0x01,0x01},    {0x01,0x01,0x01},    {0x02,0x01,0x02}},{0}},
        {0x4798,6,1,1,0,0xFF,0,2,{    {0x00,0x02,0x02},    {0x02,0x04,0x02}},{0}},
        {0x4799,3,1,1,0,0xFF,0,3,{    {0x00,0x01,0x02},    {0x01,0x01,0x02},    {0x02,0x01,0x02}},{0}},
        {0x479A,6,1,1,0,0xFF,0,2,{    {0x00,0x02,0x01},    {0x02,0x04,0x01}},{0}},
        {0x479B,3,1,1,0,0xFF,0,3,{    {0x00,0x01,0x01},    {0x01,0x01,0x01},    {0x02,0x01,0x02}},{0}},
        {0x479C,6,1,1,0,0xFF,0,2,{    {0x00,0x02,0x01},    {0x02,0x04,0x01}},{0}},
        {0x479D,3,1,1,0,0xFF,0,3,{    {0x00,0x01,0x01},    {0x01,0x01,0x01},    {0x02,0x01,0x02}},{0}},
        {0x479E,6,1,1,0,0xFF,0,2,{    {0x00,0x02,0x01},    {0x02,0x04,0x01}},{0}},
        {0x479F,3,1,1,0,0xFF,0,3,{    {0x00,0x01,0x01},    {0x01,0x01,0x01},    {0x02,0x01,0x02}},{0}},
        {0x47A0,6,1,1,0,0xFF,0,2,{    {0x00,0x02,0x02},    {0x02,0x04,0x02}},{0}},
        {0x47A1,3,1,1,0,0xFF,0,3,{    {0x00,0x01,0x01},    {0x01,0x01,0x01},    {0x02,0x01,0x02}},{0}},
        {0x47A2,6,1,1,0,0xFF,0,2,{    {0x00,0x02,0x02},    {0x02,0x04,0x02}},{0}},
        {0x47A3,3,1,1,0,0xFF,0,3,{    {0x00,0x01,0x02},    {0x01,0x01,0x02},    {0x02,0x01,0x02}},{0}},
        {0x47A4,6,1,1,0,0xFF,0,2,{    {0x00,0x02,0x02},    {0x02,0x04,0x02}},{0}},
        {0x47A5,3,1,1,0,0xFF,0,3,{    {0x00,0x01,0x02},    {0x01,0x01,0x02},    {0x02,0x01,0x02}},{0}},
        {0x47A6,6,1,1,0,0xFF,0,2,{    {0x00,0x02,0x02},    {0x02,0x04,0x02}},{0}},
        {0x47A7,3,1,1,0,0xFF,0,3,{    {0x00,0x01,0x02},    {0x01,0x01,0x02},    {0x02,0x01,0x02}},{0}},
        {0x47A8,6,1,1,0,0xFF,0,2,{    {0x00,0x02,0x02},    {0x02,0x04,0x02}},{0}},
        {0x47A9,3,1,1,0,0xFF,0,3,{    {0x00,0x01,0x02},    {0x01,0x01,0x02},    {0x02,0x01,0x02}},{0}},
        {0x47AA,6,1,1,0,0xFF,0,2,{    {0x00,0x02,0x02},    {0x02,0x04,0x02}},{0}},
        {0x47AB,3,1,1,0,0xFF,0,3,{    {0x00,0x01,0x02},    {0x01,0x01,0x02},    {0x02,0x01,0x02}},{0}},
        {0x47AC,6,1,1,0,0xFF,0,2,{    {0x00,0x02,0x05},    {0x02,0x04,0x02}},{0}},
        {0x47AD,3,1,1,0,0xFF,0,3,{    {0x00,0x01,0x02},    {0x01,0x01,0x02},    {0x02,0x01,0x02}},{0}},
        {0x47AE,6,1,1,0,0xFF,0,2,{    {0x00,0x02,0x02},    {0x02,0x04,0x02}},{0}},
        {0x47AF,3,1,1,0,0xFF,0,3,{    {0x00,0x01,0x02},    {0x01,0x01,0x02},    {0x02,0x01,0x02}},{0}},
        {0x47B0,6,1,1,0,0xFF,0,2,{    {0x00,0x02,0x02},    {0x02,0x04,0x02}},{0}},
        {0x47B1,3,1,1,0,0xFF,0,3,{    {0x00,0x01,0x02},    {0x01,0x01,0x02},    {0x02,0x01,0x02}},{0}},
        {0x47B2,6,1,1,0,0xFF,0,2,{    {0x00,0x02,0x02},    {0x02,0x04,0x02}},{0}},
        {0x47B3,3,1,1,0,0xFF,0,3,{    {0x00,0x01,0x02},    {0x01,0x01,0x02},    {0x02,0x01,0x02}},{0}},
        {0x47B4,6,1,1,0,0xFF,0,2,{    {0x00,0x02,0x02},    {0x02,0x04,0x02}},{0}},
        {0x47B5,3,1,1,0,0xFF,0,3,{    {0x00,0x01,0x02},    {0x01,0x01,0x02},    {0x02,0x01,0x02}},{0}},
        {0x47B6,6,1,1,0,0xFF,0,2,{    {0x00,0x02,0x01},    {0x02,0x04,0x01}},{0}},
        {0x47B7,3,1,1,0,0xFF,0,3,{    {0x00,0x01,0x01},    {0x01,0x01,0x01},    {0x02,0x01,0x02}},{0}},
        {0x47B8,6,1,1,0,0xFF,0,2,{    {0x00,0x02,0x01},    {0x02,0x04,0x01}},{0}},
        {0x47B9,3,1,1,0,0xFF,0,3,{    {0x00,0x01,0x01},    {0x01,0x01,0x01},    {0x02,0x01,0x02}},{0}},
        {0x47BA,6,1,1,0,0xFF,0,2,{    {0x00,0x02,0x01},    {0x02,0x04,0x01}},{0}},
        {0x47BB,3,1,1,0,0xFF,0,3,{    {0x00,0x01,0x01},    {0x01,0x01,0x01},    {0x02,0x01,0x02}},{0}},
        {0x47BC,6,1,1,0,0xFF,0,2,{    {0x00,0x02,0x01},    {0x02,0x04,0x01}},{0}},
        {0x47BD,3,1,1,0,0xFF,0,3,{    {0x00,0x01,0x01},    {0x01,0x01,0x01},    {0x02,0x01,0x02}},{0}},
        {0x47BE,6,1,1,0,0xFF,0,2,{    {0x00,0x02,0x01},    {0x02,0x04,0x01}},{0}},
        {0x47BF,3,1,1,0,0xFF,0,3,{    {0x00,0x01,0x01},    {0x01,0x01,0x01},    {0x02,0x01,0x02}},{0}},
        {0x47C0,6,1,1,0,0xFF,0,2,{    {0x00,0x02,0x01},    {0x02,0x04,0x01}},{0}},
        {0x47C1,3,1,1,0,0xFF,0,3,{    {0x00,0x01,0x01},    {0x01,0x01,0x01},    {0x02,0x01,0x02}},{0}},
        {0x47C2,6,1,1,0,0xFF,0,2,{    {0x00,0x02,0x01},    {0x02,0x04,0x01}},{0}},
        {0x47C3,3,1,1,0,0xFF,0,3,{    {0x00,0x01,0x01},    {0x01,0x01,0x01},    {0x02,0x01,0x02}},{0}},
        {0x47C4,6,1,1,0,0xFF,0,2,{    {0x00,0x02,0x01},    {0x02,0x04,0x01}},{0}},
        {0x47C5,3,1,1,0,0xFF,0,3,{    {0x00,0x01,0x01},    {0x01,0x01,0x01},    {0x02,0x01,0x02}},{0}},
        {0x47C6,1,1,1,0,0xFF,0,1,{    {0x00,0x01,0x01}},{0}},
        {0x47C7,1,1,1,0,0xFF,0,1,{    {0x00,0x01,0x01}},{0}},
        {0x47C8,2,1,1,0,0xFF,0,1,{    {0x00,0x02,0x01}},{0}},
        {0x47C9,1,1,1,0,0xFF,0,1,{    {0x00,0x01,0x01}},{0}},
        {0x47CA,1,1,1,0,0xFF,0,1,{    {0x00,0x01,0x01}},{0}},
        {0x47CB,1,1,1,0,0xFF,0,1,{    {0x00,0x01,0x01}},{0}},
        {0x47CC,2,1,1,0,0xFF,0,1,{    {0x00,0x02,0x01}},{0}},
        {0x47CD,1,1,1,0,0xFF,0,1,{    {0x00,0x01,0x02}},{0}},
        {0x47CE,1,1,1,0,0xFF,0,1,{    {0x00,0x01,0x02}},{0}},
        {0x47CF,2,1,1,0,0xFF,0,2,{    {0x00,0x01,0x01},    {0x01,0x01,0x01}},{0}},
        {0x47D0,8,1,1,0,0xFF,0,3,{    {0x00,0x04,0x02},    {0x04,0x02,0x01},    {0x06,0x02,0x01}},{0}},
        {0x47D1,3,1,1,0,0xFF,0,3,{    {0x00,0x01,0x01},    {0x01,0x01,0x01},    {0x02,0x01,0x02}},{0}},
        {0x47D2,8,1,1,0,0xFF,0,3,{    {0x00,0x04,0x02},    {0x04,0x02,0x01},    {0x06,0x02,0x01}},{0}},
        {0x47D3,3,1,1,0,0xFF,0,3,{    {0x00,0x01,0x01},    {0x01,0x01,0x01},    {0x02,0x01,0x02}},{0}},
        {0x47D4,8,1,1,0,0xFF,0,3,{    {0x00,0x04,0x02},    {0x04,0x02,0x01},    {0x06,0x02,0x01}},{0}},
        {0x47D5,3,1,1,0,0xFF,0,3,{    {0x00,0x01,0x01},    {0x01,0x01,0x01},    {0x02,0x01,0x02}},{0}},
        {0x47D6,8,1,1,0,0xFF,0,3,{    {0x00,0x04,0x05},    {0x04,0x02,0x01},    {0x06,0x02,0x01}},{0}},
        {0x47D7,3,1,1,0,0xFF,0,3,{    {0x00,0x01,0x01},    {0x01,0x01,0x01},    {0x02,0x01,0x02}},{0}},
        {0x47D8,8,1,1,0,0xFF,0,3,{    {0x00,0x04,0x02},    {0x04,0x02,0x01},    {0x06,0x02,0x01}},{0}},
        {0x47D9,3,1,1,0,0xFF,0,3,{    {0x00,0x01,0x01},    {0x01,0x01,0x01},    {0x02,0x01,0x02}},{0}},
        {0x47DA,8,1,1,0,0xFF,0,3,{    {0x00,0x04,0x06},    {0x04,0x02,0x01},    {0x06,0x02,0x01}},{0}},
        {0x47DB,3,1,1,0,0xFF,0,3,{    {0x00,0x01,0x01},    {0x01,0x01,0x01},    {0x02,0x01,0x02}},{0}},
        {0x47DC,8,1,1,0,0xFF,0,3,{    {0x00,0x04,0x02},    {0x04,0x02,0x01},    {0x06,0x02,0x01}},{0}},
        {0x47DD,3,1,1,0,0xFF,0,3,{    {0x00,0x01,0x01},    {0x01,0x01,0x01},    {0x02,0x01,0x02}},{0}},
        {0x47DE,1,1,1,0,0xFF,0,1,{    {0x00,0x01,0x02}},{0}},
        {0x47DF,6,1,1,0,0xFF,0,6,{    {0x00,0x01,0x01},    {0x01,0x01,0x01},    {0x02,0x01,0x01},    {0x03,0x01,0x01},    {0x04,0x01,0x01},    {0x05,0x01,0x01}},{0}},
        {0x47E0,11,1,1,0,0xFF,0,11,{    {0x00,0x01,0x02},    {0x01,0x01,0x02},    {0x02,0x01,0x02},    {0x03,0x01,0x02},    {0x04,0x01,0x02},    {0x05,0x01,0x02},    {0x06,0x01,0x02},    {0x07,0x01,0x02},    {0x08,0x01,0x02},    {0x09,0x01,0x02},    {0x0A,0x01,0x02}},{0}},
        {0x47F1,300,1,1,0,0xFF,0,270,{    {0x00,0x01,0x01},    {0x01,0x01,0x01},    {0x02,0x01,0x01},    {0x03,0x01,0x01},    {0x04,0x01,0x01},    {0x05,0x01,0x01},    {0x06,0x01,0x01},    {0x07,0x01,0x01},    {0x08,0x01,0x01},    {0x09,0x01,0x01},    {0x0A,0x01,0x01},    {0x0B,0x01,0x01},    {0x0C,0x01,0x01},    {0x0D,0x01,0x01},    {0x0E,0x01,0x01},    {0x0F,0x01,0x01},    {0x10,0x04,0x01},    {0x14,0x01,0x01},    {0x15,0x01,0x01},    {0x16,0x01,0x01},    {0x17,0x01,0x01},    {0x18,0x01,0x01},    {0x19,0x01,0x01},    {0x1A,0x01,0x01},    {0x1B,0x01,0x01},    {0x1C,0x01,0x01},    {0x1D,0x01,0x01},    {0x1E,0x01,0x01},    {0x1F,0x01,0x01},    {0x20,0x01,0x01},    {0x21,0x01,0x01},    {0x22,0x01,0x01},    {0x23,0x01,0x01},    {0x24,0x01,0x01},    {0x25,0x01,0x01},    {0x26,0x01,0x01},    {0x27,0x01,0x01},    {0x28,0x01,0x01},    {0x29,0x01,0x01},    {0x2A,0x01,0x01},    {0x2B,0x01,0x01},    {0x2C,0x01,0x01},    {0x2D,0x01,0x01},    {0x2E,0x04,0x01},    {0x32,0x01,0x01},    {0x33,0x01,0x01},    {0x34,0x01,0x01},    {0x35,0x01,0x01},    {0x36,0x01,0x01},    {0x37,0x01,0x01},    {0x38,0x01,0x01},    {0x39,0x01,0x01},    {0x3A,0x01,0x01},    {0x3B,0x01,0x01},    {0x3C,0x01,0x01},    {0x3D,0x01,0x01},    {0x3E,0x01,0x01},    {0x3F,0x01,0x01},    {0x40,0x01,0x01},    {0x41,0x01,0x01},    {0x42,0x01,0x01},    {0x43,0x01,0x01},    {0x44,0x01,0x01},    {0x45,0x01,0x01},    {0x46,0x01,0x01},    {0x47,0x01,0x01},    {0x48,0x01,0x01},    {0x49,0x01,0x01},    {0x4A,0x01,0x01},    {0x4B,0x01,0x01},    {0x4C,0x04,0x01},    {0x50,0x01,0x01},    {0x51,0x01,0x01},    {0x52,0x01,0x01},    {0x53,0x01,0x01},    {0x54,0x01,0x01},    {0x55,0x01,0x01},    {0x56,0x01,0x01},    {0x57,0x01,0x01},    {0x58,0x01,0x01},    {0x59,0x01,0x01},    {0x5A,0x01,0x01},    {0x5B,0x01,0x01},    {0x5C,0x01,0x01},    {0x5D,0x01,0x01},    {0x5E,0x01,0x01},    {0x5F,0x01,0x01},    {0x60,0x01,0x01},    {0x61,0x01,0x01},    {0x62,0x01,0x01},    {0x63,0x01,0x01},    {0x64,0x01,0x01},    {0x65,0x01,0x01},    {0x66,0x01,0x01},    {0x67,0x01,0x01},    {0x68,0x01,0x01},    {0x69,0x01,0x01},    {0x6A,0x04,0x01},    {0x6E,0x01,0x01},    {0x6F,0x01,0x01},    {0x70,0x01,0x01},    {0x71,0x01,0x01},    {0x72,0x01,0x01},    {0x73,0x01,0x01},    {0x74,0x01,0x01},    {0x75,0x01,0x01},    {0x76,0x01,0x01},    {0x77,0x01,0x01},    {0x78,0x01,0x01},    {0x79,0x01,0x01},    {0x7A,0x01,0x01},    {0x7B,0x01,0x01},    {0x7C,0x01,0x01},    {0x7D,0x01,0x01},    {0x7E,0x01,0x01},    {0x7F,0x01,0x01},    {0x80,0x01,0x01},    {0x81,0x01,0x01},    {0x82,0x01,0x01},    {0x83,0x01,0x01},    {0x84,0x01,0x01},    {0x85,0x01,0x01},    {0x86,0x01,0x01},    {0x87,0x01,0x01},    {0x88,0x04,0x01},    {0x8C,0x01,0x01},    {0x8D,0x01,0x01},    {0x8E,0x01,0x01},    {0x8F,0x01,0x01},    {0x90,0x01,0x01},    {0x91,0x01,0x01},    {0x92,0x01,0x01},    {0x93,0x01,0x01},    {0x94,0x01,0x01},    {0x95,0x01,0x01},    {0x96,0x01,0x01},    {0x97,0x01,0x01},    {0x98,0x01,0x01},    {0x99,0x01,0x01},    {0x9A,0x01,0x01},    {0x9B,0x01,0x01},    {0x9C,0x01,0x01},    {0x9D,0x01,0x01},    {0x9E,0x01,0x01},    {0x9F,0x01,0x01},    {0xA0,0x01,0x01},    {0xA1,0x01,0x01},    {0xA2,0x01,0x01},    {0xA3,0x01,0x01},    {0xA4,0x01,0x01},    {0xA5,0x01,0x01},    {0xA6,0x04,0x01},    {0xAA,0x01,0x01},    {0xAB,0x01,0x01},    {0xAC,0x01,0x01},    {0xAD,0x01,0x01},    {0xAE,0x01,0x01},    {0xAF,0x01,0x01},    {0xB0,0x01,0x01},    {0xB1,0x01,0x01},    {0xB2,0x01,0x01},    {0xB3,0x01,0x01},    {0xB4,0x01,0x01},    {0xB5,0x01,0x01},    {0xB6,0x01,0x01},    {0xB7,0x01,0x01},    {0xB8,0x01,0x01},    {0xB9,0x01,0x01},    {0xBA,0x01,0x01},    {0xBB,0x01,0x01},    {0xBC,0x01,0x01},    {0xBD,0x01,0x01},    {0xBE,0x01,0x01},    {0xBF,0x01,0x01},    {0xC0,0x01,0x01},    {0xC1,0x01,0x01},    {0xC2,0x01,0x01},    {0xC3,0x01,0x01},    {0xC4,0x04,0x01},    {0xC8,0x01,0x01},    {0xC9,0x01,0x01},    {0xCA,0x01,0x01},    {0xCB,0x01,0x01},    {0xCC,0x01,0x01},    {0xCD,0x01,0x01},    {0xCE,0x01,0x01},    {0xCF,0x01,0x01},    {0xD0,0x01,0x01},    {0xD1,0x01,0x01},    {0xD2,0x01,0x01},    {0xD3,0x01,0x01},    {0xD4,0x01,0x01},    {0xD5,0x01,0x01},    {0xD6,0x01,0x01},    {0xD7,0x01,0x01},    {0xD8,0x01,0x01},    {0xD9,0x01,0x01},    {0xDA,0x01,0x01},    {0xDB,0x01,0x01},    {0xDC,0x01,0x01},    {0xDD,0x01,0x01},    {0xDE,0x01,0x01},    {0xDF,0x01,0x01},    {0xE0,0x01,0x01},    {0xE1,0x01,0x01},    {0xE2,0x04,0x01},    {0xE6,0x01,0x01},    {0xE7,0x01,0x01},    {0xE8,0x01,0x01},    {0xE9,0x01,0x01},    {0xEA,0x01,0x01},    {0xEB,0x01,0x01},    {0xEC,0x01,0x01},    {0xED,0x01,0x01},    {0xEE,0x01,0x01},    {0xEF,0x01,0x01},    {0xF0,0x01,0x01},    {0xF1,0x01,0x01},    {0xF2,0x01,0x01},    {0xF3,0x01,0x01},    {0xF4,0x01,0x01},    {0xF5,0x01,0x01},    {0xF6,0x01,0x01},    {0xF7,0x01,0x01},    {0xF8,0x01,0x01},    {0xF9,0x01,0x01},    {0xFA,0x01,0x01},    {0xFB,0x01,0x01},    {0xFC,0x01,0x01},    {0xFD,0x01,0x01},    {0xFE,0x01,0x01},    {0xFF,0x01,0x01},    {0x0100,0x04,0x01},    {0x0104,0x01,0x01},    {0x0105,0x01,0x01},    {0x0106,0x01,0x01},    {0x0107,0x01,0x01},    {0x0108,0x01,0x01},    {0x0109,0x01,0x01},    {0x010A,0x01,0x01},    {0x010B,0x01,0x01},    {0x010C,0x01,0x01},    {0x010D,0x01,0x01},    {0x010E,0x01,0x01},    {0x010F,0x01,0x01},    {0x0110,0x01,0x01},    {0x0111,0x01,0x01},    {0x0112,0x01,0x01},    {0x0113,0x01,0x01},    {0x0114,0x01,0x01},    {0x0115,0x01,0x01},    {0x0116,0x01,0x01},    {0x0117,0x01,0x01},    {0x0118,0x01,0x01},    {0x0119,0x01,0x01},    {0x011A,0x01,0x01},    {0x011B,0x01,0x01},    {0x011C,0x01,0x01},    {0x011D,0x01,0x01},    {0x011E,0x04,0x01},    {0x0122,0x01,0x01},    {0x0123,0x01,0x01},    {0x0124,0x01,0x01},    {0x0125,0x01,0x01},    {0x0126,0x01,0x01},    {0x0127,0x01,0x01},    {0x0128,0x01,0x01},    {0x0129,0x01,0x01},    {0x012A,0x01,0x01},    {0x012B,0x01,0x01}},{0}},
        {0x47F2,300,1,1,0,0xFF,0,270,{    {0x00,0x01,0x01},    {0x01,0x01,0x01},    {0x02,0x01,0x01},    {0x03,0x01,0x01},    {0x04,0x01,0x01},    {0x05,0x01,0x01},    {0x06,0x01,0x01},    {0x07,0x01,0x01},    {0x08,0x01,0x01},    {0x09,0x01,0x01},    {0x0A,0x01,0x01},    {0x0B,0x01,0x01},    {0x0C,0x01,0x01},    {0x0D,0x01,0x01},    {0x0E,0x01,0x01},    {0x0F,0x01,0x01},    {0x10,0x04,0x01},    {0x14,0x01,0x01},    {0x15,0x01,0x01},    {0x16,0x01,0x01},    {0x17,0x01,0x01},    {0x18,0x01,0x01},    {0x19,0x01,0x01},    {0x1A,0x01,0x01},    {0x1B,0x01,0x01},    {0x1C,0x01,0x01},    {0x1D,0x01,0x01},    {0x1E,0x01,0x01},    {0x1F,0x01,0x01},    {0x20,0x01,0x01},    {0x21,0x01,0x01},    {0x22,0x01,0x01},    {0x23,0x01,0x01},    {0x24,0x01,0x01},    {0x25,0x01,0x01},    {0x26,0x01,0x01},    {0x27,0x01,0x01},    {0x28,0x01,0x01},    {0x29,0x01,0x01},    {0x2A,0x01,0x01},    {0x2B,0x01,0x01},    {0x2C,0x01,0x01},    {0x2D,0x01,0x01},    {0x2E,0x04,0x01},    {0x32,0x01,0x01},    {0x33,0x01,0x01},    {0x34,0x01,0x01},    {0x35,0x01,0x01},    {0x36,0x01,0x01},    {0x37,0x01,0x01},    {0x38,0x01,0x01},    {0x39,0x01,0x01},    {0x3A,0x01,0x01},    {0x3B,0x01,0x01},    {0x3C,0x01,0x01},    {0x3D,0x01,0x01},    {0x3E,0x01,0x01},    {0x3F,0x01,0x01},    {0x40,0x01,0x01},    {0x41,0x01,0x01},    {0x42,0x01,0x01},    {0x43,0x01,0x01},    {0x44,0x01,0x01},    {0x45,0x01,0x01},    {0x46,0x01,0x01},    {0x47,0x01,0x01},    {0x48,0x01,0x01},    {0x49,0x01,0x01},    {0x4A,0x01,0x01},    {0x4B,0x01,0x01},    {0x4C,0x04,0x01},    {0x50,0x01,0x01},    {0x51,0x01,0x01},    {0x52,0x01,0x01},    {0x53,0x01,0x01},    {0x54,0x01,0x01},    {0x55,0x01,0x01},    {0x56,0x01,0x01},    {0x57,0x01,0x01},    {0x58,0x01,0x01},    {0x59,0x01,0x01},    {0x5A,0x01,0x01},    {0x5B,0x01,0x01},    {0x5C,0x01,0x01},    {0x5D,0x01,0x01},    {0x5E,0x01,0x01},    {0x5F,0x01,0x01},    {0x60,0x01,0x01},    {0x61,0x01,0x01},    {0x62,0x01,0x01},    {0x63,0x01,0x01},    {0x64,0x01,0x01},    {0x65,0x01,0x01},    {0x66,0x01,0x01},    {0x67,0x01,0x01},    {0x68,0x01,0x01},    {0x69,0x01,0x01},    {0x6A,0x04,0x01},    {0x6E,0x01,0x01},    {0x6F,0x01,0x01},    {0x70,0x01,0x01},    {0x71,0x01,0x01},    {0x72,0x01,0x01},    {0x73,0x01,0x01},    {0x74,0x01,0x01},    {0x75,0x01,0x01},    {0x76,0x01,0x01},    {0x77,0x01,0x01},    {0x78,0x01,0x01},    {0x79,0x01,0x01},    {0x7A,0x01,0x01},    {0x7B,0x01,0x01},    {0x7C,0x01,0x01},    {0x7D,0x01,0x01},    {0x7E,0x01,0x01},    {0x7F,0x01,0x01},    {0x80,0x01,0x01},    {0x81,0x01,0x01},    {0x82,0x01,0x01},    {0x83,0x01,0x01},    {0x84,0x01,0x01},    {0x85,0x01,0x01},    {0x86,0x01,0x01},    {0x87,0x01,0x01},    {0x88,0x04,0x01},    {0x8C,0x01,0x01},    {0x8D,0x01,0x01},    {0x8E,0x01,0x01},    {0x8F,0x01,0x01},    {0x90,0x01,0x01},    {0x91,0x01,0x01},    {0x92,0x01,0x01},    {0x93,0x01,0x01},    {0x94,0x01,0x01},    {0x95,0x01,0x01},    {0x96,0x01,0x01},    {0x97,0x01,0x01},    {0x98,0x01,0x01},    {0x99,0x01,0x01},    {0x9A,0x01,0x01},    {0x9B,0x01,0x01},    {0x9C,0x01,0x01},    {0x9D,0x01,0x01},    {0x9E,0x01,0x01},    {0x9F,0x01,0x01},    {0xA0,0x01,0x01},    {0xA1,0x01,0x01},    {0xA2,0x01,0x01},    {0xA3,0x01,0x01},    {0xA4,0x01,0x01},    {0xA5,0x01,0x01},    {0xA6,0x04,0x01},    {0xAA,0x01,0x01},    {0xAB,0x01,0x01},    {0xAC,0x01,0x01},    {0xAD,0x01,0x01},    {0xAE,0x01,0x01},    {0xAF,0x01,0x01},    {0xB0,0x01,0x01},    {0xB1,0x01,0x01},    {0xB2,0x01,0x01},    {0xB3,0x01,0x01},    {0xB4,0x01,0x01},    {0xB5,0x01,0x01},    {0xB6,0x01,0x01},    {0xB7,0x01,0x01},    {0xB8,0x01,0x01},    {0xB9,0x01,0x01},    {0xBA,0x01,0x01},    {0xBB,0x01,0x01},    {0xBC,0x01,0x01},    {0xBD,0x01,0x01},    {0xBE,0x01,0x01},    {0xBF,0x01,0x01},    {0xC0,0x01,0x01},    {0xC1,0x01,0x01},    {0xC2,0x01,0x01},    {0xC3,0x01,0x01},    {0xC4,0x04,0x01},    {0xC8,0x01,0x01},    {0xC9,0x01,0x01},    {0xCA,0x01,0x01},    {0xCB,0x01,0x01},    {0xCC,0x01,0x01},    {0xCD,0x01,0x01},    {0xCE,0x01,0x01},    {0xCF,0x01,0x01},    {0xD0,0x01,0x01},    {0xD1,0x01,0x01},    {0xD2,0x01,0x01},    {0xD3,0x01,0x01},    {0xD4,0x01,0x01},    {0xD5,0x01,0x01},    {0xD6,0x01,0x01},    {0xD7,0x01,0x01},    {0xD8,0x01,0x01},    {0xD9,0x01,0x01},    {0xDA,0x01,0x01},    {0xDB,0x01,0x01},    {0xDC,0x01,0x01},    {0xDD,0x01,0x01},    {0xDE,0x01,0x01},    {0xDF,0x01,0x01},    {0xE0,0x01,0x01},    {0xE1,0x01,0x01},    {0xE2,0x04,0x01},    {0xE6,0x01,0x01},    {0xE7,0x01,0x01},    {0xE8,0x01,0x01},    {0xE9,0x01,0x01},    {0xEA,0x01,0x01},    {0xEB,0x01,0x01},    {0xEC,0x01,0x01},    {0xED,0x01,0x01},    {0xEE,0x01,0x01},    {0xEF,0x01,0x01},    {0xF0,0x01,0x01},    {0xF1,0x01,0x01},    {0xF2,0x01,0x01},    {0xF3,0x01,0x01},    {0xF4,0x01,0x01},    {0xF5,0x01,0x01},    {0xF6,0x01,0x01},    {0xF7,0x01,0x01},    {0xF8,0x01,0x01},    {0xF9,0x01,0x01},    {0xFA,0x01,0x01},    {0xFB,0x01,0x01},    {0xFC,0x01,0x01},    {0xFD,0x01,0x01},    {0xFE,0x01,0x01},    {0xFF,0x01,0x01},    {0x0100,0x04,0x01},    {0x0104,0x01,0x01},    {0x0105,0x01,0x01},    {0x0106,0x01,0x01},    {0x0107,0x01,0x01},    {0x0108,0x01,0x01},    {0x0109,0x01,0x01},    {0x010A,0x01,0x01},    {0x010B,0x01,0x01},    {0x010C,0x01,0x01},    {0x010D,0x01,0x01},    {0x010E,0x01,0x01},    {0x010F,0x01,0x01},    {0x0110,0x01,0x01},    {0x0111,0x01,0x01},    {0x0112,0x01,0x01},    {0x0113,0x01,0x01},    {0x0114,0x01,0x01},    {0x0115,0x01,0x01},    {0x0116,0x01,0x01},    {0x0117,0x01,0x01},    {0x0118,0x01,0x01},    {0x0119,0x01,0x01},    {0x011A,0x01,0x01},    {0x011B,0x01,0x01},    {0x011C,0x01,0x01},    {0x011D,0x01,0x01},    {0x011E,0x04,0x01},    {0x0122,0x01,0x01},    {0x0123,0x01,0x01},    {0x0124,0x01,0x01},    {0x0125,0x01,0x01},    {0x0126,0x01,0x01},    {0x0127,0x01,0x01},    {0x0128,0x01,0x01},    {0x0129,0x01,0x01},    {0x012A,0x01,0x01},    {0x012B,0x01,0x01}},{0}},
        {0x47F3,2,1,1,0,0xFF,0,2,{    {0x00,0x01,0x02},    {0x01,0x01,0x02}},{0}},
        {0x47F4,4,1,1,0,0xFF,0,4,{    {0x00,0x01,0x02},    {0x01,0x01,0x02},    {0x02,0x01,0x02},    {0x03,0x01,0x02}},{0}},
        {0x47F5,6,1,1,0,0xFF,0,6,{    {0x00,0x01,0x02},    {0x01,0x01,0x02},    {0x02,0x01,0x02},    {0x03,0x01,0x02},    {0x04,0x01,0x02},    {0x05,0x01,0x02}},{0}},
        {0x47F6,1,1,1,0,0xFF,0,1,{    {0x00,0x01,0x02}},{0}},
        {0x47F7,5,1,1,0,0xFF,0,5,{    {0x00,0x01,0x02},    {0x01,0x01,0x02},    {0x02,0x01,0x02},    {0x03,0x01,0x02},    {0x04,0x01,0x02}},{0}},
        {0x47F8,8,1,1,0,0xFF,0,8,{    {0x00,0x01,0x02},    {0x01,0x01,0x02},    {0x02,0x01,0x02},    {0x03,0x01,0x02},    {0x04,0x01,0x02},    {0x05,0x01,0x02},    {0x06,0x01,0x02},    {0x07,0x01,0x02}},{0}},
        {0x47F9,8,1,1,0,0xFF,0,4,{    {0x00,0x02,0x02},    {0x02,0x02,0x02},    {0x04,0x02,0x02},    {0x06,0x02,0x02}},{0}},
        {0x47FD,870,1,1,0,0xFF,0,506,{    {0x00,0x01,0x01},    {0x01,0x01,0x01},    {0x02,0x01,0x01},    {0x03,0x02,0x01},    {0x05,0x02,0x01},    {0x07,0x02,0x01},    {0x09,0x02,0x01},    {0x0B,0x01,0x01},    {0x0C,0x01,0x01},    {0x0D,0x01,0x01},    {0x0E,0x04,0x01},    {0x12,0x01,0x01},    {0x13,0x01,0x01},    {0x14,0x01,0x01},    {0x15,0x02,0x01},    {0x17,0x02,0x01},    {0x19,0x02,0x01},    {0x1B,0x02,0x01},    {0x1D,0x01,0x01},    {0x1E,0x01,0x01},    {0x1F,0x01,0x01},    {0x20,0x04,0x01},    {0x24,0x01,0x01},    {0x25,0x01,0x01},    {0x26,0x01,0x01},    {0x27,0x02,0x01},    {0x29,0x02,0x01},    {0x2B,0x02,0x01},    {0x2D,0x02,0x01},    {0x2F,0x01,0x01},    {0x30,0x01,0x01},    {0x31,0x01,0x01},    {0x32,0x04,0x01},    {0x36,0x01,0x01},    {0x37,0x01,0x01},    {0x38,0x01,0x01},    {0x39,0x02,0x01},    {0x3B,0x02,0x01},    {0x3D,0x02,0x01},    {0x3F,0x02,0x01},    {0x41,0x01,0x01},    {0x42,0x01,0x01},    {0x43,0x01,0x01},    {0x44,0x04,0x01},    {0x48,0x01,0x01},    {0x49,0x01,0x01},    {0x4A,0x01,0x01},    {0x4B,0x02,0x01},    {0x4D,0x02,0x01},    {0x4F,0x02,0x01},    {0x51,0x02,0x01},    {0x53,0x01,0x01},    {0x54,0x01,0x01},    {0x55,0x01,0x01},    {0x56,0x04,0x01},    {0x5A,0x01,0x01},    {0x5B,0x01,0x01},    {0x5C,0x01,0x01},    {0x5D,0x02,0x01},    {0x5F,0x02,0x01},    {0x61,0x02,0x01},    {0x63,0x02,0x01},    {0x65,0x01,0x01},    {0x66,0x01,0x01},    {0x67,0x01,0x01},    {0x68,0x04,0x01},    {0x6C,0x01,0x01},    {0x6D,0x01,0x01},    {0x6E,0x01,0x01},    {0x6F,0x02,0x01},    {0x71,0x02,0x01},    {0x73,0x02,0x01},    {0x75,0x02,0x01},    {0x77,0x01,0x01},    {0x78,0x01,0x01},    {0x79,0x01,0x01},    {0x7A,0x04,0x01},    {0x7E,0x01,0x01},    {0x7F,0x01,0x01},    {0x80,0x01,0x01},    {0x81,0x02,0x01},    {0x83,0x02,0x01},    {0x85,0x02,0x01},    {0x87,0x02,0x01},    {0x89,0x01,0x01},    {0x8A,0x01,0x01},    {0x8B,0x01,0x01},    {0x8C,0x04,0x01},    {0x90,0x01,0x01},    {0x91,0x01,0x01},    {0x92,0x01,0x01},    {0x93,0x02,0x01},    {0x95,0x02,0x01},    {0x97,0x02,0x01},    {0x99,0x02,0x01},    {0x9B,0x01,0x01},    {0x9C,0x01,0x01},    {0x9D,0x01,0x01},    {0x9E,0x04,0x01},    {0xA2,0x01,0x01},    {0xA3,0x01,0x01},    {0xA4,0x01,0x01},    {0xA5,0x02,0x01},    {0xA7,0x02,0x01},    {0xA9,0x02,0x01},    {0xAB,0x02,0x01},    {0xAD,0x01,0x01},    {0xAE,0x01,0x01},    {0xAF,0x01,0x01},    {0xB0,0x04,0x01},    {0xB4,0x01,0x01},    {0xB5,0x01,0x01},    {0xB6,0x01,0x01},    {0xB7,0x01,0x01},    {0xB8,0x01,0x01},    {0xB9,0x01,0x01},    {0xBA,0x02,0x01},    {0xBC,0x02,0x01},    {0xBE,0x02,0x01},    {0xC0,0x02,0x01},    {0xC2,0x01,0x01},    {0xC3,0x01,0x01},    {0xC4,0x01,0x01},    {0xC5,0x01,0x01},    {0xC6,0x04,0x01},    {0xCA,0x01,0x01},    {0xCB,0x01,0x01},    {0xCC,0x01,0x01},    {0xCD,0x01,0x01},    {0xCE,0x01,0x01},    {0xCF,0x01,0x01},    {0xD0,0x02,0x01},    {0xD2,0x02,0x01},    {0xD4,0x02,0x01},    {0xD6,0x02,0x01},    {0xD8,0x01,0x01},    {0xD9,0x01,0x01},    {0xDA,0x01,0x01},    {0xDB,0x01,0x01},    {0xDC,0x04,0x01},    {0xE0,0x01,0x01},    {0xE1,0x01,0x01},    {0xE2,0x01,0x01},    {0xE3,0x01,0x01},    {0xE4,0x01,0x01},    {0xE5,0x01,0x01},    {0xE6,0x02,0x01},    {0xE8,0x02,0x01},    {0xEA,0x02,0x01},    {0xEC,0x02,0x01},    {0xEE,0x01,0x01},    {0xEF,0x01,0x01},    {0xF0,0x01,0x01},    {0xF1,0x01,0x01},    {0xF2,0x04,0x01},    {0xF6,0x01,0x01},    {0xF7,0x01,0x01},    {0xF8,0x01,0x01},    {0xF9,0x01,0x01},    {0xFA,0x01,0x01},    {0xFB,0x01,0x01},    {0xFC,0x02,0x01},    {0xFE,0x02,0x01},    {0x0100,0x02,0x01},    {0x0102,0x02,0x01},    {0x0104,0x01,0x01},    {0x0105,0x01,0x01},    {0x0106,0x01,0x01},    {0x0107,0x01,0x01},    {0x0108,0x04,0x01},    {0x010C,0x01,0x01},    {0x010D,0x01,0x01},    {0x010E,0x01,0x01},    {0x010F,0x01,0x01},    {0x0110,0x01,0x01},    {0x0111,0x01,0x01},    {0x0112,0x02,0x01},    {0x0114,0x02,0x01},    {0x0116,0x02,0x01},    {0x0118,0x02,0x01},    {0x011A,0x01,0x01},    {0x011B,0x01,0x01},    {0x011C,0x01,0x01},    {0x011D,0x01,0x01},    {0x011E,0x04,0x01},    {0x0122,0x01,0x01},    {0x0123,0x01,0x01},    {0x0124,0x01,0x01},    {0x0125,0x01,0x01},    {0x0126,0x01,0x01},    {0x0127,0x01,0x01},    {0x0128,0x02,0x01},    {0x012A,0x02,0x01},    {0x012C,0x02,0x01},    {0x012E,0x02,0x01},    {0x0130,0x01,0x01},    {0x0131,0x01,0x01},    {0x0132,0x01,0x01},    {0x0133,0x01,0x01},    {0x0134,0x04,0x01},    {0x0138,0x01,0x01},    {0x0139,0x01,0x01},    {0x013A,0x01,0x01},    {0x013B,0x01,0x01},    {0x013C,0x01,0x01},    {0x013D,0x01,0x01},    {0x013E,0x02,0x01},    {0x0140,0x02,0x01},    {0x0142,0x02,0x01},    {0x0144,0x02,0x01},    {0x0146,0x01,0x01},    {0x0147,0x01,0x01},    {0x0148,0x01,0x01},    {0x0149,0x01,0x01},    {0x014A,0x04,0x01},    {0x014E,0x01,0x01},    {0x014F,0x01,0x01},    {0x0150,0x01,0x01},    {0x0151,0x01,0x01},    {0x0152,0x01,0x01},    {0x0153,0x01,0x01},    {0x0154,0x02,0x01},    {0x0156,0x02,0x01},    {0x0158,0x02,0x01},    {0x015A,0x02,0x01},    {0x015C,0x01,0x01},    {0x015D,0x01,0x01},    {0x015E,0x01,0x01},    {0x015F,0x01,0x01},    {0x0160,0x04,0x01},    {0x0164,0x01,0x01},    {0x0165,0x01,0x01},    {0x0166,0x01,0x01},    {0x0167,0x01,0x01},    {0x0168,0x01,0x01},    {0x0169,0x01,0x01},    {0x016A,0x02,0x01},    {0x016C,0x02,0x01},    {0x016E,0x02,0x01},    {0x0170,0x02,0x01},    {0x0172,0x01,0x01},    {0x0173,0x01,0x01},    {0x0174,0x01,0x01},    {0x0175,0x01,0x01},    {0x0176,0x04,0x01},    {0x017A,0x01,0x01},    {0x017B,0x01,0x01},    {0x017C,0x01,0x01},    {0x017D,0x01,0x01},    {0x017E,0x01,0x01},    {0x017F,0x01,0x01},    {0x0180,0x02,0x01},    {0x0182,0x02,0x01},    {0x0184,0x02,0x01},    {0x0186,0x02,0x01},    {0x0188,0x01,0x01},    {0x0189,0x01,0x01},    {0x018A,0x01,0x01},    {0x018B,0x01,0x01},    {0x018C,0x04,0x01},    {0x0190,0x01,0x01},    {0x0191,0x01,0x01},    {0x0192,0x01,0x01},    {0x0193,0x01,0x01},    {0x0194,0x01,0x01},    {0x0195,0x01,0x01},    {0x0196,0x02,0x01},    {0x0198,0x02,0x01},    {0x019A,0x02,0x01},    {0x019C,0x02,0x01},    {0x019E,0x01,0x01},    {0x019F,0x01,0x01},    {0x01A0,0x01,0x01},    {0x01A1,0x01,0x01},    {0x01A2,0x04,0x01},    {0x01A6,0x01,0x01},    {0x01A7,0x01,0x01},    {0x01A8,0x01,0x01},    {0x01A9,0x01,0x01},    {0x01AA,0x01,0x01},    {0x01AB,0x01,0x01},    {0x01AC,0x02,0x01},    {0x01AE,0x02,0x01},    {0x01B0,0x02,0x01},    {0x01B2,0x02,0x01},    {0x01B4,0x01,0x01},    {0x01B5,0x01,0x01},    {0x01B6,0x01,0x01},    {0x01B7,0x01,0x01},    {0x01B8,0x04,0x01},    {0x01BC,0x01,0x01},    {0x01BD,0x01,0x01},    {0x01BE,0x01,0x01},    {0x01BF,0x01,0x01},    {0x01C0,0x01,0x01},    {0x01C1,0x01,0x01},    {0x01C2,0x02,0x01},    {0x01C4,0x02,0x01},    {0x01C6,0x02,0x01},    {0x01C8,0x02,0x01},    {0x01CA,0x01,0x01},    {0x01CB,0x01,0x01},    {0x01CC,0x01,0x01},    {0x01CD,0x01,0x01},    {0x01CE,0x04,0x01},    {0x01D2,0x01,0x01},    {0x01D3,0x01,0x01},    {0x01D4,0x01,0x01},    {0x01D5,0x01,0x01},    {0x01D6,0x01,0x01},    {0x01D7,0x01,0x01},    {0x01D8,0x02,0x01},    {0x01DA,0x02,0x01},    {0x01DC,0x02,0x01},    {0x01DE,0x02,0x01},    {0x01E0,0x01,0x01},    {0x01E1,0x01,0x01},    {0x01E2,0x01,0x01},    {0x01E3,0x01,0x01},    {0x01E4,0x04,0x01},    {0x01E8,0x01,0x01},    {0x01E9,0x01,0x01},    {0x01EA,0x01,0x01},    {0x01EB,0x01,0x01},    {0x01EC,0x01,0x01},    {0x01ED,0x01,0x01},    {0x01EE,0x02,0x01},    {0x01F0,0x02,0x01},    {0x01F2,0x02,0x01},    {0x01F4,0x02,0x01},    {0x01F6,0x01,0x01},    {0x01F7,0x01,0x01},    {0x01F8,0x01,0x01},    {0x01F9,0x01,0x01},    {0x01FA,0x04,0x01},    {0x01FE,0x01,0x01},    {0x01FF,0x01,0x01},    {0x0200,0x01,0x01},    {0x0201,0x01,0x01},    {0x0202,0x01,0x01},    {0x0203,0x01,0x01},    {0x0204,0x02,0x01},    {0x0206,0x02,0x01},    {0x0208,0x02,0x01},    {0x020A,0x02,0x01},    {0x020C,0x01,0x01},    {0x020D,0x01,0x01},    {0x020E,0x01,0x01},    {0x020F,0x01,0x01},    {0x0210,0x04,0x01},    {0x0214,0x01,0x01},    {0x0215,0x01,0x01},    {0x0216,0x01,0x01},    {0x0217,0x01,0x01},    {0x0218,0x01,0x01},    {0x0219,0x01,0x01},    {0x021A,0x02,0x01},    {0x021C,0x02,0x01},    {0x021E,0x02,0x01},    {0x0220,0x02,0x01},    {0x0222,0x01,0x01},    {0x0223,0x01,0x01},    {0x0224,0x01,0x01},    {0x0225,0x01,0x01},    {0x0226,0x04,0x01},    {0x022A,0x01,0x01},    {0x022B,0x01,0x01},    {0x022C,0x01,0x01},    {0x022D,0x01,0x01},    {0x022E,0x01,0x01},    {0x022F,0x01,0x01},    {0x0230,0x02,0x01},    {0x0232,0x02,0x01},    {0x0234,0x02,0x01},    {0x0236,0x02,0x01},    {0x0238,0x01,0x01},    {0x0239,0x01,0x01},    {0x023A,0x01,0x01},    {0x023B,0x01,0x01},    {0x023C,0x04,0x01},    {0x0240,0x01,0x01},    {0x0241,0x01,0x01},    {0x0242,0x01,0x01},    {0x0243,0x01,0x01},    {0x0244,0x01,0x01},    {0x0245,0x01,0x01},    {0x0246,0x02,0x01},    {0x0248,0x02,0x01},    {0x024A,0x02,0x01},    {0x024C,0x02,0x01},    {0x024E,0x01,0x01},    {0x024F,0x01,0x01},    {0x0250,0x01,0x01},    {0x0251,0x01,0x01},    {0x0252,0x04,0x01},    {0x0256,0x01,0x01},    {0x0257,0x01,0x01},    {0x0258,0x01,0x01},    {0x0259,0x01,0x01},    {0x025A,0x01,0x01},    {0x025B,0x01,0x01},    {0x025C,0x02,0x01},    {0x025E,0x02,0x01},    {0x0260,0x02,0x01},    {0x0262,0x02,0x01},    {0x0264,0x01,0x01},    {0x0265,0x01,0x01},    {0x0266,0x01,0x01},    {0x0267,0x01,0x01},    {0x0268,0x04,0x01},    {0x026C,0x01,0x01},    {0x026D,0x04,0x01},    {0x0271,0x01,0x01},    {0x0272,0x04,0x01},    {0x0276,0x01,0x01},    {0x0277,0x04,0x01},    {0x027B,0x01,0x01},    {0x027C,0x04,0x01},    {0x0280,0x01,0x01},    {0x0281,0x04,0x01},    {0x0285,0x01,0x01},    {0x0286,0x04,0x01},    {0x028A,0x01,0x01},    {0x028B,0x04,0x01},    {0x028F,0x01,0x01},    {0x0290,0x04,0x01},    {0x0294,0x01,0x01},    {0x0295,0x04,0x01},    {0x0299,0x01,0x01},    {0x029A,0x04,0x01},    {0x029E,0x01,0x01},    {0x029F,0x01,0x01},    {0x02A0,0x04,0x01},    {0x02A4,0x01,0x01},    {0x02A5,0x01,0x01},    {0x02A6,0x04,0x01},    {0x02AA,0x01,0x01},    {0x02AB,0x01,0x01},    {0x02AC,0x04,0x01},    {0x02B0,0x01,0x01},    {0x02B1,0x01,0x01},    {0x02B2,0x04,0x01},    {0x02B6,0x01,0x01},    {0x02B7,0x01,0x01},    {0x02B8,0x04,0x01},    {0x02BC,0x01,0x01},    {0x02BD,0x01,0x01},    {0x02BE,0x04,0x01},    {0x02C2,0x01,0x01},    {0x02C3,0x01,0x01},    {0x02C4,0x04,0x01},    {0x02C8,0x01,0x01},    {0x02C9,0x01,0x01},    {0x02CA,0x04,0x01},    {0x02CE,0x01,0x01},    {0x02CF,0x01,0x01},    {0x02D0,0x04,0x01},    {0x02D4,0x01,0x01},    {0x02D5,0x01,0x01},    {0x02D6,0x04,0x01},    {0x02DA,0x02,0x01},    {0x02DC,0x02,0x01},    {0x02DE,0x04,0x01},    {0x02E2,0x02,0x01},    {0x02E4,0x02,0x01},    {0x02E6,0x04,0x01},    {0x02EA,0x02,0x01},    {0x02EC,0x02,0x01},    {0x02EE,0x04,0x01},    {0x02F2,0x02,0x01},    {0x02F4,0x02,0x01},    {0x02F6,0x04,0x01},    {0x02FA,0x02,0x01},    {0x02FC,0x02,0x01},    {0x02FE,0x04,0x01},    {0x0302,0x01,0x01},    {0x0303,0x04,0x01},    {0x0307,0x01,0x01},    {0x0308,0x04,0x01},    {0x030C,0x01,0x01},    {0x030D,0x04,0x01},    {0x0311,0x01,0x01},    {0x0312,0x04,0x01},    {0x0316,0x01,0x01},    {0x0317,0x04,0x01},    {0x031B,0x01,0x01},    {0x031C,0x04,0x01},    {0x0320,0x01,0x01},    {0x0321,0x04,0x01},    {0x0325,0x01,0x01},    {0x0326,0x04,0x01},    {0x032A,0x01,0x01},    {0x032B,0x04,0x01},    {0x032F,0x01,0x01},    {0x0330,0x04,0x01},    {0x0334,0x01,0x01},    {0x0335,0x04,0x01},    {0x0339,0x01,0x01},    {0x033A,0x04,0x01},    {0x033E,0x01,0x01},    {0x033F,0x04,0x01},    {0x0343,0x01,0x01},    {0x0344,0x04,0x01},    {0x0348,0x01,0x01},    {0x0349,0x04,0x01},    {0x034D,0x19,0x01}},{0}},
        {0x47FE,2,1,1,0,0xFF,0,2,{    {0x00,0x01,0x01},    {0x01,0x01,0x01}},{0}},
        {0x47FF,1,1,1,0,0xFF,0,1,{    {0x00,0x01,0x01}},{0}},
        {0x4AF7,3,1,1,0,0xFF,0,3,{    {0x00,0x01,0x02},    {0x01,0x01,0x02},    {0x02,0x01,0x02}},{0}},
        {0x7079,3,1,1,0,0xFF,0,3,{    {0x00,0x01,0x01},    {0x01,0x01,0x01},    {0x02,0x01,0x02}},{0}},
        {0x707A,3,1,1,0,0xFF,0,3,{    {0x00,0x01,0x01},    {0x01,0x01,0x01},    {0x02,0x01,0x01}},{0}},
        {0x707D,2,1,1,0,0xFF,0,2,{    {0x00,0x01,0x01},    {0x01,0x01,0x01}},{0}},
        {0x7081,3,1,1,0,0xFF,0,3,{    {0x00,0x01,0x01},    {0x01,0x01,0x01},    {0x02,0x01,0x01}},{0}},
        {0x9800,8,1,1,0,0xFF,0,4,{    {0x00,0x02,0x01},    {0x02,0x02,0x01},    {0x04,0x02,0x01},    {0x06,0x02,0x01}},{0}},
        {0x9801,8,1,1,0,0xFF,0,4,{    {0x00,0x02,0x01},    {0x02,0x02,0x01},    {0x04,0x02,0x01},    {0x06,0x02,0x01}},{0}},
        {0x9802,8,1,1,0,0xFF,0,4,{    {0x00,0x02,0x01},    {0x02,0x02,0x01},    {0x04,0x02,0x01},    {0x06,0x02,0x01}},{0}},
        {0x9803,5,1,1,0,0xFF,0,4,{    {0x00,0x01,0x01},    {0x01,0x01,0x01},    {0x02,0x01,0x01},    {0x03,0x02,0x01}},{0}},
        {0x9804,6,1,1,0,0xFF,0,4,{    {0x00,0x01,0x01},    {0x01,0x01,0x02},    {0x02,0x02,0x01},    {0x04,0x02,0x01}},{0}},
        {0x9805,8,1,1,0,0xFF,0,4,{    {0x00,0x02,0x01},    {0x02,0x02,0x01},    {0x04,0x02,0x01},    {0x06,0x02,0x01}},{0}},
        {0x9808,1,1,1,0,0xFF,0,1,{    {0x00,0x01,0x01}},{0}},
        {0x9809,4,1,1,0,0xFF,0,4,{    {0x00,0x01,0x01},    {0x01,0x01,0x01},    {0x02,0x01,0x01},    {0x03,0x01,0x01}},{0}},
        {0x980A,4,1,1,0,0xFF,0,4,{    {0x00,0x01,0x01},    {0x01,0x01,0x01},    {0x02,0x01,0x01},    {0x03,0x01,0x01}},{0}},
        {0x980B,11,1,1,0,0xFF,0,11,{    {0x00,0x01,0x01},    {0x01,0x01,0x01},    {0x02,0x01,0x01},    {0x03,0x01,0x01},    {0x04,0x01,0x01},    {0x05,0x01,0x01},    {0x06,0x01,0x01},    {0x07,0x01,0x01},    {0x08,0x01,0x01},    {0x09,0x01,0x01},    {0x0A,0x01,0x01}},{0}},
        {0x980E,5,1,1,0,0xFF,0,4,{    {0x00,0x01,0x01},    {0x01,0x01,0x01},    {0x02,0x02,0x01},    {0x04,0x01,0x01}},{0}},
        {0x980F,1,1,1,0,0xFF,0,1,{    {0x00,0x01,0x02}},{0}},
        {0x983E,1,1,1,0,0xFF,0,1,{    {0x00,0x01,0x02}},{0}},
        {0x987B,1,1,1,0,0xFF,0,1,{    {0x00,0x01,0x02}},{0}},
        {0x987C,5,1,1,0,0xFF,0,4,{    {0x00,0x02,0x02},    {0x02,0x01,0x02},    {0x03,0x01,0x02},    {0x04,0x01,0x02}},{0}},
        {0x987D,5,1,1,0,0xFF,0,5,{    {0x00,0x01,0x02},    {0x01,0x01,0x02},    {0x02,0x01,0x02},    {0x03,0x01,0x02},    {0x04,0x01,0x02}},{0}},
        {0x987E,6,1,1,0,0xFF,0,6,{    {0x00,0x01,0x02},    {0x01,0x01,0x02},    {0x02,0x01,0x02},    {0x03,0x01,0x02},    {0x04,0x01,0x02},    {0x05,0x01,0x02}},{0}},
        {0x987F,20,1,1,0,0xFF,0,17,{    {0x00,0x01,0x02},    {0x01,0x01,0x02},    {0x02,0x02,0x02},    {0x04,0x02,0x02},    {0x06,0x02,0x02},    {0x08,0x01,0x02},    {0x09,0x01,0x02},    {0x0A,0x01,0x02},    {0x0B,0x01,0x02},    {0x0C,0x01,0x02},    {0x0D,0x01,0x02},    {0x0E,0x01,0x02},    {0x0F,0x01,0x02},    {0x10,0x01,0x02},    {0x11,0x01,0x02},    {0x12,0x01,0x02},    {0x13,0x01,0x02}},{0}},
        {0x9880,1,1,1,0,0xFF,0,1,{    {0x00,0x01,0x02}},{0}},
        {0x988E,2,1,1,0,0xFF,0,2,{    {0x00,0x01,0x02},    {0x01,0x01,0x02}},{0}},
        {0x988F,2,1,1,0,0xFF,0,1,{    {0x00,0x02,0x02}},{0}},
        {0x9890,3,1,1,0,0xFF,0,3,{    {0x00,0x01,0x02},    {0x01,0x01,0x02},    {0x02,0x01,0x02}},{0}},
        {0x9891,3,1,1,0,0xFF,0,3,{    {0x00,0x01,0x02},    {0x01,0x01,0x02},    {0x02,0x01,0x02}},{0}},
        {0x9892,3,1,1,0,0xFF,0,3,{    {0x00,0x01,0x02},    {0x01,0x01,0x02},    {0x02,0x01,0x02}},{0}},
        {0x9893,3,1,1,0,0xFF,0,3,{    {0x00,0x01,0x02},    {0x01,0x01,0x02},    {0x02,0x01,0x02}},{0}},
        {0x9894,3,1,1,0,0xFF,0,3,{    {0x00,0x01,0x02},    {0x01,0x01,0x02},    {0x02,0x01,0x02}},{0}},
        {0x9895,3,1,1,0,0xFF,0,3,{    {0x00,0x01,0x02},    {0x01,0x01,0x02},    {0x02,0x01,0x02}},{0}},
        {0x9896,3,1,1,0,0xFF,0,3,{    {0x00,0x01,0x02},    {0x01,0x01,0x02},    {0x02,0x01,0x02}},{0}},
        {0x9897,3,1,1,0,0xFF,0,3,{    {0x00,0x01,0x02},    {0x01,0x01,0x02},    {0x02,0x01,0x02}},{0}},
        {0x9898,26,1,1,0,0xFF,0,13,{    {0x00,0x02,0x02},    {0x02,0x02,0x02},    {0x04,0x02,0x02},    {0x06,0x02,0x02},    {0x08,0x02,0x02},    {0x0A,0x02,0x02},    {0x0C,0x02,0x02},    {0x0E,0x02,0x02},    {0x10,0x02,0x02},    {0x12,0x02,0x02},    {0x14,0x02,0x02},    {0x16,0x02,0x02},    {0x18,0x02,0x02}},{0}},
        {0x989C,2,1,1,0,0xFF,0,2,{    {0x00,0x01,0x02},    {0x01,0x01,0x02}},{0}},
        {0x989D,10,1,1,0,0xFF,0,4,{    {0x00,0x01,0x02},    {0x01,0x01,0x02},    {0x02,0x01,0x02},    {0x03,0x07,0x02}},{0}},
        {0x989E,3,1,1,0,0xFF,0,3,{    {0x00,0x01,0x02},    {0x01,0x01,0x02},    {0x02,0x01,0x02}},{0}},
        {0x989F,22,1,1,0,0xFF,0,5,{    {0x00,0x01,0x02},    {0x01,0x01,0x02},    {0x02,0x01,0x02},    {0x03,0x01,0x02},    {0x04,0x12,0x02}},{0}},
        {0x98A1,14,1,1,0,0xFF,0,7,{    {0x00,0x02,0x01},    {0x02,0x02,0x01},    {0x04,0x02,0x01},    {0x06,0x02,0x01},    {0x08,0x02,0x01},    {0x0A,0x02,0x01},    {0x0C,0x02,0x01}},{0}},
        {0x98A2,2,1,1,0,0xFF,0,1,{    {0x00,0x02,0x01}},{0}},
        {0x98A3,4,1,1,0,0xFF,0,4,{    {0x00,0x01,0x02},    {0x01,0x01,0x02},    {0x02,0x01,0x02},    {0x03,0x01,0x02}},{0}},
        {0x98A4,4,1,1,0,0xFF,0,4,{    {0x00,0x01,0x02},    {0x01,0x01,0x02},    {0x02,0x01,0x02},    {0x03,0x01,0x02}},{0}},
        {0x98A5,7,1,1,0,0xFF,0,6,{    {0x00,0x02,0x02},    {0x02,0x01,0x02},    {0x03,0x01,0x02},    {0x04,0x01,0x02},    {0x05,0x01,0x02},    {0x06,0x01,0x02}},{0}},
        {0x9A23,1,1,1,0,0xFF,0,1,{    {0x00,0x01,0x01}},{0}},
        {0xA01C,700,1,1,0,0xFF,0,1,{    {0x00,0x02BC,0x02}},{0}},
        {0xA4A2,2,1,1,0,0xFF,0,1,{    {0x00,0x02,0x01}},{0}},
        {0xB100,80,1,1,0,0xFF,0,45,{    {0x00,0x01,0x01},    {0x01,0x01,0x02},    {0x02,0x02,0x01},    {0x04,0x02,0x01},    {0x06,0x04,0x01},    {0x0A,0x03,0x01},    {0x0D,0x01,0x01},    {0x0E,0x02,0x01},    {0x0F,0x01,0x01},    {0x10,0x01,0x01},    {0x11,0x01,0x02},    {0x12,0x02,0x01},    {0x14,0x02,0x01},    {0x16,0x04,0x01},    {0x1A,0x03,0x01},    {0x1D,0x01,0x01},    {0x1E,0x02,0x01},    {0x1F,0x01,0x01},    {0x20,0x01,0x01},    {0x21,0x01,0x02},    {0x22,0x02,0x01},    {0x24,0x02,0x01},    {0x26,0x04,0x01},    {0x2A,0x03,0x01},    {0x2D,0x01,0x01},    {0x2E,0x02,0x01},    {0x2F,0x01,0x01},    {0x30,0x01,0x01},    {0x31,0x01,0x02},    {0x32,0x02,0x01},    {0x34,0x02,0x01},    {0x36,0x04,0x01},    {0x3A,0x03,0x01},    {0x3D,0x01,0x01},    {0x3E,0x02,0x01},    {0x3F,0x01,0x01},    {0x40,0x01,0x01},    {0x41,0x01,0x02},    {0x42,0x02,0x01},    {0x44,0x02,0x01},    {0x46,0x04,0x01},    {0x4A,0x03,0x01},    {0x4D,0x01,0x01},    {0x4E,0x02,0x01},    {0x4F,0x01,0x01}},{0}},
        {0xB101,8,1,1,0,0xFF,0,8,{    {0x00,0x01,0x02},    {0x01,0x01,0x02},    {0x02,0x01,0x02},    {0x03,0x01,0x02},    {0x04,0x01,0x02},    {0x05,0x01,0x02},    {0x06,0x01,0x02},    {0x07,0x01,0x02}},{0}},
        {0xB102,1,1,1,0,0xFF,0,1,{    {0x00,0x01,0x02}},{0}},
        {0xB103,81,1,1,0,0xFF,0,31,{    {0x00,0x01,0x02},    {0x01,0x01,0x02},    {0x02,0x01,0x02},    {0x03,0x06,0x01},    {0x09,0x01,0x02},    {0x0A,0x01,0x02},    {0x0B,0x06,0x01},    {0x11,0x01,0x02},    {0x12,0x01,0x02},    {0x13,0x06,0x01},    {0x19,0x01,0x02},    {0x1A,0x01,0x02},    {0x1B,0x06,0x01},    {0x21,0x01,0x02},    {0x22,0x01,0x02},    {0x23,0x06,0x01},    {0x29,0x01,0x02},    {0x2A,0x01,0x02},    {0x2B,0x06,0x01},    {0x31,0x01,0x02},    {0x32,0x01,0x02},    {0x33,0x06,0x01},    {0x39,0x01,0x02},    {0x3A,0x01,0x02},    {0x3B,0x06,0x01},    {0x41,0x01,0x02},    {0x42,0x01,0x02},    {0x43,0x06,0x01},    {0x49,0x01,0x02},    {0x4A,0x01,0x02},    {0x4B,0x06,0x01}},{0}},
        {0xB106,1,1,1,0,0xFF,0,1,{    {0x00,0x01,0x02}},{0}},
        {0xB165,100,1,1,0,0xFF,0,50,{    {0x00,0x01,0x01},    {0x01,0x02,0x01},    {0x03,0x02,0x01},    {0x05,0x01,0x01},    {0x06,0x04,0x01},    {0x0A,0x01,0x01},    {0x0B,0x02,0x01},    {0x0D,0x02,0x01},    {0x0F,0x01,0x01},    {0x10,0x04,0x01},    {0x14,0x01,0x01},    {0x15,0x02,0x01},    {0x17,0x02,0x01},    {0x19,0x01,0x01},    {0x1A,0x04,0x01},    {0x1E,0x01,0x01},    {0x1F,0x02,0x01},    {0x21,0x02,0x01},    {0x23,0x01,0x01},    {0x24,0x04,0x01},    {0x28,0x01,0x01},    {0x29,0x02,0x01},    {0x2B,0x02,0x01},    {0x2D,0x01,0x01},    {0x2E,0x04,0x01},    {0x32,0x01,0x01},    {0x33,0x02,0x01},    {0x35,0x02,0x01},    {0x37,0x01,0x01},    {0x38,0x04,0x01},    {0x3C,0x01,0x01},    {0x3D,0x02,0x01},    {0x3F,0x02,0x01},    {0x41,0x01,0x01},    {0x42,0x04,0x01},    {0x46,0x01,0x01},    {0x47,0x02,0x01},    {0x49,0x02,0x01},    {0x4B,0x01,0x01},    {0x4C,0x04,0x01},    {0x50,0x01,0x01},    {0x51,0x02,0x01},    {0x53,0x02,0x01},    {0x55,0x01,0x01},    {0x56,0x04,0x01},    {0x5A,0x01,0x01},    {0x5B,0x02,0x01},    {0x5D,0x02,0x01},    {0x5F,0x01,0x01},    {0x60,0x04,0x01}},{0}},
        {0xB166,100,1,1,0,0xFF,0,50,{    {0x00,0x01,0x01},    {0x01,0x02,0x01},    {0x03,0x02,0x01},    {0x05,0x01,0x01},    {0x06,0x04,0x01},    {0x0A,0x01,0x01},    {0x0B,0x02,0x01},    {0x0D,0x02,0x01},    {0x0F,0x01,0x01},    {0x10,0x04,0x01},    {0x14,0x01,0x01},    {0x15,0x02,0x01},    {0x17,0x02,0x01},    {0x19,0x01,0x01},    {0x1A,0x04,0x01},    {0x1E,0x01,0x01},    {0x1F,0x02,0x01},    {0x21,0x02,0x01},    {0x23,0x01,0x01},    {0x24,0x04,0x01},    {0x28,0x01,0x01},    {0x29,0x02,0x01},    {0x2B,0x02,0x01},    {0x2D,0x01,0x01},    {0x2E,0x04,0x01},    {0x32,0x01,0x01},    {0x33,0x02,0x01},    {0x35,0x02,0x01},    {0x37,0x01,0x01},    {0x38,0x04,0x01},    {0x3C,0x01,0x01},    {0x3D,0x02,0x01},    {0x3F,0x02,0x01},    {0x41,0x01,0x01},    {0x42,0x04,0x01},    {0x46,0x01,0x01},    {0x47,0x02,0x01},    {0x49,0x02,0x01},    {0x4B,0x01,0x01},    {0x4C,0x04,0x01},    {0x50,0x01,0x01},    {0x51,0x02,0x01},    {0x53,0x02,0x01},    {0x55,0x01,0x01},    {0x56,0x04,0x01},    {0x5A,0x01,0x01},    {0x5B,0x02,0x01},    {0x5D,0x02,0x01},    {0x5F,0x01,0x01},    {0x60,0x04,0x01}},{0}},
        {0xB167,1,1,1,0,0xFF,0,1,{    {0x00,0x01,0x02}},{0}},
        {0xB16B,2,1,1,0,0xFF,0,3,{    {0x00,0x01,0x02},    {0x00,0x02,0x02},    {0x01,0x01,0x02}},{0}},
        {0xB174,3,1,1,0,0xFF,0,2,{    {0x00,0x02,0x01},    {0x02,0x01,0x02}},{0}},
        {0xB175,3,1,1,0,0xFF,0,2,{    {0x00,0x02,0x01},    {0x02,0x01,0x02}},{0}},
        {0xB176,3,1,1,0,0xFF,0,2,{    {0x00,0x02,0x01},    {0x02,0x01,0x02}},{0}},
        {0xB177,3,1,1,0,0xFF,0,2,{    {0x00,0x02,0x01},    {0x02,0x01,0x02}},{0}},
        {0xB178,3,1,1,0,0xFF,0,2,{    {0x00,0x02,0x01},    {0x02,0x01,0x02}},{0}},
        {0xB179,3,1,1,0,0xFF,0,2,{    {0x00,0x02,0x01},    {0x02,0x01,0x02}},{0}},
        {0xB17A,3,1,1,0,0xFF,0,2,{    {0x00,0x02,0x01},    {0x02,0x01,0x02}},{0}},
        {0xC00A,189,0,1,0,0x19,0,63,{    {0x00,0x01,0x02},    {0x01,0x04,0x02},    {0x05,0x04,0x02},    {0x09,0x04,0x02},    {0x0D,0x01,0x02},    {0x0E,0x04,0x02},    {0x12,0x04,0x02},    {0x16,0x01,0x02},    {0x17,0x04,0x02},    {0x1B,0x04,0x02},    {0x1F,0x01,0x02},    {0x20,0x04,0x02},    {0x24,0x04,0x02},    {0x28,0x01,0x02},    {0x29,0x04,0x02},    {0x2D,0x04,0x02},    {0x31,0x01,0x02},    {0x32,0x04,0x02},    {0x36,0x04,0x02},    {0x3A,0x01,0x02},    {0x3B,0x04,0x02},    {0x3F,0x04,0x02},    {0x43,0x01,0x02},    {0x44,0x04,0x02},    {0x48,0x04,0x02},    {0x4C,0x01,0x02},    {0x4D,0x04,0x02},    {0x51,0x04,0x02},    {0x55,0x01,0x02},    {0x56,0x04,0x02},    {0x5A,0x04,0x02},    {0x5E,0x01,0x02},    {0x5F,0x04,0x02},    {0x63,0x04,0x02},    {0x67,0x01,0x02},    {0x68,0x04,0x02},    {0x6C,0x04,0x02},    {0x70,0x01,0x02},    {0x71,0x04,0x02},    {0x75,0x04,0x02},    {0x79,0x01,0x02},    {0x7A,0x04,0x02},    {0x7E,0x04,0x02},    {0x82,0x01,0x02},    {0x83,0x04,0x02},    {0x87,0x04,0x02},    {0x8B,0x01,0x02},    {0x8C,0x04,0x02},    {0x90,0x04,0x02},    {0x94,0x01,0x02},    {0x95,0x04,0x02},    {0x99,0x04,0x02},    {0x9D,0x01,0x02},    {0x9E,0x04,0x02},    {0xA2,0x04,0x02},    {0xA6,0x01,0x02},    {0xA7,0x04,0x02},    {0xAB,0x04,0x02},    {0xAF,0x01,0x02},    {0xB0,0x04,0x02},    {0xB4,0x04,0x02},    {0xB8,0x01,0x02},    {0xB9,0x04,0x02}},{0}},
        {0xC00B,165,0,1,0,0x19,0,62,{    {0x00,0x01,0x02},    {0x01,0x04,0x02},    {0x05,0x04,0x02},    {0x09,0x01,0x02},    {0x0A,0x03,0x02},    {0x0D,0x04,0x02},    {0x11,0x01,0x02},    {0x12,0x03,0x02},    {0x15,0x04,0x02},    {0x19,0x01,0x02},    {0x1A,0x03,0x02},    {0x1D,0x04,0x02},    {0x21,0x01,0x02},    {0x22,0x03,0x02},    {0x25,0x04,0x02},    {0x29,0x01,0x02},    {0x2A,0x03,0x02},    {0x2D,0x04,0x02},    {0x31,0x01,0x02},    {0x32,0x03,0x02},    {0x35,0x04,0x02},    {0x39,0x01,0x02},    {0x3A,0x03,0x02},    {0x3D,0x04,0x02},    {0x41,0x01,0x02},    {0x42,0x03,0x02},    {0x45,0x04,0x02},    {0x49,0x01,0x02},    {0x4A,0x03,0x02},    {0x4D,0x04,0x02},    {0x51,0x01,0x02},    {0x52,0x03,0x02},    {0x55,0x04,0x02},    {0x59,0x01,0x02},    {0x5A,0x03,0x02},    {0x5D,0x04,0x02},    {0x61,0x01,0x02},    {0x62,0x03,0x02},    {0x65,0x04,0x02},    {0x69,0x01,0x02},    {0x6A,0x03,0x02},    {0x6D,0x04,0x02},    {0x71,0x01,0x02},    {0x72,0x03,0x02},    {0x75,0x04,0x02},    {0x79,0x01,0x02},    {0x7A,0x03,0x02},    {0x7D,0x04,0x02},    {0x81,0x01,0x02},    {0x82,0x03,0x02},    {0x85,0x04,0x02},    {0x89,0x01,0x02},    {0x8A,0x03,0x02},    {0x8D,0x04,0x02},    {0x91,0x01,0x02},    {0x92,0x03,0x02},    {0x95,0x04,0x02},    {0x99,0x01,0x02},    {0x9A,0x03,0x02},    {0x9D,0x04,0x02},    {0xA1,0x01,0x02},    {0xA2,0x03,0x02}},{0}},
        {0xC00C,269,0,1,0,0x19,0,63,{    {0x00,0x01,0x02},    {0x01,0x04,0x02},    {0x05,0x04,0x02},    {0x09,0x04,0x02},    {0x0D,0x01,0x02},    {0x0E,0x08,0x02},    {0x16,0x04,0x02},    {0x1A,0x01,0x02},    {0x1B,0x08,0x02},    {0x23,0x04,0x02},    {0x27,0x01,0x02},    {0x28,0x08,0x02},    {0x30,0x04,0x02},    {0x34,0x01,0x02},    {0x35,0x08,0x02},    {0x3D,0x04,0x02},    {0x41,0x01,0x02},    {0x42,0x08,0x02},    {0x4A,0x04,0x02},    {0x4E,0x01,0x02},    {0x4F,0x08,0x02},    {0x57,0x04,0x02},    {0x5B,0x01,0x02},    {0x5C,0x08,0x02},    {0x64,0x04,0x02},    {0x68,0x01,0x02},    {0x69,0x08,0x02},    {0x71,0x04,0x02},    {0x75,0x01,0x02},    {0x76,0x08,0x02},    {0x7E,0x04,0x02},    {0x82,0x01,0x02},    {0x83,0x08,0x02},    {0x8B,0x04,0x02},    {0x8F,0x01,0x02},    {0x90,0x08,0x02},    {0x98,0x04,0x02},    {0x9C,0x01,0x02},    {0x9D,0x08,0x02},    {0xA5,0x04,0x02},    {0xA9,0x01,0x02},    {0xAA,0x08,0x02},    {0xB2,0x04,0x02},    {0xB6,0x01,0x02},    {0xB7,0x08,0x02},    {0xBF,0x04,0x02},    {0xC3,0x01,0x02},    {0xC4,0x08,0x02},    {0xCC,0x04,0x02},    {0xD0,0x01,0x02},    {0xD1,0x08,0x02},    {0xD9,0x04,0x02},    {0xDD,0x01,0x02},    {0xDE,0x08,0x02},    {0xE6,0x04,0x02},    {0xEA,0x01,0x02},    {0xEB,0x08,0x02},    {0xF3,0x04,0x02},    {0xF7,0x01,0x02},    {0xF8,0x08,0x02},    {0x0100,0x04,0x02},    {0x0104,0x01,0x02},    {0x0105,0x08,0x02}},{0}},
        {0xC00E,145,0,1,0,0x19,0,62,{    {0x00,0x01,0x02},    {0x01,0x04,0x02},    {0x05,0x04,0x02},    {0x09,0x01,0x02},    {0x0A,0x02,0x02},    {0x0C,0x04,0x02},    {0x10,0x01,0x02},    {0x11,0x02,0x02},    {0x13,0x04,0x02},    {0x17,0x01,0x02},    {0x18,0x02,0x02},    {0x1A,0x04,0x02},    {0x1E,0x01,0x02},    {0x1F,0x02,0x02},    {0x21,0x04,0x02},    {0x25,0x01,0x02},    {0x26,0x02,0x02},    {0x28,0x04,0x02},    {0x2C,0x01,0x02},    {0x2D,0x02,0x02},    {0x2F,0x04,0x02},    {0x33,0x01,0x02},    {0x34,0x02,0x02},    {0x36,0x04,0x02},    {0x3A,0x01,0x02},    {0x3B,0x02,0x02},    {0x3D,0x04,0x02},    {0x41,0x01,0x02},    {0x42,0x02,0x02},    {0x44,0x04,0x02},    {0x48,0x01,0x02},    {0x49,0x02,0x02},    {0x4B,0x04,0x02},    {0x4F,0x01,0x02},    {0x50,0x02,0x02},    {0x52,0x04,0x02},    {0x56,0x01,0x02},    {0x57,0x02,0x02},    {0x59,0x04,0x02},    {0x5D,0x01,0x02},    {0x5E,0x02,0x02},    {0x60,0x04,0x02},    {0x64,0x01,0x02},    {0x65,0x02,0x02},    {0x67,0x04,0x02},    {0x6B,0x01,0x02},    {0x6C,0x02,0x02},    {0x6E,0x04,0x02},    {0x72,0x01,0x02},    {0x73,0x02,0x02},    {0x75,0x04,0x02},    {0x79,0x01,0x02},    {0x7A,0x02,0x02},    {0x7C,0x04,0x02},    {0x80,0x01,0x02},    {0x81,0x02,0x02},    {0x83,0x04,0x02},    {0x87,0x01,0x02},    {0x88,0x02,0x02},    {0x8A,0x04,0x02},    {0x8E,0x01,0x02},    {0x8F,0x02,0x02}},{0}},
        {0xC00F,185,0,1,0,0x19,0,62,{    {0x00,0x01,0x02},    {0x01,0x04,0x02},    {0x05,0x04,0x02},    {0x09,0x01,0x02},    {0x0A,0x04,0x02},    {0x0E,0x04,0x02},    {0x12,0x01,0x02},    {0x13,0x04,0x02},    {0x17,0x04,0x02},    {0x1B,0x01,0x02},    {0x1C,0x04,0x02},    {0x20,0x04,0x02},    {0x24,0x01,0x02},    {0x25,0x04,0x02},    {0x29,0x04,0x02},    {0x2D,0x01,0x02},    {0x2E,0x04,0x02},    {0x32,0x04,0x02},    {0x36,0x01,0x02},    {0x37,0x04,0x02},    {0x3B,0x04,0x02},    {0x3F,0x01,0x02},    {0x40,0x04,0x02},    {0x44,0x04,0x02},    {0x48,0x01,0x02},    {0x49,0x04,0x02},    {0x4D,0x04,0x02},    {0x51,0x01,0x02},    {0x52,0x04,0x02},    {0x56,0x04,0x02},    {0x5A,0x01,0x02},    {0x5B,0x04,0x02},    {0x5F,0x04,0x02},    {0x63,0x01,0x02},    {0x64,0x04,0x02},    {0x68,0x04,0x02},    {0x6C,0x01,0x02},    {0x6D,0x04,0x02},    {0x71,0x04,0x02},    {0x75,0x01,0x02},    {0x76,0x04,0x02},    {0x7A,0x04,0x02},    {0x7E,0x01,0x02},    {0x7F,0x04,0x02},    {0x83,0x04,0x02},    {0x87,0x01,0x02},    {0x88,0x04,0x02},    {0x8C,0x04,0x02},    {0x90,0x01,0x02},    {0x91,0x04,0x02},    {0x95,0x04,0x02},    {0x99,0x01,0x02},    {0x9A,0x04,0x02},    {0x9E,0x04,0x02},    {0xA2,0x01,0x02},    {0xA3,0x04,0x02},    {0xA7,0x04,0x02},    {0xAB,0x01,0x02},    {0xAC,0x04,0x02},    {0xB0,0x04,0x02},    {0xB4,0x01,0x02},    {0xB5,0x04,0x02}},{0}},
        {0xC012,309,0,1,0,0x19,0,63,{    {0x00,0x01,0x02},    {0x01,0x04,0x02},    {0x05,0x04,0x02},    {0x09,0x04,0x02},    {0x0D,0x01,0x02},    {0x0E,0x0A,0x02},    {0x18,0x04,0x02},    {0x1C,0x01,0x02},    {0x1D,0x0A,0x02},    {0x27,0x04,0x02},    {0x2B,0x01,0x02},    {0x2C,0x0A,0x02},    {0x36,0x04,0x02},    {0x3A,0x01,0x02},    {0x3B,0x0A,0x02},    {0x45,0x04,0x02},    {0x49,0x01,0x02},    {0x4A,0x0A,0x02},    {0x54,0x04,0x02},    {0x58,0x01,0x02},    {0x59,0x0A,0x02},    {0x63,0x04,0x02},    {0x67,0x01,0x02},    {0x68,0x0A,0x02},    {0x72,0x04,0x02},    {0x76,0x01,0x02},    {0x77,0x0A,0x02},    {0x81,0x04,0x02},    {0x85,0x01,0x02},    {0x86,0x0A,0x02},    {0x90,0x04,0x02},    {0x94,0x01,0x02},    {0x95,0x0A,0x02},    {0x9F,0x04,0x02},    {0xA3,0x01,0x02},    {0xA4,0x0A,0x02},    {0xAE,0x04,0x02},    {0xB2,0x01,0x02},    {0xB3,0x0A,0x02},    {0xBD,0x04,0x02},    {0xC1,0x01,0x02},    {0xC2,0x0A,0x02},    {0xCC,0x04,0x02},    {0xD0,0x01,0x02},    {0xD1,0x0A,0x02},    {0xDB,0x04,0x02},    {0xDF,0x01,0x02},    {0xE0,0x0A,0x02},    {0xEA,0x04,0x02},    {0xEE,0x01,0x02},    {0xEF,0x0A,0x02},    {0xF9,0x04,0x02},    {0xFD,0x01,0x02},    {0xFE,0x0A,0x02},    {0x0108,0x04,0x02},    {0x010C,0x01,0x02},    {0x010D,0x0A,0x02},    {0x0117,0x04,0x02},    {0x011B,0x01,0x02},    {0x011C,0x0A,0x02},    {0x0126,0x04,0x02},    {0x012A,0x01,0x02},    {0x012B,0x0A,0x02}},{0}},
        {0xD006,2,1,1,0,0xFF,0,2,{    {0x00,0x01,0x02},    {0x01,0x01,0x02}},{0}},
        {0xD007,2,1,1,0,0xFF,0,2,{    {0x00,0x01,0x02},    {0x01,0x01,0x02}},{0}},
        {0xD010,2,1,1,0,0xFF,0,2,{    {0x00,0x01,0x02},    {0x01,0x01,0x02}},{0}},
        {0xD012,2,1,1,0,0xFF,0,2,{    {0x00,0x01,0x02},    {0x01,0x01,0x02}},{0}},
        {0xD01C,32,1,1,0,0xFF,0,1,{    {0x00,0x20,0x02}},{0}},
        {0xD09E,2,1,1,0,0xFF,0,1,{    {0x00,0x02,0x01}},{0}},
        {0xD0B5,3,1,1,0,0xFF,0,2,{    {0x00,0x01,0x05},    {0x00,0x03,0x05}},{0}},
        {0xD105,1,1,1,0,0xFF,0,1,{    {0x00,0x01,0x02}},{0}},
        {0xD123,8,1,1,0,0xFF,0,4,{    {0x00,0x01,0x01},    {0x01,0x01,0x02},    {0x02,0x02,0x02},    {0x04,0x04,0x02}},{0}},
        {0xD131,32,1,1,0,0xFF,0,1,{    {0x00,0x20,0x02}},{0}},
        {0xD134,1,1,1,0,0xFF,0,1,{    {0x00,0x01,0x02}},{0}},
        {0xD907,1,1,1,0,0xFF,0,1,{    {0x00,0x01,0x02}},{0}},
        {0xD938,100,1,1,0,0xFF,0,50,{    {0x00,0x01,0x01},    {0x01,0x02,0x01},    {0x03,0x02,0x01},    {0x05,0x01,0x01},    {0x06,0x04,0x01},    {0x0A,0x01,0x01},    {0x0B,0x02,0x01},    {0x0D,0x02,0x01},    {0x0F,0x01,0x01},    {0x10,0x04,0x01},    {0x14,0x01,0x01},    {0x15,0x02,0x01},    {0x17,0x02,0x01},    {0x19,0x01,0x01},    {0x1A,0x04,0x01},    {0x1E,0x01,0x01},    {0x1F,0x02,0x01},    {0x21,0x02,0x01},    {0x23,0x01,0x01},    {0x24,0x04,0x01},    {0x28,0x01,0x01},    {0x29,0x02,0x01},    {0x2B,0x02,0x01},    {0x2D,0x01,0x01},    {0x2E,0x04,0x01},    {0x32,0x01,0x01},    {0x33,0x02,0x01},    {0x35,0x02,0x01},    {0x37,0x01,0x01},    {0x38,0x04,0x01},    {0x3C,0x01,0x01},    {0x3D,0x02,0x01},    {0x3F,0x02,0x01},    {0x41,0x01,0x01},    {0x42,0x04,0x01},    {0x46,0x01,0x01},    {0x47,0x02,0x01},    {0x49,0x02,0x01},    {0x4B,0x01,0x01},    {0x4C,0x04,0x01},    {0x50,0x01,0x01},    {0x51,0x02,0x01},    {0x53,0x02,0x01},    {0x55,0x01,0x01},    {0x56,0x04,0x01},    {0x5A,0x01,0x01},    {0x5B,0x02,0x01},    {0x5D,0x02,0x01},    {0x5F,0x01,0x01},    {0x60,0x04,0x01}},{0}},
        {0xD939,100,1,1,0,0xFF,0,50,{    {0x00,0x01,0x01},    {0x01,0x02,0x01},    {0x03,0x02,0x01},    {0x05,0x01,0x01},    {0x06,0x04,0x01},    {0x0A,0x01,0x01},    {0x0B,0x02,0x01},    {0x0D,0x02,0x01},    {0x0F,0x01,0x01},    {0x10,0x04,0x01},    {0x14,0x01,0x01},    {0x15,0x02,0x01},    {0x17,0x02,0x01},    {0x19,0x01,0x01},    {0x1A,0x04,0x01},    {0x1E,0x01,0x01},    {0x1F,0x02,0x01},    {0x21,0x02,0x01},    {0x23,0x01,0x01},    {0x24,0x04,0x01},    {0x28,0x01,0x01},    {0x29,0x02,0x01},    {0x2B,0x02,0x01},    {0x2D,0x01,0x01},    {0x2E,0x04,0x01},    {0x32,0x01,0x01},    {0x33,0x02,0x01},    {0x35,0x02,0x01},    {0x37,0x01,0x01},    {0x38,0x04,0x01},    {0x3C,0x01,0x01},    {0x3D,0x02,0x01},    {0x3F,0x02,0x01},    {0x41,0x01,0x01},    {0x42,0x04,0x01},    {0x46,0x01,0x01},    {0x47,0x02,0x01},    {0x49,0x02,0x01},    {0x4B,0x01,0x01},    {0x4C,0x04,0x01},    {0x50,0x01,0x01},    {0x51,0x02,0x01},    {0x53,0x02,0x01},    {0x55,0x01,0x01},    {0x56,0x04,0x01},    {0x5A,0x01,0x01},    {0x5B,0x02,0x01},    {0x5D,0x02,0x01},    {0x5F,0x01,0x01},    {0x60,0x04,0x01}},{0}},
        {0xD93A,80,1,1,0,0xFF,0,10,{    {0x00,0x08,0x02},    {0x08,0x08,0x02},    {0x10,0x08,0x02},    {0x18,0x08,0x02},    {0x20,0x08,0x02},    {0x28,0x08,0x02},    {0x30,0x08,0x02},    {0x38,0x08,0x02},    {0x40,0x08,0x02},    {0x48,0x08,0x02}},{0}},
        {0xD93B,180,1,1,0,0xFF,0,56,{    {0x00,0x04,0x02},    {0x04,0x01,0x02},    {0x05,0x02,0x02},    {0x07,0x02,0x02},    {0x09,0x02,0x02},    {0x0B,0x02,0x02},    {0x0D,0x02,0x02},    {0x0F,0x02,0x02},    {0x11,0x04,0x02},    {0x15,0x01,0x02},    {0x16,0x02,0x02},    {0x18,0x02,0x02},    {0x1A,0x02,0x02},    {0x1C,0x02,0x02},    {0x1E,0x02,0x02},    {0x20,0x02,0x02},    {0x22,0x04,0x02},    {0x26,0x01,0x02},    {0x27,0x02,0x02},    {0x29,0x02,0x02},    {0x2B,0x02,0x02},    {0x2D,0x02,0x02},    {0x2F,0x02,0x02},    {0x31,0x02,0x02},    {0x33,0x04,0x02},    {0x37,0x01,0x02},    {0x38,0x02,0x02},    {0x3A,0x02,0x02},    {0x3C,0x02,0x02},    {0x3E,0x02,0x02},    {0x40,0x02,0x02},    {0x42,0x02,0x02},    {0x44,0x04,0x02},    {0x48,0x01,0x02},    {0x49,0x02,0x02},    {0x4B,0x02,0x02},    {0x4D,0x02,0x02},    {0x4F,0x02,0x02},    {0x51,0x02,0x02},    {0x53,0x02,0x02},    {0x55,0x04,0x02},    {0x59,0x02,0x02},    {0x5B,0x09,0x02},    {0x64,0x04,0x02},    {0x68,0x02,0x02},    {0x6A,0x09,0x02},    {0x73,0x04,0x02},    {0x77,0x02,0x02},    {0x79,0x09,0x02},    {0x82,0x04,0x02},    {0x86,0x02,0x02},    {0x88,0x09,0x02},    {0x91,0x04,0x02},    {0x95,0x02,0x02},    {0x97,0x09,0x02},    {0xA0,0x14,0x02}},{0}},
        {0xD93C,80,1,1,0,0xFF,0,10,{    {0x00,0x08,0x02},    {0x08,0x08,0x02},    {0x10,0x08,0x02},    {0x18,0x08,0x02},    {0x20,0x08,0x02},    {0x28,0x08,0x02},    {0x30,0x08,0x02},    {0x38,0x08,0x02},    {0x40,0x08,0x02},    {0x48,0x08,0x02}},{0}},
        {0xD93D,80,1,1,0,0xFF,0,10,{    {0x00,0x08,0x02},    {0x08,0x08,0x02},    {0x10,0x08,0x02},    {0x18,0x08,0x02},    {0x20,0x08,0x02},    {0x28,0x08,0x02},    {0x30,0x08,0x02},    {0x38,0x08,0x02},    {0x40,0x08,0x02},    {0x48,0x08,0x02}},{0}},
        {0xD93E,32,1,1,0,0xFF,0,1,{    {0x00,0x20,0x02}},{0}},
        {0xD93F,32,1,1,0,0xFF,0,1,{    {0x00,0x20,0x02}},{0}},
        {0xD940,254,1,1,0,0xFF,0,3,{    {0x00,0x04,0x02},    {0x04,0x0A,0x02},    {0x0E,0xF0,0x02}},{0}},
        {0xD941,1,1,1,0,0xFF,0,1,{    {0x00,0x01,0x01}},{0}},
        {0xD942,7,1,1,0,0xFF,0,1,{    {0x00,0x07,0x02}},{0}},
        {0xD94A,4,1,1,0,0xFF,0,1,{    {0x00,0x04,0x02}},{0}},
        {0xD94B,14,1,1,0,0xFF,0,1,{    {0x00,0x0E,0x06}},{0}},
        {0xD94C,28,1,1,0,0xFF,0,2,{    {0x00,0x11,0x06},    {0x11,0x0B,0x06}},{0}},
        {0xD950,6,1,1,0,0xFF,0,6,{    {0x00,0x01,0x01},    {0x01,0x01,0x01},    {0x02,0x01,0x01},    {0x03,0x01,0x01},    {0x04,0x01,0x01},    {0x05,0x01,0x01}},{0}},
        {0xD951,18,1,1,0,0xFF,0,6,{    {0x00,0x03,0x01},    {0x03,0x03,0x01},    {0x06,0x03,0x01},    {0x09,0x03,0x01},    {0x0C,0x03,0x01},    {0x0F,0x03,0x01}},{0}},
        {0xD952,36,1,1,0,0xFF,0,20,{    {0x00,0x02,0x02},    {0x02,0x02,0x01},    {0x04,0x02,0x01},    {0x06,0x02,0x01},    {0x08,0x02,0x01},    {0x0A,0x01,0x02},    {0x0B,0x01,0x02},    {0x0C,0x01,0x02},    {0x0D,0x01,0x02},    {0x0E,0x01,0x02},    {0x0F,0x01,0x02},    {0x10,0x01,0x02},    {0x11,0x01,0x02},    {0x12,0x01,0x02},    {0x13,0x01,0x02},    {0x14,0x02,0x01},    {0x16,0x02,0x01},    {0x18,0x01,0x01},    {0x19,0x01,0x01},    {0x1A,0x0A,0x02}},{0}},
        {0xD957,1,1,1,0,0xFF,0,1,{    {0x00,0x01,0x01}},{0}},
        {0xDA00,100,1,1,0,0xFF,0,1,{    {0x00,0x64,0x01}},{0}},
        {0xDA03,1759,1,1,0,0xFF,0,145,{    {0x00,0x01,0x02},    {0x01,0x01,0x02},    {0x02,0x20,0x02},    {0x22,0x01,0x02},    {0x23,0x01,0x02},    {0x24,0x0D,0x02},    {0x31,0x01,0x02},    {0x32,0x01,0x02},    {0x33,0x01,0x02},    {0x34,0x1D,0x01},    {0x51,0x01,0x02},    {0x52,0x01,0x02},    {0x53,0x13,0x02},    {0x66,0x01,0x02},    {0x67,0x01,0x02},    {0x68,0x01,0x02},    {0x69,0x01,0x02},    {0x6A,0x01,0x02},    {0x6B,0x01,0x02},    {0x6C,0x14,0x02},    {0x80,0x01,0x02},    {0x81,0x51,0x02},    {0xD2,0x01,0x02},    {0xD3,0x9F,0x02},    {0x0172,0x01,0x02},    {0x0173,0x01,0x02},    {0x0174,0x01,0x02},    {0x0175,0x01,0x02},    {0x0176,0x01,0x02},    {0x0177,0x01,0x02},    {0x0178,0x01,0x02},    {0x0179,0x01,0x02},    {0x017A,0x01,0x02},    {0x017B,0x24,0x02},    {0x019F,0x01,0x02},    {0x01A0,0x01,0x02},    {0x01A1,0x01,0x02},    {0x01A2,0x19,0x02},    {0x01BB,0x01,0x02},    {0x01BC,0x16,0x02},    {0x01D2,0x01,0x02},    {0x01D3,0x01,0x02},    {0x01D4,0x01,0x02},    {0x01D5,0x01,0x02},    {0x01D6,0x01,0x02},    {0x01D7,0x01,0x02},    {0x01D8,0x01,0x02},    {0x01D9,0x01,0x02},    {0x01DA,0x01,0x02},    {0x01DB,0x01,0x02},    {0x01DC,0x01,0x02},    {0x01DD,0x01,0x02},    {0x01DE,0x01,0x02},    {0x01DF,0x01,0x02},    {0x01E0,0x01,0x02},    {0x01E1,0x01,0x02},    {0x01E2,0x01,0x02},    {0x01E3,0x01,0x02},    {0x01E4,0x01,0x02},    {0x01E5,0x01,0x02},    {0x01E6,0x01,0x02},    {0x01E7,0x01,0x02},    {0x01E8,0x01,0x02},    {0x01E9,0x01,0x02},    {0x01EA,0x01,0x02},    {0x01EB,0x01,0x02},    {0x01EC,0x01,0x02},    {0x01ED,0x01,0x02},    {0x01EE,0x01,0x02},    {0x01EF,0x01,0x02},    {0x01F0,0x01,0x02},    {0x01F1,0x01,0x02},    {0x01F2,0x01,0x02},    {0x01F3,0x01,0x02},    {0x01F4,0x01,0x02},    {0x01F5,0x01,0x02},    {0x01F6,0x01,0x02},    {0x01F7,0x01,0x02},    {0x01F8,0x01,0x02},    {0x01F9,0x01,0x02},    {0x01FA,0x01,0x02},    {0x01FB,0x01,0x02},    {0x01FC,0x01,0x02},    {0x01FD,0x01,0x02},    {0x01FE,0x01,0x02},    {0x01FF,0x01,0x02},    {0x0200,0x01,0x02},    {0x0201,0x01,0x02},    {0x0202,0x01,0x02},    {0x0203,0x01,0x02},    {0x0204,0x01,0x02},    {0x0205,0x01,0x02},    {0x0206,0x01,0x02},    {0x0207,0x01,0x02},    {0x0208,0x01,0x02},    {0x0209,0x01,0x02},    {0x020A,0x01,0x02},    {0x020B,0x01,0x02},    {0x020C,0x01,0x02},    {0x020D,0x01,0x02},    {0x020E,0x01,0x02},    {0x020F,0x01,0x02},    {0x0210,0x01,0x02},    {0x0211,0x01,0x02},    {0x0212,0x01,0x02},    {0x0213,0x01,0x02},    {0x0214,0x01,0x02},    {0x0215,0x01,0x02},    {0x0216,0x01,0x02},    {0x0217,0x01,0x02},    {0x0218,0x01,0x02},    {0x0219,0x01,0x02},    {0x021A,0x01,0x02},    {0x021B,0x01,0x02},    {0x021C,0x01,0x02},    {0x021D,0x01,0x02},    {0x021E,0x01,0x02},    {0x021F,0x01,0x02},    {0x0220,0x01,0x02},    {0x0221,0x01,0x02},    {0x0222,0x01,0x02},    {0x0223,0x01,0x02},    {0x0224,0x01,0x02},    {0x0225,0x01,0x02},    {0x0226,0x01,0x02},    {0x0227,0x01,0x02},    {0x0228,0x01,0x02},    {0x0229,0x01,0x02},    {0x022A,0x01,0x02},    {0x022B,0x01,0x02},    {0x022C,0x01,0x02},    {0x022D,0x01,0x02},    {0x022E,0x01,0x02},    {0x022F,0x01,0x02},    {0x0230,0x01,0x02},    {0x0231,0x01,0x02},    {0x0232,0x01,0x02},    {0x0233,0x01,0x02},    {0x0234,0x01,0x02},    {0x0235,0x01,0x02},    {0x0236,0x01,0x02},    {0x0237,0x01,0x02},    {0x0238,0x01,0x02},    {0x0239,0x0499,0x02},    {0x06D2,0x0D,0x02}},{0}},
        {0xDB05,16,1,1,0,0xFF,0,1,{    {0x00,0x10,0x01}},{0}},
        {0xDD01,3,1,1,0,0xFF,0,1,{    {0x00,0x03,0x01}},{0}},
        {0xDD02,1,1,1,0,0xFF,0,1,{    {0x00,0x01,0x01}},{0}},
        {0xDD06,2,1,1,0,0xFF,0,1,{    {0x00,0x02,0x01}},{0}},
        {0xDD07,6,1,1,0,0xFF,0,6,{    {0x00,0x01,0x01},    {0x01,0x01,0x01},    {0x02,0x01,0x01},    {0x03,0x01,0x01},    {0x04,0x01,0x01},    {0x05,0x01,0x01}},{0}},
        {0xDD0A,1,1,1,0,0xFF,0,1,{    {0x00,0x01,0x02}},{0}},
        {0xDD0C,1,1,1,0,0xFF,0,1,{    {0x00,0x01,0x02}},{0}},
        {0xE103,31,1,1,0,0xFF,0,21,{    {0x00,0x01,0x01},    {0x01,0x02,0x01},    {0x03,0x01,0x01},    {0x04,0x02,0x01},    {0x06,0x01,0x01},    {0x07,0x02,0x01},    {0x09,0x01,0x01},    {0x0A,0x02,0x01},    {0x0C,0x01,0x01},    {0x0D,0x02,0x01},    {0x0F,0x01,0x01},    {0x10,0x02,0x01},    {0x12,0x01,0x01},    {0x13,0x02,0x01},    {0x15,0x01,0x01},    {0x16,0x02,0x01},    {0x18,0x01,0x01},    {0x19,0x02,0x01},    {0x1B,0x01,0x01},    {0x1C,0x02,0x01},    {0x1E,0x01,0x01}},{0}},
        {0xED20,202,1,1,0,0xFF,0,0,{0}},
        {0xEDA0,194,1,1,0,0xFF,0,0,{0}},
        {0xEF06,1,1,1,0,0xFF,0,1,{    {0x00,0x01,0x02}},{0}},
        {0xEF11,1,1,1,0,0xFF,0,1,{    {0x00,0x01,0x02}},{0}},
        {0xF120,7,1,1,0,0xFF,0,1,{    {0x00,0x07,0x07}},{0}},
        {0xF125,7,1,1,0,0xFF,0,1,{    {0x00,0x07,0x07}},{0}},
        {0xF126,51,1,1,0,0xFF,0,45,{    {0x00,0x02,0x02},    {0x02,0x01,0x01},    {0x03,0x01,0x01},    {0x04,0x01,0x01},    {0x05,0x01,0x01},    {0x06,0x01,0x01},    {0x07,0x01,0x01},    {0x08,0x01,0x02},    {0x09,0x01,0x02},    {0x0A,0x01,0x02},    {0x0B,0x02,0x02},    {0x0D,0x01,0x01},    {0x0E,0x01,0x01},    {0x0F,0x01,0x01},    {0x10,0x01,0x01},    {0x11,0x01,0x01},    {0x12,0x01,0x01},    {0x13,0x02,0x02},    {0x15,0x01,0x01},    {0x16,0x01,0x01},    {0x17,0x01,0x01},    {0x18,0x01,0x01},    {0x19,0x01,0x01},    {0x1A,0x01,0x01},    {0x1B,0x02,0x02},    {0x1D,0x01,0x01},    {0x1E,0x01,0x01},    {0x1F,0x01,0x01},    {0x20,0x01,0x01},    {0x21,0x01,0x01},    {0x22,0x01,0x01},    {0x23,0x02,0x02},    {0x25,0x01,0x01},    {0x26,0x01,0x01},    {0x27,0x01,0x01},    {0x28,0x01,0x01},    {0x29,0x01,0x01},    {0x2A,0x01,0x01},    {0x2B,0x02,0x02},    {0x2D,0x01,0x01},    {0x2E,0x01,0x01},    {0x2F,0x01,0x01},    {0x30,0x01,0x01},    {0x31,0x01,0x01},    {0x32,0x01,0x01}},{0}},
        {0xF12A,7,1,1,0,0xFF,0,1,{    {0x00,0x07,0x07}},{0}},
        {0xF12B,7,1,1,0,0xFF,0,1,{    {0x00,0x07,0x07}},{0}},
        {0xF12E,36,1,1,0,0xFF,0,6,{    {0x00,0x01,0x01},    {0x01,0x07,0x07},    {0x08,0x07,0x07},    {0x0F,0x07,0x07},    {0x16,0x07,0x07},    {0x1D,0x07,0x07}},{0}},
        {0xF13B,78,1,1,0,0xFF,0,12,{    {0x00,0x01,0x01},    {0x01,0x07,0x07},    {0x08,0x07,0x07},    {0x0F,0x07,0x07},    {0x16,0x07,0x07},    {0x1D,0x07,0x07},    {0x24,0x07,0x07},    {0x2B,0x07,0x07},    {0x32,0x07,0x07},    {0x39,0x07,0x07},    {0x40,0x07,0x07},    {0x47,0x07,0x07}},{0}},
        {0xF13F,121,1,1,0,0xFF,0,11,{    {0x00,0x01,0x01},    {0x01,0x0C,0x06},    {0x0D,0x0C,0x06},    {0x19,0x0C,0x06},    {0x25,0x0C,0x06},    {0x31,0x0C,0x06},    {0x3D,0x0C,0x06},    {0x49,0x0C,0x06},    {0x55,0x0C,0x06},    {0x61,0x0C,0x06},    {0x6D,0x0C,0x06}},{0}},
        {0xF186,1,1,1,0,0xFF,0,1,{    {0x00,0x01,0x02}},{0}},
        {0xF18A,6,1,1,0,0xFF,0,1,{    {0x00,0x06,0x06}},{0}},
        {0xF18C,4,1,1,0,0xFF,0,1,{    {0x00,0x04,0x05}},{0}},
        {0xF190,17,1,1,0,0xFF,0,1,{    {0x00,0x11,0x06}},{0}},
        {0xF1A0,8,1,1,0,0xFF,0,1,{    {0x00,0x08,0x08}},{0}},
        {0xF1A5,8,1,1,0,0xFF,0,1,{    {0x00,0x08,0x08}},{0}},
        {0xF1AA,8,1,1,0,0xFF,0,1,{    {0x00,0x08,0x08}},{0}},
        {0xF1AB,8,1,1,0,0xFF,0,1,{    {0x00,0x08,0x08}},{0}},
        {0xF1AE,41,1,1,0,0xFF,0,6,{    {0x00,0x01,0x01},    {0x01,0x08,0x08},    {0x09,0x08,0x08},    {0x11,0x08,0x08},    {0x19,0x08,0x08},    {0x21,0x08,0x08}},{0}},
        {0xF1BB,89,1,1,0,0xFF,0,12,{    {0x00,0x01,0x01},    {0x01,0x08,0x08},    {0x09,0x08,0x08},    {0x11,0x08,0x08},    {0x19,0x08,0x08},    {0x21,0x08,0x08},    {0x29,0x08,0x08},    {0x31,0x08,0x08},    {0x39,0x08,0x08},    {0x41,0x08,0x08},    {0x49,0x08,0x08},    {0x51,0x08,0x08}},{0}}
    };
    //2E服务参数
    const int NumOfWriteDIDAPP=19;
    struct DataIdentifer DIDOfWriteAPP[NumOfWriteDIDAPP]={
        {0x4058,1,0,1,0,0x05,0,1,{    {0x00,0x01,0x01}},{0}},
        {0x4059,1,0,1,0,0x05,0,1,{    {0x00,0x01,0x01}},{0}},
        {0x405A,1,0,1,0,0x05,0,1,{    {0x00,0x01,0x01}},{0}},
        {0x405B,1,0,1,0,0x05,0,1,{    {0x00,0x01,0x01}},{0}},
        {0x4072,1,0,1,0,0x05,0,1,{    {0x00,0x01,0x01}},{0}},
        {0x407F,1,0,1,0,0x05,0,1,{    {0x00,0x01,0x01}},{0}},
        {0x4150,1,0,1,0,0x05,0,1,{    {0x00,0x01,0x01}},{0}},
        {0x419A,2,0,1,0,0x05,0,1,{    {0x00,0x02,0x01}},{0}},
        {0x419D,2,0,1,0,0x05,0,1,{    {0x00,0x02,0x01}},{0}},
        {0x419E,2,0,1,0,0x05,0,1,{    {0x00,0x02,0x01}},{0}},
        {0x419F,2,0,1,0,0x05,0,1,{    {0x00,0x02,0x01}},{0}},
        {0x42BA,1,0,1,0,0x05,0,1,{    {0x00,0x01,0x01}},{0}},
        {0x4307,1,0,1,0,0x05,0,1,{    {0x00,0x01,0x02}},{0}},
        {0x4308,1,0,1,0,0x05,0,1,{    {0x00,0x01,0x02}},{0}},
        {0x4762,8,0,1,0,0x05,0,8,{    {0x00,0x01,0x01},    {0x01,0x01,0x01},    {0x02,0x01,0x01},    {0x03,0x01,0x01},    {0x04,0x01,0x01},    {0x05,0x01,0x01},    {0x06,0x01,0x01},    {0x07,0x01,0x01}},{0}},
        {0xD09E,2,0,1,0,0xFF,0,1,{    {0x00,0x02,0x01}},{0}},
        {0xD907,1,0,1,0,0x05,0,1,{    {0x00,0x01,0x02}},{0}},
        {0xF10A,16,0,1,0,0x11,0,1,{    {0x00,0x10,0x02}},{0}},
        {0xF10B,16,0,1,0,0x19,0,1,{    {0x00,0x10,0x02}},{0}}
    };

    const int NumOfReadDIDPBL=15;
    struct DataIdentifer DIDOfReadPBL[NumOfReadDIDPBL]={
        {0xD01C,292,0,0,1,0xFF,0,3,{    {0x00,0x0100,0x02},    {0x0100,0x04,0x02},    {0x0104,0x20,0x02}},{0}},
        {0xD94B,14,0,0,1,0xFF,0,1,{    {0x00,0x0E,0x06}},{0}},
        {0xED20,46,0,0,1,0xFF,0,0,{0}},
        {0xEDA0,42,0,0,1,0xFF,0,0,{0}},
        {0xF121,7,0,0,1,0xFF,0,1,{    {0x00,0x07,0x07}},{0}},
        {0xF125,7,0,0,1,0xFF,0,1,{    {0x00,0x07,0x07}},{0}},
        {0xF12A,7,0,0,1,0xFF,0,1,{    {0x00,0x07,0x07}},{0}},
        {0xF12B,7,0,0,1,0xFF,0,1,{    {0x00,0x07,0x07}},{0}},
        {0xF186,1,0,0,1,0xFF,0,1,{    {0x00,0x01,0x02}},{0}},
        {0xF18A,6,0,0,1,0xFF,0,1,{    {0x00,0x06,0x06}},{0}},
        {0xF18C,4,0,0,1,0xFF,0,1,{    {0x00,0x04,0x05}},{0}},
        {0xF1A1,8,0,0,1,0xFF,0,1,{    {0x00,0x08,0x08}},{0}},
        {0xF1A5,8,0,0,1,0xFF,0,1,{    {0x00,0x08,0x08}},{0}},
        {0xF1AA,8,0,0,1,0xFF,0,1,{    {0x00,0x08,0x08}},{0}},
        {0xF1AB,8,0,0,1,0xFF,0,1,{    {0x00,0x08,0x08}},{0}}
    };


        const int NumOfWriteDIDPBL=0;
        struct DataIdentifer DIDOfWritePBL[1];
        
        int Flag_1902 = 1;
    int Flag_1903 = 1;
    int Flag_1904= 1;
    int Flag_1906 = 1;
    int Flag_190A = 1;
    int Flag_1915 = 0;
    int Flag_1955 = 0;

        struct RecordStruct
        {
            dword DTCNumber;
            byte DTCStatus;
        };
          const int NumofDTC=581;
    struct RecordStruct StorageDTC[NumofDTC]={
       {0x48011,0xFF},
       {0x48015,0xFF},
       {0x48111,0xFF},
       {0x48115,0xFF},
       {0x48511,0xFF},
       {0x48512,0xFF},
       {0x48513,0xFF},
       {0x8f611,0xFF},
       {0x8f612,0xFF},
       {0x8f711,0xFF},
       {0x8f712,0xFF},
       {0xa1b11,0xFF},
       {0xa1b15,0xFF},
       {0xa1c11,0xFF},
       {0xa1c15,0xFF},
       {0x103106,0xFF},
       {0x130e09,0xFF},
       {0x130e96,0xFF},
       {0x454600,0xFF},
       {0x512011,0xFF},
       {0x512015,0xFF},
       {0x51a196,0xFF},
       {0x901c11,0xFF},
       {0x901c15,0xFF},
       {0x901d11,0xFF},
       {0x902e11,0xFF},
       {0x902e15,0xFF},
       {0x905a11,0xFF},
       {0x905a15,0xFF},
       {0x906c11,0xFF},
       {0x906d64,0xFF},
       {0x907401,0xFF},
       {0x907413,0xFF},
       {0x907449,0xFF},
       {0x90744b,0xFF},
       {0x907454,0xFF},
       {0x907455,0xFF},
       {0x908313,0xFF},
       {0x908319,0xFF},
       {0x908377,0xFF},
       {0x908513,0xFF},
       {0x908519,0xFF},
       {0x908577,0xFF},
       {0x908613,0xFF},
       {0x908619,0xFF},
       {0x908677,0xFF},
       {0x908809,0xFF},
       {0x908883,0xFF},
       {0x908887,0xFF},
       {0x908896,0xFF},
       {0x909101,0xFF},
       {0x909113,0xFF},
       {0x909149,0xFF},
       {0x90914b,0xFF},
       {0x909154,0xFF},
       {0x909155,0xFF},
       {0x909b11,0xFF},
       {0x90ae12,0xFF},
       {0x90ae13,0xFF},
       {0x90ae14,0xFF},
       {0x90ae19,0xFF},
       {0x90ae77,0xFF},
       {0x90b012,0xFF},
       {0x90b014,0xFF},
       {0x90b312,0xFF},
       {0x90b313,0xFF},
       {0x90b314,0xFF},
       {0x90b319,0xFF},
       {0x90b377,0xFF},
       {0x90b412,0xFF},
       {0x90b413,0xFF},
       {0x90b414,0xFF},
       {0x90b419,0xFF},
       {0x90b477,0xFF},
       {0x90b911,0xFF},
       {0x90b915,0xFF},
       {0x90ba01,0xFF},
       {0x90ec01,0xFF},
       {0x90ec13,0xFF},
       {0x90f611,0xFF},
       {0x90f615,0xFF},
       {0x910977,0xFF},
       {0x910b77,0xFF},
       {0x910d01,0xFF},
       {0x910d13,0xFF},
       {0x912711,0xFF},
       {0x912715,0xFF},
       {0x912771,0xFF},
       {0x912811,0xFF},
       {0x912815,0xFF},
       {0x912871,0xFF},
       {0x912911,0xFF},
       {0x912915,0xFF},
       {0x912971,0xFF},
       {0x913611,0xFF},
       {0x913615,0xFF},
       {0x913671,0xFF},
       {0x913711,0xFF},
       {0x913715,0xFF},
       {0x913771,0xFF},
       {0x913811,0xFF},
       {0x913815,0xFF},
       {0x913871,0xFF},
       {0x913911,0xFF},
       {0x913915,0xFF},
       {0x913971,0xFF},
       {0x915811,0xFF},
       {0x915a11,0xFF},
       {0x915a12,0xFF},
       {0x915a13,0xFF},
       {0x916611,0xFF},
       {0x916615,0xFF},
       {0x917c94,0xFF},
       {0x917e94,0xFF},
       {0x918931,0xFF},
       {0x918a31,0xFF},
       {0x919c11,0xFF},
       {0x919c15,0xFF},
       {0x919d11,0xFF},
       {0x919d15,0xFF},
       {0x91b911,0xFF},
       {0x91b915,0xFF},
       {0x91d101,0xFF},
       {0x91d171,0xFF},
       {0x91d183,0xFF},
       {0x91d187,0xFF},
       {0x91db87,0xFF},
       {0x91db96,0xFF},
       {0x91e412,0xFF},
       {0x91e413,0xFF},
       {0x91e414,0xFF},
       {0x91e419,0xFF},
       {0x91e477,0xFF},
       {0x91f701,0xFF},
       {0x91f713,0xFF},
       {0x924711,0xFF},
       {0x924715,0xFF},
       {0x924811,0xFF},
       {0x924815,0xFF},
       {0x929a01,0xFF},
       {0x929a71,0xFF},
       {0x929a83,0xFF},
       {0x929a87,0xFF},
       {0x92ac11,0xFF},
       {0x92ac12,0xFF},
       {0x92c909,0xFF},
       {0x92c983,0xFF},
       {0x92c987,0xFF},
       {0x92c996,0xFF},
       {0x92d811,0xFF},
       {0x92d815,0xFF},
       {0x92fe1c,0xFF},
       {0x931611,0xFF},
       {0x931615,0xFF},
       {0x934e11,0xFF},
       {0x934e15,0xFF},
       {0x937811,0xFF},
       {0x937812,0xFF},
       {0x937911,0xFF},
       {0x937915,0xFF},
       {0x937c11,0xFF},
       {0x937c12,0xFF},
       {0x939b11,0xFF},
       {0x939b15,0xFF},
       {0x939c11,0xFF},
       {0x939c15,0xFF},
       {0x939d11,0xFF},
       {0x939d15,0xFF},
       {0x93a011,0xFF},
       {0x93a015,0xFF},
       {0x93a111,0xFF},
       {0x93a115,0xFF},
       {0x93b411,0xFF},
       {0x93b415,0xFF},
       {0x949f11,0xFF},
       {0x94a213,0xFF},
       {0x94a255,0xFF},
       {0x94a313,0xFF},
       {0x94a355,0xFF},
       {0x94a413,0xFF},
       {0x94a455,0xFF},
       {0x94a513,0xFF},
       {0x94a555,0xFF},
       {0x94a655,0xFF},
       {0x94a831,0xFF},
       {0x94a929,0xFF},
       {0x94aa31,0xFF},
       {0x94ab31,0xFF},
       {0x94ac31,0xFF},
       {0x94ba01,0xFF},
       {0x94ba13,0xFF},
       {0x94f723,0xFF},
       {0x94f823,0xFF},
       {0x951149,0xFF},
       {0x956d11,0xFF},
       {0x956d15,0xFF},
       {0x957311,0xFF},
       {0x957315,0xFF},
       {0x95a512,0xFF},
       {0x95a514,0xFF},
       {0x95c123,0xFF},
       {0x95e78f,0xFF},
       {0x96f749,0xFF},
       {0x96f849,0xFF},
       {0x96f912,0xFF},
       {0x96f914,0xFF},
       {0x96fa12,0xFF},
       {0x96fa14,0xFF},
       {0x96fb11,0xFF},
       {0x96fb15,0xFF},
       {0x96fb71,0xFF},
       {0x96fc11,0xFF},
       {0x96fc15,0xFF},
       {0x96fc71,0xFF},
       {0x970255,0xFF},
       {0x970431,0xFF},
       {0x970655,0xFF},
       {0x970831,0xFF},
       {0x970f11,0xFF},
       {0x970f15,0xFF},
       {0x970f71,0xFF},
       {0x971011,0xFF},
       {0x971015,0xFF},
       {0x971071,0xFF},
       {0x972b1c,0xFF},
       {0x972e01,0xFF},
       {0x972e13,0xFF},
       {0x972e63,0xFF},
       {0x972e67,0xFF},
       {0x972f01,0xFF},
       {0x972f13,0xFF},
       {0x972f63,0xFF},
       {0x972f67,0xFF},
       {0x973001,0xFF},
       {0x973013,0xFF},
       {0x973063,0xFF},
       {0x973101,0xFF},
       {0x973113,0xFF},
       {0x973163,0xFF},
       {0x973294,0xFF},
       {0x973394,0xFF},
       {0x973401,0xFF},
       {0x973413,0xFF},
       {0x973477,0xFF},
       {0x973501,0xFF},
       {0x973513,0xFF},
       {0x973577,0xFF},
       {0x973e23,0xFF},
       {0x973e63,0xFF},
       {0x973f23,0xFF},
       {0x973f63,0xFF},
       {0x976812,0xFF},
       {0x976814,0xFF},
       {0x976912,0xFF},
       {0x976914,0xFF},
       {0x976a12,0xFF},
       {0x976a14,0xFF},
       {0x976b12,0xFF},
       {0x976b14,0xFF},
       {0x976c11,0xFF},
       {0x976c15,0xFF},
       {0x978811,0xFF},
       {0x978815,0xFF},
       {0x978871,0xFF},
       {0x979b11,0xFF},
       {0x97bf11,0xFF},
       {0x97bf15,0xFF},
       {0x97bf71,0xFF},
       {0x97d712,0xFF},
       {0x97d714,0xFF},
       {0x981291,0xFF},
       {0x981296,0xFF},
       {0x981f49,0xFF},
       {0x981f87,0xFF},
       {0x982049,0xFF},
       {0x982087,0xFF},
       {0x984471,0xFF},
       {0x989601,0xFF},
       {0x989683,0xFF},
       {0x989687,0xFF},
       {0x989f11,0xFF},
       {0x989f15,0xFF},
       {0x989f71,0xFF},
       {0x98b883,0xFF},
       {0x98b887,0xFF},
       {0x98b896,0xFF},
       {0x98df11,0xFF},
       {0x98e111,0xFF},
       {0x993055,0xFF},
       {0x994496,0xFF},
       {0x994696,0xFF},
       {0x995b96,0xFF},
       {0x997811,0xFF},
       {0x997a11,0xFF},
       {0x997a12,0xFF},
       {0x997a13,0xFF},
       {0x9a6811,0xFF},
       {0x9a6815,0xFF},
       {0x9a7911,0xFF},
       {0x9a7915,0xFF},
       {0x9b7111,0xFF},
       {0x9b7115,0xFF},
       {0x9b7211,0xFF},
       {0x9b7215,0xFF},
       {0x9b7311,0xFF},
       {0x9b7315,0xFF},
       {0x9b7d01,0xFF},
       {0x9b7d71,0xFF},
       {0x9b7d83,0xFF},
       {0x9b7d87,0xFF},
       {0x9b8111,0xFF},
       {0x9b8115,0xFF},
       {0x9c1101,0xFF},
       {0x9c1201,0xFF},
       {0x9dbe31,0xFF},
       {0x9dbf55,0xFF},
       {0x9dcb9e,0xFF},
       {0x9dcc9e,0xFF},
       {0x9dcd31,0xFF},
       {0x9dcd55,0xFF},
       {0x9dd796,0xFF},
       {0x9e2513,0xFF},
       {0x9e2554,0xFF},
       {0x9e2613,0xFF},
       {0x9e2654,0xFF},
       {0x9e6831,0xFF},
       {0x9e7031,0xFF},
       {0x9e7131,0xFF},
       {0x9e7311,0xFF},
       {0x9e7315,0xFF},
       {0x9e7411,0xFF},
       {0x9e7415,0xFF},
       {0x9e7511,0xFF},
       {0x9e7515,0xFF},
       {0x9e8111,0xFF},
       {0x9e8115,0xFF},
       {0x9e8811,0xFF},
       {0x9e8815,0xFF},
       {0x9e8911,0xFF},
       {0x9e8915,0xFF},
       {0x9e8a11,0xFF},
       {0x9e8a15,0xFF},
       {0x9e8a71,0xFF},
       {0x9e9c01,0xFF},
       {0x9e9c96,0xFF},
       {0x9e9d01,0xFF},
       {0x9e9d83,0xFF},
       {0x9e9d87,0xFF},
       {0x9e9d96,0xFF},
       {0x9e9e11,0xFF},
       {0x9e9e15,0xFF},
       {0x9e9f12,0xFF},
       {0x9e9f14,0xFF},
       {0x9ea012,0xFF},
       {0x9ea014,0xFF},
       {0x9ea111,0xFF},
       {0x9ea115,0xFF},
       {0x9ea211,0xFF},
       {0x9ea215,0xFF},
       {0x9ea711,0xFF},
       {0x9ea712,0xFF},
       {0x9ea713,0xFF},
       {0x9ea812,0xFF},
       {0x9ea814,0xFF},
       {0x9ea912,0xFF},
       {0x9ea914,0xFF},
       {0x9ebe11,0xFF},
       {0x9ebe15,0xFF},
       {0xba6512,0xFF},
       {0xba6514,0xFF},
       {0xd05c44,0xFF},
       {0xd05c45,0xFF},
       {0xd05c46,0xFF},
       {0xd09947,0xFF},
       {0xd09949,0xFF},
       {0xd14b51,0xFF},
       {0xd14c51,0xFF},
       {0xd15e87,0xFF},
       {0xd15f87,0xFF},
       {0xd19287,0xFF},
       {0xd30086,0xFF},
       {0xd30186,0xFF},
       {0xd30286,0xFF},
       {0xd30386,0xFF},
       {0xd31186,0xFF},
       {0xd31386,0xFF},
       {0xd31986,0xFF},
       {0xd33c01,0xFF},
       {0xd33c83,0xFF},
       {0xd33c87,0xFF},
       {0xd33c96,0xFF},
       {0xd38a11,0xFF},
       {0xd38a12,0xFF},
       {0xd38a13,0xFF},
       {0xd40909,0xFF},
       {0xd40983,0xFF},
       {0xd40987,0xFF},
       {0xd40996,0xFF},
       {0xd40b83,0xFF},
       {0xd40b87,0xFF},
       {0xd41201,0xFF},
       {0xd41283,0xFF},
       {0xd41287,0xFF},
       {0xd41296,0xFF},
       {0xd41601,0xFF},
       {0xd41683,0xFF},
       {0xd41687,0xFF},
       {0xd41696,0xFF},
       {0xd41701,0xFF},
       {0xd41783,0xFF},
       {0xd41787,0xFF},
       {0xd41796,0xFF},
       {0xd42283,0xFF},
       {0xd42383,0xFF},
       {0xd42901,0xFF},
       {0xd42983,0xFF},
       {0xd42987,0xFF},
       {0xd42a01,0xFF},
       {0xd42a71,0xFF},
       {0xd42a83,0xFF},
       {0xd42a87,0xFF},
       {0xd42b01,0xFF},
       {0xd42b71,0xFF},
       {0xd42b83,0xFF},
       {0xd42b87,0xFF},
       {0xd42c01,0xFF},
       {0xd42c71,0xFF},
       {0xd42c83,0xFF},
       {0xd42c87,0xFF},
       {0xd42d01,0xFF},
       {0xd42d71,0xFF},
       {0xd42d83,0xFF},
       {0xd42d87,0xFF},
       {0xd42e01,0xFF},
       {0xd42e71,0xFF},
       {0xd42e83,0xFF},
       {0xd42e87,0xFF},
       {0xd42f01,0xFF},
       {0xd42f71,0xFF},
       {0xd42f83,0xFF},
       {0xd42f87,0xFF},
       {0xd43001,0xFF},
       {0xd43071,0xFF},
       {0xd43083,0xFF},
       {0xd43087,0xFF},
       {0xd43101,0xFF},
       {0xd43171,0xFF},
       {0xd43183,0xFF},
       {0xd43187,0xFF},
       {0xd43201,0xFF},
       {0xd43271,0xFF},
       {0xd43283,0xFF},
       {0xd43287,0xFF},
       {0xd43301,0xFF},
       {0xd43371,0xFF},
       {0xd43383,0xFF},
       {0xd43387,0xFF},
       {0xd43401,0xFF},
       {0xd43471,0xFF},
       {0xd43483,0xFF},
       {0xd43487,0xFF},
       {0xd43501,0xFF},
       {0xd43571,0xFF},
       {0xd43583,0xFF},
       {0xd43587,0xFF},
       {0xd43601,0xFF},
       {0xd43671,0xFF},
       {0xd43683,0xFF},
       {0xd43687,0xFF},
       {0xd43701,0xFF},
       {0xd43771,0xFF},
       {0xd43783,0xFF},
       {0xd43787,0xFF},
       {0xd43801,0xFF},
       {0xd43871,0xFF},
       {0xd43883,0xFF},
       {0xd43887,0xFF},
       {0xd43901,0xFF},
       {0xd43971,0xFF},
       {0xd43983,0xFF},
       {0xd43987,0xFF},
       {0xd43a01,0xFF},
       {0xd43a71,0xFF},
       {0xd43a83,0xFF},
       {0xd43a87,0xFF},
       {0xd43b01,0xFF},
       {0xd43b71,0xFF},
       {0xd43b83,0xFF},
       {0xd43b87,0xFF},
       {0xd43c01,0xFF},
       {0xd43c71,0xFF},
       {0xd43c83,0xFF},
       {0xd43c87,0xFF},
       {0xd49a01,0xFF},
       {0xd49a71,0xFF},
       {0xd49a83,0xFF},
       {0xd49a87,0xFF},
       {0xd49b01,0xFF},
       {0xd49b71,0xFF},
       {0xd49b83,0xFF},
       {0xd49b87,0xFF},
       {0xd49c01,0xFF},
       {0xd49c71,0xFF},
       {0xd49c83,0xFF},
       {0xd49c87,0xFF},
       {0xd49d01,0xFF},
       {0xd49d71,0xFF},
       {0xd49d83,0xFF},
       {0xd49d87,0xFF},
       {0xd4a201,0xFF},
       {0xd4a271,0xFF},
       {0xd4a283,0xFF},
       {0xd4a287,0xFF},
       {0xd4a301,0xFF},
       {0xd4a371,0xFF},
       {0xd4a383,0xFF},
       {0xd4a387,0xFF},
       {0xd4a401,0xFF},
       {0xd4a471,0xFF},
       {0xd4a483,0xFF},
       {0xd4a487,0xFF},
       {0xd4a501,0xFF},
       {0xd4a571,0xFF},
       {0xd4a583,0xFF},
       {0xd4a587,0xFF},
       {0xd4ac01,0xFF},
       {0xd4ac71,0xFF},
       {0xd4ac83,0xFF},
       {0xd4ac87,0xFF},
       {0xd4ad01,0xFF},
       {0xd4ad71,0xFF},
       {0xd4ad83,0xFF},
       {0xd4ad87,0xFF},
       {0xd4ae01,0xFF},
       {0xd4ae71,0xFF},
       {0xd4ae83,0xFF},
       {0xd4ae87,0xFF},
       {0xd4af01,0xFF},
       {0xd4af71,0xFF},
       {0xd4af83,0xFF},
       {0xd4af87,0xFF},
       {0xd4b501,0xFF},
       {0xd4b583,0xFF},
       {0xd4b587,0xFF},
       {0xd5d111,0xFF},
       {0xd5d115,0xFF},
       {0xd5d171,0xFF},
       {0xd61483,0xFF},
       {0xd61487,0xFF},
       {0xd61496,0xFF},
       {0xd6149e,0xFF},
       {0xd64711,0xFF},
       {0xd64715,0xFF},
       {0xd64771,0xFF},
       {0xd67e13,0xFF},
       {0xd67f13,0xFF},
       {0xd68113,0xFF},
       {0xd68213,0xFF},
       {0xd68413,0xFF},
       {0xd68513,0xFF},
       {0xd68713,0xFF},
       {0xd76011,0xFF},
       {0xd76015,0xFF},
       {0xd76071,0xFF},
       {0xdc4088,0xFF},
       {0xdc7788,0xFF},
       {0xdc7888,0xFF},
       {0xdcc088,0xFF},
       {0xdced87,0xFF},
       {0xdcee87,0xFF},
       {0xdcf487,0xFF},
       {0xe30055,0xFF},
       {0xe30056,0xFF},
       {0xed8b83,0xFF},
       {0xee0068,0xFF},
       {0xee0168,0xFF},
       {0xee0301,0xFF},
       {0xee0368,0xFF},
       {0xee0401,0xFF},
       {0xee0468,0xFF},
       {0xf00362,0xFF}
    };

        struct SnapShoot
        {
            byte DTCSnapshotRecordNumber;
            int  DTCSnapshotRecordNumberOfIdentifiers;
            int  DIDnum;
            byte DID[20];
            byte DIDLenth;
        };
        int NumOfSnap=1;
        struct SnapShoot Snap[1]={
            {1,1,0x00,{1,1},1}
        };
      
      
        struct ExtendData
        {
            byte  DTCExtDataRecordNumber;
            int   DTCExtDataRecordLenth;
        };
        int    NumOfEtn=0;
        struct ExtendData Extend[5];
      
        //-------2F服务的参数
        struct IOControl
        {
            dword DID;
            int  SelectFlag;
            int  Flag_Ser01;
            int  Flag_Ser02;
            int  Flag_Ser03;
            int  Flag_Sub00;
            int  Flag_Sub01;
            int  Flag_Sub02;
            int  Flag_Sub03;
            int  SecuLevel;
            int  AuthenticationFlag;
            int  RequestLenth;
            byte requestData[5000];
        };
          const int NumOfIO=53;
    struct IOControl IODID[NumOfIO]={
        {0x0696,1,0,0,1,1,0,0,1,0x05,0,1,{0}},
        {0x4003,1,0,0,1,1,0,0,1,0x05,0,1,{0}},
        {0x4004,1,0,0,1,1,0,0,1,0x05,0,1,{0}},
        {0x4052,1,0,0,1,1,0,0,1,0x05,0,1,{0}},
        {0x4053,1,0,0,1,1,0,0,1,0x05,0,1,{0}},
        {0x4054,1,0,0,1,1,0,0,1,0x05,0,1,{0}},
        {0x4055,1,0,0,1,1,0,0,1,0x05,0,1,{0}},
        {0x4056,1,0,0,1,1,0,0,1,0x05,0,1,{0}},
        {0x4057,1,0,0,1,1,0,0,1,0x05,0,1,{0}},
        {0x4096,1,0,0,1,1,0,0,1,0x05,0,2,{0}},
        {0x409D,1,0,0,1,1,0,0,1,0x05,0,2,{0}},
        {0x40B9,1,0,0,1,1,0,0,1,0x05,0,1,{0}},
        {0x40BA,1,0,0,1,1,0,0,1,0x05,0,1,{0}},
        {0x41EF,1,0,0,1,1,0,0,1,0x05,0,1,{0}},
        {0x4219,1,0,0,1,1,0,0,1,0x05,0,1,{0}},
        {0x421A,1,0,0,1,1,0,1,1,0x05,0,1,{0}},
        {0x421B,1,0,0,1,1,0,1,1,0x05,0,4,{0}},
        {0x4221,1,0,0,1,1,0,1,1,0x05,0,1,{0}},
        {0x4224,1,0,0,1,1,0,1,1,0x05,0,1,{0}},
        {0x42A1,1,0,0,1,1,0,0,1,0x05,0,1,{0}},
        {0x439F,1,0,0,1,1,0,0,1,0x05,0,2,{0}},
        {0x4571,1,0,0,1,1,0,1,1,0x05,0,1,{0}},
        {0x4577,1,0,0,1,1,0,1,1,0x05,0,3,{0}},
        {0x4578,1,0,0,1,1,0,1,1,0x05,0,3,{0}},
        {0x4579,1,0,0,1,1,0,1,1,0x05,0,3,{0}},
        {0x457A,1,0,0,1,1,0,1,1,0x05,0,3,{0}},
        {0x457B,1,0,0,1,1,0,1,1,0x05,0,3,{0}},
        {0x4759,1,0,0,1,1,0,0,1,0x05,0,2,{0}},
        {0x47FE,1,0,0,1,1,0,1,1,0x05,0,2,{0}},
        {0x47FF,1,0,0,1,1,0,1,1,0x05,0,1,{0}},
        {0x4AF7,1,0,0,1,1,0,0,1,0xFF,0,3,{0}},
        {0x7079,1,0,0,1,1,0,0,1,0x05,0,3,{0}},
        {0x707A,1,0,0,1,1,0,0,1,0x05,0,3,{0}},
        {0x707D,1,0,0,1,1,0,0,1,0x05,0,2,{0}},
        {0x7081,1,0,0,1,1,0,0,1,0x05,0,3,{0}},
        {0x9808,1,0,0,1,1,0,0,1,0x05,0,1,{0}},
        {0x9809,1,0,0,1,1,0,0,1,0x05,0,4,{0}},
        {0x980A,1,0,0,1,1,0,1,1,0x05,0,4,{0}},
        {0x980B,1,0,0,1,1,0,1,1,0x05,0,11,{0}},
        {0x980E,1,0,0,1,1,0,1,1,0x05,0,5,{0}},
        {0x980F,1,0,0,1,1,0,1,1,0x05,0,1,{0}},
        {0xB174,1,0,0,1,1,0,1,1,0x05,0,3,{0}},
        {0xB175,1,0,0,1,1,0,1,1,0x05,0,3,{0}},
        {0xB176,1,0,0,1,1,0,1,1,0x05,0,3,{0}},
        {0xB177,1,0,0,1,1,0,1,1,0x05,0,3,{0}},
        {0xB178,1,0,0,1,1,0,1,1,0x05,0,3,{0}},
        {0xB179,1,0,0,1,1,0,1,1,0x05,0,3,{0}},
        {0xB17A,1,0,0,1,1,0,1,1,0x05,0,3,{0}},
        {0xD006,1,0,0,1,1,0,0,1,0x05,0,2,{0}},
        {0xD007,1,0,0,1,1,0,0,1,0x05,0,2,{0}},
        {0xD010,1,0,0,1,1,0,0,1,0x05,0,2,{0}},
        {0xEF06,1,0,0,1,1,0,0,1,0x05,0,1,{0}},
        {0xEF11,1,0,0,1,1,0,1,1,0x05,0,1,{0}}
    };
        //31服务的参数
        struct Routine
        {
            dword DID;
            int  SelectFlag;
            int  routinetype;
            dword  runtime;
            int  Flag_Ser01;
            int  Flag_Ser02;
            int  Flag_Ser03; 
            int  RequestLenth;
            int  SecuLevel;
            int  AuthenticationFlag;
            byte requestData[500];
        };
    
        const int NumOfRoutine_Sub0x01=41;
        const int NumOfRoutine_Sub0x02=33;
        const int NumOfRoutine_Sub0x03=39;
         struct Routine Routine_Sub0x01[NumOfRoutine_Sub0x01]={
        {0x0206,1,1,0,1,0,1,0,0xFF,0,{0}},
        {0x020A,1,2,15000,0,0,1,0,0x05,0,{0}},
        {0x2000,1,2,36000,0,0,1,0,0x05,0,{0}},
        {0x202B,1,1,0,0,0,1,0,0x05,0,{0}},
        {0x203D,1,2,20000,0,0,1,0,0x05,0,{0}},
        {0x2046,1,2,30000,0,0,1,0,0x05,0,{0}},
        {0x204E,1,2,30000,0,0,1,0,0x05,0,{0}},
        {0x204F,1,2,15000,0,0,1,0,0x05,0,{0}},
        {0x2050,1,2,15000,0,0,1,0,0x05,0,{0}},
        {0x2058,1,2,15000,0,0,1,0,0x05,0,{0}},
        {0x2059,1,2,15000,0,0,1,0,0x05,0,{0}},
        {0x205A,1,1,0,0,0,1,0,0x05,0,{0}},
        {0x205B,1,1,0,0,0,1,0,0x05,0,{0}},
        {0x2097,1,2,120000,0,0,1,0,0x05,0,{0}},
        {0x20A1,1,1,0,0,0,1,0,0x05,0,{0}},
        {0x20EB,1,1,0,0,0,1,0,0x05,0,{0}},
        {0x212E,1,2,120000,0,0,1,0,0x05,0,{0}},
        {0x212F,1,2,45000,0,0,1,0,0x05,0,{0}},
        {0x2139,1,3,0,0,0,1,1,0x05,0,{0}},
        {0x213A,1,3,0,0,0,1,1,0x05,0,{0}},
        {0x213B,1,3,0,0,0,1,1,0x05,0,{0}},
        {0x213C,1,3,0,0,0,1,1,0x05,0,{0}},
        {0x213D,1,3,0,0,0,1,1,0x05,0,{0}},
        {0x213E,1,3,0,0,0,1,1,0x05,0,{0}},
        {0x213F,1,3,0,0,0,1,1,0x05,0,{0}},
        {0x2140,1,3,0,0,0,1,1,0x05,0,{0}},
        {0x2141,1,2,120000,0,0,1,1,0x05,0,{0}},
        {0x214E,1,3,0,0,0,1,1,0x05,0,{0}},
        {0x2150,1,3,0,0,0,1,1,0x05,0,{0}},
        {0x2186,1,2,15000,0,0,1,0,0x05,0,{0}},
        {0x2187,1,2,120000,0,0,1,0,0x05,0,{0}},
        {0x2188,1,2,0,0,0,1,1,0x05,0,{0}},
        {0x2189,1,2,20000,0,0,1,0,0x05,0,{0}},
        {0x218A,1,3,0,0,0,1,1,0x05,0,{0}},
        {0x218B,1,3,0,0,0,1,1,0x05,0,{0}},
        {0x218C,1,3,0,0,0,1,1,0x05,0,{0}},
        {0x218D,1,3,0,0,0,1,1,0x05,0,{0}},
        {0x218E,1,3,0,0,0,1,1,0x05,0,{0}},
        {0x218F,1,3,0,0,0,1,1,0x05,0,{0}},
        {0xDF20,1,1,0,0,0,1,0,0x05,0,{0}},
        {0xDF40,1,1,0,0,0,1,0,0x05,0,{0}}
    };

    struct  Routine Routine_Sub0x02[NumOfRoutine_Sub0x02]={
        {0x020A,1,2,0,0,0,1,0,0x05,0,{0}},
        {0x2000,1,2,0,0,0,1,0,0x05,0,{0}},
        {0x203D,1,2,0,0,0,1,0,0x05,0,{0}},
        {0x2046,1,2,0,0,0,1,0,0x05,0,{0}},
        {0x204E,1,2,0,0,0,1,0,0x05,0,{0}},
        {0x204F,1,2,0,0,0,1,0,0x05,0,{0}},
        {0x2050,1,2,0,0,0,1,0,0x05,0,{0}},
        {0x2058,1,2,0,0,0,1,0,0x05,0,{0}},
        {0x2059,1,2,0,0,0,1,0,0x05,0,{0}},
        {0x2097,1,2,0,0,0,1,0,0x05,0,{0}},
        {0x212E,1,2,0,0,0,1,0,0x05,0,{0}},
        {0x212F,1,2,0,0,0,1,0,0x05,0,{0}},
        {0x2139,1,3,0,0,0,1,0,0x05,0,{0}},
        {0x213A,1,3,0,0,0,1,0,0x05,0,{0}},
        {0x213B,1,3,0,0,0,1,0,0x05,0,{0}},
        {0x213C,1,3,0,0,0,1,0,0x05,0,{0}},
        {0x213D,1,3,0,0,0,1,0,0x05,0,{0}},
        {0x213E,1,3,0,0,0,1,0,0x05,0,{0}},
        {0x213F,1,3,0,0,0,1,0,0x05,0,{0}},
        {0x2140,1,3,0,0,0,1,0,0x05,0,{0}},
        {0x2141,1,2,0,0,0,1,0,0x05,0,{0}},
        {0x214E,1,3,0,0,0,1,0,0x05,0,{0}},
        {0x2150,1,3,0,0,0,1,0,0x05,0,{0}},
        {0x2186,1,2,0,0,0,1,0,0x05,0,{0}},
        {0x2187,1,2,0,0,0,1,0,0x05,0,{0}},
        {0x2188,1,2,0,0,0,1,0,0x05,0,{0}},
        {0x2189,1,2,0,0,0,1,0,0x05,0,{0}},
        {0x218A,1,3,0,0,0,1,0,0x05,0,{0}},
        {0x218B,1,3,0,0,0,1,0,0x05,0,{0}},
        {0x218C,1,3,0,0,0,1,0,0x05,0,{0}},
        {0x218D,1,3,0,0,0,1,0,0x05,0,{0}},
        {0x218E,1,3,0,0,0,1,0,0x05,0,{0}},
        {0x218F,1,3,0,0,0,1,0,0x05,0,{0}}
    };

    struct  Routine Routine_Sub0x03[NumOfRoutine_Sub0x03]={
        {0x020A,1,2,0,0,0,1,0,0x05,0,{0}},
        {0x2000,1,2,0,0,0,1,0,0x05,0,{0}},
        {0x203D,1,2,0,0,0,1,0,0x05,0,{0}},
        {0x2046,1,2,0,0,0,1,0,0x05,0,{0}},
        {0x204E,1,2,0,0,0,1,0,0x05,0,{0}},
        {0x204F,1,2,0,0,0,1,0,0x05,0,{0}},
        {0x2050,1,2,0,0,0,1,0,0x05,0,{0}},
        {0x2058,1,2,0,0,0,1,0,0x05,0,{0}},
        {0x2059,1,2,0,0,0,1,0,0x05,0,{0}},
        {0x205A,1,1,0,0,0,1,0,0x05,0,{0}},
        {0x205B,1,1,0,0,0,1,0,0x05,0,{0}},
        {0x2097,1,2,0,0,0,1,0,0x05,0,{0}},
        {0x20A1,1,1,0,0,0,1,0,0x05,0,{0}},
        {0x20EB,1,1,0,0,0,1,0,0x05,0,{0}},
        {0x212E,1,2,0,0,0,1,0,0x05,0,{0}},
        {0x212F,1,2,0,0,0,1,0,0x05,0,{0}},
        {0x2139,1,3,0,0,0,1,0,0x05,0,{0}},
        {0x213A,1,3,0,0,0,1,0,0x05,0,{0}},
        {0x213B,1,3,0,0,0,1,0,0x05,0,{0}},
        {0x213C,1,3,0,0,0,1,0,0x05,0,{0}},
        {0x213D,1,3,0,0,0,1,0,0x05,0,{0}},
        {0x213E,1,3,0,0,0,1,0,0x05,0,{0}},
        {0x213F,1,3,0,0,0,1,0,0x05,0,{0}},
        {0x2140,1,3,0,0,0,1,0,0x05,0,{0}},
        {0x2141,1,2,0,0,0,1,0,0x05,0,{0}},
        {0x214E,1,3,0,0,0,1,0,0x05,0,{0}},
        {0x2150,1,3,0,0,0,1,0,0x05,0,{0}},
        {0x2186,1,2,0,0,0,1,0,0x05,0,{0}},
        {0x2187,1,2,0,0,0,1,0,0x05,0,{0}},
        {0x2188,1,2,0,0,0,1,0,0x05,0,{0}},
        {0x2189,1,2,0,0,0,1,0,0x05,0,{0}},
        {0x218A,1,3,0,0,0,1,0,0x05,0,{0}},
        {0x218B,1,3,0,0,0,1,0,0x05,0,{0}},
        {0x218C,1,3,0,0,0,1,0,0x05,0,{0}},
        {0x218D,1,3,0,0,0,1,0,0x05,0,{0}},
        {0x218E,1,3,0,0,0,1,0,0x05,0,{0}},
        {0x218F,1,3,0,0,0,1,0,0x05,0,{0}},
        {0xDF20,1,1,0,0,0,1,0,0x05,0,{0}},
        {0xDF40,1,1,0,0,0,1,0,0x05,0,{0}}
    };


    const int NumOfRoutine_Sub0x01_PBL=3;
    const int NumOfRoutine_Sub0x02_PBL=0;
    const int NumOfRoutine_Sub0x03_PBL=0;
    struct Routine Routine_Sub0x01_PBL[NumOfRoutine_Sub0x01_PBL]={
        {0x0205,1,1,0,0,1,0,0,0x01,0,{0}},
        {0x0212,1,1,0,0,1,0,256,0x01,0,{0}},
        {0x0301,1,1,0,0,1,0,4,0x01,0,{0}}
    };


    struct Routine Routine_Sub0x02_PBL[1];
    struct Routine Routine_Sub0x03_PBL[1];
      
    }