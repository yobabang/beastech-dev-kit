/*@!Encoding:936*/
includes
{
  #include "..\02_Library\TestContext.cin"
}
variables
{
  dword ECUAddress;
  int current_e2e_index;
}

/// <石太佳>
int check_DID_is_22_DID(byte PID[])
/*
    20240214石太佳：检查DID是否22服务可以读的DID
    
*/
{
  
  int i;
  
  for(i=0;i<NumOfReadDIDAPP;i++)
  {
     if ((dword)(PID[0]*256+ PID[1])==DIDOfReadAPP[i].DID)
     {
          return 1; 
     }
    
  }
  return 0;
  
}

void set_trc_valid()
{
  int j;
  char info[1024];
  int i,k;
    /* 获取所有待测信号的数量并将信号值设置成有效值 */
  for(i=0;i<E2E_FRAME_NUM;i++) 
  { 
  	for(j=0;j<elcount(e2eFrameList[i].e2eSigGroupList);j++)
  	{
  		if(strncmp(e2eFrameList[i].e2eSigGroupList[j].sigGroupName,"",elcount(e2eFrameList[i].e2eSigGroupList[j].sigGroupName)) == 0) { break; }
  		else
  		{
  			for(k=0;k<e2eFrameList[i].e2eSigGroupList[j].sigNum;k++)
  			{
  				if(e2eFrameList[i].e2eSigGroupList[j].e2eSignalList[k].sigUsed & SIGNALPROGRAMMING == SIGNALPROGRAMMING) 
          { 
            snprintf(info,elCount(info),"%s%s = %02X(Fulfilled)\n",info,e2eFrameList[i].e2eSigGroupList[j].e2eSignalList[k].sigName,
  					e2eFrameList[i].e2eSigGroupList[j].e2eSignalList[k].sigValue_Fulfilled);
            e2eFrameList[i].e2eSigGroupList[j].e2eSignalList[k].sigValue = e2eFrameList[i].e2eSigGroupList[j].e2eSignalList[k].sigValue_Fulfilled;
            e2eFrameList[i].simFrFlg = 1; e2eFrameList[i].simFrImtFlg = 1;
            //count++; 
          }
  			}
  		}
  	}
  }





}

/// <APP_CommonServiceTest>
testcase Service_0x10_Valid_Physical_All_Sessions_Supported_Service()
{
  char logName[400] = "";
  byte ExpectNRC[2]={0x12,0x7E};
  char info[1024];
  
  strncat(logName,"1350868_Service_0x10_Valid_Physical_All_Sessions_Supported_Service_R2",400);
  testCaseDescription("The intent is to verify that the ECU can transition between different session, with service DiagnosticSessionControl (0x10). The test will also verify that the sessionParameterRecord is correct.");
  testCaseTitle("1350868","Service_0x10_Valid_Physical_All_Sessions_Supported_Service");
  
  SetLog(logName);
  Precondition();

  /******************************以下为测试步骤*********************************/
  SessionFlag=APP;
  gflag_check_ecu_init_time = 1;
  
  TestStep("Transition to defaultSesion(0x01)",TestStepIntervalTime);
  SID10_DiagnosticSessionControl(DEFAULTSESSION,PHYSICAL,SPRMIB_FALSE);
  CheckPosResponse_SID10(DEFAULTSESSION,gP2Client_APP,gP2StarClientFor10Check,0,0);
  TestStep("Verify defaultSession",TestStepIntervalTime);
  CheckCurrentSession(DEFAULTSESSION,PHYSICAL,0,0);
  TestStep("Transition from defaultSession(0x01) to defaultSession(0x01)",TestStepIntervalTime);
  SID10_DiagnosticSessionControl(DEFAULTSESSION,PHYSICAL,SPRMIB_TRUE);
  CheckNonResponse(0,0);
  TestStep("Verify defaultSession(0x01)",TestStepIntervalTime);
  CheckCurrentSession(DEFAULTSESSION,PHYSICAL,0,0);
  SessionFlag=BOOT;
  TestStep("Transition to programmingSession(0x02)",TestStepIntervalTime);
  SID10_DiagnosticSessionControl(PROGRAMMINGSESSION,PHYSICAL,SPRMIB_FALSE);
  CheckPosResponse_SID10(PROGRAMMINGSESSION,gP2Client_BOOT,gP2StarClientFor10Check,0,0);
  ECUinitHandle(0);
  TestStep("Verify programmingSession",TestStepIntervalTime);
  CheckCurrentSession(PROGRAMMINGSESSION,PHYSICAL,0,0);
  SessionFlag=APP;
  
  TestStep("Transition from programmingSession(0x02) to defaultSession(0x01)",TestStepIntervalTime);
  SID10_DiagnosticSessionControl(DEFAULTSESSION,PHYSICAL,SPRMIB_FALSE);
  CheckPosResponse_SID10(DEFAULTSESSION,gP2Client_APP,gP2StarClientFor10Check,0,0);
  ECUinitHandle(0);
  TestStep("Verify defaultSession",TestStepIntervalTime);
  CheckCurrentSession(DEFAULTSESSION,PHYSICAL,0,0);
  SessionFlag=BOOT;
  
  TestStep("Transition from defaultSession(0x01) to programmingSession(0x02)",TestStepIntervalTime);
  SID10_DiagnosticSessionControl(PROGRAMMINGSESSION,PHYSICAL,SPRMIB_TRUE);
  CheckNonResponse(0,0);
  ECUinitHandle(0);
  TestStep("Verify programmingSession",TestStepIntervalTime);
  CheckCurrentSession(PROGRAMMINGSESSION,PHYSICAL,0,0);
  SessionFlag=APP;
  
  TestStep("Transition from programmingSession(0x02) to defaultSession(0x01)",TestStepIntervalTime);
  SID10_DiagnosticSessionControl(DEFAULTSESSION,PHYSICAL,SPRMIB_TRUE);
  CheckNonResponse(0,0);
  ECUinitHandle(0);
  TestStep("Verify defaultSession",TestStepIntervalTime);
  CheckCurrentSession(DEFAULTSESSION,PHYSICAL,0,0);
  TestStep("Transition from defaultSession(0x01) to extendedDiagnosticSession(0x03)",TestStepIntervalTime);
  SID10_DiagnosticSessionControl(EXTENDEDSESSION,PHYSICAL,SPRMIB_FALSE);
  CheckPosResponse_SID10(EXTENDEDSESSION,gP2Client_APP,gP2StarClientFor10Check,0,0);
  TestStep("Verify extendedDiagnosticSession",TestStepIntervalTime);
  CheckCurrentSession(EXTENDEDSESSION,PHYSICAL,0,0);
  TestStep("Transition from extendedDiagnosticSession(0x03) to defaultSession(0x01)",TestStepIntervalTime);
  SID10_DiagnosticSessionControl(DEFAULTSESSION,PHYSICAL,SPRMIB_TRUE);
  CheckNonResponse(0,0);
  TestStep("Verify defaultSession",TestStepIntervalTime);
  CheckCurrentSession(DEFAULTSESSION,PHYSICAL,0,0);
  TestStep("Transition from defaultSession(0x01) to extendedDiagnosticSession(0x03)",TestStepIntervalTime);
  SID10_DiagnosticSessionControl(EXTENDEDSESSION,PHYSICAL,SPRMIB_TRUE);
  CheckNonResponse(0,0);
  TestStep("Verify extendedDiagnosticSession",TestStepIntervalTime);
  CheckCurrentSession(EXTENDEDSESSION,PHYSICAL,0,0);
  TestStep("Transition from extendedDiagnosticSession(0x03) to extendedDiagnosticSession(0x03)",TestStepIntervalTime);
  SID10_DiagnosticSessionControl(EXTENDEDSESSION,PHYSICAL,SPRMIB_FALSE);
  CheckPosResponse_SID10(EXTENDEDSESSION,gP2Client_APP,gP2StarClientFor10Check,0,0);
  TestStep("Verify extendedDiagnosticSession",TestStepIntervalTime);
  CheckCurrentSession(EXTENDEDSESSION,PHYSICAL,0,0);
  TestStep("Transition from extendedDiagnosticSession(0x03) to extendedDiagnosticSession(0x03)",TestStepIntervalTime);
  SID10_DiagnosticSessionControl(EXTENDEDSESSION,PHYSICAL,SPRMIB_TRUE);
  CheckNonResponse(0,0);
  TestStep("Verify extendedDiagnosticSession",TestStepIntervalTime);
  CheckCurrentSession(EXTENDEDSESSION,PHYSICAL,0,0);
  SessionFlag=BOOT;
  
  TestStep("Transition from extendedDiagnosticSession(0x03) to ProgrammingSession(0x02)",TestStepIntervalTime);
  SID10_DiagnosticSessionControl(PROGRAMMINGSESSION,PHYSICAL,SPRMIB_FALSE);
  CheckPosResponse_SID10(PROGRAMMINGSESSION,gP2Client_BOOT,gP2StarClientFor10Check,0,0);
  ECUinitHandle(0);
  
  TestStep("Verify ProgrammingSession",TestStepIntervalTime);
  CheckCurrentSession(PROGRAMMINGSESSION,PHYSICAL,0,0);
  TestStep("Transition from ProgrammingSession(0x02) to ProgrammingSession(0x02)",TestStepIntervalTime);
  SID10_DiagnosticSessionControl(PROGRAMMINGSESSION,PHYSICAL,SPRMIB_FALSE);
  CheckPosResponse_SID10(PROGRAMMINGSESSION,gP2Client_BOOT,gP2StarClientFor10Check,0,0);
  TestStep("Verify ProgrammingSession",TestStepIntervalTime);
  CheckCurrentSession(PROGRAMMINGSESSION,PHYSICAL,0,0);
  TestStep("Transition from ProgrammingSession(0x02) to ProgrammingSession(0x02)",TestStepIntervalTime);
  SID10_DiagnosticSessionControl(PROGRAMMINGSESSION,PHYSICAL,SPRMIB_TRUE);
  CheckNonResponse(0,0);
  TestStep("Verify ProgrammingSession",TestStepIntervalTime);
  CheckCurrentSession(PROGRAMMINGSESSION,PHYSICAL,0,0);
  TestStep("Transition from ProgrammingSession(0x02) to extendedDiagnosticSession(0x03) is not allowed",TestStepIntervalTime);
  SID10_DiagnosticSessionControl(EXTENDEDSESSION,PHYSICAL,SPRMIB_FALSE);
  CheckNegResponse(ExpectNRC,0,0,0,0);
  if(gRss!=NEG)
  {
    TestStepFail("Fail","ERROR:Unexpected response, testcase ends");
    PostCondition();
    return;
  }
  TestStep("Verify ProgrammingSession",TestStepIntervalTime);
  CheckCurrentSession(PROGRAMMINGSESSION,PHYSICAL,0,0);
  TestStep("Transition from ProgrammingSession(0x02) to extendedDiagnosticSession(0x03)",TestStepIntervalTime);
  SID10_DiagnosticSessionControl(EXTENDEDSESSION,PHYSICAL,SPRMIB_TRUE);
  CheckNegResponse(ExpectNRC,0,0,0,0);
  if(gRss!=NEG)
  {
    TestStepFail("Fail","ERROR:Unexpected response, testcase ends");
    PostCondition();
    return;
  }
  
  TestStep("Verify ProgrammingSession",TestStepIntervalTime);
  CheckCurrentSession(PROGRAMMINGSESSION,PHYSICAL,0,0);
  SessionFlag=APP;
  
  TestStep("Transition from ProgrammingSession(0x02) to DefaultSession(0x01)",TestStepIntervalTime);
  SID10_DiagnosticSessionControl(DEFAULTSESSION,PHYSICAL,SPRMIB_FALSE);
  CheckPosResponse_SID10(DEFAULTSESSION,gP2Client_APP,gP2StarClientFor10Check,0,0);
  ECUinitHandle(0);
  TestStep("Verify defaultSession",TestStepIntervalTime);
  CheckCurrentSession(DEFAULTSESSION,PHYSICAL,0,0);
  TestStep("Transition from DefaultSession(0x01) to extendedDiagnosticSession(0x03)",TestStepIntervalTime);
  SID10_DiagnosticSessionControl(EXTENDEDSESSION,PHYSICAL,SPRMIB_FALSE);
  CheckPosResponse_SID10(EXTENDEDSESSION,gP2Client_APP,gP2StarClientFor10Check,0,0);
  TestStep("Verify extendedDiagnosticSession",TestStepIntervalTime);
  CheckCurrentSession(EXTENDEDSESSION,PHYSICAL,0,0);
  SessionFlag=BOOT;
  
  TestStep("Transition from extendedDiagnosticSession(0x03) to ProgrammingSession(0x02)",TestStepIntervalTime);
  SID10_DiagnosticSessionControl(PROGRAMMINGSESSION,PHYSICAL,SPRMIB_TRUE);
  CheckNonResponse(0,0);
  ECUinitHandle(0);
  TestStep("Verify ProgrammingSession",TestStepIntervalTime);
  CheckCurrentSession(PROGRAMMINGSESSION,PHYSICAL,0,0);
  SessionFlag=APP;
  
  TestStep("Transition from ProgrammingSession(0x02) to defaultSession(0x01)",TestStepIntervalTime);
  SID10_DiagnosticSessionControl(DEFAULTSESSION,PHYSICAL,SPRMIB_TRUE);
  CheckNonResponse(0,0);
  ECUinitHandle(0);
  CheckCurrentSession(DEFAULTSESSION,PHYSICAL,0,0);
  TestStep("Transition from DefaultSession(0x01) to DefaultSession(0x01)",TestStepIntervalTime);
  SID10_DiagnosticSessionControl(DEFAULTSESSION,PHYSICAL,SPRMIB_FALSE);
  CheckPosResponse_SID10(DEFAULTSESSION,gP2Client_APP,gP2StarClientFor10Check,0,0);

  TestStep("Verify defaultSession",TestStepIntervalTime);
  CheckCurrentSession(DEFAULTSESSION,PHYSICAL,0,0);
  TestStep("Transition from DefaultSession(0x01) to extendedDiagnosticSession(0x03)",TestStepIntervalTime);
  SID10_DiagnosticSessionControl(EXTENDEDSESSION,PHYSICAL,SPRMIB_FALSE);
  CheckPosResponse_SID10(EXTENDEDSESSION,gP2Client_APP,gP2StarClientFor10Check,0,0);
  TestStep("Verify extendedDiagnosticSession",TestStepIntervalTime);
  CheckCurrentSession(EXTENDEDSESSION,PHYSICAL,0,0);
  TestStep("Transition from extendedDiagnosticSession(0x01) to DefaultSession(0x01)",TestStepIntervalTime);
  SID10_DiagnosticSessionControl(DEFAULTSESSION,PHYSICAL,SPRMIB_FALSE);
  CheckPosResponse_SID10(DEFAULTSESSION,gP2Client_APP,gP2StarClientFor10Check,0,0);
  TestStep("Verify defaultSession",TestStepIntervalTime);
  CheckCurrentSession(DEFAULTSESSION,PHYSICAL,0,0);
    
  gflag_check_ecu_init_time = 0;
  /******************************以上为测试步骤*********************************/
  PostCondition();
}

/// <APP_CommonServiceTest>
testcase Service_0x10_Valid_Functional_All_Sessions_Supported_Service()
{
  char logName[400] = "";
  byte ExpectNRC[2]={0x12,0x7E};
  char info[1024];
  
  strncat(logName,"1350869_Service_0x10_Valid_Functional_All_Sessions_Supported_Service_R2",400);
  testCaseDescription("The intent is to verify that the ECU can transition between different session, with service DiagnosticSessionControl (0x10). The test will also verify that the sessionParameterRecord is correct.");
  testCaseTitle("1350869","Service_0x10_Valid_Functional_All_Sessions_Supported_Service");
	if(gBusFlag==3)
	{
		testStepWarning("Test","This test case does not apply to the LIN bus");
		return;
	}
  SetLog(logName);
  Precondition();

  /******************************以下为测试步骤*********************************/
  gflag_check_ecu_init_time = 1;
  
  TestStep("Transition to defaultSesion(0x01)",TestStepIntervalTime);
  SID10_DiagnosticSessionControl(DEFAULTSESSION,FUNCTIONAL,SPRMIB_FALSE);
  CheckPosResponse_SID10(DEFAULTSESSION,gP2Client_APP,gP2StarClientFor10Check,0,0);
  TestStep("Verify defaultSession",TestStepIntervalTime);
  CheckCurrentSession(DEFAULTSESSION,PHYSICAL,0,0);
  TestStep("Transition from defaultSession(0x01) to defaultSession(0x01)",TestStepIntervalTime);
  SID10_DiagnosticSessionControl(DEFAULTSESSION,FUNCTIONAL,SPRMIB_TRUE);
  CheckNonResponse(0,0);
  TestStep("Verify defaultSession(0x01)",TestStepIntervalTime);
  CheckCurrentSession(DEFAULTSESSION,PHYSICAL,0,0);
  SessionFlag=BOOT;
  
  TestStep("Transition to programmingSession(0x02)",TestStepIntervalTime);
  SID10_DiagnosticSessionControl(PROGRAMMINGSESSION,FUNCTIONAL,SPRMIB_FALSE);
  CheckPosResponse_SID10(PROGRAMMINGSESSION,gP2Client_BOOT,gP2StarClientFor10Check,0,0);
  ECUinitHandle(0);
  TestStep("Verify programmingSession",TestStepIntervalTime);
  CheckCurrentSession(PROGRAMMINGSESSION,PHYSICAL,0,0);
  SessionFlag=APP;
  
  TestStep("Transition from programmingSession(0x02) to defaultSession(0x01)",TestStepIntervalTime);
  SID10_DiagnosticSessionControl(DEFAULTSESSION,FUNCTIONAL,SPRMIB_FALSE);
  CheckPosResponse_SID10(DEFAULTSESSION,gP2Client_APP,gP2StarClientFor10Check,0,0);
  ECUinitHandle(0);
  TestStep("Verify defaultSession",TestStepIntervalTime);
  CheckCurrentSession(DEFAULTSESSION,PHYSICAL,0,0);
  SessionFlag=BOOT;
  
  TestStep("Transition from defaultSession(0x01) to programmingSession(0x02)",TestStepIntervalTime);
  SID10_DiagnosticSessionControl(PROGRAMMINGSESSION,FUNCTIONAL,SPRMIB_TRUE);
  CheckNonResponse(0,0);
  ECUinitHandle(0);
  TestStep("Verify programmingSession",TestStepIntervalTime);
  CheckCurrentSession(PROGRAMMINGSESSION,PHYSICAL,0,0);
  SessionFlag=APP;
  
  TestStep("Transition from programmingSession(0x02) to defaultSession(0x01)",TestStepIntervalTime);
  SID10_DiagnosticSessionControl(DEFAULTSESSION,FUNCTIONAL,SPRMIB_TRUE);
  CheckNonResponse(0,0);
  ECUinitHandle(0);
  TestStep("Verify defaultSession",TestStepIntervalTime);
  CheckCurrentSession(DEFAULTSESSION,PHYSICAL,0,0);
  TestStep("Transition from defaultSession(0x01) to extendedDiagnosticSession(0x03)",TestStepIntervalTime);
  SID10_DiagnosticSessionControl(EXTENDEDSESSION,FUNCTIONAL,SPRMIB_FALSE);
  CheckPosResponse_SID10(EXTENDEDSESSION,gP2Client_APP,gP2StarClientFor10Check,0,0);
  TestStep("Verify extendedDiagnosticSession",TestStepIntervalTime);
  CheckCurrentSession(EXTENDEDSESSION,PHYSICAL,0,0);
  TestStep("Transition from extendedDiagnosticSession(0x03) to defaultSession(0x01)",TestStepIntervalTime);
  SID10_DiagnosticSessionControl(DEFAULTSESSION,FUNCTIONAL,SPRMIB_TRUE);
  CheckNonResponse(0,0);
  TestStep("Verify defaultSession",TestStepIntervalTime);
  CheckCurrentSession(DEFAULTSESSION,PHYSICAL,0,0);
  TestStep("Transition from defaultSession(0x01) to extendedDiagnosticSession(0x03)",TestStepIntervalTime);
  SID10_DiagnosticSessionControl(EXTENDEDSESSION,FUNCTIONAL,SPRMIB_TRUE);
  CheckNonResponse(0,0);
  TestStep("Verify extendedDiagnosticSession",TestStepIntervalTime);
  CheckCurrentSession(EXTENDEDSESSION,PHYSICAL,0,0);
  TestStep("Transition from extendedDiagnosticSession(0x03) to extendedDiagnosticSession(0x03)",TestStepIntervalTime);
  SID10_DiagnosticSessionControl(EXTENDEDSESSION,FUNCTIONAL,SPRMIB_FALSE);
  CheckPosResponse_SID10(EXTENDEDSESSION,gP2Client_APP,gP2StarClientFor10Check,0,0);
  TestStep("Verify extendedDiagnosticSession",TestStepIntervalTime);
  CheckCurrentSession(EXTENDEDSESSION,PHYSICAL,0,0);
  TestStep("Transition from extendedDiagnosticSession(0x03) to extendedDiagnosticSession(0x03)",TestStepIntervalTime);
  SID10_DiagnosticSessionControl(EXTENDEDSESSION,FUNCTIONAL,SPRMIB_TRUE);
  CheckNonResponse(0,0);
  TestStep("Verify extendedDiagnosticSession",TestStepIntervalTime);
  CheckCurrentSession(EXTENDEDSESSION,PHYSICAL,0,0);
  SessionFlag=BOOT;
  
  TestStep("Transition from extendedDiagnosticSession(0x03) to ProgrammingSession(0x02)",TestStepIntervalTime);
  SID10_DiagnosticSessionControl(PROGRAMMINGSESSION,FUNCTIONAL,SPRMIB_FALSE);
  CheckPosResponse_SID10(PROGRAMMINGSESSION,gP2Client_BOOT,gP2StarClientFor10Check,0,0);
  ECUinitHandle(0);
  TestStep("Verify ProgrammingSession",TestStepIntervalTime);
  CheckCurrentSession(PROGRAMMINGSESSION,PHYSICAL,0,0);
  TestStep("Transition from ProgrammingSession(0x02) to ProgrammingSession(0x02)",TestStepIntervalTime);
  SID10_DiagnosticSessionControl(PROGRAMMINGSESSION,FUNCTIONAL,SPRMIB_FALSE);
  CheckPosResponse_SID10(PROGRAMMINGSESSION,gP2Client_BOOT,gP2StarClientFor10Check,0,0);
  TestStep("Verify ProgrammingSession",TestStepIntervalTime);
  CheckCurrentSession(PROGRAMMINGSESSION,PHYSICAL,0,0);
  TestStep("Transition from ProgrammingSession(0x02) to ProgrammingSession(0x02)",TestStepIntervalTime);
  SID10_DiagnosticSessionControl(PROGRAMMINGSESSION,FUNCTIONAL,SPRMIB_TRUE);
  CheckNonResponse(0,0);
  TestStep(":Verify ProgrammingSession",TestStepIntervalTime);
  CheckCurrentSession(PROGRAMMINGSESSION,PHYSICAL,0,0);
  TestStep("Transition from ProgrammingSession(0x02) to extendedDiagnosticSession(0x03) is not allowed",TestStepIntervalTime);
  SID10_DiagnosticSessionControl(EXTENDEDSESSION,FUNCTIONAL,SPRMIB_FALSE);
  CheckNonResponse(0,0);
  TestStep("Verify ProgrammingSession",TestStepIntervalTime);
  CheckCurrentSession(PROGRAMMINGSESSION,PHYSICAL,0,0);
  TestStep("Transition from ProgrammingSession(0x02) to extendedDiagnosticSession(0x03)",TestStepIntervalTime);
  SID10_DiagnosticSessionControl(EXTENDEDSESSION,FUNCTIONAL,SPRMIB_TRUE);
  CheckNonResponse(0,0);
  TestStep("Verify ProgrammingSession",TestStepIntervalTime);
  CheckCurrentSession(PROGRAMMINGSESSION,PHYSICAL,0,0);
  SessionFlag=APP;

  TestStep("Transition from ProgrammingSession(0x02) to DefaultSession(0x01)",TestStepIntervalTime);
  SID10_DiagnosticSessionControl(DEFAULTSESSION,FUNCTIONAL,SPRMIB_FALSE);
  CheckPosResponse_SID10(DEFAULTSESSION,gP2Client_APP,gP2StarClientFor10Check,0,0);
  ECUinitHandle(0);
  TestStep("Verify defaultSession",TestStepIntervalTime);
  CheckCurrentSession(DEFAULTSESSION,PHYSICAL,0,0);
  TestStep("Transition from DefaultSession(0x01) to extendedDiagnosticSession(0x03)",TestStepIntervalTime);
  SID10_DiagnosticSessionControl(EXTENDEDSESSION,FUNCTIONAL,SPRMIB_FALSE);
  CheckPosResponse_SID10(EXTENDEDSESSION,gP2Client_APP,gP2StarClientFor10Check,0,0);
  TestStep("Verify extendedDiagnosticSession",TestStepIntervalTime);
  CheckCurrentSession(EXTENDEDSESSION,PHYSICAL,0,0);
  SessionFlag=BOOT;
  
  TestStep("Transition from extendedDiagnosticSession(0x03) to ProgrammingSession(0x02)",TestStepIntervalTime);
  SID10_DiagnosticSessionControl(PROGRAMMINGSESSION,FUNCTIONAL,SPRMIB_TRUE);
  CheckNonResponse(0,0);
  ECUinitHandle(0);
  TestStep("Verify ProgrammingSession",TestStepIntervalTime);
  CheckCurrentSession(PROGRAMMINGSESSION,PHYSICAL,0,0);
  SessionFlag=APP;
  
  TestStep("Transition from ProgrammingSession(0x02) to defaultSession(0x01)",TestStepIntervalTime);
  SID10_DiagnosticSessionControl(DEFAULTSESSION,FUNCTIONAL,SPRMIB_TRUE);
  CheckNonResponse(0,0);
  ECUinitHandle(0);
  TestStep("Verify defaultSession",TestStepIntervalTime);
  CheckCurrentSession(DEFAULTSESSION,PHYSICAL,0,0);
  TestStep("Transition from DefaultSession(0x01) to DefaultSession(0x01)",TestStepIntervalTime);
  SID10_DiagnosticSessionControl(DEFAULTSESSION,FUNCTIONAL,SPRMIB_FALSE);
  CheckPosResponse_SID10(DEFAULTSESSION,gP2Client_APP,gP2StarClientFor10Check,0,0);
  TestStep("Verify defaultSession",TestStepIntervalTime);
  CheckCurrentSession(DEFAULTSESSION,PHYSICAL,0,0);
  TestStep("Transition from DefaultSession(0x01) to extendedDiagnosticSession(0x03)",TestStepIntervalTime);
  SID10_DiagnosticSessionControl(EXTENDEDSESSION,FUNCTIONAL,SPRMIB_FALSE);
  CheckPosResponse_SID10(EXTENDEDSESSION,gP2Client_APP,gP2StarClientFor10Check,0,0);
  TestStep("Verify extendedDiagnosticSession",TestStepIntervalTime);
  CheckCurrentSession(EXTENDEDSESSION,PHYSICAL,0,0);
  TestStep("Transition from extendedDiagnosticSession(0x01) to DefaultSession(0x01)",TestStepIntervalTime);
  SID10_DiagnosticSessionControl(DEFAULTSESSION,FUNCTIONAL,SPRMIB_FALSE);
  CheckPosResponse_SID10(DEFAULTSESSION,gP2Client_APP,gP2StarClientFor10Check,0,0);
  TestStep("Verify defaultSession",TestStepIntervalTime);
  CheckCurrentSession(DEFAULTSESSION,PHYSICAL,0,0);
  
  gflag_check_ecu_init_time = 0;
  /******************************以上为测试步骤*********************************/
  PostCondition();
}
/// <APP_CommonServiceTest>
testcase Sercice_0x11_Valid_Physical_DefaultSession_Supported()
{
  char logName[400] = "";
  char info[1024];
  
  strncat(logName,"1350870_Sercice_0x11_Valid_Physical_DefaultSession_Supported_R2",400);
  testCaseDescription("The intent of this test is to verify that the service ECUReset(0x11) and its subfunction is functioning correctly in defaultSession");
  testCaseTitle("1350870","Sercice_0x11_Valid_Physical_DefaultSession_Supported");
  
  SetLog(logName);
  Precondition();

  /******************************以下为测试步骤*********************************/
  SessionFlag=APP;
  gflag_check_ecu_init_time = 1;
  
  TestStep("ECU Reset (hard reset)",TestStepIntervalTime);
  //SID11_ECUReset(HardReset,SPRMIB_False,PHYSICAL);
  SID11_ECUReset(HARDRESET,PHYSICAL,SPRMIB_FALSE);
  CheckPosResponse_SID11(HARDRESET,0,0);
  ECUinitHandle(0);
  
  TestStep("Verify defaultSession, the ECU shall return to defaultSession after hardReset.",TestStepIntervalTime);
  CheckCurrentSession(DEFAULTSESSION,PHYSICAL,0,0);
  TestStep("ECU Reset (hard reset)",TestStepIntervalTime);
  //SID11_ECUReset(HardReset,SPRMIB_True,PHYSICAL);
  SID11_ECUReset(HARDRESET,PHYSICAL,SPRMIB_TRUE);
  CheckNonResponse(0,0);
  ECUinitHandle(0);
  TestStep("Verify defaultSession.",TestStepIntervalTime);
  CheckCurrentSession(DEFAULTSESSION,PHYSICAL,0,0);
  
  gflag_check_ecu_init_time = 0;
  /******************************以上为测试步骤*********************************/
  Postcondition();
}
/// <APP_CommonServiceTest>
testcase Sercice_0x11_Valid_Functional_DefaultSession_Supported()
{
  char logPath[400] = "";
  char logName[400] = "";
  char info[1024];
  
  strncat(logName,"1350871_Sercice_0x11_Valid_Functional_DefaultSession_Supported_R2",400);
  testCaseDescription("The intent of this test is to verify that the service ECUReset(0x11) and its subfunction is functioning correctly in defaultSession"); 
  testCaseTitle("1350871","Sercice_0x11_Valid_Functional_DefaultSession_Supported");
  if(gBusFlag==3)
	{
		testStepWarning("Test","This test case does not apply to the LIN bus");
		return;
	}
  SetLog(logName);
  Precondition();

  /******************************以下为测试步骤*********************************/
  SessionFlag=APP;
  gflag_check_ecu_init_time = 1;
  
  TestStep("ECU Reset (hard reset)",TestStepIntervalTime);
  SID11_ECUReset(HARDRESET,FUNCTIONAL,SPRMIB_FALSE);
  CheckPosResponse_SID11(HARDRESET,0,0);
  ECUinitHandle(0);
  TestStep("Verify defaultSession, the ECU shall return to defaultSession after hardReset.",TestStepIntervalTime);
  CheckCurrentSession(DEFAULTSESSION,PHYSICAL,0,0);
  TestStep("ECU Reset (hard reset)",TestStepIntervalTime);
  SID11_ECUReset(HARDRESET,FUNCTIONAL,SPRMIB_TRUE);
  CheckNonResponse(0,0);
  ECUinitHandle(0);
  TestStep("Verify defaultSession.",TestStepIntervalTime);
  CheckCurrentSession(DEFAULTSESSION,PHYSICAL,0,0);
  
  gflag_check_ecu_init_time = 0;
  /******************************以上为测试步骤*********************************/
  Postcondition();
   
}
/// <APP_CommonServiceTest>
testcase Sercice_0x11_Valid_Physical_ExtendedDiagnosticSession_Supported()
{
  char logPath[400] = "";
  float T3,T4,Delta;
  int i;
  char logName[400] = "";
  char info[1024];
  
  strncat(logName,"1350872_Sercice_0x11_Valid_Physical_ExtendedDiagnosticSession_Supported",400);
  testCaseDescription("The intent of this test is to verify that the service ECUReset(0x11) and its subfunction is functioning correctly in defaultSession");
  testCaseTitle("1350872","Sercice_0x11_Valid_Physical_ExtendedDiagnosticSession_Supported");
  
  SetLog(logName);
  Precondition();

  /******************************以下为测试步骤*********************************/
  SessionFlag=APP;
  gflag_check_ecu_init_time = 1;
  
  TestStep("Transition from defaultSession(0x01) to extendedDiagnosticSession(0x03).",TestStepIntervalTime);
  SID10_DiagnosticSessionControl(EXTENDEDSESSION,PHYSICAL,SPRMIB_FALSE);
  CheckPosResponse_SID10(EXTENDEDSESSION,gP2Client_APP,gP2StarClientFor10Check,0,0);
  TestStep("Verify extendedDiagnosticSession.",TestStepIntervalTime);
  CheckCurrentSession(EXTENDEDSESSION,PHYSICAL,0,0);
  TestStep("ECU Reset (hard reset)",TestStepIntervalTime);
  //SID11_ECUReset(HardReset,SPRMIB_False,PHYSICAL);
  SID11_ECUReset(HARDRESET,PHYSICAL,SPRMIB_FALSE);
  CheckPosResponse_SID11(HARDRESET,0,0);
  
//  T4 = timeNowFloat()/10000;
//  setTimerCyclic(SendF186,5);
//  for(i = 0;i<500;i++)
//  {
//    testJoinMessageEvent(ResponseID);
//    //write("Response ID is %03x",ResponseID);
//    if(TestWaitForAnyJoinedEvent(10)>0)
//    {
//      //write("Get new message!");
//      //write("The data is %02x %02x",gTpRxData[0],gTpRxData[3]);
//      if((gTpRxData[0]==0x62)&&(gTpRxData[3]==0x01))
//      {
//        T3 = timeNowFloat()/10000;
//        break;
//      }
//    }
//    
//  }
//  cancelTimer(SendF186);
//  Delta = (T3-T4)*100;
//  TestStep("","The ECU reset time is %f ms",Delta);
  ECUinitHandle(0);
  
  TestStep("Verify defaultSession.",TestStepIntervalTime);
  CheckCurrentSession(DEFAULTSESSION,PHYSICAL,0,0);
  TestStep("Transition from defaultSession(0x01) to extendedDiagnosticSession(0x03).",TestStepIntervalTime);
  SID10_DiagnosticSessionControl(EXTENDEDSESSION,PHYSICAL,SPRMIB_FALSE);
  CheckPosResponse_SID10(EXTENDEDSESSION,gP2Client_APP,gP2StarClientFor10Check,0,0);
  TestStep("Verify extendedDiagnosticSession.",TestStepIntervalTime);
  CheckCurrentSession(EXTENDEDSESSION,PHYSICAL,0,0);
  TestStep("ECU Reset (hard reset)",TestStepIntervalTime);
  //SID11_ECUReset(HardReset,SPRMIB_True,PHYSICAL);
  SID11_ECUReset(HARDRESET,PHYSICAL,SPRMIB_TRUE);
  CheckNonResponse(0,0);
  ECUinitHandle(0);
  TestStep("Verify defaultSession.",TestStepIntervalTime);
  CheckCurrentSession(DEFAULTSESSION,PHYSICAL,0,0);
  TestStep("Transition from defaultSession(0x01) to extendedDiagnosticSession(0x03).",TestStepIntervalTime);
  SID10_DiagnosticSessionControl(EXTENDEDSESSION,PHYSICAL,SPRMIB_FALSE);
  CheckPosResponse_SID10(EXTENDEDSESSION,gP2Client_APP,gP2StarClientFor10Check,0,0);
  TestStep("Verify extendedDiagnosticSession.",TestStepIntervalTime);
  CheckCurrentSession(EXTENDEDSESSION,PHYSICAL,0,0);
  
  gflag_check_ecu_init_time = 0;
  /******************************以上为测试步骤*********************************/
  Postcondition();
   
}
/// <APP_CommonServiceTest>
testcase Sercice_0x11_Valid_Functional_ExtendedDiagnosticSession_Supported()
{
  char logPath[400] = "";
  char logName[400] = "";
  char info[1024];
  
  strncat(logName,"1350873_Sercice_0x11_Valid_Functional_ExtendedDiagnosticSession_Supported_R2",400);
  testCaseDescription("The intent of this test is to verify that the service ECUReset(0x11) and its subfunction is functioning correctly in defaultSession");
  testCaseTitle("1350873","Sercice_0x11_Valid_Functional_ExtendedDiagnosticSession_Supported");
  if(gBusFlag==3)
	{
		testStepWarning("Test","This test case does not apply to the LIN bus");
		return;
	}
  SetLog(logName);
  Precondition();

  /******************************以下为测试步骤*********************************/
  SessionFlag=APP;
  gflag_check_ecu_init_time = 1;
  
  TestStep("Transition from defaultSession(0x01) to extendedDiagnosticSession(0x03).",TestStepIntervalTime);
  SID10_DiagnosticSessionControl(EXTENDEDSESSION,FUNCTIONAL,SPRMIB_FALSE);
  CheckPosResponse_SID10(EXTENDEDSESSION,gP2Client_APP,gP2StarClientFor10Check,0,0);
  TestStep("Verify extendedDiagnosticSession.",TestStepIntervalTime);
  CheckCurrentSession(EXTENDEDSESSION,PHYSICAL,0,0);
  TestStep("ECU Reset (hard reset)",TestStepIntervalTime);
  //SID11_ECUReset(HardReset,SPRMIB_False,FUNCTIONAL);
  SID11_ECUReset(HARDRESET,FUNCTIONAL,SPRMIB_FALSE);
  CheckPosResponse_SID11(HARDRESET,0,0);
  ECUinitHandle(0);
  
  TestStep("Verify defaultSession.",TestStepIntervalTime);
  CheckCurrentSession(DEFAULTSESSION,PHYSICAL,0,0);
  TestStep("Transition from defaultSession(0x01) to extendedDiagnosticSession(0x03).",TestStepIntervalTime);
  SID10_DiagnosticSessionControl(EXTENDEDSESSION,FUNCTIONAL,SPRMIB_FALSE);
  CheckPosResponse_SID10(EXTENDEDSESSION,gP2Client_APP,gP2StarClientFor10Check,0,0);
  TestStep("Verify extendedDiagnosticSession.",TestStepIntervalTime);
  CheckCurrentSession(EXTENDEDSESSION,PHYSICAL,0,0);
  TestStep("ECU Reset (hard reset)",TestStepIntervalTime);
  //SID11_ECUReset(HardReset,SPRMIB_True,FUNCTIONAL);
  SID11_ECUReset(HARDRESET,FUNCTIONAL,SPRMIB_TRUE);
  CheckNonResponse(0,0);
  ECUinitHandle(0);
  TestStep("Verify defaultSession.",TestStepIntervalTime);
  CheckCurrentSession(DEFAULTSESSION,PHYSICAL,0,0);
  TestStep("Transition from defaultSession(0x01) to extendedDiagnosticSession(0x03).",TestStepIntervalTime);
  SID10_DiagnosticSessionControl(EXTENDEDSESSION,FUNCTIONAL,SPRMIB_FALSE);
  CheckPosResponse_SID10(EXTENDEDSESSION,gP2Client_APP,gP2StarClientFor10Check,0,0);
  TestStep("Verify extendedDiagnosticSession.",TestStepIntervalTime);
  CheckCurrentSession(EXTENDEDSESSION,PHYSICAL,0,0);
  
  gflag_check_ecu_init_time = 0;
  /******************************以上为测试步骤*********************************/
  Postcondition();
   
}
 
/// <APP_CommonServiceTest>
testcase Service_0x14_Valid_Physical_DefaultSession_Supported_Service()
{
  byte ExpectNRC[1]={0x31};
  byte GroupOfDTC[3]={0xff,0xff,0xff};
  byte GroupOfDTC_OBD[3]={0xff,0xf0,0x00};
  char logName[400] = "";
  char info[1024];
  
  strncat(logName,"1022421_Service_0x14_Valid_Physical_DefaultSession_Supported_Service_R2",400);
  testCaseDescription("The intent is to verify service ClearDiagnosticInformation (0x14).");
  testCaseTitle("1022421","Service_0x14_Valid_Physical_DefaultSession_Supported_Service");
  
  SetLog(logName);
  Precondition();

  /******************************以下为测试步骤*********************************/
  
  SessionFlag=APP;
  
//  if(Flag_OBDNode == 1)
//  {
//    TestStep("Clear DTCs",TestStepIntervalTime);
//    SID14_ClearDTC(GroupOfDTC,PHYSICAL);
//    //CheckPosResponse_SID14(0,0);
//    CheckNegResponse(ExpectNRC,0,1);
//    
//    return ;
//  }
  
  //TestStep("Verify default session",TestStepIntervalTime);
  SID10_DiagnosticSessionControl(DEFAULTSESSION,PHYSICAL,SPRMIB_FALSE);
  CheckPosResponse_SID10(DEFAULTSESSION,gP2Client_APP,gP2StarClientFor10Check,0,0);
  if(Flag_OBDNode == 1)
  {
    TestStep("Clear All DTCs in emission related ECU",TestStepIntervalTime);
    SID14_ClearDTC(GroupOfDTC_OBD,PHYSICAL);
    //CheckPosResponse_SID14(0,0);
    CheckNegResponse(0x31,0,0);
    return ;
  } 
  TestStep("Clear All DTCs",TestStepIntervalTime);
  SID14_ClearDTC(GroupOfDTC,PHYSICAL);
  CheckPosResponse_SID14(0,0);
  TestStep("Verify defaultSession",TestStepIntervalTime);
  CheckCurrentSession(DEFAULTSESSION,PHYSICAL,0,0);
  /******************************以上为测试步骤*********************************/
  Postcondition();
   
}
 
/// <APP_CommonServiceTest>
testcase Service_0x14_Valid_Physical_ExtendedSession_Supported_Service()
{
  char logPath[400] = "";
  byte ExpectNRC[1]={0x31};
  byte GroupOfDTC[3]={0xff,0xff,0xff};
  byte GroupOfDTC_OBD[3]={0xff,0xf0,0x00};
  char logName[400] = "";
  char info[1024];
  
  strncat(logName,"1022422_Service_0x14_Valid_Physical_ExtendedSession_Supported_Service_R2",400);
  testCaseDescription("The intent is to verify service ClearDiagnosticInformation (0x14).");
  testCaseTitle("1022422","Service_0x14_Valid_Physical_ExtendedSession_Supported_Service");
  
  SetLog(logName);
  Precondition();

  /******************************以下为测试步骤*********************************/
  
  SessionFlag=APP;

  TestStep("Transition from defaultSession(0x01) to extendedDiagnosticSession(0x03).",TestStepIntervalTime);
  SID10_DiagnosticSessionControl(EXTENDEDSESSION,PHYSICAL,SPRMIB_FALSE);
  CheckPosResponse_SID10(EXTENDEDSESSION,gP2Client_APP,gP2StarClientFor10Check,0,0);
  TestStep("Verify extendedDiagnosticSession.",TestStepIntervalTime);
  CheckCurrentSession(EXTENDEDSESSION,PHYSICAL,0,0);
  
  if(Flag_OBDNode == 1)
  {
    TestStep("Clear All DTCs in emission related ECU",TestStepIntervalTime);
    SID14_ClearDTC(GroupOfDTC_OBD,PHYSICAL);
    //CheckPosResponse_SID14(0,0);
    CheckNegResponse(0x31,0,0);
    return ;
  }
  
  TestStep("Clear DTCs",TestStepIntervalTime);
  SID14_ClearDTC(GroupOfDTC,PHYSICAL);
  CheckPosResponse_SID14(0,0);
  
  TestStep("Verify extendedDiagnosticSession.",TestStepIntervalTime);
  CheckCurrentSession(EXTENDEDSESSION,PHYSICAL,0,0);
  /******************************以上为测试步骤*********************************/
  Postcondition();
   
}
 

/// <APP_CommonServiceTest>
testcase Service_0x14_Valid_Functional_DefaultSession_Supported_Service()
{
  char logPath[400] = "";
  byte ExpectNRC[1]={0x31};
  byte GroupOfDTC[3]={0xff,0xff,0xff};
  byte GroupOfDTC_OBD[3]={0xff,0xf0,0x00};
  char logName[400] = "";
  char info[1024];
  
  strncat(logName,"1022423_Service_0x14_Valid_Functional_DefaultSession_Supported_Service_R2",400);
  testCaseDescription("The intent is to verify service ClearDiagnosticInformation (0x14).");
  testCaseTitle("1022423","Service_0x14_Valid_Functional_DefaultSession_Supported_Service");
  if(gBusFlag==3)
	{
		testStepWarning("Test","This test case does not apply to the LIN bus");
		return;
	}
  SetLog(logName);
  Precondition();

  /******************************以下为测试步骤*********************************/
  
  SessionFlag=APP;
  
//  if(CheckOBDNode() == 1)
//  {
//    TestStep("Clear DTCs",TestStepIntervalTime);
//    SID14_ClearDTC(GroupOfDTC,FUNCTIONAL);
//    //CheckPosResponse_SID14(0,0);
//    CheckNegResponse(ExpectNRC,0,1);
//    
//    return ;
//  }
  
  //TestStep("Verify default session",TestStepIntervalTime);
  
  SID10_DiagnosticSessionControl(DEFAULTSESSION,PHYSICAL,SPRMIB_FALSE);
  CheckPosResponse_SID10(DEFAULTSESSION,gP2Client_APP,gP2StarClientFor10Check,0,0);
  
  TestStep("Clear All DTCs in emission related ECU",TestStepIntervalTime);
  SID14_ClearDTC(GroupOfDTC_OBD,PHYSICAL);
  if(Flag_OBDNode == 1)
  {
    CheckPosResponse_SID14(0,0);
  }
  else 
  {
    CheckNegResponse(0x31,0,0);
  }
  
  TestStep("Clear All DTCs",TestStepIntervalTime);
  SID14_ClearDTC(GroupOfDTC,FUNCTIONAL);
  CheckPosResponse_SID14(0,0);
  TestStep("Verify defaultSession",TestStepIntervalTime);
  CheckCurrentSession(DEFAULTSESSION,PHYSICAL,0,0);
  /******************************以上为测试步骤*********************************/
  Postcondition();
   
}
 
/// <APP_CommonServiceTest>
testcase Service_0x14_Valid_Functional_ExtendedSession_Supported_Service()
{
  char logPath[400] = "";
  byte ExpectNRC[1]={0x31};
  byte GroupOfDTC[3]={0xff,0xff,0xff};
  byte GroupOfDTC_OBD[3]={0xff,0xf0,0x00};
  char logName[400] = "";
  char info[1024];
  
  strncat(logName,"1022424_Service_0x14_Valid_Functional_ExtendedSession_Supported_Service_R2",400);
  testCaseDescription("The intent is to verify service ClearDiagnosticInformation (0x14).");
  testCaseTitle("1022424","Service_0x14_Valid_Functional_ExtendedSession_Supported_Service");
  if(gBusFlag==3)
	{
		testStepWarning("Test","This test case does not apply to the LIN bus");
		return;
	}
  SetLog(logName);
  Precondition();

  /******************************以下为测试步骤*********************************/
  
  SessionFlag=APP;
  
  TestStep("Transition from defaultSession(0x01) to extendedDiagnosticSession(0x03).",TestStepIntervalTime);
  SID10_DiagnosticSessionControl(EXTENDEDSESSION,PHYSICAL,SPRMIB_FALSE);
  CheckPosResponse_SID10(EXTENDEDSESSION,gP2Client_APP,gP2StarClientFor10Check,0,0);
  
//  if(CheckOBDNode() == 1)
//  {
//    TestStep("Clear DTCs",TestStepIntervalTime);
//    SID14_ClearDTC(GroupOfDTC,FUNCTIONAL);
//    //CheckPosResponse_SID14(0,0);
//    CheckNegResponse(ExpectNRC,0,1);
//    
//    return ;
//  }
  TestStep("Verify extendedDiagnosticSession.",TestStepIntervalTime);
  CheckCurrentSession(EXTENDEDSESSION,PHYSICAL,0,0);
  
  TestStep("Clear All DTCs in emission related ECU",TestStepIntervalTime);
  SID14_ClearDTC(GroupOfDTC_OBD,PHYSICAL);
  if(Flag_OBDNode == 1)
  {
    CheckPosResponse_SID14(0,0);
  }
  else 
  {
    CheckNegResponse(0x31,0,0);
  }
  
  TestStep("Clear DTCs",TestStepIntervalTime);
  SID14_ClearDTC(GroupOfDTC,FUNCTIONAL);
  CheckPosResponse_SID14(0,0);
  TestStep("Verify extendedDiagnosticSession.",TestStepIntervalTime);
  CheckCurrentSession(EXTENDEDSESSION,PHYSICAL,0,0);
  /******************************以上为测试步骤*********************************/
  Postcondition();
   
}
 
/// <APP_CommonServiceTest>
testcase Service_0x19_Sf0x02_Valid_Physical_DefaultSession_Supported_Service()
{
  int i;
  char logName[400] = "";
  char info[1024];
  
  strncat(logName,"1350878_Service_0x19_Sf0x02_Valid_Physical_DefaultSession_Supported_Service_R2",400);
  testCaseDescription("The intent is to verify that the service ReadDTCInformation (0x19) and its subfunction reportDTCByStatusMask (0x02) is supported.");
  testCaseTitle("1350878","Service_0x19_Sf0x02_Valid_Physical_DefaultSession_Supported_Service");
  
  SetLog(logName);
  Precondition();

  /******************************以下为测试步骤*********************************/
  
  SessionFlag=APP;
  
  if(Flag_1902 == 0)
  {
    TestStepWarning("ECU doesn't support this subfunction , test case exit!");
    Postcondition();
     
    return;
  }

  for(i=0; i<=0xff; i++)
  {
    if(i==0)
    {
      TestStep("Let DS(DTC ststus mask)=0x00",TestStepIntervalTime);
    }
    else
    {
      TestStep("If DS<0xFF,let DS=DS+1,jump to step2",TestStepIntervalTime,2);
    }
    
    TestStep("Report DTCs",TestStepIntervalTime);
    SID19_Sub02_ReportDTCByStatusMask(i,PHYSICAL);
    CheckPosResponse_SID19_02(0xFF,0,0);
    StorageDTC();
    CheckDTCState(i);
    testWaitForTimeout(100);
  }
  TestStep("Verify defaultSession",TestStepIntervalTime);
  CheckCurrentSession(DEFAULTSESSION,PHYSICAL,0,0);
  /******************************以上为测试步骤*********************************/
  Postcondition();
   
}
 
/// <APP_CommonServiceTest>
testcase Service_0x19_Sf0x02_Valid_Physical_ExtendedSession_Supported_Service()
{
  int i;
  char logName[400] = "";
  char info[1024];
  
  strncat(logName,"1350879_Service_0x19_Sf0x02_Valid_Physical_ExtendedSession_Supported_Service_R2",400);
  testCaseDescription("The intent is to verify that the service ReadDTCInformation (0x19) and its subfunction reportDTCByStatusMask (0x02) is supported.");
  testCaseTitle("1350879","Service_0x19_Sf0x02_Valid_Physical_ExtendedSession_Supported_Service");
  
  SetLog(logName);
  Precondition();

  /******************************以下为测试步骤*********************************/
  
  SessionFlag=APP;
  
  if(Flag_1902 == 0)
  {
    TestStepWarning("ECU doesn't support this subfunction , test case exit!");
    Postcondition();
     
    return;
  }
  
  TestStep("Transition from defaultSession(0x01) to extendedDiagnosticSession(0x03).",TestStepIntervalTime);
  SID10_DiagnosticSessionControl(EXTENDEDSESSION,PHYSICAL,SPRMIB_FALSE);
  CheckPosResponse_SID10(EXTENDEDSESSION,gP2Client_APP,gP2StarClientFor10Check,0,0);
  TestStep("Verify extendedDiagnosticSession.",TestStepIntervalTime);
  CheckCurrentSession(EXTENDEDSESSION,PHYSICAL,0,0);
  
  for(i=0; i<=0xff; i++)
  {
    if(i==0)
    {
      TestStep("Let DS(DTC ststus mask)=0x00",TestStepIntervalTime);
    }
    else
    {
      TestStep("If DS<0xFF,let DS=DS+1,jump to step4",TestStepIntervalTime,4);
    }
    
    TestStep("Report DTCs",TestStepIntervalTime);
    SID19_Sub02_ReportDTCByStatusMask(i,PHYSICAL);
    CheckPosResponse_SID19_02(0xFF,0,0);
    StorageDTC();
    CheckDTCState(i);
    testWaitForTimeout(100);
  }
  TestStep("Verify extendedDiagnosticSession.",TestStepIntervalTime);
  CheckCurrentSession(EXTENDEDSESSION,PHYSICAL,0,0);
  /******************************以上为测试步骤*********************************/
  Postcondition();
   
}
 
/// <APP_CommonServiceTest>
testcase Service_0x19_Sf0x02_Valid_Functional_DefaultSession_Supported_Service()
{
  int i;
  char logName[400] = "";
  char info[1024];
  
  strncat(logName,"1350880_Service_0x19_Sf0x02_Valid_Functional_DefaultSession_Supported_Service_R2",400);
  testCaseDescription("That the ECU supports the service ReadDTCInformation (0x19) and its subfunction reportDTCByStatusMask (0x02) with different DTCStatusMasks.?  The DTCStatusAvailabilityMask in the response from the ECU will be verified to be correct according to configured database.?  Plausibility check of the statusmask in the response (statusOfDTC) from each DTC will be performed.");
  testCaseTitle("1350880","Service_0x19_Sf0x02_Valid_Functional_DefaultSession_Supported_Service");
  if(gBusFlag==3)
	{
		testStepWarning("Test","This test case does not apply to the LIN bus");
		return;
	}
  SetLog(logName);
  Precondition();

  /******************************以下为测试步骤*********************************/
  
  SessionFlag=APP;
  
  if(Flag_1902 == 0)
  {
    TestStepWarning("ECU doesn't support this subfunction , test case exit!");
    Postcondition();
     
    return;
  }
  
  for(i=0; i<=0xff; i++)
  {
    if(i==0)
    {
      TestStep("Let DS(DTC ststus mask)=0x00",TestStepIntervalTime);
    }
    else
    {
      TestStep("If DS<0xFF,let DS=DS+1,jump to step2",TestStepIntervalTime,2);
    }
    
    TestStep("Report DTCs",TestStepIntervalTime);
    SID19_Sub02_ReportDTCByStatusMask(i,FUNCTIONAL);
    CheckPosResponse_SID19_02(0xFF,0,0);
    StorageDTC();
    CheckDTCState(i);
    testWaitForTimeout(100);
  }
  TestStep("Verify defaultSession",TestStepIntervalTime);
  CheckCurrentSession(DEFAULTSESSION,PHYSICAL,0,0);
  /******************************以上为测试步骤*********************************/
  Postcondition();
   
}
 
/// <DiagnosticService_Common>
/// <APP_CommonServiceTest>
testcase Service_0x19_Sf0x02_Valid_Functional_ExtendedSession_Supported_Service()
{
  int i;
  char logName[400] = "";
  char info[1024];
  
  strncat(logName,"1350881_Service_0x19_Sf0x02_Valid_Functional_ExtendedSession_Supported_Service_R2",400);
  testCaseDescription("The intent is to verify that the service ReadDTCInformation (0x19) and its subfunction reportDTCByStatusMask (0x02) is supported.");
  testCaseTitle("1350881","Service_0x19_Sf0x02_Valid_Functional_ExtendedSession_Supported_Service");
  if(gBusFlag==3)
	{
		testStepWarning("Test","This test case does not apply to the LIN bus");
		return;
	}
  SetLog(logName);
  Precondition();

  /******************************以下为测试步骤*********************************/
  
  SessionFlag=APP;
  
  if(Flag_1902 == 0)
  {
    TestStepWarning("ECU doesn't support this subfunction , test case exit!");
    Postcondition();
     
    return;
  }
  
  TestStep("Transition from defaultSession(0x01) to extendedDiagnosticSession(0x03).",TestStepIntervalTime);
  SID10_DiagnosticSessionControl(EXTENDEDSESSION,PHYSICAL,SPRMIB_FALSE);
  CheckPosResponse_SID10(EXTENDEDSESSION,gP2Client_APP,gP2StarClientFor10Check,0,0);
  TestStep("Verify extendedDiagnosticSession.",TestStepIntervalTime);
  CheckCurrentSession(EXTENDEDSESSION,PHYSICAL,0,0);
  
  for(i=0; i<=0xff; i++)
  {
    if(i==0)
    {
      TestStep("Let DS(DTC ststus mask)=0x00",TestStepIntervalTime);
    }
    else
    {
      TestStep("If DS<0xFF,let DS=DS+1,jump to step4",TestStepIntervalTime,4);
    }
    
    TestStep("Report DTCs",TestStepIntervalTime);
    SID19_Sub02_ReportDTCByStatusMask(i,FUNCTIONAL);
    CheckPosResponse_SID19_02(0xFF,0,0);
    StorageDTC();
    CheckDTCState(i);
    testWaitForTimeout(100);
  }
  TestStep("Verify extendedDiagnosticSession.",TestStepIntervalTime);
  CheckCurrentSession(EXTENDEDSESSION,PHYSICAL,0,0);
  /******************************以上为测试步骤*********************************/
  Postcondition();
   
}
/// <APP_CommonServiceTest>
testcase Service_0x19_Sf0x03_0x04_Valid_Physical_DefaultSession_Supported_Service()
{
  byte DTC[3];
  int i,j;
  char logName[400] = "";
  char info[1024];
  
  strncat(logName,"1350882_Service_0x19_Sf0x03_0x04_Valid_Physical_DefaultSession_Supported_Service_R2",400);
  testCaseDescription("The intent of the test is to verify that service ReadDTCInformation (0x19) and subfunction reportDTCSnapshotIdentification (0x03) and reportDTCSnapshotRecordByDTCNumber (0x04) is supported. ");
  testCaseTitle("1350882","Service_0x19_Sf0x03_0x04_Valid_Physical_DefaultSession_Supported_Service");
  
  SetLog(logName);
  Precondition();

  /******************************以下为测试步骤*********************************/
  
  SessionFlag=APP;
  
  if(Flag_1904 == 0)
  {
    TestStepWarning("ECU doesn't support this subfunction , test case exit!");
    Postcondition();
    return;
  }

  TestStep("Report DTCs",TestStepIntervalTime);
  SID19_Sub02_ReportDTCByStatusMask(0x27,PHYSICAL);
  CheckPosResponse_SID19_02(AvailiableMask,0,0);
  Rss1=gTpRxLength;
  if(Rss1<=3)
  {
    TestStepWarning("No avalible DTC,Test end");
    Postcondition();
    return;
  }
  //write("The number of storaged DTC is %d",Ndtc);
  TestStep("report DTC snapshot identification",TestStepIntervalTime);
  SID19_Sub03_ReportDTCSnapshotIdentification(PHYSICAL);
  CheckPosResponse_SID19_03(0,0);
  if(StorageDTCSnapshotData()>0)
  {
    for(i=0; i<NdtcSD; i++)
    {
      if(i==0)
      {
        TestStep("Let DX DY DZ = First DTC from the array of supported DTCs from configured list.",TestStepIntervalTime);
      }
      else
      {
        TestStep(" let DX DY DZ= next DTC, jump to step 3.",TestStepIntervalTime,3);
      }
      DTC[0]=DTCSnapshotDataREC[i].DTCNumber[0];
      DTC[1]=DTCSnapshotDataREC[i].DTCNumber[1];
      DTC[2]=DTCSnapshotDataREC[i].DTCNumber[2];
      TestStep("report DTC snapshot record by DTC number",TestStepIntervalTime);
      SID19_Sub04_ReportDTCSnapshotRecordByDTCNumber(DTC,DTCSnapshotDataREC[i].DTCSnapshotRecordNum,PHYSICAL);
      CheckPosResponse_SID19_04(DTC,0,0);
    }
  }


  TestStep("Verify defaultSession",TestStepIntervalTime);
  CheckCurrentSession(DEFAULTSESSION,PHYSICAL,0,0);
  /******************************以上为测试步骤*********************************/
   Postcondition();
   
}
 
/// <APP_CommonServiceTest>
testcase Service_0x19_Sf0x03_0x04_Valid_Physical_ExtendedSession_Supported_Service()
{
  byte DTC[3];
  int i,j;
  char logName[400] = "";
  char info[1024];
  
  strncat(logName,"1350883_Service_0x19_Sf0x03_0x04_Valid_Physical_ExtendedSession_Supported_Service_R2",400);
  testCaseDescription("The intent of the test is to verify that service ReadDTCInformation (0x19) and subfunction reportDTCSnapshotIdentification (0x03) and reportDTCSnapshotRecordByDTCNumber (0x04) is supported.");
  testCaseTitle("1350883","Service_0x19_Sf0x03_0x04_Valid_Physical_ExtendedSession_Supported_Service");
  
  SetLog(logName);
  Precondition();

  /******************************以下为测试步骤*********************************/
  
  SessionFlag=APP;
  
  if(Flag_1904 == 0)
  {
    TestStepWarning("ECU doesn't support this subfunction , test case exit!");
    Postcondition();
     
    return;
  }
  
  TestStep("Transition from defaultSession(0x01) to extendedDiagnosticSession(0x03).",TestStepIntervalTime);
  SID10_DiagnosticSessionControl(EXTENDEDSESSION,PHYSICAL,SPRMIB_FALSE);
  CheckPosResponse_SID10(EXTENDEDSESSION,gP2Client_APP,gP2StarClientFor10Check,0,0);
  TestStep("Verify extendedDiagnosticSession.",TestStepIntervalTime);
  CheckCurrentSession(EXTENDEDSESSION,PHYSICAL,0,0);
  TestStep("Report DTCs",TestStepIntervalTime);
  SID19_Sub02_ReportDTCByStatusMask(0x27,PHYSICAL);
  CheckPosResponse_SID19_02(AvailiableMask,0,0);

  Rss1=gTpRxLength;
  if(Rss1<=3)
  {
    TestStepWarning("No avalible DTC,Test end");
    Postcondition();
    return;
  }
  //write("The number of storaged DTC is %d",Ndtc);
  TestStep("report DTC snapshot identification",TestStepIntervalTime);
  SID19_Sub03_ReportDTCSnapshotIdentification(PHYSICAL);
  CheckPosResponse_SID19_03(0,0);
  if(StorageDTCSnapshotData()>0)
  {
    for(i=0; i<NdtcSD; i++)
    {
      if(i==0)
      {
        TestStep("Let DX DY DZ = First DTC from the array of supported DTCs from configured list.",TestStepIntervalTime);
      }
      else
      {
        TestStep(" let DX DY DZ= next DTC, jump to step 3.",TestStepIntervalTime,3);
      }
      DTC[0]=DTCSnapshotDataREC[i].DTCNumber[0];
      DTC[1]=DTCSnapshotDataREC[i].DTCNumber[1];
      DTC[2]=DTCSnapshotDataREC[i].DTCNumber[2];
      TestStep("report DTC snapshot record by DTC number",TestStepIntervalTime);
      SID19_Sub04_ReportDTCSnapshotRecordByDTCNumber(DTC,DTCSnapshotDataREC[i].DTCSnapshotRecordNum,PHYSICAL);
      CheckPosResponse_SID19_04(DTC,0,0);
    }
  }
  TestStep("Verify extendedDiagnosticSession.",TestStepIntervalTime);
  CheckCurrentSession(EXTENDEDSESSION,PHYSICAL,0,0);
  /******************************以上为测试步骤*********************************/
   Postcondition();
   
}
/// <APP_CommonServiceTest>
testcase Service_0x19_Sf0x03_0x04_Valid_Functional_DefaultSession_Supported_Service()
{
  byte DTC[3];
  int i,j;
  char logName[400] = "";
  char info[1024];
  
  strncat(logName,"1350884_Service_0x19_Sf0x03_0x04_Valid_Functional_DefaultSession_Supported_Service",400);
  testCaseDescription("The intent of the test is to verify that service ReadDTCInformation (0x19) and subfunction reportDTCSnapshotIdentification (0x03) and reportDTCSnapshotRecordByDTCNumber (0x04) is supported. ");
  testCaseTitle("1350884","Service_0x19_Sf0x03_0x04_Valid_Functional_DefaultSession_Supported_Service");
  if(gBusFlag==3)
	{
		testStepWarning("Test","This test case does not apply to the LIN bus");
		return;
	}
  SetLog(logName);
  Precondition();

  /******************************以下为测试步骤*********************************/
  
  SessionFlag=APP;
  
  if(Flag_1904 == 0)
  {
    TestStepWarning("ECU doesn't support this subfunction , test case exit!");
    Postcondition();
    return;
  }

  TestStep("Report DTCs",TestStepIntervalTime);
  SID19_Sub02_ReportDTCByStatusMask(0x27,PHYSICAL);
  CheckPosResponse_SID19_02(AvailiableMask,0,0);

  Rss1=gTpRxLength;
  if(Rss1<=3)
  {
    TestStepWarning("No avalible DTC,Test end");
    Postcondition();
    return;
  }
  //write("The number of storaged DTC is %d",Ndtc);
  TestStep("report DTC snapshot identification",TestStepIntervalTime);
  SID19_Sub03_ReportDTCSnapshotIdentification(FUNCTIONAL);
  CheckPosResponse_SID19_03(0,0);
  if(StorageDTCSnapshotData()>0)
  {
    for(i=0; i<NdtcSD; i++)
    {
      if(i==0)
      {
        TestStep("Let DX DY DZ = First DTC from the array of supported DTCs from configured list.",TestStepIntervalTime);
      }
      else
      {
        TestStep(" let DX DY DZ= next DTC, jump to step 3.",TestStepIntervalTime,3);
      }
      DTC[0]=DTCSnapshotDataREC[i].DTCNumber[0];
      DTC[1]=DTCSnapshotDataREC[i].DTCNumber[1];
      DTC[2]=DTCSnapshotDataREC[i].DTCNumber[2];
      TestStep("report DTC snapshot record by DTC number",TestStepIntervalTime);
      SID19_Sub04_ReportDTCSnapshotRecordByDTCNumber(DTC,DTCSnapshotDataREC[i].DTCSnapshotRecordNum,FUNCTIONAL);
      CheckPosResponse_SID19_04(DTC,0,0);
    }
  }

  TestStep("Verify defaultSession",TestStepIntervalTime);
  CheckCurrentSession(DEFAULTSESSION,PHYSICAL,0,0);
  /******************************以上为测试步骤*********************************/
   Postcondition();
   
}
/// <APP_CommonServiceTest>
testcase Service_0x19_Sf0x03_0x04_Valid_Functional_ExtendedSession_Supported_Service()
{
  byte DTC[3];
  int i,j;
  char logName[400] = "";
  char info[1024];
  
  strncat(logName,"1350885_Service_0x19_Sf0x03_0x04_Valid_Functional_ExtendedSession_Supported_Service",400);
  testCaseDescription("The intent of the test is to verify that service ReadDTCInformation (0x19) and subfunction reportDTCSnapshotIdentification (0x03) and reportDTCSnapshotRecordByDTCNumber (0x04) is supported.");
  testCaseTitle("1350885","Service_0x19_Sf0x03_0x04_Valid_Functional_ExtendedSession_Supported_Service");
  if(gBusFlag==3)
	{
		testStepWarning("Test","This test case does not apply to the LIN bus");
		return;
	}
  SetLog(logName);
  Precondition();

  /******************************以下为测试步骤*********************************/
  
  SessionFlag=APP;
  
  if(Flag_1904 == 0)
  {
    TestStepWarning("ECU doesn't support this subfunction , test case exit!");
    Postcondition();
     
    return;
  }
  
  TestStep("Transition from defaultSession(0x01) to extendedDiagnosticSession(0x03).",TestStepIntervalTime);
  SID10_DiagnosticSessionControl(EXTENDEDSESSION,PHYSICAL,SPRMIB_FALSE);
  CheckPosResponse_SID10(EXTENDEDSESSION,gP2Client_APP,gP2StarClientFor10Check,0,0);
  TestStep("Verify extendedDiagnosticSession.",TestStepIntervalTime);
  CheckCurrentSession(EXTENDEDSESSION,PHYSICAL,0,0);
  TestStep("Report DTCs",TestStepIntervalTime);
  SID19_Sub02_ReportDTCByStatusMask(0x27,PHYSICAL);
  CheckPosResponse_SID19_02(AvailiableMask,0,0);

  Rss1=gTpRxLength;
  if(Rss1<=3)
  {
    TestStepWarning("No avalible DTC,Test end");
    Postcondition();
    return;
  }
  //write("The number of storaged DTC is %d",Ndtc);
  TestStep("report DTC snapshot identification",TestStepIntervalTime);
  SID19_Sub03_ReportDTCSnapshotIdentification(FUNCTIONAL);
  CheckPosResponse_SID19_03(0,0);
  if(StorageDTCSnapshotData()>0)
  {
    for(i=0; i<NdtcSD; i++)
    {
      if(i==0)
      {
        TestStep("Let DX DY DZ = First DTC from the array of supported DTCs from configured list.",TestStepIntervalTime);
      }
      else
      {
        TestStep(" let DX DY DZ= next DTC, jump to step 3.",TestStepIntervalTime,3);
      }
      DTC[0]=DTCSnapshotDataREC[i].DTCNumber[0];
      DTC[1]=DTCSnapshotDataREC[i].DTCNumber[1];
      DTC[2]=DTCSnapshotDataREC[i].DTCNumber[2];
      TestStep("report DTC snapshot record by DTC number",TestStepIntervalTime);
      SID19_Sub04_ReportDTCSnapshotRecordByDTCNumber(DTC,DTCSnapshotDataREC[i].DTCSnapshotRecordNum,FUNCTIONAL);
      CheckPosResponse_SID19_04(DTC,0,0);
    }
  }
  TestStep("Verify extendedDiagnosticSession.",TestStepIntervalTime);
  CheckCurrentSession(EXTENDEDSESSION,PHYSICAL,0,0);
  /******************************以上为测试步骤*********************************/
   Postcondition();
   
}
/// <APP_CommonServiceTest>
testcase Service_0x19_Sf0x06_Valid_Physical_DefaultSession_Supported_Service()
{
  byte DTC[3];
  int i,j;
  char logName[400] = "";
  char info[1024];
  
  strncat(logName,"1350886_Service_0x19_Sf0x06_Valid_Physical_DefaultSession_Supported_Service",400);
  testCaseDescription("The intent is to verify that the service ReadDTCInformation (0x19) with the subfunction reportDTCExtendedDataRecordByDTCNumber is supported.");
  testCaseTitle("1350886","Service_0x19_Sf0x06_Valid_Physical_DefaultSession_Supported_Service");
  
  SetLog(logName);
  Precondition();

  /******************************以下为测试步骤*********************************/
  
  SessionFlag=APP;
  
  if(Flag_1906 == 0)
  {
    TestStepWarning("ECU doesn't support this subfunction , test case exit!");
    Postcondition();   
    return;
  }
  
  TestStep("Report DTCs",TestStepIntervalTime);
  SID19_Sub02_ReportDTCByStatusMask(0x27,PHYSICAL);
  CheckPosResponse_SID19_02(AvailiableMask,0,0);
  StorageDTC();
  Rss1=gTpRxLength;
  if(Rss1<=3)
  {
    TestStepWarning("No avalible DTC,Test end");
    Postcondition();
    return;
  }
  
  for(i=0; i<Ndtc; i++)
  {
    if(i==0)
    {
      TestStep("Let DX DY DZ = First DTC from the array of supported DTCs from configured list.",TestStepIntervalTime);
    }
    else
    {
      TestStep(" let DX DY DZ= next DTC, jump to step 2.",TestStepIntervalTime,2);
    }
    DTC[0]=recdtc[i].DTCNumber[0];
    DTC[1]=recdtc[i].DTCNumber[1];
    DTC[2]=recdtc[i].DTCNumber[2];
    
    for(j=0;j<gnum_of_extended_record_num;j++)
    {
      if(j == 0) { TestStep("report DTC extended data record by DTC number(Except 0xFF)",TestStepIntervalTime); }
      SID19_Sub06_ReportDTCExtendedDataRecordByDTCNumber(DTC,gdtc_extended_record_num[j],PHYSICAL);
      CheckPosResponse_SID19_06(DTC,0,0);
    }
    
    TestStep("report DTC extended data record by DTC number",TestStepIntervalTime);
    SID19_Sub06_ReportDTCExtendedDataRecordByDTCNumber(DTC,0xFF,PHYSICAL);
    CheckPosResponse_SID19_06(DTC,0,0);
    //checkExtenddata();检查每一个DTCExtDataRecordNumber下的数据长度是否正确
  }
  TestStep("Verify defaultSession",TestStepIntervalTime);
  CheckCurrentSession(DEFAULTSESSION,PHYSICAL,0,0);
  /******************************以上为测试步骤*********************************/
  Postcondition();
   
}
/// <APP_CommonServiceTest>
testcase Service_0x19_Sf0x06_Valid_Physical_ExtendedSession_Supported_Service()
{
  byte DTC[3];
  int i,j;
  char logName[400] = "";
  char info[1024];
  
  strncat(logName,"1350887_Service_0x19_Sf0x06_Valid_Physical_ExtendedSession_Supported_Service",400);
  testCaseDescription("The intent is to verify that the service ReadDTCInformation (0x19) with the subfunction reportDTCExtendedDataRecordByDTCNumber is supported.");
  testCaseTitle("1350887","Service_0x19_Sf0x06_Valid_Physical_ExtendedSession_Supported_Service");
  
  SetLog(logName);
  Precondition();

  /******************************以下为测试步骤*********************************/
  
  SessionFlag=APP;
  
  if(Flag_1906 == 0)
  {
    TestStepWarning("ECU doesn't support this subfunction , test case exit!");
    Postcondition();
     
    return;
  }
  
  TestStep("Transition from defaultSession(0x01) to extendedDiagnosticSession(0x03).",TestStepIntervalTime);
  SID10_DiagnosticSessionControl(EXTENDEDSESSION,PHYSICAL,SPRMIB_FALSE);
  CheckPosResponse_SID10(EXTENDEDSESSION,gP2Client_APP,gP2StarClientFor10Check,0,0);
  TestStep("Verify extendedDiagnosticSession.",TestStepIntervalTime);
  CheckCurrentSession(EXTENDEDSESSION,PHYSICAL,0,0);
  
  TestStep("Report DTCs",TestStepIntervalTime);
  SID19_Sub02_ReportDTCByStatusMask(0x27,PHYSICAL);
  CheckPosResponse_SID19_02(AvailiableMask,0,0);
  StorageDTC();
  Rss1=gTpRxLength;
  if(Rss1<=3)
  {
    TestStepWarning("No avalible DTC,Test end");
    Postcondition();
    return;
  }
  for(i=0; i<Ndtc; i++)
  {
    if(i==0)
    {
      TestStep("Let DX DY DZ = First DTC from the array of supported DTCs from configured list.",TestStepIntervalTime);
    }
    else
    {
      TestStep(" let DX DY DZ= next DTC, jump to step 4.",TestStepIntervalTime,4);
    }
    DTC[0]=recdtc[i].DTCNumber[0];
    DTC[1]=recdtc[i].DTCNumber[1];
    DTC[2]=recdtc[i].DTCNumber[2];
    
    for(j=0;j<gnum_of_extended_record_num;j++)
    {
      if(j == 0) { TestStep("report DTC extended data record by DTC number(Except 0xFF)",TestStepIntervalTime); }
      SID19_Sub06_ReportDTCExtendedDataRecordByDTCNumber(DTC,gdtc_extended_record_num[j],PHYSICAL);
      CheckPosResponse_SID19_06(DTC,0,0);
    }
    
    TestStep("report DTC extended data record by DTC number",TestStepIntervalTime);
    SID19_Sub06_ReportDTCExtendedDataRecordByDTCNumber(DTC,0xFF,PHYSICAL);
    CheckPosResponse_SID19_06(DTC,0,0);
    //checkExtenddata();检查每一个DTCExtDataRecordNumber下的数据长度是否正确
  }
  TestStep("Verify extendedDiagnosticSession.",TestStepIntervalTime);
  CheckCurrentSession(EXTENDEDSESSION,PHYSICAL,0,0);
  /******************************以上为测试步骤*********************************/
  Postcondition();
   
}
 
/// <APP_CommonServiceTest>
testcase Service_0x19_Sf0x06_Valid_Functional_DefaultSession_Supported_Service()
{
  byte DTC[3];
  int i,j;
  char logName[400] = "";
  char info[1024];
  
  strncat(logName,"1350888_Service_0x19_Sf0x06_Valid_Functional_DefaultSession_Supported_Service",400);
  testCaseDescription("The intent is to verify that the service ReadDTCInformation (0x19) with the subfunction reportDTCExtendedDataRecordByDTCNumber is supported.");
  testCaseTitle("1350888","Service_0x19_Sf0x06_Valid_Functional_DefaultSession_Supported_Service");
  if(gBusFlag==3)
	{
		testStepWarning("Test","This test case does not apply to the LIN bus");
		return;
	}
  SetLog(logName);
  Precondition();

  /******************************以下为测试步骤*********************************/
  
  SessionFlag=APP;
  
  if(Flag_1906 == 0)
  {
    TestStepWarning("ECU doesn't support this subfunction , test case exit!");
    Postcondition();   
    return;
  }
  
  TestStep("Report DTCs",TestStepIntervalTime);
  SID19_Sub02_ReportDTCByStatusMask(0x27,PHYSICAL);
  CheckPosResponse_SID19_02(AvailiableMask,0,0);
  StorageDTC();
  Rss1=gTpRxLength;
  if(Rss1<=3)
  {
    TestStepWarning("No avalible DTC,Test end");
    Postcondition();
    return;
  }
  
  for(i=0; i<Ndtc; i++)
  {
    if(i==0)
    {
      TestStep("Let DX DY DZ = First DTC from the array of supported DTCs from configured list.",TestStepIntervalTime);
    }
    else
    {
      TestStep(" let DX DY DZ= next DTC, jump to step 2.",TestStepIntervalTime,2);
    }
    DTC[0]=recdtc[i].DTCNumber[0];
    DTC[1]=recdtc[i].DTCNumber[1];
    DTC[2]=recdtc[i].DTCNumber[2];
    
    for(j=0;j<gnum_of_extended_record_num;j++)
    {
      if(j == 0) { TestStep("report DTC extended data record by DTC number(Except 0xFF)",TestStepIntervalTime); }
      SID19_Sub06_ReportDTCExtendedDataRecordByDTCNumber(DTC,gdtc_extended_record_num[j],PHYSICAL);
      CheckPosResponse_SID19_06(DTC,0,0);
    }
    
    TestStep("report DTC extended data record by DTC number",TestStepIntervalTime);
    SID19_Sub06_ReportDTCExtendedDataRecordByDTCNumber(DTC,0xFF,FUNCTIONAL);
    CheckPosResponse_SID19_06(DTC,0,0);
    //checkExtenddata();检查每一个DTCExtDataRecordNumber下的数据长度是否正确
  }
  TestStep("Verify defaultSession",TestStepIntervalTime);
  CheckCurrentSession(DEFAULTSESSION,PHYSICAL,0,0);
  /******************************以上为测试步骤*********************************/
  Postcondition();
   
}
/// <APP_CommonServiceTest>
testcase Service_0x19_Sf0x06_Valid_Functional_ExtendedSession_Supported_Service()
{
  byte DTC[3];
  int i,j;
  char logName[400] = "";
  char info[1024];
  
  strncat(logName,"1350889_Service_0x19_Sf0x06_Valid_Functional_ExtendedSession_Supported_Service",400);
  testCaseDescription("The intent is to verify that the service ReadDTCInformation (0x19) with the subfunction reportDTCExtendedDataRecordByDTCNumber is supported.");
  testCaseTitle("1350889","Service_0x19_Sf0x06_Valid_Functional_ExtendedSession_Supported_Service");
  if(gBusFlag==3)
	{
		testStepWarning("Test","This test case does not apply to the LIN bus");
		return;
	}
  SetLog(logName);
  Precondition();

  /******************************以下为测试步骤*********************************/
  
  SessionFlag=APP;
  
  if(Flag_1906 == 0)
  {
    TestStepWarning("ECU doesn't support this subfunction , test case exit!");
    Postcondition();
     
    return;
  }
  
  TestStep("Transition from defaultSession(0x01) to extendedDiagnosticSession(0x03).",TestStepIntervalTime);
  SID10_DiagnosticSessionControl(EXTENDEDSESSION,PHYSICAL,SPRMIB_FALSE);
  CheckPosResponse_SID10(EXTENDEDSESSION,gP2Client_APP,gP2StarClientFor10Check,0,0);
  TestStep("Verify extendedDiagnosticSession.",TestStepIntervalTime);
  CheckCurrentSession(EXTENDEDSESSION,PHYSICAL,0,0);
  
  TestStep("Report DTCs",TestStepIntervalTime);
  SID19_Sub02_ReportDTCByStatusMask(0x27,PHYSICAL);
  CheckPosResponse_SID19_02(AvailiableMask,0,0);
  StorageDTC();
  Rss1=gTpRxLength;
  if(Rss1<=3)
  {
    TestStepWarning("No avalible DTC,Test end");
    Postcondition();
    return;
  }
  for(i=0; i<Ndtc; i++)
  {
    if(i==0)
    {
      TestStep("Let DX DY DZ = First DTC from the array of supported DTCs from configured list.",TestStepIntervalTime);
    }
    else
    {
      TestStep(" let DX DY DZ= next DTC, jump to step 4.",TestStepIntervalTime,4);
    }
    DTC[0]=recdtc[i].DTCNumber[0];
    DTC[1]=recdtc[i].DTCNumber[1];
    DTC[2]=recdtc[i].DTCNumber[2];
    
    for(j=0;j<gnum_of_extended_record_num;j++)
    {
      if(j == 0) { TestStep("report DTC extended data record by DTC number(Except 0xFF)",TestStepIntervalTime); }
      SID19_Sub06_ReportDTCExtendedDataRecordByDTCNumber(DTC,gdtc_extended_record_num[j],PHYSICAL);
      CheckPosResponse_SID19_06(DTC,0,0);
    }
    
    TestStep("report DTC extended data record by DTC number",TestStepIntervalTime);
    SID19_Sub06_ReportDTCExtendedDataRecordByDTCNumber(DTC,0xFF,FUNCTIONAL);
    CheckPosResponse_SID19_06(DTC,0,0);
    //checkExtenddata();检查每一个DTCExtDataRecordNumber下的数据长度是否正确
  }
  TestStep("Verify extendedDiagnosticSession.",TestStepIntervalTime);
  CheckCurrentSession(EXTENDEDSESSION,PHYSICAL,0,0);
  /******************************以上为测试步骤*********************************/
  Postcondition();
   
}
/// <APP_CommonServiceTest>
testcase Service_0x19_Sf0x0A_Valid_Physical_DefaultSession_Supported_Service()
{
  char logName[400] = "";
  char info[1024];
  
  strncat(logName,"1350890_Service_0x19_Sf0x0A_Valid_Physical_DefaultSession_Supported_Service",400);
  testCaseDescription("The intent is to verify that service 0x19 with subfunction 0x0A is supported."); 
  testCaseTitle("1350890","Service_0x19_Sf0x0A_Valid_Physical_DefaultSession_Supported_Service");
  
  SetLog(logName);
  Precondition();

  /******************************以下为测试步骤*********************************/
  
  SessionFlag=APP;
  
  if(Flag_190A == 0)
  {
    TestStepWarning("ECU doesn't support this subfunction , test case exit!");
    Postcondition();
    return;
  }
  
  TestStep("read supported DTC information",TestStepIntervalTime);
  SID19_Sub0A_ReportSupportDTC(PHYSICAL);
  CheckPosResponse_SID19_0A(AvailiableMask,0,0);
  StorageDTC();
  Cmpwithsupdtc(NumofDTC);
  CheckAvalibleDTCState(0xFF);
  TestStep("Verify defaultSession",TestStepIntervalTime);
  CheckCurrentSession(DEFAULTSESSION,PHYSICAL,0,0);
  /******************************以上为测试步骤*********************************/
  Postcondition();
   
}
 
/// <APP_CommonServiceTest>
testcase Service_0x19_Sf0x0A_Valid_Physical_ExtendedSession_Supported_Service()
{
  char logName[400] = "";
  char info[1024];
  
  strncat(logName,"1350891_Service_0x19_Sf0x0A_Valid_Physical_ExtendedSession_Supported_Service",400);
  testCaseDescription("The intent is to verify that service 0x19 with subfunction 0x0A is supported.");
  testCaseTitle("1350891","Service_0x19_Sf0x0A_Valid_Physical_ExtendedSession_Supported_Service");
  
  SetLog(logName);
  Precondition();

  /******************************以下为测试步骤*********************************/
  
  SessionFlag=APP;
  
  if(Flag_190A == 0)
  {
    TestStepWarning("ECU doesn't support this subfunction , test case exit!");
    Postcondition();
    return;
  }
  
  TestStep("Transition from defaultSession(0x01) to extendedDiagnosticSession(0x03).",TestStepIntervalTime);
  SID10_DiagnosticSessionControl(EXTENDEDSESSION,PHYSICAL,SPRMIB_FALSE);
  CheckPosResponse_SID10(EXTENDEDSESSION,gP2Client_APP,gP2StarClientFor10Check,0,0);
  TestStep("Verify extendedDiagnosticSession.",TestStepIntervalTime);
  CheckCurrentSession(EXTENDEDSESSION,PHYSICAL,0,0);
  TestStep("read supported DTC information",TestStepIntervalTime);
  SID19_Sub0A_ReportSupportDTC(PHYSICAL);
  CheckPosResponse_SID19_0A(AvailiableMask,0,0);
  StorageDTC();
  Cmpwithsupdtc(NumofDTC);
  CheckAvalibleDTCState(0xFF);
  TestStep("Verify extendedDiagnosticSession.",TestStepIntervalTime);
  CheckCurrentSession(EXTENDEDSESSION,PHYSICAL,0,0);
  /******************************以上为测试步骤*********************************/
  Postcondition();
   
}
 
/// <APP_CommonServiceTest>
testcase Service_0x19_Sf0x0A_Valid_Functional_DefaultSession_Supported_Service()
{
  char logName[400] = "";
  char info[1024];
  
  strncat(logName,"1350892_Service_0x19_Sf0x0A_Valid_Functional_DefaultSession_Supported_Service",400);
  testCaseDescription("The intent is to verify that service 0x19 with subfunction 0x0A is supported.");
  testCaseTitle("1350892","Service_0x19_Sf0x0A_Valid_Functional_DefaultSession_Supported_Service");
  if(gBusFlag==3)
	{
		testStepWarning("Test","This test case does not apply to the LIN bus");
		return;
	}
  SetLog(logName);
  Precondition();

  /******************************以下为测试步骤*********************************/
  
  SessionFlag=APP;
  
  if(Flag_190A == 0)
  {
    TestStepWarning("ECU doesn't support this subfunction , test case exit!");
    Postcondition(); 
    return;
  }
  
  TestStep("read supported DTC information",TestStepIntervalTime);
  SID19_Sub0A_ReportSupportDTC(FUNCTIONAL);
  CheckPosResponse_SID19_0A(AvailiableMask,0,0);
  StorageDTC();
  Cmpwithsupdtc(NumofDTC);
  CheckAvalibleDTCState(0xFF);
  TestStep("Verify defaultSession",TestStepIntervalTime);
  CheckCurrentSession(DEFAULTSESSION,PHYSICAL,0,0);
  /******************************以上为测试步骤*********************************/
  Postcondition();
   
}
 
/// <APP_CommonServiceTest>
testcase Service_0x19_Sf0x0A_Valid_Functional_ExtendedSession_Supported_Service()
{
  char logName[400] = "";
  char info[1024];
  
  strncat(logName,"1350893_Service_0x19_Sf0x0A_Valid_Functional_ExtendedSession_Supported_Service",400); 
  testCaseDescription("The intent is to verify that service 0x19 with subfunction 0x0A is supported.");
  testCaseTitle("1350893","Service_0x19_Sf0x0A_Valid_Functional_ExtendedSession_Supported_Service");
  if(gBusFlag==3)
	{
		testStepWarning("Test","This test case does not apply to the LIN bus");
		return;
	}
  SetLog(logName);
  Precondition();

  /******************************以下为测试步骤*********************************/
  
  SessionFlag=APP;
  
  if(Flag_190A == 0)
  {
    TestStepWarning("ECU doesn't support this subfunction , test case exit!");
    Postcondition();
    return;
  }
  
  TestStep("Transition from defaultSession(0x01) to extendedDiagnosticSession(0x03).",TestStepIntervalTime);
  SID10_DiagnosticSessionControl(EXTENDEDSESSION,PHYSICAL,SPRMIB_FALSE);
  CheckPosResponse_SID10(EXTENDEDSESSION,gP2Client_APP,gP2StarClientFor10Check,0,0);
  
  TestStep("Verify extendedDiagnosticSession.",TestStepIntervalTime);
  CheckCurrentSession(EXTENDEDSESSION,PHYSICAL,0,0);
  
  TestStep("read supported DTC information",TestStepIntervalTime);
  SID19_Sub0A_ReportSupportDTC(FUNCTIONAL);
  CheckPosResponse_SID19_0A(AvailiableMask,0,0);
  StorageDTC();
  Cmpwithsupdtc(NumofDTC);
  CheckAvalibleDTCState(0xFF);
  TestStep("Verify extendedDiagnosticSession.",TestStepIntervalTime);
  CheckCurrentSession(EXTENDEDSESSION,PHYSICAL,0,0);
  /******************************以上为测试步骤*********************************/
  Postcondition();
   
}

/// <APP_CommonServiceTest>
testcase Sercice_0x19_Sf0x15_Valid_Physical_DefaultSession_Supported_Service()
{
  byte DTC1[2000];
  byte DTC2[2000];
  int  DTC1Lenth;
  int  DTC2Lenth;
  int  i;
  int  Flag=0;
  int  IntroStatus;
  char logName[400] = "";
  char info[1024];
  byte GroupOfDTC[3]={0xff,0xff,0xff};
  
  strncat(logName,"1350894_Sercice_0x19_Sf0x15_Valid_Physical_DefaultSession_Supported_Service",400);
  testCaseDescription("The intent is to verify that service 0x19 with subfunction 0x15 is supported.");
  testCaseTitle("1350894","Sercice_0x19_Sf0x15_Valid_Physical_DefaultSession_Supported_Service");
  
  SetLog(logName);
  Precondition();

  /******************************以下为测试步骤*********************************/
  
  SessionFlag=APP;
  
  if(Flag_1915 == 0)
  {
    TestStepWarning("ECU doesn't support this subfunction , test case exit!");
    Postcondition();
     
    return;
  }
  
  TestStep("Read DTC With Permanent Status",TestStepIntervalTime);
  SID19_Sub15_ReportDTCWithPermanentStatus(PHYSICAL);
  CheckPosResponse_SID19_15(AvailiableMask,0,0);
  StorageDTC();
  for(i=0; i<(gTpRxLength-3)/4; i++)
  {
    DTC1[3*i]=gTpRxData[i*4+3];
    DTC1[3*i+1]=gTpRxData[i*4+4];
    DTC1[3*i+2]=gTpRxData[i*4+5];
  }
  DTC1Lenth=(gTpRxLength-3)/4;
  TestStep("Clear DTCs",TestStepIntervalTime);
  SID14_ClearDTC(GroupOfDTC,FUNCTIONAL);
  CheckPosResponse_SID14(0,0);
  
  TestStep("Read DTC With Permanent Status",TestStepIntervalTime);
  SID19_Sub15_ReportDTCWithPermanentStatus(PHYSICAL);
  CheckPosResponse_SID19_15(0xff,0,0);
  StorageDTC();
  for(i=0; i<(gTpRxLength-3)/4; i++)
  {
    DTC2[3*i]=gTpRxData[i*4+3];
    DTC2[3*i+1]=gTpRxData[i*4+4];
    DTC2[3*i+2]=gTpRxData[i*4+5];
  }
  DTC2Lenth=(gTpRxLength-3)/4;
  for(i=1; i<DTC1Lenth*3; i++)
  {
    if(DTC1[i]==DTC2[i])
      Flag=1;
  }
  if(DTC1Lenth!=DTC2Lenth||Flag!=1)
    TestStepFail("Fail","The DTC change");
  TestStep("Verify defaultSession.",TestStepIntervalTime);
  CheckCurrentSession(DEFAULTSESSION,PHYSICAL,0,0);
  /******************************以上为测试步骤*********************************/
  Postcondition();
   
}
/// <APP_CommonServiceTest>
testcase Sercice_0x19_Sf0x15_Valid_Functional_DefaultSession_Supported_Service()
{
  byte DTC1[2000];
  byte DTC2[2000];
  int  DTC1Lenth;
  int  DTC2Lenth;
  int  i;
  int  Flag=0;
  int  IntroStatus;
  char logName[400] = "";
  char info[1024];
  byte GroupOfDTC[3]={0xff,0xff,0xff};
  
  strncat(logName,"1350896_Sercice_0x19_Sf0x15_Valid_Functional_DefaultSession_Supported_Service",400); 
  testCaseDescription("The intent is to verify that service 0x19 with subfunction 0x15 is supported.");
  testCaseTitle("1350896","Sercice_0x19_Sf0x15_Valid_Functional_DefaultSession_Supported_Service");
  if(gBusFlag==3)
	{
		testStepWarning("Test","This test case does not apply to the LIN bus");
		return;
	}
  SetLog(logName);
  Precondition();

  /******************************以下为测试步骤*********************************/
  
  SessionFlag=APP;
  
  if(Flag_1915 == 0)
  {
    TestStepWarning("ECU doesn't support this subfunction , test case exit!");
    Postcondition();
     
    return;
  }

  TestStep("Read DTC With Permanent Status",TestStepIntervalTime);
  SID19_Sub15_ReportDTCWithPermanentStatus(PHYSICAL);
  CheckPosResponse_SID19_15(AvailiableMask,0,0);
  for(i=0; i<(gTpRxLength-3)/4; i++)
  {
    DTC1[3*i]=gTpRxData[i*4+3];
    DTC1[3*i+1]=gTpRxData[i*4+4];
    DTC1[3*i+2]=gTpRxData[i*4+5];
  }
  DTC1Lenth=(gTpRxLength-3)/4;
  
  TestStep("Clear DTCs",TestStepIntervalTime);
  SID14_ClearDTC(GroupOfDTC,FUNCTIONAL);
  CheckPosResponse_SID14(0,0); 
  TestStep("Read DTC With Permanent Status",TestStepIntervalTime);
  SID19_Sub15_ReportDTCWithPermanentStatus(FUNCTIONAL);
  CheckPosResponse_SID19_15(0xff,0,0);
  StorageDTC();
  for(i=0; i<(gTpRxLength-3)/4; i++)
  {
    DTC2[3*i]=gTpRxData[i*4+3];
    DTC2[3*i+1]=gTpRxData[i*4+4];
    DTC2[3*i+2]=gTpRxData[i*4+5];
  }
  DTC2Lenth=(gTpRxLength-3)/4;
  for(i=1; i<DTC1Lenth*3; i++)
  {
    if(DTC1[i]==DTC2[i])
      Flag=1;
  }
  if(DTC1Lenth==DTC2Lenth&&Flag==1)
    TestStepPass("Chk","The DTC don't change");
  else
    TestStepFail("Fail","The DTC change");
  TestStep("Verify defaultSession.",TestStepIntervalTime);
  CheckCurrentSession(DEFAULTSESSION,PHYSICAL,0,0);
  /******************************以上为测试步骤*********************************/
  Postcondition();
   
}
/// <APP_CommonServiceTest>
testcase Sercice_0x19_Sf0x15_Valid_Physical_ExtendedSession_Supported_Service()
{
  byte DTC1[2000];
  byte DTC2[2000];
  int  DTC1Lenth;
  int  DTC2Lenth;
  int  i;
  int  Flag=0;
  int  IntroStatus;
  char logName[400] = "";
  char info[1024];
  byte GroupOfDTC[3]={0xff,0xff,0xff};
  
  strncat(logName,"1350895_Sercice_0x19_Sf0x15_Valid_Physical_ExtendedSession_Supported_Service",400);
  testCaseDescription("The intent is to verify that service 0x19 with subfunction 0x15 is supported.");
  testCaseTitle("1350895","Sercice_0x19_Sf0x15_Valid_Physical_ExtendedSession_Supported_Service");
  
  SetLog(logName);
  Precondition();

  /******************************以下为测试步骤*********************************/
  
  SessionFlag=APP;
  
      if(Flag_1915 == 0)
  {
    TestStepWarning("ECU doesn't support this subfunction , test case exit!");
    Postcondition();
     
    return;
  }
  
  TestStep("Transition from defaultSession(0x01) to extendedDiagnosticSession(0x03).",TestStepIntervalTime);
  SID10_DiagnosticSessionControl(EXTENDEDSESSION,PHYSICAL,SPRMIB_FALSE);
  CheckPosResponse_SID10(EXTENDEDSESSION,gP2Client_APP,gP2StarClientFor10Check,0,0);
  TestStep("Verify extendedDiagnosticSession.",TestStepIntervalTime);
  CheckCurrentSession(EXTENDEDSESSION,PHYSICAL,0,0);
  
  TestStep("Read DTC With Permanent Status",TestStepIntervalTime);
  SID19_Sub15_ReportDTCWithPermanentStatus(PHYSICAL);
  CheckPosResponse_SID19_15(AvailiableMask,0,0);
  StorageDTC();
  for(i=0; i<(gTpRxLength-3)/4; i++)
  {
    DTC1[3*i]=gTpRxData[i*4+3];
    DTC1[3*i+1]=gTpRxData[i*4+4];
    DTC1[3*i+2]=gTpRxData[i*4+5];
  }
  DTC1Lenth=(gTpRxLength-3)/4;
  TestStep("Clear DTCs",TestStepIntervalTime);
  SID14_ClearDTC(GroupOfDTC,FUNCTIONAL);
  CheckPosResponse_SID14(0,0);
  
  TestStep("Read DTC With Permanent Status",TestStepIntervalTime);
  SID19_Sub15_ReportDTCWithPermanentStatus(PHYSICAL);
  CheckPosResponse_SID19_15(0xff,0,0);
  StorageDTC();
  for(i=0; i<(gTpRxLength-3)/4; i++)
  {
    DTC2[3*i]=gTpRxData[i*4+3];
    DTC2[3*i+1]=gTpRxData[i*4+4];
    DTC2[3*i+2]=gTpRxData[i*4+5];
  }
  DTC2Lenth=(gTpRxLength-3)/4;
  for(i=1; i<DTC1Lenth*3; i++)
  {
    if(DTC1[i]==DTC2[i])
      Flag=1;
  }
  if(DTC1Lenth!=DTC2Lenth||Flag!=1)
    TestStepFail("Fail","The DTC change");
  TestStep("Verify extendedSession.",TestStepIntervalTime);
  CheckCurrentSession(EXTENDEDSESSION,PHYSICAL,0,0);
  /******************************以上为测试步骤*********************************/
  Postcondition();
   
}
/// <APP_CommonServiceTest>
testcase Sercice_0x19_Sf0x15_Valid_Functional_ExtendedSession_Supported_Service()
{
  byte DTC1[2000];
  byte DTC2[2000];
  int  DTC1Lenth;
  int  DTC2Lenth;
  int  i;
  int  Flag=0;
  int  IntroStatus;
  char logName[400] = "";
  char info[1024];
  byte GroupOfDTC[3]={0xff,0xff,0xff};
  
  strncat(logName,"1350897_Sercice_0x19_Sf0x15_Valid_Functional_ExtendedSession_Supported_Service",400);
  testCaseDescription("The intent is to verify that service 0x19 with subfunction 0x15 is supported.");
  testCaseTitle("1350897","Sercice_0x19_Sf0x15_Valid_Functional_ExtendedSession_Supported_Service");
  if(gBusFlag==3)
	{
		testStepWarning("Test","This test case does not apply to the LIN bus");
		return;
	}
  SetLog(logName);
  Precondition();

  /******************************以下为测试步骤*********************************/
  
  SessionFlag=APP;
  
  if(Flag_1915 == 0)
  {
    TestStepWarning("ECU doesn't support this subfunction , test case exit!");
    Postcondition();
     
    return;
  }
  
  TestStep("Transition from defaultSession(0x01) to extendedDiagnosticSession(0x03).",TestStepIntervalTime);
  SID10_DiagnosticSessionControl(EXTENDEDSESSION,PHYSICAL,SPRMIB_FALSE);
  CheckPosResponse_SID10(EXTENDEDSESSION,gP2Client_APP,gP2StarClientFor10Check,0,0);
  TestStep("Verify extendedDiagnosticSession.",TestStepIntervalTime);
  CheckCurrentSession(EXTENDEDSESSION,PHYSICAL,0,0);
  TestStep("Read DTC With Permanent Status",TestStepIntervalTime);
  SID19_Sub15_ReportDTCWithPermanentStatus(PHYSICAL);
  CheckPosResponse_SID19_15(AvailiableMask,0,0);
  
  StorageDTC();
  for(i=0; i<(gTpRxLength-3)/4; i++)
  {
    DTC1[3*i]=gTpRxData[i*4+3];
    DTC1[3*i+1]=gTpRxData[i*4+4];
    DTC1[3*i+2]=gTpRxData[i*4+5];
  }
  DTC1Lenth=(gTpRxLength-3)/4;
  TestStep("Clear DTCs",TestStepIntervalTime);
  SID14_ClearDTC(GroupOfDTC,FUNCTIONAL);
  CheckPosResponse_SID14(0,0);
  
  TestStep("Read DTC With Permanent Status",TestStepIntervalTime);
  SID19_Sub15_ReportDTCWithPermanentStatus(FUNCTIONAL);
  CheckPosResponse_SID19_15(0xff,0,0);
  StorageDTC();
  for(i=0; i<(gTpRxLength-3)/4; i++)
  {
    DTC2[3*i]=gTpRxData[i*4+3];
    DTC2[3*i+1]=gTpRxData[i*4+4];
    DTC2[3*i+2]=gTpRxData[i*4+5];
  }
  DTC2Lenth=(gTpRxLength-3)/4;
  for(i=1; i<DTC1Lenth*3; i++)
  {
    if(DTC1[i]==DTC2[i])
      Flag=1;
  }
  if(DTC1Lenth!=DTC2Lenth||Flag!=1)
    TestStepFail("Fail","The DTC change");
  TestStep("Verify extendedSession.",TestStepIntervalTime);
  CheckCurrentSession(EXTENDEDSESSION,PHYSICAL,0,0);
  /******************************以上为测试步骤*********************************/
  Postcondition();
   
}


/// <APP_CommonServiceTest>
testcase Service_0x19_Sf0x55_Valid_Physical_DefaultSession_Supported_Service()
{
  int i;
  char logName[400] = "";
  char info[1024];
  int groupNum=2;
  byte groups[2]={0x30,0x55};
  
  strncat(logName,"1413768_Service_0x19_Sf0x55_Valid_Physical_DefaultSession_Supported_Service_R2",400);
  testCaseDescription("The intent is to verify that the service ReadDTCInformation (0x19) and its subfunction (0x55) is supported.");
  testCaseTitle("1413768","Service_0x19_Sf0x55_Valid_Physical_DefaultSession_Supported_Service_R2");
  
  SetLog(logName);
  Precondition();

  /******************************以下为测试步骤*********************************/
  
  SessionFlag=APP;
  
  if(Flag_1955 == 0)
  {
    TestStepWarning("ECU doesn't support this subfunction , test case exit!");
    Postcondition();
     
    return;
  }

  for(i=0; i<groupNum; i++)
  {
    
    TestStep("Report WWHOBDDTCWithPermanentStatus",TestStepIntervalTime);
    SID19_Sub55(groups[i],PHYSICAL);
    CheckPosResponse_SID19_55(0xFF,groups[i]);
    
    testWaitForTimeout(100);
  }
  TestStep("Verify defaultSession",TestStepIntervalTime);
  CheckCurrentSession(DEFAULTSESSION,PHYSICAL,0,0);
  /******************************以上为测试步骤*********************************/
  Postcondition();
   
}

/// <APP_CommonServiceTest>
testcase Service_0x19_Sf0x55_Valid_Physical_ExtendedSession_Supported_Service()
{
  int i;
  char logName[400] = "";
  char info[1024];
  int groupNum=2;
  byte groups[2]={0x30,0x55};
  
  strncat(logName,"1413767_Service_0x19_Sf0x55_Valid_Physical_ExtendedSession_Supported_Service_R2",400);
  testCaseDescription("The intent is to verify that the service ReadDTCInformation (0x19) and its subfunction  (0x55) is supported.");
  testCaseTitle("1413767","Service_0x19_Sf0x55_Valid_Physical_ExtendedSession_Supported_Service");
  
  SetLog(logName);
  Precondition();

  /******************************以下为测试步骤*********************************/
  
  SessionFlag=APP;
  
  if(Flag_1955 == 0)
  {
    TestStepWarning("ECU doesn't support this subfunction , test case exit!");
    Postcondition();
     
    return;
  }
  
  TestStep("Transition from defaultSession(0x01) to extendedDiagnosticSession(0x03).",TestStepIntervalTime);
  SID10_DiagnosticSessionControl(EXTENDEDSESSION,PHYSICAL,SPRMIB_FALSE);
  CheckPosResponse_SID10(EXTENDEDSESSION,gP2Client_APP,gP2StarClientFor10Check,0,0);
  TestStep("Verify extendedDiagnosticSession.",TestStepIntervalTime);
  CheckCurrentSession(EXTENDEDSESSION,PHYSICAL,0,0);
  
  for(i=0; i<groupNum; i++)
  {
    
    TestStep("Report WWHOBDDTCWithPermanentStatus",TestStepIntervalTime);
    SID19_Sub55(groups[i],PHYSICAL);
    CheckPosResponse_SID19_55(0xFF,groups[i]);
    
    testWaitForTimeout(100);
  }
  
 
  TestStep("Verify extendedDiagnosticSession.",TestStepIntervalTime);
  CheckCurrentSession(EXTENDEDSESSION,PHYSICAL,0,0);
  /******************************以上为测试步骤*********************************/
  Postcondition();
   
}

/// <APP_CommonServiceTest>
testcase Service_0x19_Sf0x55_Valid_Functional_DefaultSession_Supported_Service()
{
  int i;
  char logName[400] = "";
  char info[1024];
  int groupNum=2;
  byte groups[2]={0x30,0x55};
  
  strncat(logName,"1413769_Service_0x19_Sf0x55_Valid_Functional_DefaultSession_Supported_Service_R2",400);
  testCaseDescription("The intent is to verify that the service ReadDTCInformation (0x19) and its subfunction (0x55) is supported.");
  testCaseTitle("1413769","Service_0x19_Sf0x55_Valid_Functional_DefaultSession_Supported_Service_R2");
  
  SetLog(logName);
  Precondition();

  /******************************以下为测试步骤*********************************/
  
  SessionFlag=APP;
  
  if(Flag_1955 == 0)
  {
    TestStepWarning("ECU doesn't support this subfunction , test case exit!");
    Postcondition();
     
    return;
  }

  for(i=0; i<groupNum; i++)
  {
    
    TestStep("Report WWHOBDDTCWithPermanentStatus",TestStepIntervalTime);
    SID19_Sub55(groups[i],FUNCTIONAL);
    CheckPosResponse_SID19_55(0xFF,groups[i]);
    
    testWaitForTimeout(100);
  }
  TestStep("Verify defaultSession",TestStepIntervalTime);
  CheckCurrentSession(DEFAULTSESSION,PHYSICAL,0,0);
  /******************************以上为测试步骤*********************************/
  Postcondition();
   
}
/// <APP_CommonServiceTest>
testcase Service_0x19_Sf0x55_Valid_Functional_ExtendedSession_Supported_Service()
{
  int i;
  char logName[400] = "";
  char info[1024];
  int groupNum=2;
  byte groups[2]={0x30,0x55};
  
  strncat(logName,"1413770_Service_0x19_Sf0x55_Valid_Functional_ExtendedSession_Supported_Service_R2",400);
  testCaseDescription("The intent is to verify that the service ReadDTCInformation (0x19) and its subfunction  (0x55) is supported.");
  testCaseTitle("1413770","Service_0x19_Sf0x55_Valid_Functional_ExtendedSession_Supported_Service");
  
  SetLog(logName);
  Precondition();

  /******************************以下为测试步骤*********************************/
  
  SessionFlag=APP;
  
  if(Flag_1955 == 0)
  {
    TestStepWarning("ECU doesn't support this subfunction , test case exit!");
    Postcondition();
     
    return;
  }
  
  TestStep("Transition from defaultSession(0x01) to extendedDiagnosticSession(0x03).",TestStepIntervalTime);
  SID10_DiagnosticSessionControl(EXTENDEDSESSION,PHYSICAL,SPRMIB_FALSE);
  CheckPosResponse_SID10(EXTENDEDSESSION,gP2Client_APP,gP2StarClientFor10Check,0,0);
  TestStep("Verify extendedDiagnosticSession.",TestStepIntervalTime);
  CheckCurrentSession(EXTENDEDSESSION,PHYSICAL,0,0);
  
  for(i=0; i<groupNum; i++)
  {
    
    TestStep("Report WWHOBDDTCWithPermanentStatus",TestStepIntervalTime);
    SID19_Sub55(groups[i],FUNCTIONAL);
    CheckPosResponse_SID19_55(0xFF,groups[i]);
    
    testWaitForTimeout(100);
  }
  
 
  TestStep("Verify extendedDiagnosticSession.",TestStepIntervalTime);
  CheckCurrentSession(EXTENDEDSESSION,PHYSICAL,0,0);
  /******************************以上为测试步骤*********************************/
  Postcondition();
   
}






/// <APP_CommonServiceTest>
testcase Service_0x22_0x2E_Valid_Physical_DefultSession_Supported_Service()
{
  int  i;
  byte PID[2];
  int code;
  byte ExpectNRC[1]={0x22};
  int  Result;
  char TemDescription[500];
  char Description[5000];
  int DesFlag;
  char Description2[5000];
  int DesFlag2;
  char Description1[5000];
  int DesFlag1;
  char logName[400] = "";
  char info[1024];
  
  strncat(logName,"1350898_Service_0x22_0x2E_Valid_Physical_DefultSession_Supported_Service_R2",400);
  testCaseDescription("The intent of the test is to verify the services ReadDataByIdentifier (0x22) and WriteDataByIdentifier (0x2E).");
  testCaseTitle("1350898","Service_0x22_0x2E_Valid_Physical_DefultSession_Supported_Service");
  
  SetLog(logName);
  Precondition();

  /******************************以下为测试步骤*********************************/
  
  SessionFlag=APP;
  
  DesFlag = 0;
  DesFlag2 = 0;
  snprintf(Description,400,"The following DIDs gives wrong length for service 0x22:");
  snprintf(Description2,400,"The following DIDs gives unexpected negative response for service 0x22:");
  TestStep("Let Z1 Z2= First Dataidentifier from configured list.",TestStepIntervalTime);
  
  //添加步骤，在未进行安全解锁的时候发送读安全日志相关的DID，期望回复负相应。
   CheckUnlockReadDID_ResponseNRC(PHYSICAL);
  // 
  for(i=0; i<NumOfReadDIDAPP; i++)
  {
    if(DIDOfReadAPP[i].Flag_Default==0)
    {
      continue;
    }
    PID[0]=DIDOfReadAPP[i].DID>>8;
    PID[1]=DIDOfReadAPP[i].DID&0xFF;
    if((PID[0] == 0xD0)&&(PID[1] == 0x1C))
    {
      continue;
    }
    if((PID[0] == 0xD0)&&(PID[1] == 0x3A))
    {
      continue;
    }
    if((PID[0] == 0xF1)&&(PID[1] == 0x09))
    {
      continue;
    }
    if((PID[0] == 0xF1)&&(PID[1] == 0x0B))
    {
      continue;
    }
    if((PID[0] == 0xF1)&&(PID[1] == 0x0A))
    {
      continue;
    }
    
    if(i!=0)
    {
      TestStep("Jump to Step 2 until all the dataIdentifiers in the configured list are tested. Let Z1 Z2 = next dataIdentifier",TestStepIntervalTime,2);
    }
    
//    if(DIDOfReadAPP[i].SecuLevel!=0xFF)
//    {
//      SID10_DiagnosticSessionControl_Default(PHYSICAL);
//      CheckPosResponse_SID10(0x01,6);
//      
//      testWaitForTimeout(100);
//      
//      SID27_SecurityAccess_RequestSeed(DIDOfReadAPP[i].SecuLevel,PHYSICAL);
//      CheckPosResponse_SID27_ReqSeed(DIDOfReadAPP[i].SecuLevel,5);
//      SID27_SecurityAccess_SendKey(DIDOfReadAPP[i].SecuLevel,PHYSICAL);
//      CheckPosResponse_SID27_SenKey(DIDOfReadAPP[i].SecuLevel,2);
//      
//    }
    TestStep("Read data",TestStepIntervalTime);
    SID22_ReadDataByIdentifier(PID,PHYSICAL);
    Result=CheckPosResponse_SID22(PID,DIDOfReadAPP[i].Lenth,0,0); 
    if(Result>0)
    {
      
      CheckParametersCoding(DIDOfReadAPP[i]);
      if(DIDOfReadAPP[i].Lenth != (gTpRxLength-3))
      {
        DesFlag = 1;
        snprintf(TemDescription,400,"[%02x %02x] ,",PID[0],PID[1]);
        strncat(Description,TemDescription,5000);
        TestStepFail("","Expect lenth is %d but get lenth is %d",DIDOfReadAPP[i].Lenth,gTpRxLength-3);
      }
      else
      {
        TestStepPass("","Expect lenth is %d and get lenth is %d",DIDOfReadAPP[i].Lenth,gTpRxLength-3);
      }
    }
    else
    {
      DesFlag2 = 1;
      snprintf(TemDescription,400,"[%02x %02x] ,",PID[0],PID[1]);
      strncat(Description2,TemDescription,5000);
    }
  }
  
  DesFlag1 = 0;
  snprintf(Description1,400,"The following DIDs gives wrong response for service 0x2E:");
  
  for(i=0;i<NumOfWriteDIDAPP;i++)
  {
    if(DIDOfWriteAPP[i].Flag_Default==0)
    {
      continue;
    }
    PID[0]=DIDOfWriteAPP[i].DID>>8;
    PID[1]=DIDOfWriteAPP[i].DID&0xFF;
    
    if((PID[0] == 0xD0)&&(PID[1] == 0x1C))
    {
      continue;
    }
    if((PID[0] == 0xD0)&&(PID[1] == 0x3A))
    {
      continue;
    }
    if((PID[0] == 0xF1)&&(PID[1] == 0x09))
    {
      continue;
    }
    if((PID[0] == 0xF1)&&(PID[1] == 0x0B))
    {
      continue;
    }
    if((PID[0] == 0xF1)&&(PID[1] == 0x0A))
    {
      continue;
    }
    if(DIDOfWriteAPP[i].SecuLevel!=0xFF)
    {
      SID10_DiagnosticSessionControl(DEFAULTSESSION,PHYSICAL,SPRMIB_FALSE);
      CheckPosResponse_SID10(DEFAULTSESSION,gP2Client_APP,gP2StarClientFor10Check,0,0);
      
      testWaitForTimeout(100);
      
      SID27_SecurityAccess_RequestSeed(DIDOfWriteAPP[i].SecuLevel,PHYSICAL);
      CheckPosResponse_SID27_ReqSeed(DIDOfWriteAPP[i].SecuLevel,gSeedArray,16,0,0);
      SID27_SecurityAccess_SendKey(DIDOfWriteAPP[i].SecuLevel,gKeyArray,PHYSICAL);
      CheckPosResponse_SID27_SenKey(DIDOfWriteAPP[i].SecuLevel,0,0);
    }
    
    SID22_ReadDataByIdentifier(PID,PHYSICAL);
    CheckPosResponse_SID22(PID,DIDOfWriteAPP[i].Lenth,0,0);
    RecordData();
    TestStep("Write data",TestStepIntervalTime);
    WriteTestData(DIDOfWriteAPP[i],PHYSICAL);
    if(CheckNegResponse(ExpectNRC,1,0,0,0)==0)
    {
      DesFlag1 = 1;
      snprintf(TemDescription,400,"[%02x %02x] ,",PID[0],PID[1]);
      strncat(Description1,TemDescription,5000);
      TestStep("The DID is not writable in active session.",TestStepIntervalTime);
      continue;
    }
    TestStep("Read data",TestStepIntervalTime);
    SID22_ReadDataByIdentifier(PID,PHYSICAL);
    CheckPosResponse_SID22(PID,DIDOfWriteAPP[i].Lenth,0,0);
    ComTestData();
    testWaitForTimeout(500);
    
    SID11_ECUReset(HARDRESET,PHYSICAL,SPRMIB_FALSE);
    CheckPosResponse_SID11(HARDRESET,0,0);
    
    ECUinitHandle(0);

    if(DIDOfWriteAPP[i].SecuLevel!=0xFF)
    {
      SID10_DiagnosticSessionControl(DEFAULTSESSION,PHYSICAL,SPRMIB_FALSE);
      CheckPosResponse_SID10(DEFAULTSESSION,gP2Client_APP,gP2StarClientFor10Check,0,0);
      
      testWaitForTimeout(100);
      
      SID27_SecurityAccess_RequestSeed(DIDOfWriteAPP[i].SecuLevel,PHYSICAL);
      CheckPosResponse_SID27_ReqSeed(DIDOfWriteAPP[i].SecuLevel,gSeedArray,16,0,0);
      SID27_SecurityAccess_SendKey(DIDOfWriteAPP[i].SecuLevel,gKeyArray,PHYSICAL);
      CheckPosResponse_SID27_SenKey(DIDOfWriteAPP[i].SecuLevel,0,0);
    }
    
    SID22_ReadDataByIdentifier(PID,PHYSICAL);
    CheckPosResponse_SID22(PID,DIDOfWriteAPP[i].Lenth,0,0);
    ComTestData();
    
    WritePreviousData(PHYSICAL);
    CheckPosResponse_SID2E(PID,0,0);

    //TestStep("Data recover",TestStepIntervalTime);
    SID22_ReadDataByIdentifier(PID,PHYSICAL);
    CheckPosResponse_SID22(PID,DIDOfWriteAPP[i].Lenth,0,0);
  }
  
  if(DesFlag == 1)
  {
   TestStep(Description);
  }
  if(DesFlag1 == 1)
  {
    TestStep(Description1);
  }
  if(DesFlag2 == 1)
  {
    TestStep(Description2);
  }
  TestStep("Verify defaultSession",TestStepIntervalTime);
  CheckCurrentSession(DEFAULTSESSION,PHYSICAL,0,0);
  /******************************以上为测试步骤*********************************/
  Postcondition();
   
}

/// <APP_CommonServiceTest>
testcase Service_0x22_0x2E_Valid_Physical_ExtendedSession_Supported_Service()
{
  int  i;
  byte PID[2];
  int code;
  byte ExpectNRC[1]={0x22};
  int  Result;
  char TemDescription[500];
  char Description[5000];
  int DesFlag;
  char Description2[5000];
  int DesFlag2;
  char Description1[5000];
  int DesFlag1;
  char logName[400] = "";
  char info[1024];
  
  strncat(logName,"1350899_Service_0x22_0x2E_Valid_Physical_ExtendedSession_Supported_Service_R2",400);
  testCaseDescription("The intent of the test is to verify the services ReadDataByIdentifier (0x22) and WriteDataByIdentifier (0x2E).");
  testCaseTitle("1350899","Service_0x22_0x2E_Valid_Physical_ExtendedSession_Supported_Service");
  
  SetLog(logName);
  Precondition();

  /******************************以下为测试步骤*********************************/
  
  SessionFlag=APP;
  
  DesFlag = 0;
  DesFlag2 = 0;
  snprintf(Description,400,"The following DIDs gives wrong length for service 0x22:");
  snprintf(Description2,400,"The following DIDs gives unexpected negative response for service 0x22:");
  
  TestStep("Let Z1 Z2= First Dataidentifier from configured list.",TestStepIntervalTime);
  
  TestStep("Transition from defaultSession(0x01) to extendedDiagnosticSession(0x03).",TestStepIntervalTime);
  SID10_DiagnosticSessionControl(EXTENDEDSESSION,PHYSICAL,SPRMIB_FALSE);
  CheckPosResponse_SID10(EXTENDEDSESSION,gP2Client_APP,gP2StarClientFor10Check,0,0);
  TestStep("Verify extendedDiagnosticSession.",TestStepIntervalTime);
  CheckCurrentSession(EXTENDEDSESSION,PHYSICAL,0,0);
  
  //添加步骤，在未进行安全解锁的时候发送读安全日志相关的DID，期望回复负相应。
   CheckUnlockReadDID_ResponseNRC(PHYSICAL);
  // 
  
  for(i=0; i<NumOfReadDIDAPP; i++)
  {
    if(DIDOfReadAPP[i].Flag_Extended==0)
    {
      continue;
    }
    PID[0]=DIDOfReadAPP[i].DID>>8;
    PID[1]=DIDOfReadAPP[i].DID&0xFF;
    if((PID[0] == 0xD0)&&(PID[1] == 0x1C))
      {
        continue;
      }
    if((PID[0] == 0xD0)&&(PID[1] == 0x3A))
    {
      continue;
    }
    if((PID[0] == 0xF1)&&(PID[1] == 0x09))
    {
      continue;
    }
    if((PID[0] == 0xF1)&&(PID[1] == 0x0B))
    {
      continue;
    }
    if((PID[0] == 0xF1)&&(PID[1] == 0x0A))
    {
      continue;
    }
    
    if(i!=0)
    {
      TestStep("Jump to Step 4 until all the dataIdentifiers in the configured list are tested. Let Z1 Z2 = next dataIdentifier",TestStepIntervalTime,4);
    }
    
      if(DIDOfReadAPP[i].SecuLevel!=0xFF)
      {
        SID10_DiagnosticSessionControl(EXTENDEDSESSION,PHYSICAL,SPRMIB_FALSE);
        CheckPosResponse_SID10(EXTENDEDSESSION,gP2Client_APP,gP2StarClientFor10Check,0,0);
        
        testWaitForTimeout(gTimeWaitForSecuAccess);
        
        SID27_SecurityAccess_RequestSeed(DIDOfReadAPP[i].SecuLevel,PHYSICAL);
        CheckPosResponse_SID27_ReqSeed(DIDOfReadAPP[i].SecuLevel,gSeedArray,16,0,0);
        SID27_SecurityAccess_SendKey(DIDOfReadAPP[i].SecuLevel,gKeyArray,PHYSICAL);
        CheckPosResponse_SID27_SenKey(DIDOfReadAPP[i].SecuLevel,0,0);
      }
    TestStep("Read data",TestStepIntervalTime);
    SID22_ReadDataByIdentifier(PID,PHYSICAL);
    Result=CheckPosResponse_SID22(PID,DIDOfReadAPP[i].Lenth,0,0); 
    if(Result>0)
    {
      CheckParametersCoding(DIDOfReadAPP[i]);
      if(DIDOfReadAPP[i].Lenth != (gTpRxLength-3))
      {
        DesFlag = 1;
        snprintf(TemDescription,400,"[%02x %02x] ,",PID[0],PID[1]);
        strncat(Description,TemDescription,5000);
        TestStepFail("","Expect lenth is %d but get lenth is %d",DIDOfReadAPP[i].Lenth,gTpRxLength-3);
      }
      else
      {
        TestStepPass("","Expect lenth is %d and get lenth is %d",DIDOfReadAPP[i].Lenth,gTpRxLength-3);
      }
    }
    else
    {
      DesFlag2 = 1;
      snprintf(TemDescription,400,"[%02x %02x] ,",PID[0],PID[1]);
      strncat(Description2,TemDescription,5000);
    }
  }
  SID10_DiagnosticSessionControl(EXTENDEDSESSION,PHYSICAL,SPRMIB_FALSE);
  CheckPosResponse_SID10(EXTENDEDSESSION,gP2Client_APP,gP2StarClientFor10Check,0,0);
  DesFlag1 = 0;
  snprintf(Description1,400,"The following DIDs gives wrong response for service 0x2E:");
  
  for(i=0;i<NumOfWriteDIDAPP;i++)
  {
    if(DIDOfWriteAPP[i].Flag_Extended==0)
    {
      continue;
    }
    PID[0]=DIDOfWriteAPP[i].DID>>8;
    PID[1]=DIDOfWriteAPP[i].DID&0xFF;
    if((PID[0] == 0xD0)&&(PID[1] == 0x1C))
    {
      continue;
    }
    if((PID[0] == 0xD0)&&(PID[1] == 0x3A))
    {
      continue;
    }
    if((PID[0] == 0xF1)&&(PID[1] == 0x09))
    {
      continue;
    }
    if((PID[0] == 0xF1)&&(PID[1] == 0x0B))
    {
      continue;
    }
    if((PID[0] == 0xF1)&&(PID[1] == 0x0A))
    {
      continue;
    }
      
    if(DIDOfWriteAPP[i].SecuLevel!=0xFF)
    {
      SID10_DiagnosticSessionControl(EXTENDEDSESSION,PHYSICAL,SPRMIB_FALSE);
      CheckPosResponse_SID10(EXTENDEDSESSION,gP2Client_APP,gP2StarClientFor10Check,0,0);
      
      testWaitForTimeout(gTimeWaitForSecuAccess);
      
      SID27_SecurityAccess_RequestSeed(DIDOfWriteAPP[i].SecuLevel,PHYSICAL);
      CheckPosResponse_SID27_ReqSeed(DIDOfWriteAPP[i].SecuLevel,gSeedArray,16,0,0);
      SID27_SecurityAccess_SendKey(DIDOfWriteAPP[i].SecuLevel,gKeyArray,PHYSICAL);
      CheckPosResponse_SID27_SenKey(DIDOfWriteAPP[i].SecuLevel,0,0);
    }
    
    if( check_DID_is_22_DID(PID)==1)
    {
        SID22_ReadDataByIdentifier(PID,PHYSICAL);
        CheckPosResponse_SID22(PID,DIDOfWriteAPP[i].Lenth,0,0);
        RecordData();
    }
    TestStep("Write data",TestStepIntervalTime);
    WriteTestData(DIDOfWriteAPP[i],PHYSICAL);
    if(CheckNegResponse(ExpectNRC,1,0,0,0)==0)
    {
      TestStep("The DID is not writable in active session.",TestStepIntervalTime);
      continue;
    }
    if( check_DID_is_22_DID(PID)==1)
    {
        TestStep("Read data",TestStepIntervalTime);
        SID22_ReadDataByIdentifier(PID,PHYSICAL);
        CheckPosResponse_SID22(PID,DIDOfWriteAPP[i].Lenth,0,0);
        ComTestData();
    }
    
    testWaitForTimeout(1000);
    
    SID11_ECUReset(HARDRESET,PHYSICAL,SPRMIB_FALSE);
    CheckPosResponse_SID11(HARDRESET,0,0);
    
    ECUinitHandle(0);
    
    SID10_DiagnosticSessionControl(EXTENDEDSESSION,PHYSICAL,SPRMIB_FALSE);
    CheckPosResponse_SID10(EXTENDEDSESSION,gP2Client_APP,gP2StarClientFor10Check,0,0);
    
    if(DIDOfWriteAPP[i].SecuLevel!=0xFF)
    {
    
    testWaitForTimeout(gTimeWaitForSecuAccess);
    
    SID27_SecurityAccess_RequestSeed(DIDOfWriteAPP[i].SecuLevel,PHYSICAL);
    CheckPosResponse_SID27_ReqSeed(DIDOfWriteAPP[i].SecuLevel,gSeedArray,16,0,0);
    SID27_SecurityAccess_SendKey(DIDOfWriteAPP[i].SecuLevel,gKeyArray,PHYSICAL);
    CheckPosResponse_SID27_SenKey(DIDOfWriteAPP[i].SecuLevel,0,0);
    
    }
    
    if( check_DID_is_22_DID(PID)==1)
    {
        SID22_ReadDataByIdentifier(PID,PHYSICAL);
        CheckPosResponse_SID22(PID,DIDOfWriteAPP[i].Lenth,0,0);
    
        ComTestData();
        
        TestStep("Write Previous data",TestStepIntervalTime);
        WritePreviousData(PHYSICAL);
        CheckPosResponse_SID2E(PID,0,0);
    }
    
    
    //TestStep("Data recover",TestStepIntervalTime);
    SID22_ReadDataByIdentifier(PID,PHYSICAL);
    CheckPosResponse_SID22(PID,DIDOfWriteAPP[i].Lenth,0,0);
  }
  
  if(DesFlag == 1)
  {
    TestStep(Description);
  }
  if(DesFlag1 == 1)
  {
    TestStep(Description1);
  }
  if(DesFlag2 == 1)
  {
    TestStep(Description2);
  }
  
  TestStep("Verify extendedDiagnosticSession.",TestStepIntervalTime);
  CheckCurrentSession(EXTENDEDSESSION,PHYSICAL,0,0);
  /******************************以上为测试步骤*********************************/
    Postcondition();
   
}
  
/// <APP_CommonServiceTest>
testcase Service_0x22_0x2E_Valid_Functional_DefultSession_Supported_Service()
{
  int  i;
  byte PID[2];
  int code;
  byte ExpectNRC[1]={0x22};
  int Result;
  char TemDescription[500];
  char Description[5000];
  int DesFlag;
  char Description2[5000];
  int DesFlag2;
  char Description1[5000];
  int DesFlag1;
  char logName[400] = "";
  char info[1024];
  
  strncat(logName,"1350900_Service_0x22_0x2E_Valid_Functional_DefultSession_Supported_Service_R2",400);
  testCaseDescription("The intent of the test is to verify the services ReadDataByIdentifier (0x22) and WriteDataByIdentifier (0x2E).");
  testCaseTitle("1350900","Service_0x22_0x2E_Valid_Functional_DefultSession_Supported_Service");
  if(gBusFlag==3)
	{
		testStepWarning("Test","This test case does not apply to the LIN bus");
		return;
	}
  SetLog(logName);
  Precondition();

  /******************************以下为测试步骤*********************************/
  
  SessionFlag=APP;
  
  DesFlag = 0;
  DesFlag2 = 0;
  snprintf(Description,400,"The following DIDs gives wrong length for service 0x22:");
  snprintf(Description2,400,"The following DIDs gives unexpected negative response for service 0x22:");
  TestStep("Let Z1 Z2= First Dataidentifier from configured list.",TestStepIntervalTime);
  
  //添加步骤，在未进行安全解锁的时候发送读安全日志相关的DID，期望回复负相应。
   CheckUnlockReadDID_ResponseNRC(FUNCTIONAL);
  // 
  
  for(i=0; i<NumOfReadDIDAPP; i++)
  {
    if(DIDOfReadAPP[i].Flag_Default==0)
    {
      continue;
    }
    PID[0]=DIDOfReadAPP[i].DID>>8;
    PID[1]=DIDOfReadAPP[i].DID&0xFF;

    if((PID[0] == 0xD0)&&(PID[1] == 0x1C))
    {
      continue;
    }
    if((PID[0] == 0xD0)&&(PID[1] == 0x3A))
    {
      continue;
    }
    if((PID[0] == 0xF1)&&(PID[1] == 0x09))
    {
      continue;
    }
    if((PID[0] == 0xF1)&&(PID[1] == 0x0B))
    {
      continue;
    }
    if((PID[0] == 0xF1)&&(PID[1] == 0x0A))
    {
      continue;
    }
    if(i!=0)
    {
      TestStep("Jump to Step 2 until all the dataIdentifiers in the configured list are tested. Let Z1 Z2 = next dataIdentifier",TestStepIntervalTime,2);
    }

    TestStep("Read data",TestStepIntervalTime);
    SID22_ReadDataByIdentifier(PID,FUNCTIONAL);
    if((PID[0] == 0xD0)&&(PID[0] == 0x1C))
    {
     testWaitForTimeout(500);
    }
    else
    {
     Result=CheckPosResponse_SID22(PID,DIDOfReadAPP[i].Lenth,0,0); 
    }
    if(Result>0)
    {
    CheckParametersCoding(DIDOfReadAPP[i]);
    if(DIDOfReadAPP[i].Lenth != (gTpRxLength-3))
      {
        DesFlag = 1;
        snprintf(TemDescription,400,"[%02x %02x] ,",PID[0],PID[1]);
        strncat(Description,TemDescription,5000);
      TestStepFail("","Expect lenth is %d but get lenth is %d",DIDOfReadAPP[i].Lenth,gTpRxLength-3);
      }
      else
      {
        TestStepPass("","Expect lenth is %d and get lenth is %d",DIDOfReadAPP[i].Lenth,gTpRxLength-3);
      }
    }
    else
    {
      DesFlag2 = 1;
      snprintf(TemDescription,400,"[%02x %02x] ,",PID[0],PID[1]);
      strncat(Description2,TemDescription,5000);
    }
  }
  
  DesFlag1 = 0;
  snprintf(Description1,400,"The following DIDs gives wrong response for service 0x2E:");
  
  for(i=0;i<NumOfWriteDIDAPP;i++)
  {
      if(DIDOfWriteAPP[i].Flag_Default==0)
      {
        continue;
      }
      PID[0]=DIDOfWriteAPP[i].DID>>8;
      PID[1]=DIDOfWriteAPP[i].DID&0xFF;
      
      if(DIDOfReadAPP[i].SecuLevel!=0xFF)
      {
      SID10_DiagnosticSessionControl(DEFAULTSESSION,PHYSICAL,SPRMIB_FALSE);
      CheckPosResponse_SID10(DEFAULTSESSION,gP2Client_APP,gP2StarClientFor10Check,0,0);
      
      testWaitForTimeout(gTimeWaitForSecuAccess);
      
      SID27_SecurityAccess_RequestSeed(DIDOfWriteAPP[i].SecuLevel,PHYSICAL);
      CheckPosResponse_SID27_ReqSeed(DIDOfWriteAPP[i].SecuLevel,gSeedArray,16,0,0);
      SID27_SecurityAccess_SendKey(DIDOfWriteAPP[i].SecuLevel,gKeyArray,PHYSICAL);
      CheckPosResponse_SID27_SenKey(DIDOfWriteAPP[i].SecuLevel,0,0);
      
      }
      
      SID22_ReadDataByIdentifier(PID,FUNCTIONAL);
      CheckPosResponse_SID22(PID,DIDOfWriteAPP[i].Lenth,0,0);
      RecordData();
      TestStep("Write data",TestStepIntervalTime);
      WriteTestData(DIDOfWriteAPP[i],PHYSICAL);
      if(CheckNegResponse(ExpectNRC,1,0,0,0)==0)
      {
        TestStep("The DID is not writable in active session.",TestStepIntervalTime);
        continue;
      }
      TestStep("Read data",TestStepIntervalTime);
      SID22_ReadDataByIdentifier(PID,PHYSICAL);
      CheckPosResponse_SID22(PID,DIDOfWriteAPP[i].Lenth,0,0);
      ComTestData();
      testWaitForTimeout(1000);

      SID11_ECUReset(HARDRESET,PHYSICAL,SPRMIB_FALSE);
      CheckPosResponse_SID11(HARDRESET,0,0);
      
      ECUinitHandle(0);
      
      SID10_DiagnosticSessionControl(DEFAULTSESSION,PHYSICAL,SPRMIB_FALSE);
      CheckPosResponse_SID10(DEFAULTSESSION,gP2Client_APP,gP2StarClientFor10Check,0,0);
      
      if(DIDOfWriteAPP[i].SecuLevel!=0xFF)
      {
      SID10_DiagnosticSessionControl(DEFAULTSESSION,PHYSICAL,SPRMIB_FALSE);
      CheckPosResponse_SID10(DEFAULTSESSION,gP2Client_APP,gP2StarClientFor10Check,0,0);
      
      testWaitForTimeout(gTimeWaitForSecuAccess);
      
      SID27_SecurityAccess_RequestSeed(DIDOfWriteAPP[i].SecuLevel,PHYSICAL);
      CheckPosResponse_SID27_ReqSeed(DIDOfWriteAPP[i].SecuLevel,gSeedArray,16,0,0);
      SID27_SecurityAccess_SendKey(DIDOfWriteAPP[i].SecuLevel,gKeyArray,PHYSICAL);
      CheckPosResponse_SID27_SenKey(DIDOfWriteAPP[i].SecuLevel,0,0);
      
      }
      
      SID22_ReadDataByIdentifier(PID,PHYSICAL);
      CheckPosResponse_SID22(PID,DIDOfWriteAPP[i].Lenth,0,0);
      
      ComTestData();
      
      WritePreviousData(PHYSICAL);
      CheckPosResponse_SID2E(PID,0,0);

      //TestStep("Data recover",TestStepIntervalTime);
      SID22_ReadDataByIdentifier(PID,PHYSICAL);
      CheckPosResponse_SID22(PID,DIDOfWriteAPP[i].Lenth,0,0);
  }
  
  if(DesFlag == 1)
  {
  TestStep(Description);
  }
  if(DesFlag1 == 1)
  {
  TestStep(Description1);
  }
  if(DesFlag2 == 1)
  {
  TestStep(Description2);
  }
  TestStep("Verify defaultSession",TestStepIntervalTime);
  CheckCurrentSession(DEFAULTSESSION,PHYSICAL,0,0);
  /******************************以上为测试步骤*********************************/
  Postcondition();
   
}
/// <APP_CommonServiceTest>
testcase Service_0x22_0x2E_Valid_Functional_ExtendedSession_Supported_Service()
{
  int  i;
  byte PID[2];
  int code;
  byte ExpectNRC[1]={0x22};
  int  Result;
  char TemDescription[500];
  char Description[5000];
  int DesFlag;
  char Description2[5000];
  int DesFlag2;
  char Description1[5000];
  int DesFlag1;
  char logName[400] = "";
  char info[1024];
  
  strncat(logName,"1350901_Service_0x22_0x2E_Valid_Functional_ExtendedSession_Supported_Service_R2",400);
  testCaseDescription("The intent of the test is to verify the services ReadDataByIdentifier (0x22) and WriteDataByIdentifier (0x2E).");
  testCaseTitle("1350901","Service_0x22_0x2E_Valid_Functional_ExtendedSession_Supported_Service");
  if(gBusFlag==3)
	{
		testStepWarning("Test","This test case does not apply to the LIN bus");
		return;
	}
  SetLog(logName);
  Precondition();

  /******************************以下为测试步骤*********************************/
  
  SessionFlag=APP;
  
  DesFlag = 0;
  DesFlag2 = 0;
  snprintf(Description,400,"The following DIDs gives wrong length for service 0x22:");
  snprintf(Description2,400,"The following DIDs gives unexpected negative response for service 0x22:");
  
  TestStep("Let Z1 Z2= First Dataidentifier from configured list.",TestStepIntervalTime);
  
  TestStep("Transition from defaultSession(0x01) to extendedDiagnosticSession(0x03).",TestStepIntervalTime);
  SID10_DiagnosticSessionControl(EXTENDEDSESSION,PHYSICAL,SPRMIB_FALSE);
  CheckPosResponse_SID10(EXTENDEDSESSION,gP2Client_APP,gP2StarClientFor10Check,0,0);
  TestStep("Verify extendedDiagnosticSession.",TestStepIntervalTime);
  CheckCurrentSession(EXTENDEDSESSION,PHYSICAL,0,0);
  
  //添加步骤，在未进行安全解锁的时候发送读安全日志相关的DID，期望回复负相应。
  CheckUnlockReadDID_ResponseNRC(FUNCTIONAL);
  // 
  
  for(i=0; i<NumOfReadDIDAPP; i++)
  {
    if(DIDOfReadAPP[i].Flag_Extended==0)
    {
      continue;
    }
    PID[0]=DIDOfReadAPP[i].DID>>8;
    PID[1]=DIDOfReadAPP[i].DID&0xFF;
    
    if((PID[0] == 0xD0)&&(PID[1] == 0x1C))
    {
      continue;
    }
    if((PID[0] == 0xD0)&&(PID[1] == 0x3A))
    {
      continue;
    }
    if((PID[0] == 0xF1)&&(PID[1] == 0x09))
    {
      continue;
    }
    if((PID[0] == 0xF1)&&(PID[1] == 0x0B))
    {
      continue;
    }
    if((PID[0] == 0xF1)&&(PID[1] == 0x0A))
    {
      continue;
    }
    
    if(i!=0)
    {
      TestStep("Jump to Step 4 until all the dataIdentifiers in the configured list are tested. Let Z1 Z2 = next dataIdentifier",TestStepIntervalTime,4);
    }
    
    if(DIDOfReadAPP[i].SecuLevel!=0xFF)
    {
      SID10_DiagnosticSessionControl(EXTENDEDSESSION,PHYSICAL,SPRMIB_FALSE);
      CheckPosResponse_SID10(EXTENDEDSESSION,gP2Client_APP,gP2StarClientFor10Check,0,0);
      
      testWaitForTimeout(gTimeWaitForSecuAccess);
      
      SID27_SecurityAccess_RequestSeed(DIDOfReadAPP[i].SecuLevel,PHYSICAL);
      CheckPosResponse_SID27_ReqSeed(DIDOfReadAPP[i].SecuLevel,gSeedArray,16,0,0);
      SID27_SecurityAccess_SendKey(DIDOfReadAPP[i].SecuLevel,gKeyArray,PHYSICAL);
      CheckPosResponse_SID27_SenKey(DIDOfReadAPP[i].SecuLevel,0,0);
    }
    TestStep("Read data",TestStepIntervalTime);
    SID22_ReadDataByIdentifier(PID,FUNCTIONAL);
    if((PID[0] == 0xD0)&&(PID[0] == 0x1C))
    {
     testWaitForTimeout(500);
    }
    else
    {
     Result=CheckPosResponse_SID22(PID,DIDOfReadAPP[i].Lenth,0,0); 
    }
    if(Result>0)
    {
      CheckParametersCoding(DIDOfReadAPP[i]);
      if(DIDOfReadAPP[i].Lenth != (gTpRxLength-3))
      {
        DesFlag = 1;
        snprintf(TemDescription,400,"[%02x %02x] ,",PID[0],PID[1]);
        strncat(Description,TemDescription,5000);
        TestStepFail("","Expect lenth is %d but get lenth is %d",DIDOfReadAPP[i].Lenth,gTpRxLength-3);
      }
      else
      {
        TestStepPass("","Expect lenth is %d and get lenth is %d",DIDOfReadAPP[i].Lenth,gTpRxLength-3);
      }
    }
    else
    {
      DesFlag2 = 1;
      snprintf(TemDescription,400,"[%02x %02x] ,",PID[0],PID[1]);
      strncat(Description2,TemDescription,5000);
    }
  }
  
  DesFlag1 = 0;
  snprintf(Description1,400,"The following DIDs gives wrong response for service 0x2E:");
  
  for(i=0;i<NumOfWriteDIDAPP;i++)
  {
    if(DIDOfWriteAPP[i].Flag_Extended==0)
    {
      continue;
    }
    PID[0]=DIDOfWriteAPP[i].DID>>8;
    PID[1]=DIDOfWriteAPP[i].DID&0xFF;
    if((PID[0] == 0xD0)&&(PID[1] == 0x1C))
    {
      continue;
    }
    if((PID[0] == 0xD0)&&(PID[1] == 0x3A))
    {
      continue;
    }
    if((PID[0] == 0xF1)&&(PID[1] == 0x09))
    {
      continue;
    }
    if((PID[0] == 0xF1)&&(PID[1] == 0x0B))
    {
      continue;
    }
    if((PID[0] == 0xF1)&&(PID[1] == 0x0A))
    {
      continue;
    }
    
    if(DIDOfWriteAPP[i].SecuLevel!=0xFF)
    {
      SID10_DiagnosticSessionControl(EXTENDEDSESSION,PHYSICAL,SPRMIB_FALSE);
      CheckPosResponse_SID10(EXTENDEDSESSION,gP2Client_APP,gP2StarClientFor10Check,0,0);
      
      testWaitForTimeout(gTimeWaitForSecuAccess);
      
      SID27_SecurityAccess_RequestSeed(DIDOfWriteAPP[i].SecuLevel,PHYSICAL);
      CheckPosResponse_SID27_ReqSeed(DIDOfWriteAPP[i].SecuLevel,gSeedArray,16,0,0);
      SID27_SecurityAccess_SendKey(DIDOfWriteAPP[i].SecuLevel,gKeyArray,PHYSICAL);
      CheckPosResponse_SID27_SenKey(DIDOfWriteAPP[i].SecuLevel,0,0);
    }
    
    SID22_ReadDataByIdentifier(PID,FUNCTIONAL);
    CheckPosResponse_SID22(PID,DIDOfWriteAPP[i].Lenth,0,0);
    RecordData();
    TestStep("Write data",TestStepIntervalTime);
    WriteTestData(DIDOfWriteAPP[i],FUNCTIONAL);
    if(CheckNegResponse(ExpectNRC,1,0,0,0)==0)
    {
      TestStep("The DID is not writable in active session.",TestStepIntervalTime);
      continue;
    }
    TestStep("Read data",TestStepIntervalTime);
    SID22_ReadDataByIdentifier(PID,FUNCTIONAL);
    CheckPosResponse_SID22(PID,DIDOfWriteAPP[i].Lenth,0,0);
    ComTestData();
    testWaitForTimeout(1000);
    
    SID11_ECUReset(HARDRESET,PHYSICAL,SPRMIB_FALSE);
    CheckPosResponse_SID11(HARDRESET,0,0);
    
    ECUinitHandle(0);
    
    SID10_DiagnosticSessionControl(EXTENDEDSESSION,PHYSICAL,SPRMIB_FALSE);
    CheckPosResponse_SID10(EXTENDEDSESSION,gP2Client_APP,gP2StarClientFor10Check,0,0);
    
    if(DIDOfWriteAPP[i].SecuLevel!=0xFF)
    {
      testWaitForTimeout(gTimeWaitForSecuAccess);
      
      SID27_SecurityAccess_RequestSeed(DIDOfWriteAPP[i].SecuLevel,PHYSICAL);
      CheckPosResponse_SID27_ReqSeed(DIDOfWriteAPP[i].SecuLevel,gSeedArray,16,0,0);
      SID27_SecurityAccess_SendKey(DIDOfWriteAPP[i].SecuLevel,gKeyArray,PHYSICAL);
      CheckPosResponse_SID27_SenKey(DIDOfWriteAPP[i].SecuLevel,0,0);
    }
    SID22_ReadDataByIdentifier(PID,FUNCTIONAL);
    CheckPosResponse_SID22(PID,DIDOfWriteAPP[i].Lenth,0,0);
    
    ComTestData();
    
    WritePreviousData(FUNCTIONAL);
    CheckPosResponse_SID2E(PID,0,0);
    
    //TestStep("Data recover",TestStepIntervalTime);
    SID22_ReadDataByIdentifier(PID,PHYSICAL);
    CheckPosResponse_SID22(PID,DIDOfWriteAPP[i].Lenth,0,0);
  }
  
  if(DesFlag == 1)
  {
    TestStep(Description);
  }
  if(DesFlag1 == 1)
  {
    TestStep(Description1);
  }
  if(DesFlag2 == 1)
  {
    TestStep(Description2);
  }
  
  TestStep("Verify extendedDiagnosticSession.",TestStepIntervalTime);
  CheckCurrentSession(EXTENDEDSESSION,PHYSICAL,0,0);
  /******************************以上为测试步骤*********************************/
  Postcondition();
   
}
/// <APP_CommonServiceTest>
testcase Sercice_0x23_ReadMemoryByAddress_Supported_DefaultSession_Physical()
{
  int i;
  dword S23DataAddress;
  dword S23DataLength;
  byte AddressByte[4];
  byte LengthByte[4];
  dword offset;
  char logName[400] = "";
  char info[1024];
  byte DID[2];
  word index = 5;
  byte tempStorage;
  
  word Ser23MemorySegmentNum_A=4;
  struct MemoryAddressLength Ser23Memory_A[500];
  
  strncat(logName,"1022413_Sercice_0x23_ReadMemoryByAddress_Supported_DefaultSession_Physical",400);
  testCaseDescription("Verify Service ReadMemoryByAddress (0x23) is supported."); 
  testCaseTitle("1022413","Sercice_0x23_ReadMemoryByAddress_Supported_DefaultSession_Physical");
  
  SetLog(logName);
  Precondition();

  /******************************以下为测试步骤*********************************/
  
  SessionFlag=APP;
  
  tempStorage=Ser23TestAutomated;
  DID[0]=0xD1;
  DID[1]=0x22;
  {
    int result;
    result = CheckDIDSupported(0xD122,DIDOfReadAPP);
    if(result != -1 && Ser23TestAutomated == 0) 
    {
      if(DIDOfReadAPP[result].Flag_Default == 0) { testStepWarning("Warning","0x%X%X can't be read in defaultSession!!!",DID[0],DID[1]); }
      else { Ser23TestAutomated = 1; }
    }
  }
  if(Ser23TestAutomated==1)
  {
    SID22_ReadDataByIdentifier(DID,PHYSICAL);
    if(CheckPosResponse_SID22(DID,0,0)!=2)
    {
      testStepFail("Fail","Read %X%X error,it is a issue",DID[0],DID[1]);
      //Ser23TestAutomated=0;
    }
    else
    {
      if(gTpRxData[4] != 0x14) { testStepFail("Fail","0x%X%X AddressAndLengthFormatIdentifier is %X not 0x14",DID[0],DID[1],gTpRxData[4]); }
      if((gTpRxLength-5)%5==0)
      {
        Ser23MemorySegmentNum_A=gTpRxData[3];
        if(gTpRxLength==(5+Ser23MemorySegmentNum_A*5))
        {
          index=5;
          for(i=0;i<Ser23MemorySegmentNum_A;i++)
          {
            Ser23Memory_A[i].Length=gTpRxData[index];
            Ser23Memory_A[i].Address=gTpRxData[index+1]<<24|gTpRxData[index+2]<<16|gTpRxData[index+3]<<8|gTpRxData[index+4];
            index+=5;
          }
        }
        else
        {
          testStepFail("Fail","%X%X format error",DID[0],DID[1]);
          //Ser23TestAutomated=0;
        }
      }
      else
      {
        testStepFail("Fail","%X%X format error",DID[0],DID[1]);
        //Ser23TestAutomated=0;
      }
    }
    if(Ser23TestAutomated==1)
    {
      for(i=0; i<Ser23MemorySegmentNum_A; i++)
      {
        offset=0;
        do
        {
          S23DataAddress=Ser23Memory_A[i].Address+offset;
          if((Ser23Memory_A[i].Length-offset)>=0xFF)
          {
            S23DataLength=0xFF;
            offset=offset+0xFF;
          }
          else
          {
            S23DataLength=Ser23Memory_A[i].Length-offset;
            offset=offset+S23DataLength;
          }
          
          AddressByte[3]=S23DataAddress;
          AddressByte[2]=S23DataAddress>>8;
          AddressByte[1]=S23DataAddress>>16;
          AddressByte[0]=S23DataAddress>>24;
          
  //        LengthByte[3]=S23DataLength;
  //        LengthByte[2]=S23DataLength>>8;
  //        LengthByte[1]=S23DataLength>>16;
          LengthByte[0]=S23DataLength;
           
          SID23_ReadMemoryByAdress(0x14,AddressByte,LengthByte,PHYSICAL);
          CheckPosResponse_SID23(S23DataLength,0,0);
          write("Ser23Memory_A[i].Length-offset=%x",Ser23Memory_A[i].Length-offset);
           
        }
        while((Ser23Memory_A[i].Length-offset)>0xFF);
      }
    }
  }
  
  if(Ser23AddLen14Supported==1&&Ser23TestAutomated==0)
  {
    for(i=0; i<Ser23MemorySegmentNum; i++)
    {
      offset=0;
      do
      {
        S23DataAddress=Ser23Memory[i].Address+offset;
        if((Ser23Memory[i].Length-offset)>=0xFF)
        {
          S23DataLength=0xFF;
          offset=offset+0xFF;
        }
        else
        {
          S23DataLength=Ser23Memory[i].Length-offset;
          offset=offset+S23DataLength;
        }
        
        AddressByte[3]=S23DataAddress;
        AddressByte[2]=S23DataAddress>>8;
        AddressByte[1]=S23DataAddress>>16;
        AddressByte[0]=S23DataAddress>>24;
        
//        LengthByte[3]=S23DataLength;
//        LengthByte[2]=S23DataLength>>8;
//        LengthByte[1]=S23DataLength>>16;
        LengthByte[0]=S23DataLength;
         
        SID23_ReadMemoryByAdress(0x14,AddressByte,LengthByte,PHYSICAL);
        CheckPosResponse_SID23(S23DataLength,0,0);
        write("Ser23Memory[i].Length-offset=%x",Ser23Memory[i].Length-offset);
         
      }
      while((Ser23Memory[i].Length-offset)>0xFF);
    }
  }
  
  Ser23TestAutomated=tempStorage;
  
  DID[0]=0xD1;
  DID[1]=0x23;
  {
    int result;
    result = CheckDIDSupported(0xD123,DIDOfReadAPP);
    if(result != -1 && Ser23TestAutomated == 0) 
    {
      if(DIDOfReadAPP[result].Flag_Default == 0) { testStepWarning("Warning","0x%X%X can't be read in defaultSession!!!",DID[0],DID[1]); }
      else { Ser23TestAutomated = 1; }
    }
  }
  if(Ser23TestAutomated==1)
  {
    SID22_ReadDataByIdentifier(DID,PHYSICAL);
    if(CheckPosResponse_SID22(DID,0,0)!=2)
    {
      testStepFail("Fail","Read %X%X error",DID[0],DID[1]);
      //Ser23TestAutomated=0;
    }
    else
    {
      if(gTpRxData[4] != 0x24) { testStepFail("Fail","0x%X%X AddressAndLengthFormatIdentifier is %X not 0x24",DID[0],DID[1],gTpRxData[4]); }
      if((gTpRxLength-5)%6==0)
      {
        Ser23MemorySegmentNum_A=gTpRxData[3];
        if(gTpRxLength==(5+Ser23MemorySegmentNum_A*6))
        {
          index=5;
          for(i=0;i<Ser23MemorySegmentNum_A;i++)
          {
            Ser23Memory_A[i].Length=gTpRxData[index]<<8|gTpRxData[index+1];
            Ser23Memory_A[i].Address=gTpRxData[index+2]<<24|gTpRxData[index+3]<<16|gTpRxData[index+4]<<8|gTpRxData[index+5];
            index+=6;
          }
        }
        else
        {
          testStepFail("Fail","%X%X format error",DID[0],DID[1]);
          //Ser23TestAutomated=0;
        }
      }
      else
      {
        testStepFail("Fail","%X%X format error",DID[0],DID[1]);
        //Ser23TestAutomated=0;
      }
    }
    if(Ser23TestAutomated==1)
    {
      for(i=0; i<Ser23MemorySegmentNum_A; i++)
      {
        offset=0;
        do
        {
          S23DataAddress=Ser23Memory_A[i].Address+offset;
          if((Ser23Memory_A[i].Length-offset)>ReadMaxLen)
          {
            S23DataLength=ReadMaxLen;
            offset=offset+ReadMaxLen;
          }
          else
          {
            S23DataLength=Ser23Memory_A[i].Length-offset;
            offset=offset+S23DataLength;
          }
          
          AddressByte[3]=S23DataAddress;
          AddressByte[2]=S23DataAddress>>8;
          AddressByte[1]=S23DataAddress>>16;
          AddressByte[0]=S23DataAddress>>24;
          
        //        LengthByte[3]=S23DataLength;
        //        LengthByte[2]=S23DataLength>>8;
          LengthByte[1]=S23DataLength;
          LengthByte[0]=S23DataLength>>8;
           
          SID23_ReadMemoryByAdress(0x24,AddressByte,LengthByte,PHYSICAL);
          CheckPosResponse_SID23(S23DataLength,0,0);
          write("Ser23Memory[i].Length-offset=%x",Ser23Memory_A[i].Length-offset);
           
        }
        while((Ser23Memory_A[i].Length-offset)>ReadMaxLen);
      }
    }
  }
  
  if(Ser23AddLen24Supported==1&&Ser23TestAutomated==0)
  {
    for(i=0; i<Ser23MemorySegmentNum; i++)
    {
      offset=0;
      do
      {
        S23DataAddress=Ser23Memory[i].Address+offset;
        if((Ser23Memory[i].Length-offset)>ReadMaxLen)
        {
          S23DataLength=ReadMaxLen;
          offset=offset+ReadMaxLen;
        }
        else
        {
          S23DataLength=Ser23Memory[i].Length-offset;
          offset=offset+S23DataLength;
        }
        
        AddressByte[3]=S23DataAddress;
        AddressByte[2]=S23DataAddress>>8;
        AddressByte[1]=S23DataAddress>>16;
        AddressByte[0]=S23DataAddress>>24;
        
//        LengthByte[3]=S23DataLength;
//        LengthByte[2]=S23DataLength>>8;
        LengthByte[1]=S23DataLength;
        LengthByte[0]=S23DataLength>>8;
         
        SID23_ReadMemoryByAdress(0x24,AddressByte,LengthByte,PHYSICAL);
        CheckPosResponse_SID23(S23DataLength,0,0);
        write("Ser23Memory[i].Length-offset=%x",Ser23Memory[i].Length-offset);
         
      }
      while((Ser23Memory[i].Length-offset)>ReadMaxLen);
    }
  }
  
  Ser23TestAutomated=tempStorage;
  
  DID[0]=0xD1;
  DID[1]=0x24;
  {
    int result;
    result = CheckDIDSupported(0xD124,DIDOfReadAPP);
    if(result != -1 && Ser23TestAutomated == 0) 
    {
      if(DIDOfReadAPP[result].Flag_Default == 0) { testStepWarning("Warning","0x%X%X can't be read in defaultSession!!!",DID[0],DID[1]); }
      else { Ser23TestAutomated = 1; }
    }
  }
  if(Ser23TestAutomated==1)
  {
    SID22_ReadDataByIdentifier(DID,PHYSICAL);
    if(CheckPosResponse_SID22(DID,0,0)!=2)
    {
      testStepFail("Fail","Read %X%X error",DID[0],DID[1]);
      //Ser23TestAutomated=0;
    }
    else
    {
      if(gTpRxData[4] != 0x44) { testStepFail("Fail","0x%X%X AddressAndLengthFormatIdentifier is %X not 0x44",DID[0],DID[1],gTpRxData[4]); }
      if((gTpRxLength-5)%6==0)
      {
        Ser23MemorySegmentNum_A=gTpRxData[3];
        if(gTpRxLength==(5+Ser23MemorySegmentNum_A*8))
        {
          index=5;
          for(i=0;i<Ser23MemorySegmentNum_A;i++)
          {
            Ser23Memory_A[i].Length=gTpRxData[index]<<24|gTpRxData[index+1]<<16|gTpRxData[index+2]<<8|gTpRxData[index+3];
            Ser23Memory_A[i].Address=gTpRxData[index+4]<<24|gTpRxData[index+5]<<16|gTpRxData[index+6]<<8|gTpRxData[index+7];
            index+=8;
          }
        }
        else
        {
          testStepFail("Fail","%X%X format error",DID[0],DID[1]);
          //Ser23TestAutomated=0;
        }
      }
      else
      {
        testStepFail("Fail","%X%X format error",DID[0],DID[1]);
        //Ser23TestAutomated=0;
      }
    }
    if(Ser23TestAutomated==1)
    {
      for(i=0; i<Ser23MemorySegmentNum_A; i++)
      {
        offset=0;
        do
        {
          S23DataAddress=Ser23Memory_A[i].Address+offset;
          if((Ser23Memory_A[i].Length-offset)>ReadMaxLen)
          {
            S23DataLength=ReadMaxLen;
            offset=offset+ReadMaxLen;
          }
          else
          {
            S23DataLength=Ser23Memory_A[i].Length-offset;
            offset=offset+S23DataLength;
          }
          
          AddressByte[3]=S23DataAddress;
          AddressByte[2]=S23DataAddress>>8;
          AddressByte[1]=S23DataAddress>>16;
          AddressByte[0]=S23DataAddress>>24;
          
          LengthByte[3]=S23DataLength;
          LengthByte[2]=S23DataLength>>8;
          LengthByte[1]=S23DataLength>>16;
          LengthByte[0]=S23DataLength>>24;
           
          SID23_ReadMemoryByAdress(0x44,AddressByte,LengthByte,PHYSICAL);
          CheckPosResponse_SID23(S23DataLength,0,0);
          write("Ser23Memory[i].Length-offset=%x",Ser23Memory_A[i].Length-offset);

        }
        while((Ser23Memory_A[i].Length-offset)>ReadMaxLen);
      }
    }
  }
  
  if(Ser23AddLen44Supported==1&&Ser23TestAutomated==0)
  {
    for(i=0; i<Ser23MemorySegmentNum; i++)
    {
      offset=0;
      do
      {
        S23DataAddress=Ser23Memory[i].Address+offset;
        if((Ser23Memory[i].Length-offset)>ReadMaxLen)
        {
          S23DataLength=ReadMaxLen;
          offset=offset+ReadMaxLen;
        }
        else
        {
          S23DataLength=Ser23Memory[i].Length-offset;
          offset=offset+S23DataLength;
        }
        
        AddressByte[3]=S23DataAddress;
        AddressByte[2]=S23DataAddress>>8;
        AddressByte[1]=S23DataAddress>>16;
        AddressByte[0]=S23DataAddress>>24;
        
        LengthByte[3]=S23DataLength;
        LengthByte[2]=S23DataLength>>8;
        LengthByte[1]=S23DataLength>>16;
        LengthByte[0]=S23DataLength>>24;
         
        SID23_ReadMemoryByAdress(0x44,AddressByte,LengthByte,PHYSICAL);
        CheckPosResponse_SID23(S23DataLength,0,0);
        write("Ser23Memory[i].Length-offset=%x",Ser23Memory[i].Length-offset);

      }
      while((Ser23Memory[i].Length-offset)>ReadMaxLen);
    }
  }
  
  TestStep("Verify defaultSession(0x01)",TestStepIntervalTime);
  CheckCurrentSession(DEFAULTSESSION,PHYSICAL,0,0);
  /******************************以上为测试步骤*********************************/
  Postcondition();
   
}
/// <APP_CommonServiceTest>
testcase Sercice_0x23_ReadMemoryByAddress_Supported_ExtendedSession_Physical()
{
  int i;
  dword S23DataAddress;
  dword S23DataLength;
  byte AddressByte[4];
  byte LengthByte[4];
  dword offset;
  char logName[400] = "";
  char info[1024];
  byte DID[2];
  word index = 5;
  byte tempStorage;
  
  word Ser23MemorySegmentNum_A=4;
  struct MemoryAddressLength Ser23Memory_A[500];
  
  strncat(logName,"1022414_Sercice_0x23_ReadMemoryByAddress_Supported_ExtendedSession_Physical",400);
  testCaseDescription("Verify Service ReadMemoryByAddress (0x23) is supported.");
  testCaseTitle("1022414","Sercice_0x23_ReadMemoryByAddress_Supported_ExtendedSession_Physical");
  
  SetLog(logName);
//  Precondition();

  /******************************以下为测试步骤*********************************/
  
  SessionFlag=APP;
  
  TestStep("Transition from defaultSession(0x01) to extendedDiagnosticSession(0x03)",TestStepIntervalTime);
  SID10_DiagnosticSessionControl(EXTENDEDSESSION,PHYSICAL,SPRMIB_FALSE);
  CheckPosResponse_SID10(EXTENDEDSESSION,gP2Client_APP,gP2StarClientFor10Check,0,0);
  
  if(Ser23SecurityLevel!=0xFF)
  {
    testWaitForTimeout(gTimeWaitForSecuAccess);
//    TestStep("ECU response with seed. Verify that S1...S16 not equal to 0x000000.",TestStepIntervalTime);
    SID27_SecurityAccess_RequestSeed(Ser23SecurityLevel,PHYSICAL);
    CheckPosResponse_SID27_ReqSeed(Ser23SecurityLevel,gSeedArray,16,0,0);
    PID27_Parameters_Seeds_Chk(NotAllZero,gSeedArray);
    SID27_SecurityAccess_SendKey(Ser23SecurityLevel,gKeyArray,PHYSICAL);
    CheckPosResponse_SID27_SenKey(Ser23SecurityLevel,0,0);
  }
  tempStorage=Ser23TestAutomated;
  if(Ser23AddLen14Supported==1)
  {
        DID[0]=0xD1;
        DID[1]=0x22;
        {
          int result;
          result = CheckDIDSupported(0xD122,DIDOfReadAPP);
          if(result != -1 && Ser23TestAutomated == 0) 
          {
            if(DIDOfReadAPP[result].Flag_Extended == 0) { testStepWarning("Warning","0x%X%X can't be read in extendedSession!!!",DID[0],DID[1]); }
            else 
            { 
              Ser23TestAutomated = 1; 
              if(DIDOfReadAPP[result].SecuLevel != 0xFF && DIDOfReadAPP[result].SecuLevel != Ser23SecurityLevel)
              {
                SID27_SecurityAccess_RequestSeed(DIDOfReadAPP[result].SecuLevel,PHYSICAL);
                CheckPosResponse_SID27_ReqSeed(DIDOfReadAPP[result].SecuLevel,gSeedArray,16,0,0);
                PID27_Parameters_Seeds_Chk(NotAllZero,gSeedArray);
                SID27_SecurityAccess_SendKey(DIDOfReadAPP[result].SecuLevel,gKeyArray,PHYSICAL);
                CheckPosResponse_SID27_SenKey(DIDOfReadAPP[result].SecuLevel,0,0);
              }
            }
          }
        }
        if(Ser23TestAutomated==1)
        {
          SID22_ReadDataByIdentifier(DID,PHYSICAL);
          if(CheckPosResponse_SID22(DID,0,0)!=2)
          {
            testStepFail("Fail","Read %X%X error",DID[0],DID[1]);
            //Ser23TestAutomated=0;
          }
          else
          {
            if(gTpRxData[4] != 0x14) { testStepFail("Fail","0x%X%X AddressAndLengthFormatIdentifier is %X not 0x14",DID[0],DID[1],gTpRxData[4]); }
            if((gTpRxLength-5)%5==0)
            {
              Ser23MemorySegmentNum_A=gTpRxData[3];
              if(1)//(gTpRxLength==(5+Ser23MemorySegmentNum_A*5))
              {
                index=5;
                for(i=0;i<Ser23MemorySegmentNum_A;i++)
                {
                  Ser23Memory_A[i].Length=gTpRxData[index];
                  Ser23Memory_A[i].Address=gTpRxData[index+1]<<24|gTpRxData[index+2]<<16|gTpRxData[index+3]<<8|gTpRxData[index+4];
                  index+=5;
                }
              }
              else
              {
                testStepFail("Fail","%X%X format error",DID[0],DID[1]);
                //Ser23TestAutomated=0;
              }
            }
            else
            {
              testStepFail("Fail","%X%X format error",DID[0],DID[1]);
              //Ser23TestAutomated=0;
            }
          }
          if(Ser23TestAutomated==1)
          {
            for(i=0; i<Ser23MemorySegmentNum_A; i++)
            {
              offset=0;
              do
              {
                S23DataAddress=Ser23Memory_A[i].Address+offset;
                if((Ser23Memory_A[i].Length-offset)>=0xFF)
                {
                  S23DataLength=0xFF;
                  offset=offset+0xFF;
                }
                else
                {
                  S23DataLength=Ser23Memory_A[i].Length-offset;
                  offset=offset+S23DataLength;
                }
                
                AddressByte[3]=S23DataAddress;
                AddressByte[2]=S23DataAddress>>8;
                AddressByte[1]=S23DataAddress>>16;
                AddressByte[0]=S23DataAddress>>24;
                
        //        LengthByte[3]=S23DataLength;
        //        LengthByte[2]=S23DataLength>>8;
        //        LengthByte[1]=S23DataLength>>16;
                LengthByte[0]=S23DataLength;
                
                SID23_ReadMemoryByAdress(0x14,AddressByte,LengthByte,PHYSICAL);
                CheckPosResponse_SID23(S23DataLength,0,0);
                write("Ser23Memory_A[i].Length-offset=%x",Ser23Memory_A[i].Length-offset);
                
              }
              while((Ser23Memory_A[i].Length-offset)>0xFF);
            }
          }
        }
        
        if(Ser23AddLen14Supported==1&&Ser23TestAutomated==0)
        {
          for(i=0; i<Ser23MemorySegmentNum; i++)
          {
            offset=0;
            do
            {
              S23DataAddress=Ser23Memory[i].Address+offset;
              if((Ser23Memory[i].Length-offset)>=0xFF)
              {
                S23DataLength=0xFF;
                offset=offset+0xFF;
              }
              else
              {
                S23DataLength=Ser23Memory[i].Length-offset;
                offset=offset+S23DataLength;
              }
              
              AddressByte[3]=S23DataAddress;
              AddressByte[2]=S23DataAddress>>8;
              AddressByte[1]=S23DataAddress>>16;
              AddressByte[0]=S23DataAddress>>24;
              
      //        LengthByte[3]=S23DataLength;
      //        LengthByte[2]=S23DataLength>>8;
      //        LengthByte[1]=S23DataLength>>16;
              LengthByte[0]=S23DataLength;
              
              SID23_ReadMemoryByAdress(0x14,AddressByte,LengthByte,PHYSICAL);
              CheckPosResponse_SID23(S23DataLength,0,0);
              write("Ser23Memory[i].Length-offset=%x",Ser23Memory[i].Length-offset);
              
            }
            while((Ser23Memory[i].Length-offset)>0xFF);
          }
        }
  }
  
  Ser23TestAutomated=tempStorage;
  
  if(Ser23AddLen24Supported==1)
  {
        DID[0]=0xD1;
        DID[1]=0x23;
        {
          int result;
          result = CheckDIDSupported(0xD123,DIDOfReadAPP);
          if(result != -1 && Ser23TestAutomated == 0) 
          {
            if(DIDOfReadAPP[result].Flag_Extended == 0) { testStepWarning("Warning","0x%X%X can't be read in extendedSession!!!",DID[0],DID[1]); }
            else { Ser23TestAutomated = 1; }
          }
        }
        if(Ser23TestAutomated==1)
        {
          SID22_ReadDataByIdentifier(DID,PHYSICAL);
          if(CheckPosResponse_SID22(DID,0,0)!=2)
          {
            testStepFail("Fail","Read %X%X error",DID[0],DID[1]);
            //Ser23TestAutomated=0;
          }
          else
          {
            if(gTpRxData[4] != 0x24) { testStepFail("Fail","0x%X%X AddressAndLengthFormatIdentifier is %X not 0x24",DID[0],DID[1],gTpRxData[4]); }
            if((gTpRxLength-5)%6==0)
            {
              Ser23MemorySegmentNum_A=gTpRxData[3];
              if(1)//(gTpRxLength==(5+Ser23MemorySegmentNum_A*6))
              {
                index=5;
                for(i=0;i<Ser23MemorySegmentNum_A;i++)
                {
                  Ser23Memory_A[i].Length=gTpRxData[index]<<8|gTpRxData[index+1];
                  Ser23Memory_A[i].Address=gTpRxData[index+2]<<24|gTpRxData[index+3]<<16|gTpRxData[index+4]<<8|gTpRxData[index+5];
                  index+=6;
                }
              }
              else
              {
                testStepFail("Fail","%X%X format error",DID[0],DID[1]);
                //Ser23TestAutomated=0;
              }
            }
            else
            {
              testStepFail("Fail","%X%X format error",DID[0],DID[1]);
              //Ser23TestAutomated=0;
            }
          }
          if(Ser23TestAutomated==1)
          {
            for(i=0; i<Ser23MemorySegmentNum_A; i++)
            {
              offset=0;
              do
              {
                S23DataAddress=Ser23Memory_A[i].Address+offset;
                if((Ser23Memory_A[i].Length-offset)>ReadMaxLen)
                {
                  S23DataLength=ReadMaxLen;
                  offset=offset+ReadMaxLen;
                }
                else
                {
                  S23DataLength=Ser23Memory_A[i].Length-offset;
                  offset=offset+S23DataLength;
                }
                
                AddressByte[3]=S23DataAddress;
                AddressByte[2]=S23DataAddress>>8;
                AddressByte[1]=S23DataAddress>>16;
                AddressByte[0]=S23DataAddress>>24;
                
              //        LengthByte[3]=S23DataLength;
              //        LengthByte[2]=S23DataLength>>8;
                LengthByte[1]=S23DataLength;
                LengthByte[0]=S23DataLength>>8;
                
                SID23_ReadMemoryByAdress(0x24,AddressByte,LengthByte,PHYSICAL);
                CheckPosResponse_SID23(S23DataLength,0,0);
                write("Ser23Memory[i].Length-offset=%x",Ser23Memory_A[i].Length-offset);
                
              }
              while((Ser23Memory_A[i].Length-offset)>ReadMaxLen);
            }
          }
        }
        
        if(Ser23AddLen24Supported==1&&Ser23TestAutomated==0)
        {
          for(i=0; i<Ser23MemorySegmentNum; i++)
          {
            offset=0;
            do
            {
              S23DataAddress=Ser23Memory[i].Address+offset;
              if((Ser23Memory[i].Length-offset)>ReadMaxLen)
              {
                S23DataLength=ReadMaxLen;
                offset=offset+ReadMaxLen;
              }
              else
              {
                S23DataLength=Ser23Memory[i].Length-offset;
                offset=offset+S23DataLength;
              }
              
              AddressByte[3]=S23DataAddress;
              AddressByte[2]=S23DataAddress>>8;
              AddressByte[1]=S23DataAddress>>16;
              AddressByte[0]=S23DataAddress>>24;
              
      //        LengthByte[3]=S23DataLength;
      //        LengthByte[2]=S23DataLength>>8;
              LengthByte[1]=S23DataLength;
              LengthByte[0]=S23DataLength>>8;
              
              SID23_ReadMemoryByAdress(0x24,AddressByte,LengthByte,PHYSICAL);
              CheckPosResponse_SID23(S23DataLength,0,0);
              write("Ser23Memory[i].Length-offset=%x",Ser23Memory[i].Length-offset);
              
            }
            while((Ser23Memory[i].Length-offset)>ReadMaxLen);
          }
        }
  }
  
  Ser23TestAutomated=tempStorage;
  if(Ser23AddLen44Supported==1)
  {
        DID[0]=0xD1;
        DID[1]=0x24;
        {
          int result;
          result = CheckDIDSupported(0xD124,DIDOfReadAPP);
          if(result != -1 && Ser23TestAutomated == 0) 
          {
            if(DIDOfReadAPP[result].Flag_Extended == 0) { testStepWarning("Warning","0x%X%X can't be read in extendedSession!!!",DID[0],DID[1]); }
            else { Ser23TestAutomated = 1; }
          }
        }
        if(Ser23TestAutomated==1)
        {
          SID22_ReadDataByIdentifier(DID,PHYSICAL);
          if(CheckPosResponse_SID22(DID,0,0)!=2)
          {
            testStepFail("Fail","Read %X%X error",DID[0],DID[1]);
            //Ser23TestAutomated=0;
          }
          else
          {
            if(gTpRxData[4] != 0x44) { testStepFail("Fail","0x%X%X AddressAndLengthFormatIdentifier is %X not 0x44",DID[0],DID[1],gTpRxData[4]); }
            if((gTpRxLength-5)%8==0)
            {
              Ser23MemorySegmentNum_A=gTpRxData[3];
              if(1)//(gTpRxLength==(5+Ser23MemorySegmentNum_A*8))
              {
                index=5;
                for(i=0;i<Ser23MemorySegmentNum_A;i++)
                {
                  Ser23Memory_A[i].Length=gTpRxData[index]<<24|gTpRxData[index+1]<<16|gTpRxData[index+2]<<8|gTpRxData[index+3];
                  Ser23Memory_A[i].Address=gTpRxData[index+4]<<24|gTpRxData[index+5]<<16|gTpRxData[index+6]<<8|gTpRxData[index+7];
                  index+=8;
                }
              }
              else
              {
                testStepFail("Fail","%X%X format error",DID[0],DID[1]);
                //Ser23TestAutomated=0;
              }
            }
            else
            {
              testStepFail("Fail","%X%X format error",DID[0],DID[1]);
              //Ser23TestAutomated=0;
            }
          }
          if(Ser23TestAutomated==1)
          {
            for(i=0; i<Ser23MemorySegmentNum_A; i++)
            {
              offset=0;
              do
              {
                S23DataAddress=Ser23Memory_A[i].Address+offset;
                if((Ser23Memory_A[i].Length-offset)>ReadMaxLen)
                {
                  S23DataLength=ReadMaxLen;
                  offset=offset+ReadMaxLen;
                }
                else
                {
                  S23DataLength=Ser23Memory_A[i].Length-offset;
                  offset=offset+S23DataLength;
                }
                
                AddressByte[3]=S23DataAddress;
                AddressByte[2]=S23DataAddress>>8;
                AddressByte[1]=S23DataAddress>>16;
                AddressByte[0]=S23DataAddress>>24;
                
                LengthByte[3]=S23DataLength;
                LengthByte[2]=S23DataLength>>8;
                LengthByte[1]=S23DataLength>>16;
                LengthByte[0]=S23DataLength>>24;
                
                SID23_ReadMemoryByAdress(0x44,AddressByte,LengthByte,PHYSICAL);
                CheckPosResponse_SID23(S23DataLength,0,0);
                write("Ser23Memory[i].Length-offset=%x",Ser23Memory_A[i].Length-offset);

              }
              while((Ser23Memory_A[i].Length-offset)>ReadMaxLen);
            }
          }
        }
        
        if(Ser23AddLen44Supported==1&&Ser23TestAutomated==0)
        {
          for(i=0; i<Ser23MemorySegmentNum; i++)
          {
            offset=0;
            do
            {
              S23DataAddress=Ser23Memory[i].Address+offset;
              if((Ser23Memory[i].Length-offset)>ReadMaxLen)
              {
                S23DataLength=ReadMaxLen;
                offset=offset+ReadMaxLen;
              }
              else
              {
                S23DataLength=Ser23Memory[i].Length-offset;
                offset=offset+S23DataLength;
              }
              
              AddressByte[3]=S23DataAddress;
              AddressByte[2]=S23DataAddress>>8;
              AddressByte[1]=S23DataAddress>>16;
              AddressByte[0]=S23DataAddress>>24;
              
              LengthByte[3]=S23DataLength;
              LengthByte[2]=S23DataLength>>8;
              LengthByte[1]=S23DataLength>>16;
              LengthByte[0]=S23DataLength>>24;
              
              SID23_ReadMemoryByAdress(0x44,AddressByte,LengthByte,PHYSICAL);
              CheckPosResponse_SID23(S23DataLength,0,0);
              write("Ser23Memory[i].Length-offset=%x",Ser23Memory[i].Length-offset);

            }
            while((Ser23Memory[i].Length-offset)>ReadMaxLen);
          }
        }
  }
  TestStep("Verify EXTENDEDSESSION(0x03)",TestStepIntervalTime);
  CheckCurrentSession(EXTENDEDSESSION,PHYSICAL,0,0);
  /******************************以上为测试步骤*********************************/
  Postcondition();
   
}

/// <APP_CommonServiceTest>
testcase Sercice_0x27_Valid_Physical_ExtendedDiagnosticSession_Supported_Service()
{
  int i;
  char logName[400] = "";
  char info[1024];
  
  strncat(logName,"1022401_Sercice_0x27_Valid_Physical_ExtendedDiagnosticSession_Supported_Service_R2",400);
  testCaseDescription("The intent is to verify that the service SecurityAccess (0x27) and its subfunctions is supported.");
  testCaseTitle("1022401","Sercice_0x27_Valid_Physical_ExtendedDiagnosticSession_Supported_Service");
  
  SetLog(logName);
  Precondition();

  /******************************以下为测试步骤*********************************/
  
  SessionFlag=APP;
  
  TestStep("Transition from defaultSession(0x01) to extendedDiagnosticSession(0x03).",TestStepIntervalTime);
  SID10_DiagnosticSessionControl(EXTENDEDSESSION,PHYSICAL,SPRMIB_FALSE);
  CheckPosResponse_SID10(EXTENDEDSESSION,gP2Client_APP,gP2StarClientFor10Check,0,0);
  TestStep("Verify extendedDiagnosticSession.",TestStepIntervalTime);
  CheckCurrentSession(EXTENDEDSESSION,PHYSICAL,0,0);

  
  for(i=0; i<NumOfSecurityLv; i++)
  {
    if(i==0)
      TestStep("Let L1 = First security level from the configured security level array from configured list. ",TestStepIntervalTime);
    else
      TestStep("Let L1 be equal to next security level and jump to Step 4. ",TestStepIntervalTime,4);
    
    if(SELevel[i].SEFlagPBL == 1)
    {
      continue;
    }
    
    Level1=SELevel[i].SElevel;
    write("Level1 is %02x",Level1);
    testWaitForTimeout(gTimeWaitForSecuAccess);
    
    //执行解锁以确保控制器的错误计数器为0
    SID27_SecurityAccess_RequestSeed(Level1,PHYSICAL);
    CheckPosResponse_SID27_ReqSeed(Level1,gSeedArray,16,0,0);
    PID27_Parameters_Seeds_Chk(NotAllZero,gSeedArray);
    SID27_SecurityAccess_SendKey(Level1,gKeyArray,PHYSICAL);
    CheckPosResponse_SID27_SenKey(Level1,0,0);
    //执行解锁以确保控制器的错误计数器为0
    testWaitForTimeout(1000);
    
    TestStep("Transition from defaultSession(0x01) to extendedDiagnosticSession(0x03).",TestStepIntervalTime);
    SID10_DiagnosticSessionControl(EXTENDEDSESSION,PHYSICAL,SPRMIB_FALSE);
    CheckPosResponse_SID10(EXTENDEDSESSION,gP2Client_APP,gP2StarClientFor10Check,0,0);
    TestStep("Verify extendedDiagnosticSession.",TestStepIntervalTime);
    CheckCurrentSession(EXTENDEDSESSION,PHYSICAL,0,0);
    
    testWaitForTimeout(gTimeWaitForSecuAccess);
    
    TestStep("ECU response with seed. Verify that S1...S16 not equal to 0x000000.",TestStepIntervalTime);
    SID27_SecurityAccess_RequestSeed(Level1,PHYSICAL);
    CheckPosResponse_SID27_ReqSeed(Level1,gSeedArray,16,0,0);
    PID27_Parameters_Seeds_Chk(NotAllZero,gSeedArray);
    
//    TestStep("ECU unlock.",TestStepIntervalTime);
//    SID27_SecurityAccess_SendKey(Level1,gKeyArray,ByteNumOfSeed,DLLName,PHYSICAL);
//    CheckPosResponse_SID27_SenKey(Level1,0,0);
    TestStep("Generate wrong key from response.",TestStepIntervalTime);
    gSeedArray[2]=gSeedArray[2]+1;//产生错误的秘钥
    
    TestStep("Send invalid key.",TestStepIntervalTime);
    SID27_SecurityAccess_SendKey(Level1,gKeyArray,PHYSICAL);
    CheckNegResponse(0x35,0,0);
    TestStep("ECU response with seed. Verify that S1...S16 not equal to 0x000000.",TestStepIntervalTime);
    SID27_SecurityAccess_RequestSeed(Level1,PHYSICAL);
    CheckPosResponse_SID27_ReqSeed(Level1,gSeedArray,16,0,0);
    PID27_Parameters_Seeds_Chk(NotAllZero,gSeedArray);
    
     TestStep("Generate wrong key from response.",TestStepIntervalTime);
    gSeedArray[2]=gSeedArray[2]+1;//产生错误的秘钥
    TestStep("Generate wrong key from response.",TestStepIntervalTime);
    SID27_SecurityAccess_SendKey(Level1,gKeyArray,PHYSICAL);
    CheckNegResponse(0x36,0,0);
    TestStep("Wait for Delaytimer-1s.");
    testWaitForTimeout(DelayTimer-1000);
    TestStep("ECU response with seed. Verify that S1...S16 not equal to 0x000000.",TestStepIntervalTime);
    SID27_SecurityAccess_RequestSeed(Level1,PHYSICAL);
    CheckNegResponse(0x37,0,0);
    TestStep("Wait for 2s.");
    testWaitForTimeout(2000);
    TestStep("ECU response with seed. Verify that S1...S16 not equal to 0x000000.",TestStepIntervalTime);
    SID27_SecurityAccess_RequestSeed(Level1,PHYSICAL);
    CheckPosResponse_SID27_ReqSeed(Level1,gSeedArray,16,0,0);
    PID27_Parameters_Seeds_Chk(NotAllZero,gSeedArray);
    TestStep("ECU unlock.",TestStepIntervalTime);
    SID27_SecurityAccess_SendKey(Level1,gKeyArray,PHYSICAL);
    CheckPosResponse_SID27_SenKey(Level1,0,0);
    TestStep("Transition from extendedDiagnosticSession(0x03) to extendedDiagnosticSession(0x03).",TestStepIntervalTime);
    SID10_DiagnosticSessionControl(EXTENDEDSESSION,PHYSICAL,SPRMIB_FALSE);
    CheckPosResponse_SID10(EXTENDEDSESSION,gP2Client_APP,gP2StarClientFor10Check,0,0);
    TestStep("Verify extendedDiagnosticSession.",TestStepIntervalTime);
    CheckCurrentSession(EXTENDEDSESSION,PHYSICAL,0,0);
    
    testWaitForTimeout(gTimeWaitForSecuAccess);
    TestStep("ECU response with seed. Verify that S1...S16 not equal to 0x000000.",TestStepIntervalTime);
    SID27_SecurityAccess_RequestSeed(Level1,PHYSICAL);
    CheckPosResponse_SID27_ReqSeed(Level1,gSeedArray,16,0,0);
    PID27_Parameters_Seeds_Chk(NotAllZero,gSeedArray);
    TestStep("ECU unlock.",TestStepIntervalTime);
    SID27_SecurityAccess_SendKey(Level1,gKeyArray,PHYSICAL);
    CheckPosResponse_SID27_SenKey(Level1,0,0);
    TestStep("Transition to defaultSesion(0x01)",TestStepIntervalTime);
    SID10_DiagnosticSessionControl(DEFAULTSESSION,PHYSICAL,SPRMIB_FALSE);
    CheckPosResponse_SID10(DEFAULTSESSION,gP2Client_APP,gP2StarClientFor10Check,0,0);
    TestStep("Verify defaultSession",TestStepIntervalTime);
    CheckCurrentSession(DEFAULTSESSION,PHYSICAL,0,0);
    TestStep("Transition from DefaultSession(0x01) to extendedDiagnosticSession(0x03).",TestStepIntervalTime);
    SID10_DiagnosticSessionControl(EXTENDEDSESSION,PHYSICAL,SPRMIB_FALSE);
    CheckPosResponse_SID10(EXTENDEDSESSION,gP2Client_APP,gP2StarClientFor10Check,0,0);
    TestStep("Verify extendedDiagnosticSession.",TestStepIntervalTime);
    CheckCurrentSession(EXTENDEDSESSION,PHYSICAL,0,0);
    TestStep("ECU response with seed. Verify that S1...S16 not equal to 0x000000.",TestStepIntervalTime);
    SID27_SecurityAccess_RequestSeed(Level1,PHYSICAL);
    CheckPosResponse_SID27_ReqSeed(Level1,gSeedArray,16,0,0);
    PID27_Parameters_Seeds_Chk(NotAllZero,gSeedArray);
    TestStep("ECU unlock.",TestStepIntervalTime);
    SID27_SecurityAccess_SendKey(Level1,gKeyArray,PHYSICAL);
    CheckPosResponse_SID27_SenKey(Level1,0,0);
    TestStep("Disable functionally addressed periodic testerPresent.Wait for 4.8 seconds.");
    TP_TesterPresentSet(TP_OFF);
    delay(4800);
    TP_TesterPresentSet(TP_ON);
    
    TestStep("ECU response with seed. Verify that S1...S16 is equal to 0x000000.",TestStepIntervalTime);
    SID27_SecurityAccess_RequestSeed(Level1,PHYSICAL);
    CheckPosResponse_SID27_ReqSeed(Level1,gSeedArray,16,0,0);
    PID27_Parameters_Seeds_Chk(AllZero,gSeedArray);
    TestStep("Verify extendedDiagnosticSession.",TestStepIntervalTime);
    CheckCurrentSession(EXTENDEDSESSION,PHYSICAL,0,0);
    TestStep(":Wait for 6s.",TestStepIntervalTime);
    TP_TesterPresentSet(TP_OFF);
    delay(6000);
    TP_TesterPresentSet(TP_ON);
    TestStep("Verify defaultSession",TestStepIntervalTime);
    CheckCurrentSession(DEFAULTSESSION,PHYSICAL,0,0);
    TestStep("Transition from defaultSession(0x01) to extendedDiagnosticSession(0x03)",TestStepIntervalTime);
    SID10_DiagnosticSessionControl(EXTENDEDSESSION,PHYSICAL,SPRMIB_TRUE);
    CheckNonResponse(0,0);
    TestStep("Verify extendedDiagnosticSession.",TestStepIntervalTime);
    CheckCurrentSession(EXTENDEDSESSION,PHYSICAL,0,0);
    
    testWaitForTimeout(gTimeWaitForSecuAccess);
    TestStep("ECU response with seed. Verify that S1...S16 not equal to 0x000000.",TestStepIntervalTime);
    SID27_SecurityAccess_RequestSeed(Level1,PHYSICAL);
    CheckPosResponse_SID27_ReqSeed(Level1,gSeedArray,16,0,0);
    PID27_Parameters_Seeds_Chk(NotAllZero,gSeedArray);
    
    TestStep("ECU response with seed. Verify that S1...S16 not equal to 0x000000 and S1...S16 not equal to S1...S16 in step 32.",TestStepIntervalTime);
    SID27_SecurityAccess_RequestSeed(Level1,PHYSICAL);
    CheckPosResponse_SID27_ReqSeed(Level1,gSeedArray,16,0,0);
    PID27_Parameters_Seeds_Chk(NotAllZero,gSeedArray);
  }
  TestStep("Verify extendedDiagnosticSession.",TestStepIntervalTime);
  CheckCurrentSession(EXTENDEDSESSION,PHYSICAL,0,0);

  /******************************以上为测试步骤*********************************/
  PostCondition();
}

void delay(long timeout)
{
    linFrame 0x30 msg;
    int m,i;
  
    if(gBusFlag==3)//LIN 总线单独处理，1s 发一个22 F1 86
    {
        m=timeout/1000;
        if(timeout<2000)
        {
             testWaitForTimeout(timeout); 
          
        }
        else
        {
              for(i=0;i<m;i++)
              {
                  //CheckCurrentSession(DEFAULTSESSION,PHYSICAL,0,0); 
                  
                  msg.dlc=1;
                  msg.rtr=1;
                  output(msg);
                  testWaitForTimeout(1000);
              }
        }
        
        m=timeout%1000;
        testWaitForTimeout(m);
      
  
    }
    else
    {
       testWaitForTimeout(timeout); 
      
    }
    
    
}

void delaywithreq(long timeout)
{
    linFrame 0x30 msg;
    int m,i;
  
    if(gBusFlag==3)//LIN 总线单独处理，1s 发一个22 F1 86
    {
        m=timeout/1000;
        if(timeout<2000)
        {
             testWaitForTimeout(timeout); 
          
        }
        else
        {
              for(i=0;i<m;i++)
              {
                  SID3E_TesterPresent(PHYSICAL,SPRMIB_TRUE);
                  
                  //msg.dlc=1;
                  //msg.rtr=1;
                  //output(msg);
                  //testWaitForTimeout(1000);
              }
        }
        
        m=timeout%1000;
        testWaitForTimeout(m);
      
  
    }
    else
    {
       testWaitForTimeout(timeout); 
      
    }
    
    
}

/// <APP_CommonServiceTest>
testcase Sercice_0x27_Valid_Functional_ExtendedDiagnosticSession_Supported_Service()
{
  int i;
  char logName[400] = "";
  char info[1024];
  
  strncat(logName,"1022402_Sercice_0x27_Valid_Functional_ExtendedDiagnosticSession_Supported_Service_R2",400);
  testCaseDescription("The intent is to verify that the service SecurityAccess (0x27) and its subfunctions is supported.");
  testCaseTitle("1022402","Sercice_0x27_Valid_Functional_ExtendedDiagnosticSession_Supported_Service");
  if(gBusFlag==3)
	{
		testStepWarning("Test","This test case does not apply to the LIN bus");
		return;
	}
  else if(gBusFlag==1)
  {
		testStepWarning("Test","This test case does not apply to the Classical CAN bus");
		return;
  }
  SetLog(logName);
  Precondition();

  /******************************以下为测试步骤*********************************/
   
  SessionFlag=APP;
  
  TestStep("Transition from defaultSession(0x01) to extendedDiagnosticSession(0x03).",TestStepIntervalTime);
  SID10_DiagnosticSessionControl(EXTENDEDSESSION,PHYSICAL,SPRMIB_FALSE);
  CheckPosResponse_SID10(EXTENDEDSESSION,gP2Client_APP,gP2StarClientFor10Check,0,0);
  TestStep("Verify extendedDiagnosticSession.",TestStepIntervalTime);
  CheckCurrentSession(EXTENDEDSESSION,PHYSICAL,0,0);

  
  for(i=0; i<NumOfSecurityLv; i++)
  {
    if(i==0)
      TestStep("Let L1 = First security level from the configured security level array from configured list. ",TestStepIntervalTime);
    else
      TestStep("Let L1 be equal to next security level and jump to Step 4. ",TestStepIntervalTime);
    
    if(SELevel[i].SEFlagPBL == 1)
    {
      continue;
    }
    
    Level1=SELevel[i].SElevel;
    write("Level1 is %02x",Level1);
    testWaitForTimeout(gTimeWaitForSecuAccess);
    
    //执行解锁以确保控制器的错误计数器为0
    SID27_SecurityAccess_RequestSeed(Level1,PHYSICAL);
    CheckPosResponse_SID27_ReqSeed(Level1,gSeedArray,16,0,0);
    PID27_Parameters_Seeds_Chk(NotAllZero,gSeedArray);
    SID27_SecurityAccess_SendKey(Level1,gKeyArray,PHYSICAL);
    CheckPosResponse_SID27_SenKey(Level1,0,0);
    //执行解锁以确保控制器的错误计数器为0
    testWaitForTimeout(1000);
    
    TestStep("Transition from defaultSession(0x01) to extendedDiagnosticSession(0x03).",TestStepIntervalTime);
    SID10_DiagnosticSessionControl(EXTENDEDSESSION,PHYSICAL,SPRMIB_FALSE);
    CheckPosResponse_SID10(EXTENDEDSESSION,gP2Client_APP,gP2StarClientFor10Check,0,0);
    TestStep("Verify extendedDiagnosticSession.",TestStepIntervalTime);
    CheckCurrentSession(EXTENDEDSESSION,PHYSICAL,0,0);
    
    testWaitForTimeout(gTimeWaitForSecuAccess);
    
    TestStep("ECU response with seed. Verify that S1...S16 not equal to 0x000000.",TestStepIntervalTime);
    SID27_SecurityAccess_RequestSeed(Level1,FUNCTIONAL);
    CheckPosResponse_SID27_ReqSeed(Level1,gSeedArray,16,0,0);
    PID27_Parameters_Seeds_Chk(NotAllZero,gSeedArray);
    
//    TestStep("ECU unlock.",TestStepIntervalTime);
//    SID27_SecurityAccess_SendKey(Level1,gKeyArray,ByteNumOfSeed,DLLName,PHYSICAL);
//    CheckPosResponse_SID27_SenKey(Level1,0,0);
    TestStep("Generate wrong key from response.",TestStepIntervalTime);
    gSeedArray[2]=gSeedArray[2]+1;//产生错误的秘钥
    
    TestStep("Send invalid key.",TestStepIntervalTime);
    SID27_SecurityAccess_SendKey(Level1,gKeyArray,FUNCTIONAL);
    CheckNegResponse(0x35,0,0);
    TestStep("ECU response with seed. Verify that S1...S16 not equal to 0x000000.",TestStepIntervalTime);
    SID27_SecurityAccess_RequestSeed(Level1,FUNCTIONAL);
    CheckPosResponse_SID27_ReqSeed(Level1,gSeedArray,16,0,0);
    PID27_Parameters_Seeds_Chk(NotAllZero,gSeedArray);
    
     TestStep("Generate wrong key from response.",TestStepIntervalTime);
    gSeedArray[2]=gSeedArray[2]+1;//产生错误的秘钥
    TestStep("Generate wrong key from response.",TestStepIntervalTime);
    SID27_SecurityAccess_SendKey(Level1,gKeyArray,FUNCTIONAL);
    CheckNegResponse(0x36,0,0);
    TestStep("Wait for Delaytimer-1s.");
    delaywithreq(DelayTimer-1000);
    TestStep("ECU response with seed. Verify that S1...S16 not equal to 0x000000.",TestStepIntervalTime);
    SID27_SecurityAccess_RequestSeed(Level1,FUNCTIONAL);
    CheckNegResponse(0x37,0,0);
    TestStep("Wait for 2s.");
    testWaitForTimeout(2000);
    TestStep("ECU response with seed. Verify that S1...S16 not equal to 0x000000.",TestStepIntervalTime);
    SID27_SecurityAccess_RequestSeed(Level1,FUNCTIONAL);
    CheckPosResponse_SID27_ReqSeed(Level1,gSeedArray,16,0,0);
    PID27_Parameters_Seeds_Chk(NotAllZero,gSeedArray);
    TestStep("ECU unlock.",TestStepIntervalTime);
    SID27_SecurityAccess_SendKey(Level1,gKeyArray,FUNCTIONAL);
    CheckPosResponse_SID27_SenKey(Level1,0,0);
    TestStep("Transition from extendedDiagnosticSession(0x03) to extendedDiagnosticSession(0x03).",TestStepIntervalTime);
    SID10_DiagnosticSessionControl(EXTENDEDSESSION,PHYSICAL,SPRMIB_FALSE);
    CheckPosResponse_SID10(EXTENDEDSESSION,gP2Client_APP,gP2StarClientFor10Check,0,0);
    TestStep("Verify extendedDiagnosticSession.",TestStepIntervalTime);
    CheckCurrentSession(EXTENDEDSESSION,PHYSICAL,0,0);
    
    //testWaitForTimeout(12000);
    TestStep("ECU response with seed. Verify that S1...S16 not equal to 0x000000.",TestStepIntervalTime);
    SID27_SecurityAccess_RequestSeed(Level1,FUNCTIONAL);
    CheckPosResponse_SID27_ReqSeed(Level1,gSeedArray,16,0,0);
    PID27_Parameters_Seeds_Chk(NotAllZero,gSeedArray);
    TestStep("ECU unlock.",TestStepIntervalTime);
    SID27_SecurityAccess_SendKey(Level1,gKeyArray,FUNCTIONAL);
    CheckPosResponse_SID27_SenKey(Level1,0,0);
    TestStep("Transition to defaultSesion(0x01)",TestStepIntervalTime);
    SID10_DiagnosticSessionControl(DEFAULTSESSION,PHYSICAL,SPRMIB_FALSE);
    CheckPosResponse_SID10(DEFAULTSESSION,gP2Client_APP,gP2StarClientFor10Check,0,0);
    TestStep("Verify defaultSession",TestStepIntervalTime);
    CheckCurrentSession(DEFAULTSESSION,PHYSICAL,0,0);
    TestStep("Transition from DefaultSession(0x01) to extendedDiagnosticSession(0x03).",TestStepIntervalTime);
    SID10_DiagnosticSessionControl(EXTENDEDSESSION,PHYSICAL,SPRMIB_FALSE);
    CheckPosResponse_SID10(EXTENDEDSESSION,gP2Client_APP,gP2StarClientFor10Check,0,0);
    TestStep("Verify extendedDiagnosticSession.",TestStepIntervalTime);
    CheckCurrentSession(EXTENDEDSESSION,PHYSICAL,0,0);
    TestStep("ECU response with seed. Verify that S1...S16 not equal to 0x000000.",TestStepIntervalTime);
    SID27_SecurityAccess_RequestSeed(Level1,FUNCTIONAL);
    CheckPosResponse_SID27_ReqSeed(Level1,gSeedArray,16,0,0);
    PID27_Parameters_Seeds_Chk(NotAllZero,gSeedArray);
    TestStep("ECU unlock.",TestStepIntervalTime);
    SID27_SecurityAccess_SendKey(Level1,gKeyArray,FUNCTIONAL);
    CheckPosResponse_SID27_SenKey(Level1,0,0);
    TestStep("Disable functionally addressed periodic testerPresent.Wait for 4.8 seconds.");
    TP_TesterPresentSet(TP_OFF);
    delay(4800);
    TP_TesterPresentSet(TP_ON);
    
    TestStep("ECU response with seed. Verify that S1...S16 is equal to 0x000000.",TestStepIntervalTime);
    SID27_SecurityAccess_RequestSeed(Level1,FUNCTIONAL);
    CheckPosResponse_SID27_ReqSeed(Level1,zeroseed,16,0,0);
    PID27_Parameters_Seeds_Chk(AllZero,gSeedArray);
    TestStep("Verify extendedDiagnosticSession.",TestStepIntervalTime);
    CheckCurrentSession(EXTENDEDSESSION,FUNCTIONAL,0,0);
    TestStep(":Wait for 6s.",TestStepIntervalTime);
    TP_TesterPresentSet(TP_OFF);
    delay(6000);
    TP_TesterPresentSet(TP_ON);
    TestStep("Verify defaultSession",TestStepIntervalTime);
    CheckCurrentSession(DEFAULTSESSION,PHYSICAL,0,0);
    TestStep("Transition from defaultSession(0x01) to extendedDiagnosticSession(0x03)",TestStepIntervalTime);
    SID10_DiagnosticSessionControl(EXTENDEDSESSION,PHYSICAL,SPRMIB_TRUE);
    CheckNonResponse(0,0);
    TestStep("Verify extendedDiagnosticSession.",TestStepIntervalTime);
    CheckCurrentSession(EXTENDEDSESSION,PHYSICAL,0,0);
    
    testWaitForTimeout(gTimeWaitForSecuAccess);
    TestStep("ECU response with seed. Verify that S1...S16 not equal to 0x000000.",TestStepIntervalTime);
    SID27_SecurityAccess_RequestSeed(Level1,FUNCTIONAL);
    CheckPosResponse_SID27_ReqSeed(Level1,gSeedArray,16,0,0);
    PID27_Parameters_Seeds_Chk(NotAllZero,gSeedArray);
    
    TestStep("ECU response with seed. Verify that S1...S16 not equal to 0x000000 and S1...S16 not equal to S1...S16 in step 32.",TestStepIntervalTime);
    SID27_SecurityAccess_RequestSeed(Level1,FUNCTIONAL);
    CheckPosResponse_SID27_ReqSeed(Level1,gSeedArray,16,0,0);
    PID27_Parameters_Seeds_Chk(NotAllZero,gSeedArray);
  }
  TestStep("Verify extendedDiagnosticSession.",TestStepIntervalTime);
  CheckCurrentSession(EXTENDEDSESSION,PHYSICAL,0,0);
  /******************************以上为测试步骤*********************************/
  Postcondition();
   
}

/// <APP_CommonServiceTest>
testcase Sercice_0x27_Valid_Physical_ExtendedDiagnosticSession_Supported_Service_But_Not_Subfunction()
{
  int i;
  byte ExpectNRC[2]={0x12,0x7E};
  char logName[400] = "";
  char info[1024];
  
  strncat(logName,"1022403_Sercice_0x27_Valid_Physical_ExtendedDiagnosticSession_Supported_Service_But_Not_Subfunction_R2",400);
  testCaseDescription("The intent is to verify that the subfunction 0x01 and 0x81 is not supported.");
  testCaseTitle("1022403","Sercice_0x27_Valid_Physical_ExtendedDiagnosticSession_Supported_Service_But_Not_Subfunction");
  
  SetLog(logName);
  Precondition();

  /******************************以下为测试步骤*********************************/
  
  SessionFlag=APP;
  
  TestStep("Transition from defaultSession(0x01) to extendedDiagnosticSession(0x03).",TestStepIntervalTime);
  SID10_DiagnosticSessionControl(EXTENDEDSESSION,PHYSICAL,SPRMIB_FALSE);
  CheckPosResponse_SID10(EXTENDEDSESSION,gP2Client_APP,gP2StarClientFor10Check,0,0);
  TestStep("Verify extendedDiagnosticSession.",TestStepIntervalTime);
  CheckCurrentSession(EXTENDEDSESSION,PHYSICAL,0,0);
  
  testWaitForTimeout(gTimeWaitForSecuAccess);
  TestStep("ECU response with NRC12 and NRC7E. ",TestStepIntervalTime);
  SID27_SecurityAccess_RequestSeed(0x01,PHYSICAL);
  CheckNegResponse(ExpectNRC,0,0,0,0);
  TestStep("Verify extendedDiagnosticSession.",TestStepIntervalTime);
  CheckCurrentSession(EXTENDEDSESSION,PHYSICAL,0,0);
  /******************************以上为测试步骤*********************************/
  Postcondition();
   
}

/// <APP_CommonServiceTest>
testcase Sercice_0x27_Valid_Functional_ExtendedDiagnosticSession_Supported_Service_But_Not_Subfunction()
{
  int i;
  char logName[400] = "";
  char info[1024];
  
  strncat(logName,"1022404_Sercice_0x27_Valid_Functional_ExtendedDiagnosticSession_Supported_Service_But_Not_Subfunction_R2",400);
  testCaseDescription("That the ECU responds with valid NRC to a non-supported (temporary or permanently) request.");
  testCaseTitle("1022404","Sercice_0x27_Valid_Functional_ExtendedDiagnosticSession_Supported_Service_But_Not_Subfunction");
  if(gBusFlag==3)
	{
		testStepWarning("Test","This test case does not apply to the LIN bus");
		return;
	}
  else if(gBusFlag==1)
  {
		testStepWarning("Test","This test case does not apply to the Classical CAN bus");
		return;
  }
  SetLog(logName);
  Precondition();

  /******************************以下为测试步骤*********************************/
  
  SessionFlag=APP;
  
  TestStep("Transition from defaultSession(0x01) to extendedDiagnosticSession(0x03).",TestStepIntervalTime);
  SID10_DiagnosticSessionControl(EXTENDEDSESSION,FUNCTIONAL,SPRMIB_FALSE);
  CheckPosResponse_SID10(EXTENDEDSESSION,gP2Client_APP,gP2StarClientFor10Check,0,0);
  TestStep("Verify extendedDiagnosticSession.",TestStepIntervalTime);
  CheckCurrentSession(EXTENDEDSESSION,PHYSICAL,0,0);
  testWaitForTimeout(gTimeWaitForSecuAccess);
  TestStep("ECU response with no response. ",TestStepIntervalTime);
  SID27_SecurityAccess_RequestSeed(0x01,FUNCTIONAL);
  CheckNonResponse(0,0);
  TestStep("Verify extendedDiagnosticSession.",TestStepIntervalTime);
  CheckCurrentSession(EXTENDEDSESSION,PHYSICAL,0,0);
  /******************************以上为测试步骤*********************************/
  Postcondition();

}
/// <APP_CommonServiceTest>
testcase Service_0x28_Phy_PositiveResponse()
{
  byte expectSession[3]={0x01,0x02,0x03};
  byte SFOf28[4] = {0x00,0x01,0x02,0x03};
  int i=0,j=0;
  char logName[400] = "";
  char info[1024];
  
  strncat(logName,"1088261_Service_0x28_Phy_PositiveResponse",400);
  testCaseTitle("1088261","Service_0x28_Phy_PositiveResponse");
	if(gBusFlag==3)
	{
		testStepWarning("Test","This test case does not apply to the LIN bus");
		return;
	}
  SetLog(logName);
  Precondition();
   
  /******************************以下为测试步骤*********************************/
  TestStep("Enter defaultSession(0x01)",TestStepIntervalTime);
  SID10_DiagnosticSessionControl(DEFAULTSESSION,PHYSICAL,SPRMIB_FALSE);
  CheckPosResponse_SID10(DEFAULTSESSION,0,6);
  ECUinitHandle(0);
  TestStep("Enter extendedSession(0x03)",TestStepIntervalTime);
  SID10_DiagnosticSessionControl(EXTENDEDSESSION,PHYSICAL,SPRMIB_FALSE);
  CheckPosResponse_SID10(EXTENDEDSESSION,0,6);
  TestStep("Verify extendedSession(0x03)",TestStepIntervalTime);
  CheckCurrentSession(expectSession[2],PHYSICAL,0,0);
  
  TestStep("CommunicationControl_Request(Sub-Function= [ControlType=CT],CommunicationType=CoT,SPRMIB=FALSE)",TestStepIntervalTime);
  for(i=1;i<=3;i++)
  {
    if(i==1)
    {
      SID28_CommunicationControl(SFOf28[0],NormalCommunicationMessage,PHYSICAL,SPRMIB_FALSE);
      CheckPosResponse_SID28(SFOf28[0],0,0);
      SID28_CommunicationControl(SFOf28[1],NormalCommunicationMessage,PHYSICAL,SPRMIB_FALSE);
      CheckPosResponse_SID28(SFOf28[1],0,0);
      SID28_CommunicationControl(SFOf28[2],NormalCommunicationMessage,PHYSICAL,SPRMIB_FALSE);
      CheckPosResponse_SID28(SFOf28[2],0,0);
      SID28_CommunicationControl(SFOf28[3],NormalCommunicationMessage,PHYSICAL,SPRMIB_FALSE);
      CheckPosResponse_SID28(SFOf28[3],0,0);
    }
    if(i==2)
    {
      SID28_CommunicationControl(SFOf28[0],NetworkManagementMessage,PHYSICAL,SPRMIB_FALSE);
      CheckPosResponse_SID28(SFOf28[0],0,0);
      SID28_CommunicationControl(SFOf28[1],NetworkManagementMessage,PHYSICAL,SPRMIB_FALSE);
      CheckPosResponse_SID28(SFOf28[1],0,0);
      SID28_CommunicationControl(SFOf28[2],NetworkManagementMessage,PHYSICAL,SPRMIB_FALSE);
      CheckPosResponse_SID28(SFOf28[2],0,0);
      SID28_CommunicationControl(SFOf28[3],NetworkManagementMessage,PHYSICAL,SPRMIB_FALSE);
      CheckPosResponse_SID28(SFOf28[3],0,0);
    }
    if(i==3)
    {
      SID28_CommunicationControl(SFOf28[0],NCMAndNMM,PHYSICAL,SPRMIB_FALSE);
      CheckPosResponse_SID28(SFOf28[0],0,0);   
      SID28_CommunicationControl(SFOf28[1],NCMAndNMM,PHYSICAL,SPRMIB_FALSE);
      CheckPosResponse_SID28(SFOf28[1],0,0);       
      SID28_CommunicationControl(SFOf28[2],NCMAndNMM,PHYSICAL,SPRMIB_FALSE);
      CheckPosResponse_SID28(SFOf28[2],0,0);
      SID28_CommunicationControl(SFOf28[3],NCMAndNMM,PHYSICAL,SPRMIB_FALSE);
      CheckPosResponse_SID28(SFOf28[3],0,0);
    }
  }
  TestStep("CoT>=0x04,Go to step 6",TestStepIntervalTime);
  TestStep("CT=0x00,CoT=0x01",TestStepIntervalTime);
  
  TestStep("CommunicationControl_Request(Sub-Function= [ControlType=CT],CommunicationType=CoT,SPRMIB=TRUE)",TestStepIntervalTime);
  for(i=1;i<=3;i++)
  {
    if(i==1)
    {
      SID28_CommunicationControl(SFOf28[0],NormalCommunicationMessage,PHYSICAL,SPRMIB_TRUE);
      CheckNonResponse(0,0);
      SID28_CommunicationControl(SFOf28[1],NormalCommunicationMessage,PHYSICAL,SPRMIB_TRUE);
      CheckNonResponse(0,0);
      SID28_CommunicationControl(SFOf28[2],NormalCommunicationMessage,PHYSICAL,SPRMIB_TRUE);
      CheckNonResponse(0,0);
      SID28_CommunicationControl(SFOf28[3],NormalCommunicationMessage,PHYSICAL,SPRMIB_TRUE);
      CheckNonResponse(0,0);
    }
    if(i==2)
    {
      SID28_CommunicationControl(SFOf28[0],NetworkManagementMessage,PHYSICAL,SPRMIB_TRUE);
      CheckNonResponse(0,0);
      SID28_CommunicationControl(SFOf28[1],NetworkManagementMessage,PHYSICAL,SPRMIB_TRUE);
      CheckNonResponse(0,0);
      SID28_CommunicationControl(SFOf28[2],NetworkManagementMessage,PHYSICAL,SPRMIB_TRUE);
      CheckNonResponse(0,0);
      SID28_CommunicationControl(SFOf28[3],NetworkManagementMessage,PHYSICAL,SPRMIB_TRUE);
      CheckNonResponse(0,0);
    }
    if(i==3)
    {
      SID28_CommunicationControl(SFOf28[0],NCMAndNMM,PHYSICAL,SPRMIB_TRUE);
      CheckNonResponse(0,0);   
      SID28_CommunicationControl(SFOf28[1],NCMAndNMM,PHYSICAL,SPRMIB_TRUE);
      CheckNonResponse(0,0);       
      SID28_CommunicationControl(SFOf28[2],NCMAndNMM,PHYSICAL,SPRMIB_TRUE);
      CheckNonResponse(0,0);
      SID28_CommunicationControl(SFOf28[3],NCMAndNMM,PHYSICAL,SPRMIB_TRUE);
      CheckNonResponse(0,0);
    }
  }
  /******************************以上为测试步骤*********************************/
  PostCondition();
}
/// <APP_CommonServiceTest>
testcase Service_0x28_Func_PositiveResponse()
{
  byte expectSession[3]={0x01,0x02,0x03};
  byte SFOf28[4] = {0x00,0x01,0x02,0x03};
  int i=0,j=0;
  char logName[400] = "";
  char info[1024];
  
  strncat(logName,"1088263_Service_0x28_Func_PositiveResponse",400);
  testCaseTitle("1088263","Service_0x28_Func_PositiveResponse");
  if(gBusFlag==3)
	{
		testStepWarning("Test","This test case does not apply to the LIN bus");
		return;
	}
  SetLog(logName);
  Precondition();
   
  /******************************以下为测试步骤*********************************/
  TestStep("Enter defaultSession(0x01)",TestStepIntervalTime);
  SID10_DiagnosticSessionControl(DEFAULTSESSION,FUNCTIONAL,SPRMIB_FALSE);
  CheckPosResponse_SID10(DEFAULTSESSION,0,6);
  ECUinitHandle(0);
  TestStep("Enter extendedSession(0x03)",TestStepIntervalTime);
  SID10_DiagnosticSessionControl(EXTENDEDSESSION,FUNCTIONAL,SPRMIB_FALSE);
  CheckPosResponse_SID10(EXTENDEDSESSION,0,6);
  TestStep("Verify extendedSession(0x03)",TestStepIntervalTime);
  CheckCurrentSession(expectSession[2],FUNCTIONAL,0,0);
  
  TestStep("CommunicationControl_Request(Sub-Function= [ControlType=CT],CommunicationType=CoT,SPRMIB=FALSE)",TestStepIntervalTime);
  for(i=1;i<=3;i++)
  {
    if(i==1)
    {
      SID28_CommunicationControl(SFOf28[0],NormalCommunicationMessage,FUNCTIONAL,SPRMIB_FALSE);
      CheckPosResponse_SID28(SFOf28[0],0,0);
      SID28_CommunicationControl(SFOf28[1],NormalCommunicationMessage,FUNCTIONAL,SPRMIB_FALSE);
      CheckPosResponse_SID28(SFOf28[1],0,0);
      SID28_CommunicationControl(SFOf28[2],NormalCommunicationMessage,FUNCTIONAL,SPRMIB_FALSE);
      CheckPosResponse_SID28(SFOf28[2],0,0);
      SID28_CommunicationControl(SFOf28[3],NormalCommunicationMessage,FUNCTIONAL,SPRMIB_FALSE);
      CheckPosResponse_SID28(SFOf28[3],0,0);
    }
    if(i==2)
    {
      SID28_CommunicationControl(SFOf28[0],NetworkManagementMessage,FUNCTIONAL,SPRMIB_FALSE);
      CheckPosResponse_SID28(SFOf28[0],0,0);
      SID28_CommunicationControl(SFOf28[1],NetworkManagementMessage,FUNCTIONAL,SPRMIB_FALSE);
      CheckPosResponse_SID28(SFOf28[1],0,0);
      SID28_CommunicationControl(SFOf28[2],NetworkManagementMessage,FUNCTIONAL,SPRMIB_FALSE);
      CheckPosResponse_SID28(SFOf28[2],0,0);
      SID28_CommunicationControl(SFOf28[3],NetworkManagementMessage,FUNCTIONAL,SPRMIB_FALSE);
      CheckPosResponse_SID28(SFOf28[3],0,0);
    }
    if(i==3)
    {
      SID28_CommunicationControl(SFOf28[0],NCMAndNMM,FUNCTIONAL,SPRMIB_FALSE);
      CheckPosResponse_SID28(SFOf28[0],0,0);   
      SID28_CommunicationControl(SFOf28[1],NCMAndNMM,FUNCTIONAL,SPRMIB_FALSE);
      CheckPosResponse_SID28(SFOf28[1],0,0);       
      SID28_CommunicationControl(SFOf28[2],NCMAndNMM,FUNCTIONAL,SPRMIB_FALSE);
      CheckPosResponse_SID28(SFOf28[2],0,0);
      SID28_CommunicationControl(SFOf28[3],NCMAndNMM,FUNCTIONAL,SPRMIB_FALSE);
      CheckPosResponse_SID28(SFOf28[3],0,0);
    }
  }
  
  TestStep("CoT>=0x04,Go to step 6",TestStepIntervalTime);
  TestStep("CT=0x00,CoT=0x01",TestStepIntervalTime);
  
  TestStep("CommunicationControl_Request(Sub-Function= [ControlType=CT],CommunicationType=CoT,SPRMIB=TRUE)",TestStepIntervalTime);
  for(i=1;i<=3;i++)
  {
    if(i==1)
    {
      SID28_CommunicationControl(SFOf28[0],NormalCommunicationMessage,FUNCTIONAL,SPRMIB_TRUE);
      CheckNonResponse(0,0);
      SID28_CommunicationControl(SFOf28[1],NormalCommunicationMessage,FUNCTIONAL,SPRMIB_TRUE);
      CheckNonResponse(0,0);
      SID28_CommunicationControl(SFOf28[2],NormalCommunicationMessage,FUNCTIONAL,SPRMIB_TRUE);
      CheckNonResponse(0,0);
      SID28_CommunicationControl(SFOf28[3],NormalCommunicationMessage,FUNCTIONAL,SPRMIB_TRUE);
      CheckNonResponse(0,0);
    }
    if(i==2)
    {
      SID28_CommunicationControl(SFOf28[0],NetworkManagementMessage,FUNCTIONAL,SPRMIB_TRUE);
      CheckNonResponse(0,0);
      SID28_CommunicationControl(SFOf28[1],NetworkManagementMessage,FUNCTIONAL,SPRMIB_TRUE);
      CheckNonResponse(0,0);
      SID28_CommunicationControl(SFOf28[2],NetworkManagementMessage,FUNCTIONAL,SPRMIB_TRUE);
      CheckNonResponse(0,0);
      SID28_CommunicationControl(SFOf28[3],NetworkManagementMessage,FUNCTIONAL,SPRMIB_TRUE);
      CheckNonResponse(0,0);
    }
    if(i==3)
    {
      SID28_CommunicationControl(SFOf28[0],NCMAndNMM,FUNCTIONAL,SPRMIB_TRUE);
      CheckNonResponse(0,0);   
      SID28_CommunicationControl(SFOf28[1],NCMAndNMM,FUNCTIONAL,SPRMIB_TRUE);
      CheckNonResponse(0,0);       
      SID28_CommunicationControl(SFOf28[2],NCMAndNMM,FUNCTIONAL,SPRMIB_TRUE);
      CheckNonResponse(0,0);
      SID28_CommunicationControl(SFOf28[3],NCMAndNMM,FUNCTIONAL,SPRMIB_TRUE);
      CheckNonResponse(0,0);
    }
  }
  /******************************以上为测试步骤*********************************/
  PostCondition();
}
/// <APP_CommonServiceTest>
testcase Service_0x28_Phy_Function()
{
  byte expectSession[4]={0x01,0x02,0x03,0x04};
  byte SFOf28[4]={0x00,0x01,0x02,0x03};
  byte t28[3]={0x28,0x00,0x01};
  byte expectNRC[1]={0x31};
  byte CommType;
  int i=0,j=0;
  char logName[400] = "";
  char info[1024];
  strncat(logName,"1088264_Service_0x28_Phy_Function",400);
  testCaseTitle("1088264","Service_0x28_Phy_Function");
  if(gBusFlag==3)
	{
		testStepWarning("Test","This test case does not apply to the LIN bus");
		return;
	}
  SetLog(logName);
  Precondition();
   
  /******************************以下为测试步骤*********************************/
  
  TestStep("Enter defaultSession(0x01)",TestStepIntervalTime);
  SID10_DiagnosticSessionControl(DEFAULTSESSION,PHYSICAL,SPRMIB_FALSE);
  CheckPosResponse_SID10(DEFAULTSESSION,0,6);
  ECUinitHandle(0);
  TestStep("Enter extendedsession(0x03)",TestStepIntervalTime);
  SID10_DiagnosticSessionControl(EXTENDEDSESSION,PHYSICAL,SPRMIB_FALSE);
  CheckPosResponse_SID10(EXTENDEDSESSION,0,6);
  TestStep("Verify extendedSession(0x03)",TestStepIntervalTime);
  CheckCurrentSession(expectSession[2],PHYSICAL,0,0);
  
  gFlagNM=0;Teststep("INF","out put NM repeat request message");
  output(NMMessage_Repeat);
  testwaitfortimeout(3000);
  if(gFlagNM==1)
  {
    TestStep("ECU support NM message",TestStepIntervalTime);
    TestStep(":");
    SID28_CommunicationControl(SFOf28[1],NormalCommunicationMessage,PHYSICAL,SPRMIB_FALSE);
    CheckPosResponse_SID28(SFOf28[1],0,0);
    CheckCommunication(DEAPP,1);
    TestStep(":");
    SID28_CommunicationControl(SFOf28[2],NormalCommunicationMessage,PHYSICAL,SPRMIB_FALSE);
    CheckPosResponse_SID28(SFOf28[2],0,0);
    CheckCommunication(DENONE,1);
    TestStep(":");
    SID28_CommunicationControl(SFOf28[0],NormalCommunicationMessage,PHYSICAL,SPRMIB_FALSE);
    CheckPosResponse_SID28(SFOf28[0],0,0);
    CheckCommunication(DENONE,1);
    TestStep(":");
    SID28_CommunicationControl(SFOf28[3],NormalCommunicationMessage,PHYSICAL,SPRMIB_FALSE);
    CheckPosResponse_SID28(SFOf28[3],0,0);
    CheckCommunication(DEAPP,1);
    TestStep(":");
    SID28_CommunicationControl(SFOf28[0],NormalCommunicationMessage,PHYSICAL,SPRMIB_FALSE);
    CheckPosResponse_SID28(SFOf28[0],0,0);
    CheckCommunication(DENONE,1);
    TestStep(":");
    SID28_CommunicationControl(SFOf28[1],NetworkManagementMessage,PHYSICAL,SPRMIB_FALSE);
    CheckPosResponse_SID28(SFOf28[1],0,0);
    CheckCommunication(DENM,1);
    TestStep(":");
    
    SID28_CommunicationControl(SFOf28[2],NetworkManagementMessage,PHYSICAL,SPRMIB_FALSE);
    CheckPosResponse_SID28(SFOf28[2],0,0);
    CheckCommunication(DENONE,1);
    TestStep(":");
    SID28_CommunicationControl(SFOf28[0],NetworkManagementMessage,PHYSICAL,SPRMIB_FALSE);
    CheckPosResponse_SID28(SFOf28[0],0,0);
    CheckCommunication(DENONE,1);
    TestStep(":");
    SID28_CommunicationControl(SFOf28[3],NetworkManagementMessage,PHYSICAL,SPRMIB_FALSE);
    CheckPosResponse_SID28(SFOf28[3],0,0);
    CheckCommunication(DENM,1);
    TestStep(":");
    SID28_CommunicationControl(SFOf28[0],NetworkManagementMessage,PHYSICAL,SPRMIB_FALSE);
    CheckPosResponse_SID28(SFOf28[0],0,0);
    CheckCommunication(DENONE,1);
    TestStep(":");
    SID28_CommunicationControl(SFOf28[1],NCMAndNMM,PHYSICAL,SPRMIB_FALSE);
    CheckPosResponse_SID28(SFOf28[1],0,0);
    CheckCommunication(DEALL,1);
    TestStep(":");
    SID28_CommunicationControl(SFOf28[2],NCMAndNMM,PHYSICAL,SPRMIB_FALSE);
    CheckPosResponse_SID28(SFOf28[2],0,0);
    CheckCommunication(DENONE,1);
    TestStep(":");
    SID28_CommunicationControl(SFOf28[0],NCMAndNMM,PHYSICAL,SPRMIB_FALSE);
    CheckPosResponse_SID28(SFOf28[0],0,0);
    CheckCommunication(DENONE,1);
    TestStep(":");
    SID28_CommunicationControl(SFOf28[3],NCMAndNMM,PHYSICAL,SPRMIB_FALSE);
    CheckPosResponse_SID28(SFOf28[3],0,0);
    CheckCommunication(DEALL,1);
    TestStep(":");
    SID28_CommunicationControl(SFOf28[0],NCMAndNMM,PHYSICAL,SPRMIB_FALSE);
    CheckPosResponse_SID28(SFOf28[0],0,0);
    CheckCommunication(DENONE,1);
    TestStep(":");
    SID28_CommunicationControl(SFOf28[1],NormalCommunicationMessage,PHYSICAL,SPRMIB_FALSE);
    CheckPosResponse_SID28(SFOf28[1],0,0);
    CheckCommunication(DEAPP,1);
    TestStep(":");
    SID28_CommunicationControl(SFOf28[1],NetworkManagementMessage,PHYSICAL,SPRMIB_FALSE);
    CheckPosResponse_SID28(SFOf28[1],0,0);
    CheckCommunication(DEALL,1);
    TestStep(":");
    SID28_CommunicationControl(SFOf28[3],NCMAndNMM,PHYSICAL,SPRMIB_FALSE);
    CheckPosResponse_SID28(SFOf28[3],0,0);
    CheckCommunication(DEALL,1);
    TestStep(":");
    SID28_CommunicationControl(SFOf28[2],NormalCommunicationMessage,PHYSICAL,SPRMIB_FALSE);
    CheckPosResponse_SID28(SFOf28[2],0,0);
    CheckCommunication(DENM,1);
    TestStep(":");
    SID28_CommunicationControl(SFOf28[2],NetworkManagementMessage,PHYSICAL,SPRMIB_FALSE);
    CheckPosResponse_SID28(SFOf28[2],0,0);
    CheckCommunication(DENONE,1);
    TestStep(":");
    SID28_CommunicationControl(SFOf28[0],NCMAndNMM,PHYSICAL,SPRMIB_FALSE);
    CheckPosResponse_SID28(SFOf28[0],0,0);
    CheckCommunication(DENONE,1);
    TestStep(":");
    SID28_CommunicationControl(SFOf28[1],NetworkManagementMessage,PHYSICAL,SPRMIB_FALSE);
    CheckPosResponse_SID28(SFOf28[1],0,0);
    CheckCommunication(DENM,1);
    TestStep(":");
    SID28_CommunicationControl(SFOf28[1],NormalCommunicationMessage,PHYSICAL,SPRMIB_FALSE);
    CheckPosResponse_SID28(SFOf28[1],0,0);
    CheckCommunication(DEALL,1);
    TestStep(":");
    SID28_CommunicationControl(SFOf28[3],NCMAndNMM,PHYSICAL,SPRMIB_FALSE);
    CheckPosResponse_SID28(SFOf28[3],0,0);
    CheckCommunication(DEALL,1);
    TestStep(":");
    SID28_CommunicationControl(SFOf28[2],NormalCommunicationMessage,PHYSICAL,SPRMIB_FALSE);
    CheckPosResponse_SID28(SFOf28[2],0,0);
    CheckCommunication(DENM,1);
    TestStep(":");
    SID28_CommunicationControl(SFOf28[2],NetworkManagementMessage,PHYSICAL,SPRMIB_FALSE);
    CheckPosResponse_SID28(SFOf28[2],0,0);
    CheckCommunication(DENONE,1);
    TestStep(":");
    SID28_CommunicationControl(SFOf28[0],NCMAndNMM,PHYSICAL,SPRMIB_FALSE);
    CheckPosResponse_SID28(SFOf28[0],0,0);
    CheckCommunication(DENONE,1);
    TestStep(" Go to step 49",TestStepIntervalTime);
  }
  else if(gFlagNM==1)
  {
    TestStep("ECU not support NM message,Go to step 31",TestStepIntervalTime);
    
    SID28_CommunicationControl(SFOf28[1],NormalCommunicationMessage,PHYSICAL,SPRMIB_FALSE);
    CheckPosResponse_SID28(SFOf28[1],0,0);
    CheckCommunication(DEAPP,0);
    TestStep(":");
    SID28_CommunicationControl(SFOf28[2],NormalCommunicationMessage,PHYSICAL,SPRMIB_FALSE);
    CheckPosResponse_SID28(SFOf28[2],0,0);
    CheckCommunication(DENONE,0);
    TestStep(":");
    SID28_CommunicationControl(SFOf28[0],NormalCommunicationMessage,PHYSICAL,SPRMIB_FALSE);
    CheckPosResponse_SID28(SFOf28[0],0,0);
    CheckCommunication(DENONE,0);
    TestStep(":");
    SID28_CommunicationControl(SFOf28[3],NormalCommunicationMessage,PHYSICAL,SPRMIB_FALSE);
    CheckPosResponse_SID28(SFOf28[3],0,0);
    CheckCommunication(DEAPP,0);
    TestStep(":");
    SID28_CommunicationControl(SFOf28[0],NormalCommunicationMessage,PHYSICAL,SPRMIB_FALSE);
    CheckPosResponse_SID28(SFOf28[0],0,0);
    CheckCommunication(DENONE,0);
    TestStep(":");
    SID28_CommunicationControl(SFOf28[1],NCMAndNMM,PHYSICAL,SPRMIB_FALSE);
    CheckPosResponse_SID28(SFOf28[1],0,0);
    CheckCommunication(DEAPP,0);
    TestStep(":");
    SID28_CommunicationControl(SFOf28[2],NCMAndNMM,PHYSICAL,SPRMIB_FALSE);
    CheckPosResponse_SID28(SFOf28[2],0,0);
    CheckCommunication(DENONE,0);
    TestStep(":");
    SID28_CommunicationControl(SFOf28[0],NCMAndNMM,PHYSICAL,SPRMIB_FALSE);
    CheckPosResponse_SID28(SFOf28[0],0,0);
    CheckCommunication(DENONE,0);
    TestStep(":");
    SID28_CommunicationControl(SFOf28[3],NCMAndNMM,PHYSICAL,SPRMIB_FALSE);
    CheckPosResponse_SID28(SFOf28[3],0,0);
    CheckCommunication(DEAPP,0);
    TestStep(":");
    SID28_CommunicationControl(SFOf28[0],NCMAndNMM,PHYSICAL,SPRMIB_FALSE);
    CheckPosResponse_SID28(SFOf28[0],0,0);
    CheckCommunication(DENONE,0);
    TestStep(":");
    SID28_CommunicationControl(SFOf28[1],NormalCommunicationMessage,PHYSICAL,SPRMIB_FALSE);
    CheckPosResponse_SID28(SFOf28[1],0,0);
    CheckCommunication(DEAPP,0);
    TestStep(":");
    SID28_CommunicationControl(SFOf28[3],NCMAndNMM,PHYSICAL,SPRMIB_FALSE);
    CheckPosResponse_SID28(SFOf28[3],0,0);
    CheckCommunication(DEAPP,0);
    TestStep(":");
    SID28_CommunicationControl(SFOf28[2],NormalCommunicationMessage,PHYSICAL,SPRMIB_FALSE);
    CheckPosResponse_SID28(SFOf28[2],0,0);
    CheckCommunication(DENONE,0);
    TestStep(":");
    SID28_CommunicationControl(SFOf28[0],NCMAndNMM,PHYSICAL,SPRMIB_FALSE);
    CheckPosResponse_SID28(SFOf28[0],0,0);
    CheckCommunication(DENONE,0);
    TestStep(":");
    SID28_CommunicationControl(SFOf28[1],NormalCommunicationMessage,PHYSICAL,SPRMIB_FALSE);
    CheckPosResponse_SID28(SFOf28[1],0,0);
    CheckCommunication(DEAPP,0);
    TestStep(":");
    SID28_CommunicationControl(SFOf28[3],NCMAndNMM,PHYSICAL,SPRMIB_FALSE);
    CheckPosResponse_SID28(SFOf28[3],0,0);
    CheckCommunication(DEAPP,0);
    TestStep(":");
    SID28_CommunicationControl(SFOf28[2],NormalCommunicationMessage,PHYSICAL,SPRMIB_FALSE);
    CheckPosResponse_SID28(SFOf28[2],0,0);
    CheckCommunication(DENONE,0);
    TestStep(":");
    SID28_CommunicationControl(SFOf28[0],NCMAndNMM,PHYSICAL,SPRMIB_FALSE);
    CheckPosResponse_SID28(SFOf28[0],0,0);
    CheckCommunication(DENONE,0);
  }
  if(TestSubnetCommunicationControlFlag==1)
  {
    subnetComConTestingFlag=1;
    if(gFlagNM==0)
    {
      for(i=0;i<elcount(GEEA30_E245);i++)
      {
        if(GEEA30_E245[i].canChannelNumber!=0)
        {
          Teststep("INF","=======================Now testing %s subnet communicationControl function=======================",GEEA30_E245[i].network);
          subnetComConTestingChannel=GEEA30_E245[i].canChannelNumber;
          CommType=(GEEA30_E245[i].value<<4)|0x3;
          SID28_CommunicationControl(SFOf28[3],CommType,PHYSICAL,SPRMIB_FALSE);
          CheckPosResponse_SID28(SFOf28[3],0,0);
          CheckCommunication(DEAPP,0);
          
          SID28_CommunicationControl(SFOf28[0],CommType,PHYSICAL,SPRMIB_FALSE);
          CheckPosResponse_SID28(SFOf28[0],0,0);
          CheckCommunication(DENONE,0);
          
          testWaitForTimeout(5000);
          
          SID28_CommunicationControl(SFOf28[3],CommType,PHYSICAL,SPRMIB_TRUE);
          CheckPosResponse_SID28(SFOf28[3],0,0);
          CheckCommunication(DEAPP,0);
          
          SID28_CommunicationControl(SFOf28[0],CommType,PHYSICAL,SPRMIB_TRUE);
          CheckPosResponse_SID28(SFOf28[0],0,0);
          CheckCommunication(DENONE,0);
          
          testWaitForTimeout(5000);
        }
      }
    }
    else
    {
      for(i=0;i<elcount(GEEA30_E245);i++)
      {
        if(GEEA30_E245[i].canChannelNumber!=0)
        {
          Teststep("INF","=======================Now testing %s subnet communicationControl function=======================",GEEA30_E245[i].network);
          subnetComConTestingChannel=GEEA30_E245[i].canChannelNumber;
          CommType=(GEEA30_E245[i].value<<4)|0x3;
          SID28_CommunicationControl(SFOf28[3],CommType,PHYSICAL,SPRMIB_FALSE);
          CheckPosResponse_SID28(SFOf28[3],0,0);
          CheckCommunication(DEALL,0);
          
          SID28_CommunicationControl(SFOf28[0],CommType,PHYSICAL,SPRMIB_FALSE);
          CheckPosResponse_SID28(SFOf28[0],0,0);
          CheckCommunication(DENONE,0);
          
          testWaitForTimeout(5000);
          
          SID28_CommunicationControl(SFOf28[3],CommType,PHYSICAL,SPRMIB_TRUE);
          CheckPosResponse_SID28(SFOf28[3],0,0);
          CheckCommunication(DEALL,0);
          
          SID28_CommunicationControl(SFOf28[0],CommType,PHYSICAL,SPRMIB_TRUE);
          CheckPosResponse_SID28(SFOf28[0],0,0);
          CheckCommunication(DENONE,0);
          
          testWaitForTimeout(5000);
        }
      }
    }
    subnetComConTestingFlag=0;
  }
  TestStep("Verify extendedSession(0x03)",TestStepIntervalTime);
  CheckCurrentSession(expectSession[2],PHYSICAL,0,0);
  /******************************以上为测试步骤*********************************/
  PostCondition();
}
/// <APP_CommonServiceTest>
testcase Service_0x28_Func_Function()
{
  byte expectSession[4]={0x01,0x02,0x03,0x04};
  byte SFOf28[4]={0x00,0x01,0x02,0x03};
  byte t28[3]={0x28,0x00,0x01};
  byte expectNRC[1]={0x31};
  byte CommType=0;
  int i=0,j=0;
  char logName[400] = "";
  char info[1024];
  strncat(logName,"1088539_Service_0x28_Func_Function",400);
  testCaseTitle("1088539","Service_0x28_Func_Function");
  if(gBusFlag==3)
	{
		testStepWarning("Test","This test case does not apply to the LIN bus");
		return;
	}
  SetLog(logName);
  Precondition();
  /******************************以下为测试步骤*********************************/

  TestStep("Enter defaultSession(0x01)",TestStepIntervalTime);
  SID10_DiagnosticSessionControl(DEFAULTSESSION,FUNCTIONAL,SPRMIB_FALSE);
  CheckPosResponse_SID10(DEFAULTSESSION,0,6);
  ECUinitHandle(0);
  TestStep("Enter extendedsession(0x03)",TestStepIntervalTime);
  SID10_DiagnosticSessionControl(EXTENDEDSESSION,FUNCTIONAL,SPRMIB_FALSE);
  CheckPosResponse_SID10(EXTENDEDSESSION,0,6);
  TestStep("Verify extendedSession(0x03)",TestStepIntervalTime);
  CheckCurrentSession(expectSession[2],FUNCTIONAL,0,0);
  
  gFlagNM=0;
  output(NMMessage_Repeat);Teststep("INF","out put NM repeat request message");
  testwaitfortimeout(3000);
  if(gFlagNM==1)
  {
    TestStep("ECU support NM message",TestStepIntervalTime);
    
    SID28_CommunicationControl(SFOf28[1],NormalCommunicationMessage,FUNCTIONAL,SPRMIB_FALSE);
    CheckPosResponse_SID28(SFOf28[1],0,0);
    CheckCommunication(DEAPP,1);
    TestStep(":");
    SID28_CommunicationControl(SFOf28[2],NormalCommunicationMessage,FUNCTIONAL,SPRMIB_FALSE);
    CheckPosResponse_SID28(SFOf28[2],0,0);
    CheckCommunication(DENONE,1);
    TestStep(":");
    SID28_CommunicationControl(SFOf28[0],NormalCommunicationMessage,FUNCTIONAL,SPRMIB_FALSE);
    CheckPosResponse_SID28(SFOf28[0],0,0);
    CheckCommunication(DENONE,1);
    TestStep(":");
    SID28_CommunicationControl(SFOf28[3],NormalCommunicationMessage,FUNCTIONAL,SPRMIB_FALSE);
    CheckPosResponse_SID28(SFOf28[3],0,0);
    CheckCommunication(DEAPP,1);
    TestStep(":");
    SID28_CommunicationControl(SFOf28[0],NormalCommunicationMessage,FUNCTIONAL,SPRMIB_FALSE);
    CheckPosResponse_SID28(SFOf28[0],0,0);
    CheckCommunication(DENONE,1);
    TestStep(":");
    SID28_CommunicationControl(SFOf28[1],NetworkManagementMessage,FUNCTIONAL,SPRMIB_FALSE);
    CheckPosResponse_SID28(SFOf28[1],0,0);
    CheckCommunication(DENM,1);
    TestStep(":");
    SID28_CommunicationControl(SFOf28[2],NetworkManagementMessage,FUNCTIONAL,SPRMIB_FALSE);
    CheckPosResponse_SID28(SFOf28[2],0,0);
    CheckCommunication(DENONE,1);
    TestStep(":");
    SID28_CommunicationControl(SFOf28[0],NetworkManagementMessage,FUNCTIONAL,SPRMIB_FALSE);
    CheckPosResponse_SID28(SFOf28[0],0,0);
    CheckCommunication(DENONE,1);
    TestStep(":");
    SID28_CommunicationControl(SFOf28[3],NetworkManagementMessage,FUNCTIONAL,SPRMIB_FALSE);
    CheckPosResponse_SID28(SFOf28[3],0,0);
    CheckCommunication(DENM,1);
    TestStep(":");
    SID28_CommunicationControl(SFOf28[0],NetworkManagementMessage,FUNCTIONAL,SPRMIB_FALSE);
    CheckPosResponse_SID28(SFOf28[0],0,0);
    CheckCommunication(DENONE,1);
    TestStep(":");
    SID28_CommunicationControl(SFOf28[1],NCMAndNMM,FUNCTIONAL,SPRMIB_FALSE);
    CheckPosResponse_SID28(SFOf28[1],0,0);
    CheckCommunication(DEALL,1);
    TestStep(":");
    SID28_CommunicationControl(SFOf28[2],NCMAndNMM,FUNCTIONAL,SPRMIB_FALSE);
    CheckPosResponse_SID28(SFOf28[2],0,0);
    CheckCommunication(DENONE,1);
    TestStep(":");
    SID28_CommunicationControl(SFOf28[0],NCMAndNMM,FUNCTIONAL,SPRMIB_FALSE);
    CheckPosResponse_SID28(SFOf28[0],0,0);
    CheckCommunication(DENONE,1);
    TestStep(":");
    SID28_CommunicationControl(SFOf28[3],NCMAndNMM,FUNCTIONAL,SPRMIB_FALSE);
    CheckPosResponse_SID28(SFOf28[3],0,0);
    CheckCommunication(DEALL,1);
    TestStep(":");
    SID28_CommunicationControl(SFOf28[0],NCMAndNMM,FUNCTIONAL,SPRMIB_FALSE);
    CheckPosResponse_SID28(SFOf28[0],0,0);
    CheckCommunication(DENONE,1);
    TestStep(":");
    SID28_CommunicationControl(SFOf28[1],NormalCommunicationMessage,FUNCTIONAL,SPRMIB_FALSE);
    CheckPosResponse_SID28(SFOf28[1],0,0);
    CheckCommunication(DEAPP,1);
    TestStep(":");
    SID28_CommunicationControl(SFOf28[1],NetworkManagementMessage,FUNCTIONAL,SPRMIB_FALSE);
    CheckPosResponse_SID28(SFOf28[1],0,0);
    CheckCommunication(DEALL,1);
    TestStep(":");
    SID28_CommunicationControl(SFOf28[3],NCMAndNMM,FUNCTIONAL,SPRMIB_FALSE);
    CheckPosResponse_SID28(SFOf28[3],0,0);
    CheckCommunication(DEALL,1);
    TestStep(":");
    SID28_CommunicationControl(SFOf28[2],NormalCommunicationMessage,FUNCTIONAL,SPRMIB_FALSE);
    CheckPosResponse_SID28(SFOf28[2],0,0);
    CheckCommunication(DENM,1);
    TestStep(":");
    SID28_CommunicationControl(SFOf28[2],NetworkManagementMessage,FUNCTIONAL,SPRMIB_FALSE);
    CheckPosResponse_SID28(SFOf28[2],0,0);
    CheckCommunication(DENONE,1);
    TestStep(":");
    SID28_CommunicationControl(SFOf28[0],NCMAndNMM,FUNCTIONAL,SPRMIB_FALSE);
    CheckPosResponse_SID28(SFOf28[0],0,0);
    CheckCommunication(DENONE,1);
    TestStep(":");
    SID28_CommunicationControl(SFOf28[1],NetworkManagementMessage,FUNCTIONAL,SPRMIB_FALSE);
    CheckPosResponse_SID28(SFOf28[1],0,0);
    CheckCommunication(DENM,1);
    TestStep(":");
    SID28_CommunicationControl(SFOf28[1],NormalCommunicationMessage,FUNCTIONAL,SPRMIB_FALSE);
    CheckPosResponse_SID28(SFOf28[1],0,0);
    CheckCommunication(DEALL,1);
    TestStep(":");
    SID28_CommunicationControl(SFOf28[3],NCMAndNMM,FUNCTIONAL,SPRMIB_FALSE);
    CheckPosResponse_SID28(SFOf28[3],0,0);
    CheckCommunication(DEALL,1);
    TestStep(":",TestStepIntervalTime);
    SID28_CommunicationControl(SFOf28[2],NormalCommunicationMessage,FUNCTIONAL,SPRMIB_FALSE);
    CheckPosResponse_SID28(SFOf28[2],0,0);
    CheckCommunication(DENM,1);
    TestStep(":");
    SID28_CommunicationControl(SFOf28[2],NetworkManagementMessage,FUNCTIONAL,SPRMIB_FALSE);
    CheckPosResponse_SID28(SFOf28[2],0,0);
    CheckCommunication(DENONE,1);
    TestStep(":");
    SID28_CommunicationControl(SFOf28[0],NCMAndNMM,FUNCTIONAL,SPRMIB_FALSE);
    CheckPosResponse_SID28(SFOf28[0],0,0);
    CheckCommunication(DENONE,1);
    TestStep(" Go to step 49",TestStepIntervalTime);
  }
  else if(gFlagNM==1)
  {
    TestStep("ECU not support NM message,Go to step 31",TestStepIntervalTime);
    
    SID28_CommunicationControl(SFOf28[1],NormalCommunicationMessage,FUNCTIONAL,SPRMIB_FALSE);
    CheckPosResponse_SID28(SFOf28[1],0,0);
    CheckCommunication(DEAPP,0);
    TestStep(":");
    SID28_CommunicationControl(SFOf28[2],NormalCommunicationMessage,FUNCTIONAL,SPRMIB_FALSE);
    CheckPosResponse_SID28(SFOf28[2],0,0);
    CheckCommunication(DENONE,0);
    TestStep(":");
    SID28_CommunicationControl(SFOf28[0],NormalCommunicationMessage,FUNCTIONAL,SPRMIB_FALSE);
    CheckPosResponse_SID28(SFOf28[0],0,0);
    CheckCommunication(DENONE,0);
    TestStep(":");
    SID28_CommunicationControl(SFOf28[3],NormalCommunicationMessage,FUNCTIONAL,SPRMIB_FALSE);
    CheckPosResponse_SID28(SFOf28[3],0,0);
    CheckCommunication(DEAPP,0);
    TestStep(":");
    SID28_CommunicationControl(SFOf28[0],NormalCommunicationMessage,FUNCTIONAL,SPRMIB_FALSE);
    CheckPosResponse_SID28(SFOf28[0],0,0);
    CheckCommunication(DENONE,0);
    TestStep(":");
    SID28_CommunicationControl(SFOf28[1],NCMAndNMM,FUNCTIONAL,SPRMIB_FALSE);
    CheckPosResponse_SID28(SFOf28[1],0,0);
    CheckCommunication(DEAPP,0);
    TestStep(":");
    SID28_CommunicationControl(SFOf28[2],NCMAndNMM,FUNCTIONAL,SPRMIB_FALSE);
    CheckPosResponse_SID28(SFOf28[2],0,0);
    CheckCommunication(DENONE,0);
    TestStep(":");
    SID28_CommunicationControl(SFOf28[0],NCMAndNMM,FUNCTIONAL,SPRMIB_FALSE);
    CheckPosResponse_SID28(SFOf28[0],0,0);
    CheckCommunication(DENONE,0);
    TestStep(":");
    SID28_CommunicationControl(SFOf28[3],NCMAndNMM,FUNCTIONAL,SPRMIB_FALSE);
    CheckPosResponse_SID28(SFOf28[3],0,0);
    CheckCommunication(DEAPP,0);
    TestStep(":");
    SID28_CommunicationControl(SFOf28[0],NCMAndNMM,FUNCTIONAL,SPRMIB_FALSE);
    CheckPosResponse_SID28(SFOf28[0],0,0);
    CheckCommunication(DENONE,0);
    TestStep(":");
    SID28_CommunicationControl(SFOf28[1],NormalCommunicationMessage,FUNCTIONAL,SPRMIB_FALSE);
    CheckPosResponse_SID28(SFOf28[1],0,0);
    CheckCommunication(DEAPP,0);
    TestStep(":");
    SID28_CommunicationControl(SFOf28[3],NCMAndNMM,FUNCTIONAL,SPRMIB_FALSE);
    CheckPosResponse_SID28(SFOf28[3],0,0);
    CheckCommunication(DEAPP,0);
    TestStep(":");
    SID28_CommunicationControl(SFOf28[2],NormalCommunicationMessage,FUNCTIONAL,SPRMIB_FALSE);
    CheckPosResponse_SID28(SFOf28[2],0,0);
    CheckCommunication(DENONE,0);
    TestStep(":");
    SID28_CommunicationControl(SFOf28[0],NCMAndNMM,FUNCTIONAL,SPRMIB_FALSE);
    CheckPosResponse_SID28(SFOf28[0],0,0);
    CheckCommunication(DENONE,0);
    TestStep(":");
    SID28_CommunicationControl(SFOf28[1],NormalCommunicationMessage,FUNCTIONAL,SPRMIB_FALSE);
    CheckPosResponse_SID28(SFOf28[1],0,0);
    CheckCommunication(DEAPP,0);
    TestStep(":");
    SID28_CommunicationControl(SFOf28[3],NCMAndNMM,FUNCTIONAL,SPRMIB_FALSE);
    CheckPosResponse_SID28(SFOf28[3],0,0);
    CheckCommunication(DEAPP,0);
    TestStep(":");
    SID28_CommunicationControl(SFOf28[2],NormalCommunicationMessage,FUNCTIONAL,SPRMIB_FALSE);
    CheckPosResponse_SID28(SFOf28[2],0,0);
    CheckCommunication(DENONE,0);
    TestStep(":");
    SID28_CommunicationControl(SFOf28[0],NCMAndNMM,FUNCTIONAL,SPRMIB_FALSE);
    CheckPosResponse_SID28(SFOf28[0],0,0);
    CheckCommunication(DENONE,0);
  }
  if(TestSubnetCommunicationControlFlag==1)
  {
    subnetComConTestingFlag=1;
    if(gFlagNM==0)
    {
      for(i=0;i<elcount(GEEA30_E245);i++)
      {
        if(GEEA30_E245[i].canChannelNumber!=0)
        {
          Teststep("INF","=======================Now testing %s subnet communicationControl function=======================",GEEA30_E245[i].network);
          subnetComConTestingChannel=GEEA30_E245[i].canChannelNumber;
          CommType=(GEEA30_E245[i].value<<4)|0x3;
          SID28_CommunicationControl(SFOf28[3],CommType,FUNCTIONAL,SPRMIB_FALSE);
          CheckPosResponse_SID28(SFOf28[3],0,0);
          CheckCommunication(DEAPP,0);
          
          SID28_CommunicationControl(SFOf28[0],CommType,FUNCTIONAL,SPRMIB_FALSE);
          CheckPosResponse_SID28(SFOf28[0],0,0);
          CheckCommunication(DENONE,0);
          
          testWaitForTimeout(5000);
          SID28_CommunicationControl(SFOf28[3],CommType,FUNCTIONAL,SPRMIB_TRUE);
          CheckPosResponse_SID28(SFOf28[3],0,0);
          CheckCommunication(DEAPP,0);
          
          SID28_CommunicationControl(SFOf28[0],CommType,FUNCTIONAL,SPRMIB_TRUE);
          CheckPosResponse_SID28(SFOf28[0],0,0);
          CheckCommunication(DENONE,0);
          
          testWaitForTimeout(5000);
        }
      }
    }
    else
    {
      for(i=0;i<elcount(GEEA30_E245);i++)
      {
        if(GEEA30_E245[i].canChannelNumber!=0)
        {
          Teststep("INF","=======================Now testing %s subnet communicationControl function=======================",GEEA30_E245[i].network);
          subnetComConTestingChannel=GEEA30_E245[i].canChannelNumber;
          CommType=(GEEA30_E245[i].value<<4)|0x3;
          SID28_CommunicationControl(SFOf28[3],CommType,FUNCTIONAL,SPRMIB_FALSE);
          CheckPosResponse_SID28(SFOf28[3],0,0);
          CheckCommunication(DEALL,0);
          
          SID28_CommunicationControl(SFOf28[0],CommType,FUNCTIONAL,SPRMIB_FALSE);
          CheckPosResponse_SID28(SFOf28[0],0,0);
          CheckCommunication(DENONE,0);
          
          testWaitForTimeout(5000);
          SID28_CommunicationControl(SFOf28[3],CommType,FUNCTIONAL,SPRMIB_TRUE);
          CheckPosResponse_SID28(SFOf28[3],0,0);
          CheckCommunication(DEALL,0);
          
          SID28_CommunicationControl(SFOf28[0],CommType,FUNCTIONAL,SPRMIB_TRUE);
          CheckPosResponse_SID28(SFOf28[0],0,0);
          CheckCommunication(DENONE,0);
          
          testWaitForTimeout(5000);
        }
      }
    }
    subnetComConTestingFlag=0;
  }
  
  TestStep("Verify extendedSession(0x03)",TestStepIntervalTime);
  CheckCurrentSession(expectSession[2],FUNCTIONAL,0,0);
  /******************************以上为测试步骤*********************************/
  PostCondition();
}
/// <APP_CommonServiceTest>
testcase Service_0x28_Phy_SessionChange()
{
  byte expectSession[4]={0x01,0x02,0x03,0x04};
  byte SFOf28[4]={0x00,0x01,0x02,0x03};
  byte t28[3]={0x28,0x00,0x01};
  byte expectNRC[1]={0x31};
  int i=0,j=0;
  char logName[400] = "";
  char info[1024];
  strncat(logName,"1088540_Service_0x28_Phy_SessionChange",400);
  testCaseTitle("1088540","Service_0x28_Phy_SessionChange");
  if(gBusFlag==3)
	{
		testStepWarning("Test","This test case does not apply to the LIN bus");
		return;
	}
  SetLog(logName);
  Precondition();
  /******************************以下为测试步骤*********************************/
  
  gFlagNM=0;
  output(NMMessage_Repeat);Teststep("INF","out put NM repeat request message");
  testwaitfortimeout(3000);
  if(gFlagNM==1)
  {
    TestStep("ECU support NM message",TestStepIntervalTime);
    TestStep("Enter defaultSession(0x01)",TestStepIntervalTime);
    SID10_DiagnosticSessionControl(DEFAULTSESSION,PHYSICAL,SPRMIB_FALSE);
    CheckPosResponse_SID10(DEFAULTSESSION,0,6);
    ECUinitHandle(0);
    TestStep("Enter extendedsession(0x03)",TestStepIntervalTime);
    SID10_DiagnosticSessionControl(EXTENDEDSESSION,PHYSICAL,SPRMIB_FALSE);
    CheckPosResponse_SID10(EXTENDEDSESSION,0,6);
    CheckCurrentSession(expectSession[2],PHYSICAL,0,0);
    
    SID28_CommunicationControl(SFOf28[3],NCMAndNMM,PHYSICAL,SPRMIB_FALSE);
    CheckPosResponse_SID28(SFOf28[3],0,0);
    TestStep("Check the NM Message and APP Message are prohibited(All channels)",TestStepIntervalTime);
    CheckCommunication(DEALL,1);
    TestStep("Enter defaultSession(0x01)",TestStepIntervalTime);
    SID10_DiagnosticSessionControl(DEFAULTSESSION,PHYSICAL,SPRMIB_FALSE);
    CheckPosResponse_SID10(DEFAULTSESSION,0,6);
    ECUinitHandle(0);
    TestStep("Check the NM Message and APP Message are sent normally(All channels)",TestStepIntervalTime);
    CheckCommunication(DENONE,1);
    TestStep("Enter defaultSession(0x01)",TestStepIntervalTime);
    SID10_DiagnosticSessionControl(DEFAULTSESSION,PHYSICAL,SPRMIB_FALSE);
    CheckPosResponse_SID10(DEFAULTSESSION,0,6);
    ECUinitHandle(0);
    TestStep("Enter extendedsession(0x03)",TestStepIntervalTime);
    SID10_DiagnosticSessionControl(EXTENDEDSESSION,PHYSICAL,SPRMIB_FALSE);
    CheckPosResponse_SID10(EXTENDEDSESSION,0,6);
    CheckCurrentSession(expectSession[2],PHYSICAL,0,0);
    
    SID28_CommunicationControl(SFOf28[3],NCMAndNMM,PHYSICAL,SPRMIB_FALSE);
    CheckPosResponse_SID28(SFOf28[3],0,0);
    TestStep("Check the NM Message and APP Message are prohibited(All channels)",TestStepIntervalTime);
    CheckCommunication(DEALL,1);
    TestStep("Enter extendedsession(0x03)",TestStepIntervalTime);
    SID10_DiagnosticSessionControl(EXTENDEDSESSION,PHYSICAL,SPRMIB_FALSE);
    CheckPosResponse_SID10(EXTENDEDSESSION,0,6);
    CheckCurrentSession(expectSession[2],PHYSICAL,0,0);
    TestStep("Check the NM Message and APP Message are prohibited(All channels)",TestStepIntervalTime);
    CheckCommunication(DEALL,1);
    TestStep("Enter programmingsession(0x02)",TestStepIntervalTime);
    SID10_DiagnosticSessionControl(PROGRAMMINGSESSION,PHYSICAL,SPRMIB_FALSE);
    CheckPosResponse_SID10(PROGRAMMINGSESSION,0,6);
    ECUinitHandle(0);
    CheckCurrentSession(expectSession[1],PHYSICAL,0,0);
    
    TestStep("Check the NM Message and APP Message are prohibited(All channels)",TestStepIntervalTime);
    CheckCommunication(DEALL,1);
    TestStep("Go to step 30",TestStepIntervalTime,30);
  }
  else if(gFlagNM==0)
  {
    TestStep("ECU not support NM message,Go to step 16",TestStepIntervalTime);
    TestStep("Enter defaultSession(0x01)",TestStepIntervalTime);
    SID10_DiagnosticSessionControl(DEFAULTSESSION,PHYSICAL,SPRMIB_FALSE);
    CheckPosResponse_SID10(DEFAULTSESSION,0,6);
    ECUinitHandle(0);

    TestStep("Enter extendedsession(0x03)",TestStepIntervalTime);
    SID10_DiagnosticSessionControl(EXTENDEDSESSION,PHYSICAL,SPRMIB_FALSE);
    CheckPosResponse_SID10(EXTENDEDSESSION,0,6);
    CheckCurrentSession(expectSession[2],PHYSICAL,0,0);
    TestStep("step18",TestStepIntervalTime);
    SID28_CommunicationControl(SFOf28[3],NCMAndNMM,PHYSICAL,SPRMIB_FALSE);
    CheckPosResponse_SID28(SFOf28[3],0,0);
    TestStep("Check the APP Message is prohibited(All channels)",TestStepIntervalTime);
    CheckCommunication(DEAPP,0);

    TestStep("Enter defaultSession(0x01)",TestStepIntervalTime);
    SID10_DiagnosticSessionControl(DEFAULTSESSION,PHYSICAL,SPRMIB_FALSE);
    CheckPosResponse_SID10(DEFAULTSESSION,0,6);
    ECUinitHandle(0);
    TestStep("Check the APP Message is sent normally(All channels)",TestStepIntervalTime);
    CheckCommunication(DENONE,0);

    TestStep("Enter defaultSession(0x01)",TestStepIntervalTime);
    SID10_DiagnosticSessionControl(DEFAULTSESSION,PHYSICAL,SPRMIB_FALSE);
    CheckPosResponse_SID10(DEFAULTSESSION,0,6);
    ECUinitHandle(0);
    TestStep("Enter extendedsession(0x03)",TestStepIntervalTime);
    SID10_DiagnosticSessionControl(EXTENDEDSESSION,PHYSICAL,SPRMIB_FALSE);
    CheckPosResponse_SID10(EXTENDEDSESSION,0,6);
    CheckCurrentSession(expectSession[2],PHYSICAL,0,0);
    
    
    SID28_CommunicationControl(SFOf28[3],NCMAndNMM,PHYSICAL,SPRMIB_FALSE);
    CheckPosResponse_SID28(SFOf28[3],0,0);
    
    TestStep("Check the APP Message is prohibited(All channels)",TestStepIntervalTime);
    CheckCommunication(DEALL,0);

    TestStep("Enter extendedsession(0x03)",TestStepIntervalTime);
    SID10_DiagnosticSessionControl(EXTENDEDSESSION,PHYSICAL,SPRMIB_FALSE);
    CheckPosResponse_SID10(EXTENDEDSESSION,0,6);
    CheckCurrentSession(expectSession[2],PHYSICAL,0,0);
    TestStep("Check the APP Message is sent prohibited(All channels)",TestStepIntervalTime);
    CheckCommunication(DEALL,0);
    TestStep(":Enter programmingsession(0x02)",TestStepIntervalTime);
    SID10_DiagnosticSessionControl(PROGRAMMINGSESSION,PHYSICAL,SPRMIB_FALSE);
    CheckPosResponse_SID10(PROGRAMMINGSESSION,0,6);
    ECUinitHandle(0);
    CheckCurrentSession(expectSession[1],PHYSICAL,0,0);
    
    TestStep("Check the APP Message is prohibited(All channels)",TestStepIntervalTime);
    CheckCommunication(DEALL,0);
  }
  TestStep("Enter defaultSession(0x01)",TestStepIntervalTime);
  SID10_DiagnosticSessionControl(DEFAULTSESSION,PHYSICAL,SPRMIB_FALSE);
  CheckPosResponse_SID10(DEFAULTSESSION,0,6);
  ECUinitHandle(0);
  /******************************以上为测试步骤*********************************/
  PostCondition();
}
/// <APP_CommonServiceTest>
testcase Service_0x28_Func_SessionChange()
{
  byte expectSession[4]={0x01,0x02,0x03,0x04};
  byte SFOf28[4]={0x00,0x01,0x02,0x03};
  byte t28[3]={0x28,0x00,0x01};
  byte expectNRC[1]={0x31};
  int i=0,j=0;
  char logName[400] = "";
  char info[1024];
  strncat(logName,"1088541_Service_0x28_Func_SessionChange",400);
  testCaseTitle("1088541","Service_0x28_Func_SessionChange");
  if(gBusFlag==3)
	{
		testStepWarning("Test","This test case does not apply to the LIN bus");
		return;
	}
  SetLog(logName);
  Precondition();
  /******************************以下为测试步骤*********************************/

  gFlagNM=0;
  output(NMMessage_Repeat);Teststep("INF","out put NM repeat request message");
  testwaitfortimeout(3000);
  if(gFlagNM==1)
  {
    TestStep("ECU support NM message",TestStepIntervalTime);
    TestStep("Enter defaultSession(0x01)",TestStepIntervalTime);
    SID10_DiagnosticSessionControl(DEFAULTSESSION,FUNCTIONAL,SPRMIB_FALSE);
    CheckPosResponse_SID10(DEFAULTSESSION,0,6);
    ECUinitHandle(0);
    TestStep("Enter extendedsession(0x03)",TestStepIntervalTime);
    SID10_DiagnosticSessionControl(EXTENDEDSESSION,FUNCTIONAL,SPRMIB_FALSE);
    CheckPosResponse_SID10(EXTENDEDSESSION,0,6);
    CheckCurrentSession(expectSession[2],FUNCTIONAL,0,0);
    
    SID28_CommunicationControl(SFOf28[3],NCMAndNMM,FUNCTIONAL,SPRMIB_FALSE);
    CheckPosResponse_SID28(SFOf28[3],0,0);
    TestStep("Check the NM Message and APP Message are prohibited(All channels)",TestStepIntervalTime);
    CheckCommunication(DEALL,1);
    TestStep("Enter defaultSession(0x01)",TestStepIntervalTime);
    SID10_DiagnosticSessionControl(DEFAULTSESSION,FUNCTIONAL,SPRMIB_FALSE);
    CheckPosResponse_SID10(DEFAULTSESSION,0,6);
    ECUinitHandle(0);
    TestStep("Check the NM Message and APP Message are sent normally(All channels)",TestStepIntervalTime);
    CheckCommunication(DENONE,1);
    TestStep("Enter defaultSession(0x01)",TestStepIntervalTime);
    SID10_DiagnosticSessionControl(DEFAULTSESSION,FUNCTIONAL,SPRMIB_FALSE);
    CheckPosResponse_SID10(DEFAULTSESSION,0,6);
    ECUinitHandle(0);
    TestStep("Enter extendedsession(0x03)",TestStepIntervalTime);
    SID10_DiagnosticSessionControl(EXTENDEDSESSION,FUNCTIONAL,SPRMIB_FALSE);
    CheckPosResponse_SID10(EXTENDEDSESSION,0,6);
    CheckCurrentSession(expectSession[2],FUNCTIONAL,0,0);
    
    SID28_CommunicationControl(SFOf28[3],NCMAndNMM,FUNCTIONAL,SPRMIB_FALSE);
    CheckPosResponse_SID28(SFOf28[3],0,0);
    TestStep("Check the NM Message and APP Message are prohibited(All channels)",TestStepIntervalTime);
    CheckCommunication(DEALL,1);
    TestStep("Enter extendedsession(0x03)",TestStepIntervalTime);
    SID10_DiagnosticSessionControl(EXTENDEDSESSION,FUNCTIONAL,SPRMIB_FALSE);
    CheckPosResponse_SID10(EXTENDEDSESSION,0,6);
    CheckCurrentSession(expectSession[2],FUNCTIONAL,0,0);
    TestStep("Check the NM Message and APP Message are prohibited(All channels)",TestStepIntervalTime);
    CheckCommunication(DEALL,1);
    TestStep("Enter programmingsession(0x02)",TestStepIntervalTime);
    SID10_DiagnosticSessionControl(PROGRAMMINGSESSION,FUNCTIONAL,SPRMIB_FALSE);
    CheckPosResponse_SID10(PROGRAMMINGSESSION,0,6);
    ECUinitHandle(0);
    CheckCurrentSession(expectSession[1],FUNCTIONAL,0,0);
    
    TestStep("Check the NM Message and APP Message are prohibited(All channels)",TestStepIntervalTime);
    CheckCommunication(DEALL,1);
    TestStep("Go to step 30",TestStepIntervalTime,30);
  }
  else if(gFlagNM==0)
  {
    TestStep("ECU not support NM message,Go to step 16",TestStepIntervalTime);
    TestStep("Enter defaultSession(0x01)",TestStepIntervalTime);
    SID10_DiagnosticSessionControl(DEFAULTSESSION,FUNCTIONAL,SPRMIB_FALSE);
    CheckPosResponse_SID10(DEFAULTSESSION,0,6);
    ECUinitHandle(0);

    TestStep("Enter extendedsession(0x03)",TestStepIntervalTime);
    SID10_DiagnosticSessionControl(EXTENDEDSESSION,FUNCTIONAL,SPRMIB_FALSE);
    CheckPosResponse_SID10(EXTENDEDSESSION,0,6);
    CheckCurrentSession(expectSession[2],FUNCTIONAL,0,0);
    TestStep("step18",TestStepIntervalTime);
    SID28_CommunicationControl(SFOf28[3],NCMAndNMM,FUNCTIONAL,SPRMIB_FALSE);
    CheckPosResponse_SID28(SFOf28[3],0,0);
    TestStep("Check the APP Message is prohibited(All channels)",TestStepIntervalTime);
    CheckCommunication(DEALL,0);

    TestStep("Enter defaultSession(0x01)",TestStepIntervalTime);
    SID10_DiagnosticSessionControl(DEFAULTSESSION,FUNCTIONAL,SPRMIB_FALSE);
    CheckPosResponse_SID10(DEFAULTSESSION,0,6);
    ECUinitHandle(0);
    TestStep("Check the APP Message is sent normally(All channels)",TestStepIntervalTime);
    CheckCommunication(DENONE,0);

    TestStep("Enter defaultSession(0x01)",TestStepIntervalTime);
    SID10_DiagnosticSessionControl(DEFAULTSESSION,FUNCTIONAL,SPRMIB_FALSE);
    CheckPosResponse_SID10(DEFAULTSESSION,0,6);
    ECUinitHandle(0);
    TestStep("Enter extendedsession(0x03)",TestStepIntervalTime);
    SID10_DiagnosticSessionControl(EXTENDEDSESSION,FUNCTIONAL,SPRMIB_FALSE);
    CheckPosResponse_SID10(EXTENDEDSESSION,0,6);
    CheckCurrentSession(expectSession[2],FUNCTIONAL,0,0);
    
    
    SID28_CommunicationControl(SFOf28[3],NCMAndNMM,FUNCTIONAL,SPRMIB_FALSE);
    CheckPosResponse_SID28(SFOf28[3],0,0);
    
    TestStep("Check the APP Message is prohibited(All channels)",TestStepIntervalTime);
    CheckCommunication(DEALL,0);

    TestStep("Enter extendedsession(0x03)",TestStepIntervalTime);
    SID10_DiagnosticSessionControl(EXTENDEDSESSION,FUNCTIONAL,SPRMIB_FALSE);
    CheckPosResponse_SID10(EXTENDEDSESSION,0,6);
    CheckCurrentSession(expectSession[2],FUNCTIONAL,0,0);
    TestStep("Check the APP Message is prohibited(All channels)",TestStepIntervalTime);
    CheckCommunication(DEALL,0);
    TestStep(":Enter programmingsession(0x02)",TestStepIntervalTime);
    SID10_DiagnosticSessionControl(PROGRAMMINGSESSION,FUNCTIONAL,SPRMIB_FALSE);
    CheckPosResponse_SID10(PROGRAMMINGSESSION,0,6);
    ECUinitHandle(0);
    CheckCurrentSession(expectSession[1],FUNCTIONAL,0,0);
    
    TestStep("Check the APP Message is prohibited(All channels)",TestStepIntervalTime);
    CheckCommunication(DEALL,0);
  }
  TestStep("Enter defaultSession(0x01)",TestStepIntervalTime);
  SID10_DiagnosticSessionControl(DEFAULTSESSION,FUNCTIONAL,SPRMIB_FALSE);
  CheckPosResponse_SID10(DEFAULTSESSION,0,6);
  ECUinitHandle(0);
  /******************************以上为测试步骤*********************************/
  PostCondition();
}
/// <APP_CommonServiceTest>
testcase Service_0x28_Phy_HardReset()
{
  byte expectSession[4]={0x01,0x02,0x03,0x04};
  byte SFOf28[4]={0x00,0x01,0x02,0x03};
  byte t28[3]={0x28,0x00,0x01};
  byte expectNRC[1]={0x31};
  int i=0,j=0;
  char logName[400] = "";
  char info[1024];
  
  strncat(logName,"1088542_Service_0x28_Phy_HardReset",400);
  testCaseTitle("1088542","Service_0x28_Phy_HardReset");
  if(gBusFlag==3)
	{
		testStepWarning("Test","This test case does not apply to the LIN bus");
		return;
	}
  SetLog(logName);
  Precondition();
  /******************************以下为测试步骤*********************************/

  gFlagNM=0;
  output(NMMessage_Repeat);Teststep("INF","out put NM repeat request message");
  testwaitfortimeout(3000);
  if(gFlagNM==1)
  {
    TestStep("ECU support NM message",TestStepIntervalTime);
    TestStep("Enter defaultSession(0x01)",TestStepIntervalTime);
    SID10_DiagnosticSessionControl(DEFAULTSESSION,PHYSICAL,SPRMIB_FALSE);
    CheckPosResponse_SID10(DEFAULTSESSION,0,6);
    ECUinitHandle(0);
    TestStep("Enter extendedsession(0x03)",TestStepIntervalTime);
    SID10_DiagnosticSessionControl(EXTENDEDSESSION,PHYSICAL,SPRMIB_FALSE);
    CheckPosResponse_SID10(EXTENDEDSESSION,0,6);
    CheckCurrentSession(expectSession[2],PHYSICAL,0,0);
    
    SID28_CommunicationControl(SFOf28[3],NCMAndNMM,PHYSICAL,SPRMIB_FALSE);
    CheckPosResponse_SID28(SFOf28[3],0,0);
    TestStep("Check the NM Message and APP Message are prohibited(All channels)",TestStepIntervalTime);
    CheckCommunication(DEALL,1);
    TestStep("ECU Reset (hard reset)",TestStepIntervalTime);
    SID11_ECUReset(HARDRESET,PHYSICAL,SPRMIB_FALSE);
    CheckPosResponse_SID11(HARDRESET,0,0);
    ECUinitHandle(0);
    TestStep("Check the NM Message and APP Message are sent normally(All channels)",TestStepIntervalTime);
    CheckCommunication(DENONE,0);
    TestStep("Enter defaultSession(0x01)",TestStepIntervalTime);
    SID10_DiagnosticSessionControl(DEFAULTSESSION,PHYSICAL,SPRMIB_FALSE);
    CheckPosResponse_SID10(DEFAULTSESSION,0,6);
    ECUinitHandle(0);
    TestStep("Enter extendedsession(0x03)",TestStepIntervalTime);
    SID10_DiagnosticSessionControl(EXTENDEDSESSION,PHYSICAL,SPRMIB_FALSE);
    CheckPosResponse_SID10(EXTENDEDSESSION,0,6);
    CheckCurrentSession(expectSession[2],PHYSICAL,0,0);
    
    SID28_CommunicationControl(SFOf28[3],NCMAndNMM,PHYSICAL,SPRMIB_FALSE);
    CheckPosResponse_SID28(SFOf28[3],0,0);
    TestStep("Check the NM Message and APP Message are prohibited(All channels)",TestStepIntervalTime);
    CheckCommunication(DEALL,1);
    TestStep("Go to step 26",TestStepIntervalTime,26);
  }
  else if(gFlagNM==0)
  {
    TestStep("ECU not support NM message,Go to step 14",TestStepIntervalTime);
    TestStep("Enter defaultSession(0x01)",TestStepIntervalTime);
    SID10_DiagnosticSessionControl(DEFAULTSESSION,PHYSICAL,SPRMIB_FALSE);
    CheckPosResponse_SID10(DEFAULTSESSION,0,6);
    ECUinitHandle(0);

    TestStep("Enter extendedsession(0x03)",TestStepIntervalTime);
    SID10_DiagnosticSessionControl(EXTENDEDSESSION,PHYSICAL,SPRMIB_FALSE);
    CheckPosResponse_SID10(EXTENDEDSESSION,0,6);
    CheckCurrentSession(expectSession[2],PHYSICAL,0,0);
    TestStep("step16",TestStepIntervalTime);
    SID28_CommunicationControl(SFOf28[3],NCMAndNMM,PHYSICAL,SPRMIB_FALSE);
    CheckPosResponse_SID28(SFOf28[3],0,0);
    TestStep("Check the APP Message is prohibited(All channels)",TestStepIntervalTime);
    CheckCommunication(DEAPP,0);

    TestStep("ECU Reset (hard reset)",TestStepIntervalTime);
    SID11_ECUReset(HARDRESET,PHYSICAL,SPRMIB_FALSE);
    CheckPosResponse_SID11(HARDRESET,0,0);
    ECUinitHandle(0);
    TestStep("Check the APP Message is sent normally(All channels)",TestStepIntervalTime);
    CheckCommunication(DENONE,0);

    TestStep("Enter defaultSession(0x01)",TestStepIntervalTime);
    SID10_DiagnosticSessionControl(DEFAULTSESSION,PHYSICAL,SPRMIB_FALSE);
    CheckPosResponse_SID10(DEFAULTSESSION,0,6);
    ECUinitHandle(0);
    TestStep("Enter extendedsession(0x03)",TestStepIntervalTime);
    SID10_DiagnosticSessionControl(EXTENDEDSESSION,PHYSICAL,SPRMIB_FALSE);
    CheckPosResponse_SID10(EXTENDEDSESSION,0,6);
    CheckCurrentSession(expectSession[2],PHYSICAL,0,0);
    
    
    SID28_CommunicationControl(SFOf28[3],NCMAndNMM,PHYSICAL,SPRMIB_FALSE);
    CheckPosResponse_SID28(SFOf28[3],0,0);
    
    TestStep("Check the APP Message is prohibited(All channels)",TestStepIntervalTime);
    CheckCommunication(DEAPP,0);

  }
  TestStep("Enter defaultSession(0x01)",TestStepIntervalTime);
  SID10_DiagnosticSessionControl(DEFAULTSESSION,PHYSICAL,SPRMIB_FALSE);
  CheckPosResponse_SID10(DEFAULTSESSION,0,6);
  ECUinitHandle(0);
  /******************************以上为测试步骤*********************************/
  PostCondition();
}
/// <APP_CommonServiceTest>
testcase Service_0x28_Func_HardReset()
{
  byte expectSession[4]={0x01,0x02,0x03,0x04};
  byte SFOf28[4]={0x00,0x01,0x02,0x03};
  byte t28[3]={0x28,0x00,0x01};
  byte expectNRC[1]={0x31};
  int i=0,j=0;
  char logName[400] = "";
  char info[1024];
  
  strncat(logName,"1088544_Service_0x28_Func_HardReset",400);
  testCaseTitle("1088544","Service_0x28_Func_HardReset");
  if(gBusFlag==3)
	{
		testStepWarning("Test","This test case does not apply to the LIN bus");
		return;
	}
  SetLog(logName);
  Precondition();
  /******************************以下为测试步骤*********************************/

  gFlagNM=0;
  output(NMMessage_Repeat);Teststep("INF","out put NM repeat request message");
  testwaitfortimeout(3000);
  if(gFlagNM==1)
  {
    TestStep("ECU support NM message",TestStepIntervalTime);
    TestStep("Enter defaultSession(0x01)",TestStepIntervalTime);
    SID10_DiagnosticSessionControl(DEFAULTSESSION,FUNCTIONAL,SPRMIB_FALSE);
    CheckPosResponse_SID10(DEFAULTSESSION,0,6);
    ECUinitHandle(0);
    TestStep("Enter extendedsession(0x03)",TestStepIntervalTime);
    SID10_DiagnosticSessionControl(EXTENDEDSESSION,FUNCTIONAL,SPRMIB_FALSE);
    CheckPosResponse_SID10(EXTENDEDSESSION,0,6);
    CheckCurrentSession(expectSession[2],FUNCTIONAL,0,0);
    
    SID28_CommunicationControl(SFOf28[3],NCMAndNMM,FUNCTIONAL,SPRMIB_FALSE);
    CheckPosResponse_SID28(SFOf28[3],0,0);
    TestStep("Check the NM Message and APP Message are prohibited(All channels)",TestStepIntervalTime);
    CheckCommunication(DEALL,1);
    TestStep("ECU Reset (hard reset)",TestStepIntervalTime);
    SID11_ECUReset(HARDRESET,FUNCTIONAL,SPRMIB_FALSE);
    CheckPosResponse_SID11(HARDRESET,0,0);
    ECUinitHandle(0);
    TestStep("Check the NM Message and APP Message are sent normally(All channels)",TestStepIntervalTime);
    CheckCommunication(DENONE,0);
    TestStep("Enter defaultSession(0x01)",TestStepIntervalTime);
    SID10_DiagnosticSessionControl(DEFAULTSESSION,FUNCTIONAL,SPRMIB_FALSE);
    CheckPosResponse_SID10(DEFAULTSESSION,0,6);
    ECUinitHandle(0);
    TestStep("Enter extendedsession(0x03)",TestStepIntervalTime);
    SID10_DiagnosticSessionControl(EXTENDEDSESSION,FUNCTIONAL,SPRMIB_FALSE);
    CheckPosResponse_SID10(EXTENDEDSESSION,0,6);
    CheckCurrentSession(expectSession[2],FUNCTIONAL,0,0);
    
    SID28_CommunicationControl(SFOf28[3],NCMAndNMM,FUNCTIONAL,SPRMIB_FALSE);
    CheckPosResponse_SID28(SFOf28[3],0,0);
    TestStep("Check the NM Message and APP Message are prohibited(All channels)",TestStepIntervalTime);
    CheckCommunication(DEALL,1);
    TestStep("Go to step 26",TestStepIntervalTime,26);
  }
  else if(gFlagNM==0)
  {
    TestStep("ECU not support NM message,Go to step 14",TestStepIntervalTime);
    TestStep("Enter defaultSession(0x01)",TestStepIntervalTime);
    SID10_DiagnosticSessionControl(DEFAULTSESSION,FUNCTIONAL,SPRMIB_FALSE);
    CheckPosResponse_SID10(DEFAULTSESSION,0,6);
    ECUinitHandle(0);

    TestStep("Enter extendedsession(0x03)",TestStepIntervalTime);
    SID10_DiagnosticSessionControl(EXTENDEDSESSION,FUNCTIONAL,SPRMIB_FALSE);
    CheckPosResponse_SID10(EXTENDEDSESSION,0,6);
    CheckCurrentSession(expectSession[2],FUNCTIONAL,0,0);
    TestStep("step16",TestStepIntervalTime);
    SID28_CommunicationControl(SFOf28[3],NCMAndNMM,FUNCTIONAL,SPRMIB_FALSE);
    CheckPosResponse_SID28(SFOf28[3],0,0);
    TestStep("Check the APP Message is sent prohibited(All channels)",TestStepIntervalTime);
    CheckCommunication(DEALL,0);

    TestStep("ECU Reset (hard reset)",TestStepIntervalTime);
    SID11_ECUReset(HARDRESET,FUNCTIONAL,SPRMIB_FALSE);
    CheckPosResponse_SID11(HARDRESET,0,0);
    ECUinitHandle(0);
    TestStep("Check the APP Message is send normally(All channels)",TestStepIntervalTime);
    CheckCommunication(DENONE,0);

    TestStep("Enter defaultSession(0x01)",TestStepIntervalTime);
    SID10_DiagnosticSessionControl(DEFAULTSESSION,FUNCTIONAL,SPRMIB_FALSE);
    CheckPosResponse_SID10(DEFAULTSESSION,0,6);
    ECUinitHandle(0);
    TestStep("Enter extendedsession(0x03)",TestStepIntervalTime);
    SID10_DiagnosticSessionControl(EXTENDEDSESSION,FUNCTIONAL,SPRMIB_FALSE);
    CheckPosResponse_SID10(EXTENDEDSESSION,0,6);
    CheckCurrentSession(expectSession[2],FUNCTIONAL,0,0);
    
    
    SID28_CommunicationControl(SFOf28[3],NCMAndNMM,FUNCTIONAL,SPRMIB_FALSE);
    CheckPosResponse_SID28(SFOf28[3],0,0);
    
    TestStep("Check the APP Message is prohibited(All channels)",TestStepIntervalTime);
    CheckCommunication(DEALL,0);
  }
  TestStep("Enter defaultSession(0x01)",TestStepIntervalTime);
  SID10_DiagnosticSessionControl(DEFAULTSESSION,FUNCTIONAL,SPRMIB_FALSE);
  CheckPosResponse_SID10(DEFAULTSESSION,0,6);
  ECUinitHandle(0);
  /******************************以上为测试步骤*********************************/
  PostCondition();
}
/// <APP_CommonServiceTest>
testcase Service_0x28_Phy_Timeout()
{
  byte expectSession[4]={0x01,0x02,0x03,0x04};
  byte SFOf28[4]={0x00,0x01,0x02,0x03};
  byte t28[3]={0x28,0x00,0x01};
  byte expectNRC[1]={0x31};
  int i=0,j=0;
  char logName[400] = "";
  char info[1024];
  
  strncat(logName,"1088543_Service_0x28_Phy_Timeout",400);
  testCaseTitle("1088543","Service_0x28_Phy_Timeout");
  
  if(gBusFlag==5 && SWRS_VERSION>=8 && EthNodeTypeNow==EdgeNode)
  {
     testStepWarning("","按照SWRS 版本>=V8,需求ID 987287定义 ,边缘节点应向车内发送3E 80 ，并维持自身的会话模式，所以不会跳转到默认会话,这个用例就不适用了");
     return;
  }
  
  
  if(gBusFlag==3)
	{
		testStepWarning("Test","This test case does not apply to the LIN bus");
		return;
	}
  SetLog(logName);
  Precondition();
  /******************************以下为测试步骤*********************************/
  gFlagNM=0;
  output(NMMessage_Repeat);Teststep("INF","out put NM repeat request message");
  testwaitfortimeout(3000);
  if(gFlagNM==1)
  {
    TestStep("ECU support NM message",TestStepIntervalTime);
    TestStep("Enter defaultSession(0x01)",TestStepIntervalTime);
    SID10_DiagnosticSessionControl(DEFAULTSESSION,PHYSICAL,SPRMIB_FALSE);
    CheckPosResponse_SID10(DEFAULTSESSION,0,6);
    ECUinitHandle(0);
    TestStep("Enter extendedsession(0x03)",TestStepIntervalTime);
    SID10_DiagnosticSessionControl(EXTENDEDSESSION,PHYSICAL,SPRMIB_FALSE);
    CheckPosResponse_SID10(EXTENDEDSESSION,0,6);
    CheckCurrentSession(expectSession[2],PHYSICAL,0,0);
    
    TestStep("Tester Present on",TestStepIntervalTime);
    
    SID28_CommunicationControl(SFOf28[3],NCMAndNMM,PHYSICAL,SPRMIB_FALSE);
    CheckPosResponse_SID28(SFOf28[3],0,0);
    TestStep("Check the APP Message are prohibited(All channels)",TestStepIntervalTime);
    CheckCommunication(DEALL,1);
    TestStep("Wait 20000ms");
    testwaitfortimeout(20000);
    
    TestStep("Check the APP Message are prohibited(All channels)",TestStepIntervalTime);
    CheckCommunication(DEALL,1);
    
    TestStep("Tester Present off",TestStepIntervalTime);
    TP_TesterPresentSet(TP_OFF);
    
    TestStep("Tester Send 3E 80",TestStepIntervalTime);
    SID3E_TesterPresent(FUNCTIONAL, SPRMIB_TRUE);
    
    TestStep("Wait 5500ms");
    testwaitfortimeout(5500);
    
    TestStep("Tester Send 3E 80",TestStepIntervalTime);
    SID3E_TesterPresent(FUNCTIONAL, SPRMIB_TRUE);
    
    TestStep("Tester Present on",TestStepIntervalTime);
    TP_TesterPresentSet(TP_ON);
    
    TestStep("Check the APP Message are sent normally(All channels)",TestStepIntervalTime);
    CheckCommunication(DENONE,1);
    TestStep("Tester Present off,Go to step 29",TestStepIntervalTime,29);
  }
  else if(gFlagNM==0)
  {
    TestStep("ECU not support NM message,Go to step 16",TestStepIntervalTime);
    TestStep("Enter defaultSession(0x01)",TestStepIntervalTime);
    SID10_DiagnosticSessionControl(DEFAULTSESSION,PHYSICAL,SPRMIB_FALSE);
    CheckPosResponse_SID10(DEFAULTSESSION,0,6);
    ECUinitHandle(0);
    TestStep("Enter extendedsession(0x03)",TestStepIntervalTime);
    SID10_DiagnosticSessionControl(EXTENDEDSESSION,PHYSICAL,SPRMIB_FALSE);
    CheckPosResponse_SID10(EXTENDEDSESSION,0,6);
    CheckCurrentSession(expectSession[2],PHYSICAL,0,0);
    
    TestStep("Tester Present on",TestStepIntervalTime);
    
    SID28_CommunicationControl(SFOf28[3],NCMAndNMM,PHYSICAL,SPRMIB_FALSE);
    CheckPosResponse_SID28(SFOf28[3],0,0);
    TestStep("Check the APP Message are prohibited(All channels)",TestStepIntervalTime);
    CheckCommunication(DEAPP,1);
    TestStep("Wait 20000ms");
    testwaitfortimeout(20000);
    
    TestStep("Check the APP Message are prohibited(All channels)",TestStepIntervalTime);
    CheckCommunication(DEAPP,1);
    
    TestStep("Tester Present off",TestStepIntervalTime);
    TP_TesterPresentSet(TP_OFF);
    
    TestStep("Tester Send 3E 80",TestStepIntervalTime);
    SID3E_TesterPresent(FUNCTIONAL, SPRMIB_TRUE);
    
    TestStep("Wait 5500ms");
    testwaitfortimeout(5500);
    
    TestStep("Tester Send 3E 80",TestStepIntervalTime);
    SID3E_TesterPresent(FUNCTIONAL, SPRMIB_TRUE);
    
    TestStep("Tester Present on",TestStepIntervalTime);
    TP_TesterPresentSet(TP_ON);
    
    TestStep(":Check the APP Message are sent normally(All channels)",TestStepIntervalTime);
    CheckCommunication(DENONE,1);
  }
  TestStep("Enter defaultSession(0x01)",TestStepIntervalTime);
  SID10_DiagnosticSessionControl(DEFAULTSESSION,PHYSICAL,SPRMIB_FALSE);
  CheckPosResponse_SID10(DEFAULTSESSION,0,6);
  ECUinitHandle(0);
  /******************************以上为测试步骤*********************************/
  PostCondition();
}
/// <APP_CommonServiceTest>
testcase Service_0x28_Func_Timeout()
{
  byte expectSession[4]={0x01,0x02,0x03,0x04};
  byte SFOf28[4]={0x00,0x01,0x02,0x03};
  byte t28[3]={0x28,0x00,0x01};
  byte expectNRC[1]={0x31};
  int i=0,j=0;
  char logName[400] = "";
  char info[1024];
  
  strncat(logName,"1088545_Service_0x28_Func_Timeout",400);
  testCaseTitle("1088545","Service_0x28_Func_Timeout");
  
  if(gBusFlag==5 && SWRS_VERSION>=8 && EthNodeTypeNow==EdgeNode)
  {
     testStepWarning("","按照SWRS 版本>=V8,需求ID 987287定义 ,边缘节点应向车内发送3E 80 ，并维持自身的会话模式，所以不会跳转到默认会话,这个用例就不适用了");
     return;
  }
  
  if(gBusFlag==3)
	{
		testStepWarning("Test","This test case does not apply to the LIN bus");
		return;
	}
  SetLog(logName);
  Precondition();
  /******************************以下为测试步骤*********************************/

  gFlagNM=0;
  output(NMMessage_Repeat);Teststep("INF","out put NM repeat request message");
  testwaitfortimeout(3000);
  if(gFlagNM==1)
  {
    TestStep("ECU support NM message",TestStepIntervalTime);
    TestStep("Enter defaultSession(0x01)",TestStepIntervalTime);
    SID10_DiagnosticSessionControl(DEFAULTSESSION,FUNCTIONAL,SPRMIB_FALSE);
    CheckPosResponse_SID10(DEFAULTSESSION,0,6);
    ECUinitHandle(0);
    TestStep("Enter extendedsession(0x03)",TestStepIntervalTime);
    SID10_DiagnosticSessionControl(EXTENDEDSESSION,FUNCTIONAL,SPRMIB_FALSE);
    CheckPosResponse_SID10(EXTENDEDSESSION,0,6);
    CheckCurrentSession(expectSession[2],FUNCTIONAL,0,0);
    
    TestStep("Tester Present on",TestStepIntervalTime);
    
    SID28_CommunicationControl(SFOf28[3],NCMAndNMM,FUNCTIONAL,SPRMIB_FALSE);
    CheckPosResponse_SID28(SFOf28[3],0,0);
    TestStep("Check the APP Message are prohibited(All channels)",TestStepIntervalTime);
    CheckCommunication(DEALL,1);
    TestStep("Wait 20000ms");
    testwaitfortimeout(20000);
    
    TestStep("Check the APP Message are prohibited(All channels)",TestStepIntervalTime);
    CheckCommunication(DEALL,1);
    
    TestStep("Tester Present off",TestStepIntervalTime);
    TP_TesterPresentSet(TP_OFF);
    
    TestStep("Tester Send 3E 80",TestStepIntervalTime);
    SID3E_TesterPresent(FUNCTIONAL, SPRMIB_TRUE);
    
    TestStep("Wait 5500ms");
    testwaitfortimeout(5500);
    
    TestStep("Tester Send 3E 80",TestStepIntervalTime);
    SID3E_TesterPresent(FUNCTIONAL, SPRMIB_TRUE);
    
    TestStep("Tester Present on",TestStepIntervalTime);
    TP_TesterPresentSet(TP_ON);
    
    TestStep("Check the APP Message are sent normally(All channels)",TestStepIntervalTime);
    CheckCommunication(DENONE,1);
    TestStep("Tester Present off,Go to step 29",TestStepIntervalTime,29);
  }
  else if(gFlagNM==0)
  {
    TestStep("ECU not support NM message,Go to step 16",TestStepIntervalTime);
    TestStep("Enter defaultSession(0x01)",TestStepIntervalTime);
    SID10_DiagnosticSessionControl(DEFAULTSESSION,FUNCTIONAL,SPRMIB_FALSE);
    CheckPosResponse_SID10(DEFAULTSESSION,0,6);
    ECUinitHandle(0);
    TestStep("Enter extendedsession(0x03)",TestStepIntervalTime);
    SID10_DiagnosticSessionControl(EXTENDEDSESSION,FUNCTIONAL,SPRMIB_FALSE);
    CheckPosResponse_SID10(EXTENDEDSESSION,0,6);
    CheckCurrentSession(expectSession[2],FUNCTIONAL,0,0);
    
    TestStep("Tester Present on",TestStepIntervalTime);
    
    SID28_CommunicationControl(SFOf28[3],NCMAndNMM,FUNCTIONAL,SPRMIB_FALSE);
    CheckPosResponse_SID28(SFOf28[3],0,0);
    TestStep("Check the APP Message are prohibited(All channels)",TestStepIntervalTime);
    CheckCommunication(DEAPP,1);
    TestStep("Wait 20000ms");
    testwaitfortimeout(20000);
    
    TestStep("Check the APP Message are prohibited(All channels)",TestStepIntervalTime);
    CheckCommunication(DEAPP,1);
    
    TestStep("Tester Present off",TestStepIntervalTime);
    TP_TesterPresentSet(TP_OFF);
    
    TestStep("Tester Send 3E 80",TestStepIntervalTime);
    SID3E_TesterPresent(FUNCTIONAL, SPRMIB_TRUE);
    
    TestStep("Wait 5500ms");
    testwaitfortimeout(5500);
    
    TestStep("Tester Send 3E 80",TestStepIntervalTime);
    SID3E_TesterPresent(FUNCTIONAL, SPRMIB_TRUE);
    
    TestStep("Tester Present on",TestStepIntervalTime);
    TP_TesterPresentSet(TP_ON);
    
    TestStep(":Check the APP Message are sent normally(All channels)",TestStepIntervalTime);
    CheckCommunication(DENONE,1);
  }
  TestStep("Enter defaultSession(0x01)",TestStepIntervalTime);
  SID10_DiagnosticSessionControl(DEFAULTSESSION,PHYSICAL,SPRMIB_FALSE);
  CheckPosResponse_SID10(DEFAULTSESSION,0,6);
  ECUinitHandle(0);
  /******************************以上为测试步骤*********************************/
  PostCondition();
}
/// <APP_CommonServiceTest>
testcase Service_0x28_Phy_KL30()
{
  byte expectSession[4]={0x01,0x02,0x03,0x04};
  byte SFOf28[4]={0x00,0x01,0x02,0x03};
  byte t28[3]={0x28,0x00,0x01};
  byte expectNRC[1]={0x31};
  int i=0,j=0;
  char logName[400] = "";
  char info[1024];
  
  strncat(logName,"1088546_Service_0x28_Phy_KL30",400);
  testCaseTitle("1088546","Service_0x28_Phy_KL30");
  if(gBusFlag==3)
	{
		testStepWarning("Test","This test case does not apply to the LIN bus");
		return;
	}
  SetLog(logName);
  Precondition();
  /******************************以下为测试步骤*********************************/

  gFlagNM=0;
  output(NMMessage_Repeat);Teststep("INF","out put NM repeat request message");
  testwaitfortimeout(3000);
  if(gFlagNM==1)
  {
    TestStep("ECU support NM message",TestStepIntervalTime);
    TestStep("Enter defaultSession(0x01)",TestStepIntervalTime);
    SID10_DiagnosticSessionControl(DEFAULTSESSION,PHYSICAL,SPRMIB_FALSE);
    CheckPosResponse_SID10(DEFAULTSESSION,0,6);
    ECUinitHandle(0);
    TestStep("Enter extendedsession(0x03)",TestStepIntervalTime);
    SID10_DiagnosticSessionControl(EXTENDEDSESSION,PHYSICAL,SPRMIB_FALSE);
    CheckPosResponse_SID10(EXTENDEDSESSION,0,6);
    CheckCurrentSession(expectSession[2],PHYSICAL,0,0);
    
    SID28_CommunicationControl(SFOf28[3],NCMAndNMM,PHYSICAL,SPRMIB_FALSE);
    CheckPosResponse_SID28(SFOf28[3],0,0);
    TestStep("Check the NM Message and APP Message are prohibited(All channels)",TestStepIntervalTime);
    CheckCommunication(DEALL,1);
    TestStep("Power reset",TestStepIntervalTime);
    kl30(T_off);
    kl15(T_off);
    testWaitForTimeout(1000);
    kl30(T_on);
    kl15(T_on);
    ECUinitHandle(0);
    
    TestStep("Check the NM Message and APP Message are sent normally(All channels)",TestStepIntervalTime);
    CheckCommunication(DENONE,1);
    TestStep("Go to step 14",TestStepIntervalTime,14);
  }
  else if(gFlagNM==0)
  {
    TestStep("ECU not support NM message,Go to step 8",TestStepIntervalTime);
    TestStep("Enter defaultSession(0x01)",TestStepIntervalTime);
    SID10_DiagnosticSessionControl(DEFAULTSESSION,PHYSICAL,SPRMIB_FALSE);
    CheckPosResponse_SID10(DEFAULTSESSION,0,6);
    ECUinitHandle(0);

    TestStep("Enter extendedsession(0x03)",TestStepIntervalTime);
    SID10_DiagnosticSessionControl(EXTENDEDSESSION,PHYSICAL,SPRMIB_FALSE);
    CheckPosResponse_SID10(EXTENDEDSESSION,0,6);
    CheckCurrentSession(expectSession[2],PHYSICAL,0,0);
    TestStep("step10",TestStepIntervalTime);
    SID28_CommunicationControl(SFOf28[3],NCMAndNMM,PHYSICAL,SPRMIB_FALSE);
    CheckPosResponse_SID28(SFOf28[3],0,0);
    TestStep("Check the APP Message is prohibited(All channels)",TestStepIntervalTime);
    CheckCommunication(DEALL,0);
    TestStep("Power reset",TestStepIntervalTime);
    kl30(T_off);
    kl15(T_off);
    testWaitForTimeout(1000);
    kl30(T_on);
    kl15(T_on);
    
    ECUinitHandle(0);
    TestStep("Check the APP Message is sent normally(All channels)",TestStepIntervalTime);
    CheckCommunication(DENONE,0);
  }
  TestStep("Enter defaultSession(0x01)",TestStepIntervalTime);
  SID10_DiagnosticSessionControl(DEFAULTSESSION,PHYSICAL,SPRMIB_FALSE);
  CheckPosResponse_SID10(DEFAULTSESSION,0,6);
  ECUinitHandle(0);
  /******************************以上为测试步骤*********************************/
  PostCondition();
}
/// <APP_CommonServiceTest>
testcase Service_0x28_Func_KL30()
{
  byte expectSession[4]={0x01,0x02,0x03,0x04};
  byte SFOf28[4]={0x00,0x01,0x02,0x03};
  byte t28[3]={0x28,0x00,0x01};
  byte expectNRC[1]={0x31};
  int i=0,j=0;
  char logName[400] = "";
  char info[1024];
  
  strncat(logName,"1088547_Service_0x28_Func_KL30",400);
  testCaseTitle("1088547","Service_0x28_Func_KL30");
  if(gBusFlag==3)
	{
		testStepWarning("Test","This test case does not apply to the LIN bus");
		return;
	}
  SetLog(logName);
  Precondition();
  /******************************以下为测试步骤*********************************/

  gFlagNM=0;
  Teststep("INF","out put NM repeat request message");
  output(NMMessage_Repeat);
  testwaitfortimeout(3000);
  if(gFlagNM==1)
  {
    TestStep("ECU support NM message",TestStepIntervalTime);
    TestStep("Enter defaultSession(0x01)",TestStepIntervalTime);
    SID10_DiagnosticSessionControl(DEFAULTSESSION,FUNCTIONAL,SPRMIB_FALSE);
    CheckPosResponse_SID10(DEFAULTSESSION,0,6);
    ECUinitHandle(0);
    TestStep("Enter extendedsession(0x03)",TestStepIntervalTime);
    SID10_DiagnosticSessionControl(EXTENDEDSESSION,FUNCTIONAL,SPRMIB_FALSE);
    CheckPosResponse_SID10(EXTENDEDSESSION,0,6);
    CheckCurrentSession(expectSession[2],FUNCTIONAL,0,0);
    
    SID28_CommunicationControl(SFOf28[3],NCMAndNMM,FUNCTIONAL,SPRMIB_FALSE);
    CheckPosResponse_SID28(SFOf28[3],0,0);
    TestStep("Check the NM Message and APP Message are prohibited(All channels)",TestStepIntervalTime);
    CheckCommunication(DEALL,1);
    TestStep("Power reset",TestStepIntervalTime);
    kl30(T_off);
    kl15(T_off);
    testWaitForTimeout(1000);
    kl30(T_on);
    kl15(T_on);
    ECUinitHandle(0);
    
    TestStep("Check the NM Message and APP Message are sent normally(All channels)",TestStepIntervalTime);
    CheckCommunication(DENONE,1);
    TestStep("Go to step 14",TestStepIntervalTime,14);
  }
  else if(gFlagNM==0)
  {
    TestStep("ECU not support NM message,Go to step 8",TestStepIntervalTime);
    TestStep("Enter defaultSession(0x01)",TestStepIntervalTime);
    SID10_DiagnosticSessionControl(DEFAULTSESSION,FUNCTIONAL,SPRMIB_FALSE);
    CheckPosResponse_SID10(DEFAULTSESSION,0,6);
    ECUinitHandle(0);

    TestStep("Enter extendedsession(0x03)",TestStepIntervalTime);
    SID10_DiagnosticSessionControl(EXTENDEDSESSION,FUNCTIONAL,SPRMIB_FALSE);
    CheckPosResponse_SID10(EXTENDEDSESSION,0,6);
    CheckCurrentSession(expectSession[2],FUNCTIONAL,0,0);
    TestStep("step10",TestStepIntervalTime);
    SID28_CommunicationControl(SFOf28[3],NCMAndNMM,FUNCTIONAL,SPRMIB_FALSE);
    CheckPosResponse_SID28(SFOf28[3],0,0);
    TestStep("Check the APP Message is prohibited(All channels)",TestStepIntervalTime);
    CheckCommunication(DEALL,0);
    TestStep("Power reset",TestStepIntervalTime);
    kl30(T_off);
    kl15(T_off);
    testWaitForTimeout(1000);
    kl30(T_on);
    kl15(T_on);
    
    ECUinitHandle(0);
    TestStep("Check the APP Message is sent normally(All channels)",TestStepIntervalTime);
    CheckCommunication(DENONE,0);
  }
  TestStep("Enter defaultSession(0x01)",TestStepIntervalTime);
  SID10_DiagnosticSessionControl(DEFAULTSESSION,PHYSICAL,SPRMIB_FALSE);
  CheckPosResponse_SID10(DEFAULTSESSION,0,6);
  ECUinitHandle(0);
  /******************************以上为测试步骤*********************************/
  PostCondition();
}
/// <APP_CommonServiceTest>
testcase Sercice_0x2F_Valid_Physical_ExtendedDiagnosticSession_Supported_Service()
{
  byte PID[2];
  int  i,g;
  byte ExpectNRC[4]={0x33,0x22,0x70,0x10};
  int  NumOfLenth;
  char Description[3000];
  char answer[100];
  byte ControlOptionRecord[50];
  byte ControlEnableMaskRecord[2];
  int tem1,tem2;
  char logName[400] = "";
  char info[1024];
  
  strncat(logName,"1350947_Sercice_0x2F_Valid_Physical_ExtendedDiagnosticSession_Supported_Service",400);
  testCaseDescription("The intent is to verify service InputOutputControlByIdentifier (0x2F) and sub function freezeCurrentState (0x02),returnControlToECU (0x00) and shortTermAdjustment (0x03) is supported in extendedDiagnosticSession");
  testCaseTitle("1350947","Sercice_0x2F_Valid_Physical_ExtendedDiagnosticSession_Supported_Service");
  
  SetLog(logName);
  Precondition();

  /******************************以下为测试步骤*********************************/
  
  SessionFlag=APP;
  
  for(i=0;i<service_APP_Num;i++)
  {
    if(service_APP[i] == 0x2F)
      break;
    
    if(i==(service_APP_Num-1))
    {
    TestStepWarning("ECU doesn't support this service , test case exit!");
    Postcondition();
     
    return;
    }
    
  }
  
  TestStep("Transition from defaultSession(0x01) to extendedDiagnosticSession(0x03).",TestStepIntervalTime);
  SID10_DiagnosticSessionControl(EXTENDEDSESSION,PHYSICAL,SPRMIB_FALSE);
  CheckPosResponse_SID10(EXTENDEDSESSION,gP2Client_APP,gP2StarClientFor10Check,0,0);
  TestStep("Verify extendedDiagnosticSession.",TestStepIntervalTime);
  CheckCurrentSession(EXTENDEDSESSION,PHYSICAL,0,0);
  for(i=0; i<NumOfIO; i++)
  {
    PID[0]=IODID[i].DID>>8;
    PID[1]=IODID[i].DID&0xFF;
    
    if(IODID[i].SelectFlag != 1)
    {
      continue;
    }
    else
    {
      NumOfLenth = IODID[i].RequestLenth;
    }
    
    if(IODID[i].SecuLevel!=0xFF)
      {
        
      SID10_DiagnosticSessionControl(EXTENDEDSESSION,PHYSICAL,SPRMIB_FALSE);
      CheckPosResponse_SID10(EXTENDEDSESSION,gP2Client_APP,gP2StarClientFor10Check,0,0);
      
      testWaitForTimeout(gTimeWaitForSecuAccess);
      
      SID27_SecurityAccess_RequestSeed(IODID[i].SecuLevel,PHYSICAL);
      CheckPosResponse_SID27_ReqSeed(IODID[i].SecuLevel,gSeedArray,16,0,0);
      SID27_SecurityAccess_SendKey(IODID[i].SecuLevel,gKeyArray,PHYSICAL);
      CheckPosResponse_SID27_SenKey(IODID[i].SecuLevel,0,0);
      
      }
//
    if(IODID[i].Flag_Ser03==1)
    {
      TestStep("return control to ECU",TestStepIntervalTime);
      SID2F_IOControl(PID,0x00,IODID[i].requestData,0,ControlEnableMaskRecord,0,PHYSICAL);
      CheckPosResponse_SID2F(0x00,PID,0,0);
      
      TestStep("Short term adjustment",TestStepIntervalTime);
      SID2F_IOControl(PID,0x03,IODID[i].requestData,NumOfLenth,ControlEnableMaskRecord,0,PHYSICAL);
      CheckPosResponse_SID2F(0x03,PID,0,0);
      
      TestStep("Short term adjustment",TestStepIntervalTime);
      SID2F_IOControl(PID,0x03,IODID[i].requestData,NumOfLenth,ControlEnableMaskRecord,0,PHYSICAL);
      CheckPosResponse_SID2F(0x03,PID,0,0);
      
      TestStep("return control to ECU",TestStepIntervalTime);
      SID2F_IOControl(PID,0x00,IODID[i].requestData,0,ControlEnableMaskRecord,0,PHYSICAL);
      CheckPosResponse_SID2F(0x00,PID,0,0);
    }
    
    if(IODID[i].Flag_Ser02==1)
    {
      TestStep("freeze current state",TestStepIntervalTime);
      SID2F_IOControl(PID,0x02,IODID[i].requestData,NumOfLenth,ControlEnableMaskRecord,0,PHYSICAL);
      CheckPosResponse_SID2F(0x02,PID,0,0);
      
      TestStep("return control to ECU",TestStepIntervalTime);
      SID2F_IOControl(PID,0x00,IODID[i].requestData,0,ControlEnableMaskRecord,0,PHYSICAL);
      CheckPosResponse_SID2F(0x00,PID,0,0);
    }
  }

  TestStep("Verify extendedDiagnosticSession.",TestStepIntervalTime);
  CheckCurrentSession(EXTENDEDSESSION,PHYSICAL,0,0);
  /******************************以上为测试步骤*********************************/
  Postcondition();
   
}
/// <APP_CommonServiceTest>
testcase Sercice_0x2F_Valid_Functional_ExtendedDiagnosticSession_Supported_Service()
{
  byte PID[2];
  int  i,g;
  byte ExpectNRC[4]={0x33,0x22,0x70,0x10};
  int  NumOfLenth;
  char Description[3000];
  char answer[100];
  byte ControlOptionRecord[50];
  byte ControlEnableMaskRecord[2];
  int tem1,tem2;
  char logName[400] = "";
  char info[1024];
  
  strncat(logName,"1350948_Sercice_0x2F_Valid_Functional_ExtendedDiagnosticSession_Supported_Service",400);
  testCaseDescription("The intent is to verify service InputOutputControlByIdentifier (0x2F) and sub function freezeCurrentState (0x02),returnControlToECU (0x00) and shortTermAdjustment (0x03) is supported in extendedDiagnosticSession");  
  testCaseTitle("1350948","Sercice_0x2F_Valid_Functional_ExtendedDiagnosticSession_Supported_Service");
  if(gBusFlag==3)
	{
		testStepWarning("Test","This test case does not apply to the LIN bus");
		return;
	}
  SetLog(logName);
  Precondition();
  /******************************以下为测试步骤*********************************/
 
  SessionFlag=APP;
  
  for(i=0;i<service_APP_Num;i++)
  {
    if(service_APP[i] == 0x2F)
      break;
    
    if(i==(service_APP_Num-1))
    {
    TestStepWarning("ECU doesn't support this service , test case exit!");
    Postcondition();
     
    return;
    }
    
  }
  
  TestStep("Transition from defaultSession(0x01) to extendedDiagnosticSession(0x03).",TestStepIntervalTime);
  SID10_DiagnosticSessionControl(EXTENDEDSESSION,PHYSICAL,SPRMIB_FALSE);
  CheckPosResponse_SID10(EXTENDEDSESSION,gP2Client_APP,gP2StarClientFor10Check,0,0);
  TestStep("Verify extendedDiagnosticSession.",TestStepIntervalTime);
  CheckCurrentSession(EXTENDEDSESSION,PHYSICAL,0,0);
  for(i=0; i<NumOfIO; i++)
  {
    PID[0]=IODID[i].DID>>8;
    PID[1]=IODID[i].DID&0xFF;
    
    if(IODID[i].SelectFlag != 1)
    {
      continue;
    }
    else
    {
      NumOfLenth = IODID[i].RequestLenth;
    }
    if(IODID[i].SecuLevel!=0xFF)
    {
      SID10_DiagnosticSessionControl(EXTENDEDSESSION,PHYSICAL,SPRMIB_FALSE);
      CheckPosResponse_SID10(EXTENDEDSESSION,gP2Client_APP,gP2StarClientFor10Check,0,0);
      testWaitForTimeout(gTimeWaitForSecuAccess);
      SID27_SecurityAccess_RequestSeed(IODID[i].SecuLevel,PHYSICAL);
      CheckPosResponse_SID27_ReqSeed(IODID[i].SecuLevel,gSeedArray,16,0,0);
      SID27_SecurityAccess_SendKey(IODID[i].SecuLevel,gKeyArray,PHYSICAL);
      CheckPosResponse_SID27_SenKey(IODID[i].SecuLevel,0,0); 
    }
    if(IODID[i].Flag_Ser03==1)
    {
      TestStep("return control to ECU",TestStepIntervalTime);
      SID2F_IOControl(PID,0x00,IODID[i].requestData,0,ControlEnableMaskRecord,0,FUNCTIONAL);
      CheckPosResponse_SID2F(0x00,PID,0,0);
      
      TestStep("Short term adjustment",TestStepIntervalTime);
      SID2F_IOControl(PID,0x03,IODID[i].requestData,NumOfLenth,ControlEnableMaskRecord,0,FUNCTIONAL);
      CheckPosResponse_SID2F(0x03,PID,0,0);
      
      TestStep("Short term adjustment",TestStepIntervalTime);
      SID2F_IOControl(PID,0x03,IODID[i].requestData,NumOfLenth,ControlEnableMaskRecord,0,FUNCTIONAL);
      CheckPosResponse_SID2F(0x03,PID,0,0);
      
      TestStep("return control to ECU",TestStepIntervalTime);
      SID2F_IOControl(PID,0x00,IODID[i].requestData,0,ControlEnableMaskRecord,0,FUNCTIONAL);
      CheckPosResponse_SID2F(0x00,PID,0,0);
    }
    if(IODID[i].Flag_Ser02==1)
    {
      TestStep("freeze current state",TestStepIntervalTime);
      SID2F_IOControl(PID,0x02,IODID[i].requestData,NumOfLenth,ControlEnableMaskRecord,0,FUNCTIONAL);
      CheckPosResponse_SID2F(0x02,PID,0,0);
      
      TestStep("return control to ECU",TestStepIntervalTime);
      SID2F_IOControl(PID,0x00,IODID[i].requestData,0,ControlEnableMaskRecord,0,FUNCTIONAL);
      CheckPosResponse_SID2F(0x00,PID,0,0);
    }
  }

  TestStep("Verify extendedDiagnosticSession.",TestStepIntervalTime);
  CheckCurrentSession(EXTENDEDSESSION,PHYSICAL,0,0);
  /******************************以上为测试步骤*********************************/
  Postcondition();
}
/// <APP_CommonServiceTest>
testcase Service_0x2A_Valid_physical_ExtendedDiagnosticSession_Supported()
{
  int  i;
  char logName[400] = "";
  char info[1024];
  
  strncat(logName,"1350953_Service_0x2A_Valid_physical_ExtendedDiagnosticSession_Supported",400);
  testCaseDescription("The intent of the test is to verify:The service DynamicallyDefineDataIdentifier (0x2C) and the service ReadDataByPeriodicIdentifier (0x2A)");
  testCaseTitle("1350953","Service_0x2A_Valid_physical_ExtendedDiagnosticSession_Supported");
  
  SetLog(logName);
  Precondition();

  /******************************以下为测试步骤*********************************/
  
  for(i=0;i<service_APP_Num;i++)
  {
    if(service_APP[i] == 0x2A)
      break;
    
    if(i==(service_APP_Num-1))
    {
      TestStepWarning("ECU doesn't support this service , test case exit!");
      Postcondition();
      return;
    }
  }
  
  TestStep("Transition from defaultSession(0x01) to extendedDiagnosticSession(0x03).",TestStepIntervalTime);
  SID10_DiagnosticSessionControl(EXTENDEDSESSION,PHYSICAL,SPRMIB_FALSE);
  CheckPosResponse_SID10(EXTENDEDSESSION,gP2Client_APP,gP2StarClientFor10Check,0,0);
  TestStep("Verify extendedDiagnosticSession.",TestStepIntervalTime);
  CheckCurrentSession(EXTENDEDSESSION,PHYSICAL,0,0);
  TestStep("step3-4:Define a periodic DataIdentifier in valid identifier range",TestStepIntervalTime);
  SID2C_DynamicallyDefinedDataIdentifier_Identifier(Service_2C_DataIdentifer,CyrrentSession,0x01,0x01,PHYSICAL);
  CheckPosResponse_SID2C_Identifier(Service_2C_DataIdentifer,0,0);
  TestStep("step5-7:Periodic read out from the defined DataIdentifier.TransmissionMode = slow",TestStepIntervalTime);
  //SID2A_ReadDataByPeriodicIdentifier(SendAtSlowRate,Service_2A_DataIdentifer,PHYSICAL);
  CheckPosResponse_SID2A(0,0);
  
  TestStep("Verify that the frames use supported periodical response address according to configured list",TestStepIntervalTime);
  //CheckPeriodicID(PeriodicID,5000);
  TestStep("step8-9:Periodic read out from the defined DataIdentifier.TransmissionMode = medium",TestStepIntervalTime);
  //SID2A_ReadDataByPeriodicIdentifier(SendAtMediumRate,Service_2A_DataIdentifer,PHYSICAL);
  CheckPosResponse_SID2A(0,0);
  
  TestStep("Verify that the frames use supported periodical response address according to configured list",TestStepIntervalTime);
  //CheckPeriodicID(PeriodicID,5000);
  TestStep("step11-13:Periodic read out from the defined DataIdentifier.TransmissionMode = fast",TestStepIntervalTime);
  //SID2A_ReadDataByPeriodicIdentifier(SendAtFastRate,Service_2A_DataIdentifer,PHYSICAL);
  CheckPosResponse_SID2A(0,0);
  
  TestStep("Verify that the frames use supported periodical response address according to configured list",TestStepIntervalTime);
  //CheckPeriodicID(PeriodicID,5000);
  TestStep("step14-15:Periodic read out from the defined DataIdentifier.TransmissionMode = stop",TestStepIntervalTime);
  //SID2A_ReadDataByPeriodicIdentifier(StopSending,Service_2A_DataIdentifer,PHYSICAL);
  CheckPosResponse_SID2A(0,0);
  
  TestStep("Confirm extendedDiagnosticSession",TestStepIntervalTime);
  CheckCurrentSession(EXTENDEDSESSION,PHYSICAL,0,0);
  /******************************以上为测试步骤*********************************/
  Postcondition();
   
}
/// <APP_CommonServiceTest>
testcase Service_0x2A_Valid_Functional_ExtendedDiagnosticSession_Supported()
{
  int  i;
  char logName[400] = "";
  char info[1024];
  
  strncat(logName,"1350954_Service_0x2A_Valid_Functional_ExtendedDiagnosticSession_Supported",400);
  testCaseDescription("The intent of the test is to verify:The service DynamicallyDefineDataIdentifier (0x2C) and the service ReadDataByPeriodicIdentifier (0x2A)");
  testCaseTitle("1350954","Service_0x2A_Valid_Functional_ExtendedDiagnosticSession_Supported");
  if(gBusFlag==3)
	{
		testStepWarning("Test","This test case does not apply to the LIN bus");
		return;
	}
  SetLog(logName);
  Precondition();

  /******************************以下为测试步骤*********************************/
  
  for(i=0;i<service_APP_Num;i++)
  {
    if(service_APP[i] == 0x2A)
      break;
    
    if(i==(service_APP_Num-1))
    {
    TestStepWarning("ECU doesn't support this service , test case exit!");
    Postcondition();
     
    return;
    }
  }
  
  TestStep("Transition from defaultSession(0x01) to extendedDiagnosticSession(0x03).",TestStepIntervalTime);
  SID10_DiagnosticSessionControl(EXTENDEDSESSION,PHYSICAL,SPRMIB_FALSE);
  CheckPosResponse_SID10(EXTENDEDSESSION,gP2Client_APP,gP2StarClientFor10Check,0,0);
  TestStep("Verify extendedDiagnosticSession.",TestStepIntervalTime);
  CheckCurrentSession(EXTENDEDSESSION,PHYSICAL,0,0);
  
  TestStep("step3-4:Define a periodic DataIdentifier in valid identifier range",TestStepIntervalTime);
  SID2C_DynamicallyDefinedDataIdentifier_Identifier(Service_2C_DataIdentifer,CyrrentSession,0x01,0x01,PHYSICAL);
  CheckPosResponse_SID2C_Identifier(Service_2C_DataIdentifer,0,0);
  TestStep("step5-7:Periodic read out from the defined DataIdentifier.TransmissionMode = slow",TestStepIntervalTime);
  //SID2A_ReadDataByPeriodicIdentifier(SendAtSlowRate,Service_2A_DataIdentifer,FUNCTIONAL);
  CheckPosResponse_SID2A(0,0);
  TestStep("step8-10:Periodic read out from the defined DataIdentifier.TransmissionMode = medium",TestStepIntervalTime);
  //SID2A_ReadDataByPeriodicIdentifier(SendAtMediumRate,Service_2A_DataIdentifer,FUNCTIONAL);
  CheckPosResponse_SID2A(0,0);
  TestStep("step11-13:Periodic read out from the defined DataIdentifier.TransmissionMode = fast",TestStepIntervalTime);
  //SID2A_ReadDataByPeriodicIdentifier(SendAtFastRate,Service_2A_DataIdentifer,FUNCTIONAL);
  CheckPosResponse_SID2A(0,0);
  TestStep("step14-15:Periodic read out from the defined DataIdentifier.TransmissionMode = stop",TestStepIntervalTime);
  //SID2A_ReadDataByPeriodicIdentifier(StopSending,Service_2A_DataIdentifer,FUNCTIONAL);
  CheckPosResponse_SID2A(0,0);
  

  TestStep("Confirm extendedDiagnosticSession",TestStepIntervalTime);
  CheckCurrentSession(EXTENDEDSESSION,FUNCTIONAL,0,0);
  /******************************以上为测试步骤*********************************/
  Postcondition();
   
}
/// <APP_CommonServiceTest>
testcase Sercice_0x2C_Valid_Physical_DefaultSession_Supported()
{
  char logPath[400] = "";
  int i,j,Flag;
  byte DID_Format[2]={0xF1,0x86};
  byte ExpectNRC[2]={0x12,0x7E};
  char logName[400] = "";
  char info[1024];
  
  strncat(logName,"1350955_Sercice_0x2C_Valid_Physical_DefaultSession_Supported",400);
  testCaseDescription("The intent of the test is to verify service dynamicallyDefinedDataIdentifier (0x2C) and its subfunctions defineByIdentifier (0x01) defineByMemoryAddress (0x02) and clearDynamicallyDefinedDataIdentifier (0x03) is supported.");
  testCaseTitle("1350955","Sercice_0x2C_Valid_Physical_DefaultSession_Supported");
  
  SetLog(logName);
  Precondition();

  /******************************以下为测试步骤*********************************/
  
  SessionFlag=APP;
  
  TestStep("Let Z1 Z2 = first dataidentifier from configured list",TestStepIntervalTime);
  
  TestStep("Support of subfunction defineByIdentifier",TestStepIntervalTime);
  
  TestStep("Support of one dynamicallyDefinedDataIdentifier in one request",TestStepIntervalTime);
  
  if(Flag_Ser0x2C_Sub0x01==1)
  {
    for(i=0; i<NumOfDID2C; i++)
    {
      if(i!=0)
      {
        TestStep("Jump to step 4 until all data identifiers from configured list is tested. Let Z1 Z2 be the next data identifier.",TestStepIntervalTime,4);
      }
      
      TestStep("Dynamically Defined DataIdentifier)",TestStepIntervalTime);
      SID2C_DynamicallyDefinedDataIdentifier_Identifier(DID_0x2C[i].DID,DID_Format,1,1,PHYSICAL);//遍历DID的01子功能
      if(gRss==POS)
      {
        CheckPosResponse_SID2C_Identifier(DID_0x2C[i].DID,0,0);//检查肯定响应
        testWaitForTimeout(100);
        
        TestStep("Read out of dynamicallyDefinedDataIdentifier containing DID F1 86",TestStepIntervalTime);
        SID22_ReadDataByIdentifier(DID_0x2C[i].DID,PHYSICAL);//读取DID
        CheckPosResponse_SID22(DID_0x2C[i].DID,1,0,0);//检查肯定响应
        testWaitForTimeout(100);
        
        TestStep("Clear dynamicallyDefinedDataIdentiifier",TestStepIntervalTime);
        SID2C_ClearDynamicallyDefinedDataIdentifier_withDID(DID_0x2C[i].DID,PHYSICAL);//清除
        CheckPosResponse_SID2C_ClearwithDID(DID_0x2C[i].DID,0,0);
        testWaitForTimeout(100);
        
        TestStep("Read out of dynamicallyDefinedDataIdentifier",TestStepIntervalTime);
        SID22_ReadDataByIdentifier(DID_0x2C[i].DID,PHYSICAL);//读取DID
        CheckNegResponse(0x31,0,0);
        testWaitForTimeout(100);
      }
      else
      {
        if(CheckNegResponse(ExpectNRC,0,0,0,0)==1)
        {
          Flag=1;
        break;
          
        }
      }
    }
    if(Flag!=1)
    {
    for(i=0; i<NumOfDID2C; i++)
    {
      TestStep("Dynamically Defined DataIdentifier)",TestStepIntervalTime);
      SID2C_DynamicallyDefinedDataIdentifier_Identifier(DID_0x2C[i].DID,DID_Format,1,1,PHYSICAL);//遍历DID的01子功能
      if(gRss==POS)
      {
        CheckPosResponse_SID2C_Identifier(DID_0x2C[i].DID,0,0);//检查肯定响应
        testWaitForTimeout(100);
      }
      else if(gRss==NEG)
      {
        CheckNegResponse(ExpectNRC,0,0,0,0);
        break;
      }
    }
    
     TestStep("Clear dynamicallyDefinedDataIdentiifier",TestStepIntervalTime);
     SID2C_ClearDynamicallyDefinedDataIdentifier(PHYSICAL);//清除
     CheckPosResponse_SID2C_Clear(0,0);
     testWaitForTimeout(100);
    
    for(i=0; i<NumOfDID2C; i++)
    {
     TestStep("Read out of dynamicallyDefinedDataIdentifier",TestStepIntervalTime);
     SID22_ReadDataByIdentifier(DID_0x2C[i].DID,PHYSICAL);//读取DID
     CheckNegResponse(0x31,0,0);
     testWaitForTimeout(100);  
    }
    }
  }
  
  if(Flag_Ser0x2C_Sub0x02==1)
  {
    for(i=0; i<NumOfDID2C; i++)
    {
      for(j=0;j<NumOfAddSup;j++)
      {
        TestStep("Dynamically Defined DataIdentifier)",TestStepIntervalTime);
        SID2C_DynamicallyDefinedDataIdentifier_Address_14(DID_0x2C[i].DID,Add_0x14[j].Address,Add_0x14[j].AddressLenth,PHYSICAL);//遍历DID的01子功能
        if(gRss==POS)
        {
          CheckPosResponse_SID2C_Address_14(DID_0x2C[i].DID,0,0);//检查肯定响应
          testWaitForTimeout(100);
          
          TestStep("Read out of dynamicallyDefinedDataIdentifier",TestStepIntervalTime);
          SID22_ReadDataByIdentifier(DID_0x2C[i].DID,PHYSICAL);//读取DID
          CheckPosResponse_SID22(DID_0x2C[i].DID,4,0,0);//检查肯定响应
          testWaitForTimeout(100);
          
          TestStep("Clear dynamicallyDefinedDataIdentiifier",TestStepIntervalTime);
          SID2C_ClearDynamicallyDefinedDataIdentifier_withDID(DID_0x2C[i].DID,PHYSICAL);//清除
          CheckPosResponse_SID2C_ClearwithDID(DID_0x2C[i].DID,0,0);
          testWaitForTimeout(100);
          
          TestStep("Read out of dynamicallyDefinedDataIdentifier",TestStepIntervalTime);
          SID22_ReadDataByIdentifier(DID_0x2C[i].DID,PHYSICAL);//读取DID
          CheckNegResponse(0x31,0,0);
          testWaitForTimeout(100);
        }
        else if((gRss==NEG)&&(gTpRxData[2]==0x33))
        {
          TestStep("Transition from defaultSession(0x01) to extendedDiagnosticSession(0x03)",TestStepIntervalTime);
          SID10_DiagnosticSessionControl(EXTENDEDSESSION,PHYSICAL,SPRMIB_TRUE);
          CheckNonResponse(0,0);
          testWaitForTimeout(100);
          TestStep("Verify extendedDiagnosticSession",TestStepIntervalTime);
          CheckCurrentSession(EXTENDEDSESSION,PHYSICAL,0,0);
          testWaitForTimeout(100);
          TestStep("Dynamically Defined DataIdentifier)",TestStepIntervalTime);
          SID2C_DynamicallyDefinedDataIdentifier_Address_14(DID_0x2C[i].DID,Add_0x14[j].Address,Add_0x14[j].AddressLenth,PHYSICAL);
          CheckNegResponse(0x33,0,0);
          testWaitForTimeout(100);
          TestStep("Transition from defaultSession(0x01) to extendedDiagnosticSession(0x03)",TestStepIntervalTime);
          SID10_DiagnosticSessionControl(DEFAULTSESSION,PHYSICAL,SPRMIB_TRUE);
          CheckNonResponse(0,0);
          testWaitForTimeout(100);
          TestStep("Verify DefaultDiagnosticSession",TestStepIntervalTime);
          CheckCurrentSession(DEFAULTSESSION,PHYSICAL,0,0);
          testWaitForTimeout(100);
          TestStep("Clear dynamicallyDefinedDataIdentiifier",TestStepIntervalTime);
          SID2C_ClearDynamicallyDefinedDataIdentifier_withDID(DID_0x2C[i].DID,PHYSICAL);//清除
          CheckPosResponse_SID2C_ClearwithDID(DID_0x2C[i].DID,0,0);
          testWaitForTimeout(100);
          TestStep("Read out of dynamicallyDefinedDataIdentifier",TestStepIntervalTime);
          SID22_ReadDataByIdentifier(DID_0x2C[i].DID,PHYSICAL);//读取DID
          CheckNegResponse(0x31,0,0);
          testWaitForTimeout(100);
        }
        else
        {
          CheckNegResponse(ExpectNRC,0,0,0,0);
          break;
        }
      }
    }
    
    for(i=0; i<NumOfDID2C; i++)
    {
      for(j=0;j<NumOfAddSup;j++)
      {
        TestStep("Dynamically Defined DataIdentifier)",TestStepIntervalTime);
        SID2C_DynamicallyDefinedDataIdentifier_Address_24(DID_0x2C[i].DID,Add_0x24[j].Address,Add_0x24[j].AddressLenth,PHYSICAL);//遍历DID的01子功能
        if(gRss==POS)
        {
          CheckPosResponse_SID2C_Address_24(DID_0x2C[i].DID,0,0);//检查肯定响应
          testWaitForTimeout(100);
          
          TestStep("Read out of dynamicallyDefinedDataIdentifier",TestStepIntervalTime);
          SID22_ReadDataByIdentifier(DID_0x2C[i].DID,PHYSICAL);//读取DID
          CheckPosResponse_SID22(DID_0x2C[i].DID,4,0,0);//检查肯定响应
          testWaitForTimeout(100);
          
          TestStep("Clear dynamicallyDefinedDataIdentiifier",TestStepIntervalTime);
          SID2C_ClearDynamicallyDefinedDataIdentifier_withDID(DID_0x2C[i].DID,PHYSICAL);//清除
          CheckPosResponse_SID2C_ClearwithDID(DID_0x2C[i].DID,0,0);
          testWaitForTimeout(100);
          
          TestStep("Read out of dynamicallyDefinedDataIdentifier",TestStepIntervalTime);
          SID22_ReadDataByIdentifier(DID_0x2C[i].DID,PHYSICAL);//读取DID
          CheckNegResponse(0x31,0,0);
          testWaitForTimeout(100);
        }
        else if((gRss==NEG)&&(gTpRxData[2]==0x33))
        {
          TestStep("Transition from defaultSession(0x01) to extendedDiagnosticSession(0x03)",TestStepIntervalTime);
          SID10_DiagnosticSessionControl(EXTENDEDSESSION,PHYSICAL,SPRMIB_TRUE);
          CheckNonResponse(0,0);
          testWaitForTimeout(100);
          TestStep("Verify extendedDiagnosticSession",TestStepIntervalTime);
          CheckCurrentSession(EXTENDEDSESSION,PHYSICAL,0,0);
          testWaitForTimeout(100);
          TestStep("Dynamically Defined DataIdentifier)",TestStepIntervalTime);
          SID2C_DynamicallyDefinedDataIdentifier_Address_24(DID_0x2C[i].DID,Add_0x24[j].Address,Add_0x24[j].AddressLenth,PHYSICAL);
          CheckNegResponse(0x33,0,0);
          testWaitForTimeout(100);
          TestStep("Transition from defaultSession(0x01) to extendedDiagnosticSession(0x03)",TestStepIntervalTime);
          SID10_DiagnosticSessionControl(DEFAULTSESSION,PHYSICAL,SPRMIB_TRUE);
          CheckNonResponse(0,0);
          testWaitForTimeout(100);
          TestStep("Verify DefaultDiagnosticSession",TestStepIntervalTime);
          CheckCurrentSession(DEFAULTSESSION,PHYSICAL,0,0);
          testWaitForTimeout(100);
          TestStep("Clear dynamicallyDefinedDataIdentiifier",TestStepIntervalTime);
          SID2C_ClearDynamicallyDefinedDataIdentifier_withDID(DID_0x2C[i].DID,PHYSICAL);//清除
          CheckPosResponse_SID2C_ClearwithDID(DID_0x2C[i].DID,0,0);
          testWaitForTimeout(100);
          TestStep("Read out of dynamicallyDefinedDataIdentifier",TestStepIntervalTime);
          SID22_ReadDataByIdentifier(DID_0x2C[i].DID,PHYSICAL);//读取DID
          CheckNegResponse(0x31,0,0);
          testWaitForTimeout(100);
        }
        else
        {
          CheckNegResponse(ExpectNRC,0,0,0,0);
          break;
        }
      }
    }
  }
  
  TestStep("Verify DefaultSession.",TestStepIntervalTime);
  CheckCurrentSession(DEFAULTSESSION,PHYSICAL,0,0);
  /******************************以上为测试步骤*********************************/
  Postcondition();
   
}
/// <APP_CommonServiceTest>
testcase Sercice_0x2C_Valid_Functional_DefaultSession_Supported()
{

  int i,j,Flag;
  byte DID_Format[2]={0xF1,0x86};
  byte ExpectNRC[2]={0x11,0x7F};
  char logName[400] = "";
  char info[1024];
 
  strncat(logName,"1350956_Sercice_0x2C_Valid_Functional_DefaultSession_Supported",400);
  testCaseDescription("The intent of the test is to verify service dynamicallyDefinedDataIdentifier (0x2C) and its subfunctions defineByIdentifier (0x01) defineByMemoryAddress (0x02) and clearDynamicallyDefinedDataIdentifier (0x03) is supported.");
  testCaseTitle("1350956","Sercice_0x2C_Valid_Functional_DefaultSession_Supported");
  if(gBusFlag==3)
	{
		testStepWarning("Test","This test case does not apply to the LIN bus");
		return;
	}
  SetLog(logName);
  Precondition();

  /******************************以下为测试步骤*********************************/
  
  SessionFlag=APP;
  
  TestStep("Let Z1 Z2 = first dataidentifier from configured list",TestStepIntervalTime);
  
  TestStep("Support of subfunction defineByIdentifier",TestStepIntervalTime);
  
  TestStep("Support of one dynamicallyDefinedDataIdentifier in one request",TestStepIntervalTime);
  
  if(Flag_Ser0x2C_Sub0x01==1)
  {
    for(i=0; i<NumOfDID2C; i++)
    {
      TestStep("Dynamically Defined DataIdentifier)",TestStepIntervalTime);
      SID2C_DynamicallyDefinedDataIdentifier_Identifier(DID_0x2C[i].DID,DID_Format,1,1,PHYSICAL);//遍历DID的01子功能
      if(gRss==POS)
      {
        CheckPosResponse_SID2C_Identifier(DID_0x2C[i].DID,0,0);//检查肯定响应
        testWaitForTimeout(100);
        
        TestStep("Read out of dynamicallyDefinedDataIdentifier containing DID F1 86",TestStepIntervalTime);
        SID22_ReadDataByIdentifier(DID_0x2C[i].DID,FUNCTIONAL);//读取DID
        CheckPosResponse_SID22(DID_0x2C[i].DID,1,0,0);//检查肯定响应
        testWaitForTimeout(100);
        
        TestStep("Clear dynamicallyDefinedDataIdentiifier",TestStepIntervalTime);
        SID2C_ClearDynamicallyDefinedDataIdentifier_withDID(DID_0x2C[i].DID,FUNCTIONAL);//清除
        CheckPosResponse_SID2C_ClearwithDID(DID_0x2C[i].DID,0,0);
        testWaitForTimeout(100);
        
        TestStep("Read out of dynamicallyDefinedDataIdentifier",TestStepIntervalTime);
        SID22_ReadDataByIdentifier(DID_0x2C[i].DID,FUNCTIONAL);//读取DID
        CheckNonResponse(0,0);
        testWaitForTimeout(100);
      }
      else if(gRss==NEG)
      {
        if(CheckNegResponse(ExpectNRC,0,0,0,0)==1)
        {
          Flag=1;
        break;
          
        }
      }
    }
    if(Flag!=1)
    {
      for(i=0; i<NumOfDID2C; i++)
      {
        TestStep("Dynamically Defined DataIdentifier)",TestStepIntervalTime);
        SID2C_DynamicallyDefinedDataIdentifier_Identifier(DID_0x2C[i].DID,DID_Format,1,1,PHYSICAL);//遍历DID的01子功能
        if(gRss==POS)
        {
          CheckPosResponse_SID2C_Identifier(DID_0x2C[i].DID,0,0);//检查肯定响应
          testWaitForTimeout(100);
        }
        else if(gRss==NEG)
        {
          CheckNegResponse(ExpectNRC,0,0,0,0);
          break;
        }
      }
      
       TestStep("Clear dynamicallyDefinedDataIdentiifier",TestStepIntervalTime);
       SID2C_ClearDynamicallyDefinedDataIdentifier(PHYSICAL);//清除
       CheckPosResponse_SID2C_Clear(0,0);
       testWaitForTimeout(100);
      
      for(i=0; i<NumOfDID2C; i++)
      {
       TestStep("Read out of dynamicallyDefinedDataIdentifier",TestStepIntervalTime);
       SID22_ReadDataByIdentifier(DID_0x2C[i].DID,FUNCTIONAL);//读取DID
       CheckNonResponse(0,0);
       testWaitForTimeout(100);  
      }
    }
  }
  
  if(Flag_Ser0x2C_Sub0x02==1)
  {
    for(i=0; i<NumOfDID2C; i++)
    {
      for(j=0;j<NumOfAddSup;j++)
      {
        TestStep("Dynamically Defined DataIdentifier)",TestStepIntervalTime);
        SID2C_DynamicallyDefinedDataIdentifier_Address_14(DID_0x2C[i].DID,Add_0x14[j].Address,Add_0x14[j].AddressLenth,PHYSICAL);//遍历DID的01子功能
        if(gRss==POS)
        {
          CheckPosResponse_SID2C_Address_14(DID_0x2C[i].DID,0,0);//检查肯定响应
          testWaitForTimeout(100);
          TestStep("Read out of dynamicallyDefinedDataIdentifier",TestStepIntervalTime);
          SID22_ReadDataByIdentifier(DID_0x2C[i].DID,FUNCTIONAL);//读取DID
          CheckPosResponse_SID22(DID_0x2C[i].DID,4,0,0);//检查肯定响应
          testWaitForTimeout(100);
          TestStep("Clear dynamicallyDefinedDataIdentiifier",TestStepIntervalTime);
          SID2C_ClearDynamicallyDefinedDataIdentifier_withDID(DID_0x2C[i].DID,FUNCTIONAL);//清除
          CheckPosResponse_SID2C_ClearwithDID(DID_0x2C[i].DID,0,0);
          testWaitForTimeout(100);
          TestStep("Read out of dynamicallyDefinedDataIdentifier",TestStepIntervalTime);
          SID22_ReadDataByIdentifier(DID_0x2C[i].DID,FUNCTIONAL);//读取DID
          CheckNonResponse(0,0);
          testWaitForTimeout(100);
        }
        else if((gRss==NEG)&&(gTpRxData[2]==0x33))
        {
          continue;
        }
        else
        {
          CheckNegResponse(ExpectNRC,0,0,0,0);
          break;
        }
      }
    }
    
    for(i=0; i<NumOfDID2C; i++)
    {
      for(j=0;j<NumOfAddSup;j++)
      {
        TestStep("Dynamically Defined DataIdentifier)",TestStepIntervalTime);
        SID2C_DynamicallyDefinedDataIdentifier_Address_24(DID_0x2C[i].DID,Add_0x24[j].Address,Add_0x24[j].AddressLenth,PHYSICAL);//遍历DID的01子功能
        if(gRss==POS)
        {
          CheckPosResponse_SID2C_Address_24(DID_0x2C[i].DID,0,0);//检查肯定响应
          testWaitForTimeout(100);
          TestStep(":Read out of dynamicallyDefinedDataIdentifier",TestStepIntervalTime);
          SID22_ReadDataByIdentifier(DID_0x2C[i].DID,FUNCTIONAL);//读取DID
          CheckPosResponse_SID22(DID_0x2C[i].DID,4,0,0);//检查肯定响应
          testWaitForTimeout(100);
          TestStep("Clear dynamicallyDefinedDataIdentiifier",TestStepIntervalTime);
          SID2C_ClearDynamicallyDefinedDataIdentifier_withDID(DID_0x2C[i].DID,FUNCTIONAL);//清除
          CheckPosResponse_SID2C_ClearwithDID(DID_0x2C[i].DID,0,0);
          testWaitForTimeout(100);
          TestStep("Read out of dynamicallyDefinedDataIdentifier",TestStepIntervalTime);
          SID22_ReadDataByIdentifier(DID_0x2C[i].DID,FUNCTIONAL);//读取DID
          CheckNonResponse(0,0);
          testWaitForTimeout(100);
        }
        else if((gRss==NEG)&&(gTpRxData[2]==0x33))
        {
          continue;
        }
        else
        {
          CheckNegResponse(ExpectNRC,0,0,0,0);
          break;
        }
      }
    }
  }
  
  TestStep("Verify DefaultSession.",TestStepIntervalTime);
  CheckCurrentSession(DEFAULTSESSION,PHYSICAL,0,0);
  /******************************以上为测试步骤*********************************/
  Postcondition();
   
}
/// <APP_CommonServiceTest>
testcase Sercice_0x2C_Valid_Physical_ExtendedSession_Supported()
{
  int i,j,Flag;
  byte DID_Format[2]={0xF1,0x86};
  byte ExpectNRC[2]={0x11,0x7F};
  char logName[400] = "";
  char info[1024];
  
  strncat(logName,"1350957_Sercice_0x2C_Valid_Physical_ExtendedSession_Supported",400);
  testCaseDescription("The intent of the test is to verify service dynamicallyDefinedDataIdentifier (0x2C) and its subfunctions defineByIdentifier (0x01) defineByMemoryAddress (0x02) and clearDynamicallyDefinedDataIdentifier (0x03) is supported.");
  testCaseTitle("1350957","Sercice_0x2C_Valid_Physical_ExtendedSession_Supported");
  
  SetLog(logName);
  Precondition();

  /******************************以下为测试步骤*********************************/
  
  SessionFlag=APP;
  
  TestStep("Let Z1 Z2 = first dataidentifier from configured list",TestStepIntervalTime);
  
  TestStep("Transition from defaultSession(0x01) to extendedDiagnosticSession(0x03)",TestStepIntervalTime);
  SID10_DiagnosticSessionControl(EXTENDEDSESSION,PHYSICAL,SPRMIB_FALSE);
  CheckPosResponse_SID10(EXTENDEDSESSION,gP2Client_APP,gP2StarClientFor10Check,0,0);
  TP_TesterPresentSet(TP_ON);
  TestStep("Verify extendedDiagnosticSession",TestStepIntervalTime);
  CheckCurrentSession(EXTENDEDSESSION,PHYSICAL,0,0);
  
  TestStep("Support of subfunction defineByIdentifier",TestStepIntervalTime);
  
  TestStep("Support of one dynamicallyDefinedDataIdentifier in one request",TestStepIntervalTime);
  if(Flag_Ser0x2C_Sub0x01==1)
  {
    for(i=0; i<NumOfDID2C; i++)
    {
      TestStep("Dynamically Defined DataIdentifier)",TestStepIntervalTime);
      SID2C_DynamicallyDefinedDataIdentifier_Identifier(DID_0x2C[i].DID,DID_Format,1,1,PHYSICAL);//遍历DID的01子功能
      if(gRss==POS)
      {
        if(i!=0)
          TestStep("Jump to step6 until all data identifiers from configured list is tested. Let Z1 Z2 be the next data identifier)",TestStepIntervalTime,6);
        
        CheckPosResponse_SID2C_Identifier(DID_0x2C[i].DID,0,0);//检查肯定响应
        testWaitForTimeout(100);
        
        TestStep("Read out of dynamicallyDefinedDataIdentifier containing DID F1 86",TestStepIntervalTime);
        SID22_ReadDataByIdentifier(DID_0x2C[i].DID,PHYSICAL);//读取DID
        CheckPosResponse_SID22(DID_0x2C[i].DID,1,0,0);//检查肯定响应
        testWaitForTimeout(100);
        
        TestStep("Clear dynamicallyDefinedDataIdentiifier",TestStepIntervalTime);
        SID2C_ClearDynamicallyDefinedDataIdentifier_withDID(DID_0x2C[i].DID,PHYSICAL);//清除
        CheckPosResponse_SID2C_ClearwithDID(DID_0x2C[i].DID,0,0);
        testWaitForTimeout(100);
        
        TestStep("Read out of dynamicallyDefinedDataIdentifier",TestStepIntervalTime);
        SID22_ReadDataByIdentifier(DID_0x2C[i].DID,PHYSICAL);//读取DID
        CheckNegResponse(0x31,0,0);
        testWaitForTimeout(100);
      }
      else if(gRss==NEG)
      {
        if(CheckNegResponse(ExpectNRC,0,0,0,0)==1)
        {
          Flag=1;
        break;
        }
      }
    }
    for(i=0; i<NumOfDID2C; i++)
    {
      TestStep("Dynamically Defined DataIdentifier)",TestStepIntervalTime);
      SID2C_DynamicallyDefinedDataIdentifier_Identifier(DID_0x2C[i].DID,DID_Format,1,1,PHYSICAL);//遍历DID的01子功能
      if(gRss==POS)
      {
        CheckPosResponse_SID2C_Identifier(DID_0x2C[i].DID,0,0);//检查肯定响应
        testWaitForTimeout(100);
      }
      else if(gRss==NEG)
      {
        CheckNegResponse(ExpectNRC,0,0,0,0);
        break;
      }
    }
    
     TestStep("Clear dynamicallyDefinedDataIdentiifier",TestStepIntervalTime);
     SID2C_ClearDynamicallyDefinedDataIdentifier(PHYSICAL);//清除
     CheckPosResponse_SID2C_Clear(0,0);
     testWaitForTimeout(100);
    
    for(i=0; i<NumOfDID2C; i++)
    {
     TestStep("Read out of dynamicallyDefinedDataIdentifier",TestStepIntervalTime);
     SID22_ReadDataByIdentifier(DID_0x2C[i].DID,PHYSICAL);//读取DID
     CheckNegResponse(0x31,0,0);
     testWaitForTimeout(100);  
    }
  }
  
  if(Flag_Ser0x2C_Sub0x02==1)
  {
    for(i=0; i<NumOfDID2C; i++)
    {
      for(j=0;j<NumOfAddSup;j++)
      {
        TestStep("Dynamically Defined DataIdentifier)",TestStepIntervalTime);
        SID2C_DynamicallyDefinedDataIdentifier_Address_14(DID_0x2C[i].DID,Add_0x14[j].Address,Add_0x14[j].AddressLenth,PHYSICAL);//遍历DID的01子功能
        if(gRss==POS)
        {
          CheckPosResponse_SID2C_Address_14(DID_0x2C[i].DID,0,0);//检查肯定响应
          testWaitForTimeout(100);
          TestStep("Read out of dynamicallyDefinedDataIdentifier",TestStepIntervalTime);
          SID22_ReadDataByIdentifier(DID_0x2C[i].DID,PHYSICAL);//读取DID
          CheckPosResponse_SID22(DID_0x2C[i].DID,4,0,0);//检查肯定响应
          testWaitForTimeout(100);
          TestStep("Clear dynamicallyDefinedDataIdentiifier",TestStepIntervalTime);
          SID2C_ClearDynamicallyDefinedDataIdentifier_withDID(DID_0x2C[i].DID,PHYSICAL);//清除
          CheckPosResponse_SID2C_ClearwithDID(DID_0x2C[i].DID,0,0);
          testWaitForTimeout(100);
          TestStep("Read out of dynamicallyDefinedDataIdentifier",TestStepIntervalTime);
          SID22_ReadDataByIdentifier(DID_0x2C[i].DID,PHYSICAL);//读取DID
          CheckNegResponse(0x31,0,0);
          testWaitForTimeout(100);
        }
        else if((gRss==NEG)&&(gTpRxData[2]==0x33))
        {
          continue;
        }
        else
        {
          CheckNegResponse(ExpectNRC,0,0,0,0);
          break;
        }
      }
    }
    
    for(i=0; i<NumOfDID2C; i++)
    {
      for(j=0;j<NumOfAddSup;j++)
      {
      TestStep("Dynamically Defined DataIdentifier)",TestStepIntervalTime);
      SID2C_DynamicallyDefinedDataIdentifier_Address_24(DID_0x2C[i].DID,Add_0x24[j].Address,Add_0x24[j].AddressLenth,PHYSICAL);//遍历DID的01子功能
      if(gRss==POS)
      {
        CheckPosResponse_SID2C_Address_24(DID_0x2C[i].DID,0,0);//检查肯定响应
        testWaitForTimeout(100);
        TestStep("Read out of dynamicallyDefinedDataIdentifier",TestStepIntervalTime);
        SID22_ReadDataByIdentifier(DID_0x2C[i].DID,PHYSICAL);//读取DID
        CheckPosResponse_SID22(DID_0x2C[i].DID,4,0,0);//检查肯定响应
        testWaitForTimeout(100);
        TestStep(":Clear dynamicallyDefinedDataIdentiifier",TestStepIntervalTime);
        SID2C_ClearDynamicallyDefinedDataIdentifier_withDID(DID_0x2C[i].DID,PHYSICAL);//清除
        CheckPosResponse_SID2C_ClearwithDID(DID_0x2C[i].DID,0,0);
        testWaitForTimeout(100);
        TestStep("Read out of dynamicallyDefinedDataIdentifier",TestStepIntervalTime);
        SID22_ReadDataByIdentifier(DID_0x2C[i].DID,PHYSICAL);//读取DID
        CheckNegResponse(0x31,0,0);
        testWaitForTimeout(100);
      }
      else if((gRss==NEG)&&(gTpRxData[2]==0x33))
      {
        continue;
      }
      else
      {
        CheckNegResponse(ExpectNRC,0,0,0,0);
        break;
      }
      }
    }
  }
  
  TestStep("Verify extendedSession.",TestStepIntervalTime);
  CheckCurrentSession(EXTENDEDSESSION,PHYSICAL,0,0);
  /******************************以上为测试步骤*********************************/
  Postcondition();
   
}
/// <APP_CommonServiceTest>
testcase Sercice_0x2C_Valid_Functional_ExtendedSession_Supported()
{
  char logPath[400] = "";
  int i,j,Flag;
  byte DID_Format[2]={0xF1,0x86};
  byte ExpectNRC[2]={0x11,0x7F};
  char logName[400] = "";
  char info[1024];
  
  strncat(logName,"1350958_Sercice_0x2C_Valid_Functional_ExtendedSession_Supported",400);
  testCaseDescription("The intent of the test is to verify service dynamicallyDefinedDataIdentifier (0x2C) and its subfunctions defineByIdentifier (0x01) defineByMemoryAddress (0x02) and clearDynamicallyDefinedDataIdentifier (0x03) is supported.");
  testCaseTitle("1350958","Sercice_0x2C_Valid_Functional_ExtendedSession_Supported");
  if(gBusFlag==3)
	{
		testStepWarning("Test","This test case does not apply to the LIN bus");
		return;
	}
  SetLog(logName);
  Precondition();

  /******************************以下为测试步骤*********************************/
  
  SessionFlag=APP;
  
  TestStep("Let Z1 Z2 = first dataidentifier from configured list",TestStepIntervalTime);
  
  TestStep("Transition from defaultSession(0x01) to extendedDiagnosticSession(0x03)",TestStepIntervalTime);
  SID10_DiagnosticSessionControl(EXTENDEDSESSION,PHYSICAL,SPRMIB_FALSE);
  CheckPosResponse_SID10(EXTENDEDSESSION,gP2Client_APP,gP2StarClientFor10Check,0,0);
  TP_TesterPresentSet(TP_ON);
  TestStep("Verify extendedDiagnosticSession",TestStepIntervalTime);
  CheckCurrentSession(EXTENDEDSESSION,PHYSICAL,0,0);
  
  TestStep("Support of subfunction defineByIdentifier",TestStepIntervalTime);
  
  TestStep("Support of one dynamicallyDefinedDataIdentifier in one request",TestStepIntervalTime);
  if(Flag_Ser0x2C_Sub0x01==1)
  {
    for(i=0; i<NumOfDID2C; i++)
    {
      TestStep("Dynamically Defined DataIdentifier)",TestStepIntervalTime);
      SID2C_DynamicallyDefinedDataIdentifier_Identifier(DID_0x2C[i].DID,DID_Format,1,1,PHYSICAL);//遍历DID的01子功能
      if(gRss==POS)
      {
        if(i!=0)
          TestStep("Jump to step6 until all data identifiers from configured list is tested. Let Z1 Z2 be the next data identifier)",TestStepIntervalTime,6);
        
        CheckPosResponse_SID2C_Identifier(DID_0x2C[i].DID,0,0);//检查肯定响应
        testWaitForTimeout(100);
        
        TestStep("Read out of dynamicallyDefinedDataIdentifier containing DID F1 86",TestStepIntervalTime);
        SID22_ReadDataByIdentifier(DID_0x2C[i].DID,FUNCTIONAL);//读取DID
        CheckPosResponse_SID22(DID_0x2C[i].DID,1,0,0);//检查肯定响应
        testWaitForTimeout(100);
        
        TestStep("Clear dynamicallyDefinedDataIdentiifier",TestStepIntervalTime);
        SID2C_ClearDynamicallyDefinedDataIdentifier_withDID(DID_0x2C[i].DID,FUNCTIONAL);//清除
        CheckPosResponse_SID2C_ClearwithDID(DID_0x2C[i].DID,0,0);
        testWaitForTimeout(100);
        
        TestStep("Read out of dynamicallyDefinedDataIdentifier",TestStepIntervalTime);
        SID22_ReadDataByIdentifier(DID_0x2C[i].DID,FUNCTIONAL);//读取DID
        CheckNonResponse(0,0);
        testWaitForTimeout(100);
      }
      else if(gRss==NEG)
      {
        if(CheckNegResponse(ExpectNRC,0,0,0,0)==1)
        {
          Flag=1;
        break;
        }
      }
    }
    for(i=0; i<NumOfDID2C; i++)
    {
      TestStep("Dynamically Defined DataIdentifier)",TestStepIntervalTime);
      SID2C_DynamicallyDefinedDataIdentifier_Identifier(DID_0x2C[i].DID,DID_Format,1,1,PHYSICAL);//遍历DID的01子功能
      if(gRss==POS)
      {
        CheckPosResponse_SID2C_Identifier(DID_0x2C[i].DID,0,0);//检查肯定响应
        testWaitForTimeout(100);
      }
      else if(gRss==NEG)
      {
        CheckNegResponse(ExpectNRC,0,0,0,0);
        break;
      }
    }
    
     TestStep("Clear dynamicallyDefinedDataIdentiifier",TestStepIntervalTime);
     SID2C_ClearDynamicallyDefinedDataIdentifier(FUNCTIONAL);//清除
     CheckPosResponse_SID2C_Clear(0,0);
     testWaitForTimeout(100);
    
    for(i=0; i<NumOfDID2C; i++)
    {
     TestStep("Read out of dynamicallyDefinedDataIdentifier",TestStepIntervalTime);
     SID22_ReadDataByIdentifier(DID_0x2C[i].DID,FUNCTIONAL);//读取DID
     CheckNonResponse(0,0);
     testWaitForTimeout(100);  
    }
  }
  
  if(Flag_Ser0x2C_Sub0x02==1)
  {
    for(i=0; i<NumOfDID2C; i++)
    {
      for(j=0;j<NumOfAddSup;j++)
      {
      TestStep("Dynamically Defined DataIdentifier)",TestStepIntervalTime);
      SID2C_DynamicallyDefinedDataIdentifier_Address_14(DID_0x2C[i].DID,Add_0x14[j].Address,Add_0x14[j].AddressLenth,PHYSICAL);//遍历DID的01子功能
      if(gRss==POS)
      {
        CheckPosResponse_SID2C_Address_14(DID_0x2C[i].DID,0,0);//检查肯定响应
        testWaitForTimeout(100);
        TestStep("Read out of dynamicallyDefinedDataIdentifier",TestStepIntervalTime);
        SID22_ReadDataByIdentifier(DID_0x2C[i].DID,FUNCTIONAL);//读取DID
        CheckPosResponse_SID22(DID_0x2C[i].DID,4,0,0);//检查肯定响应
        testWaitForTimeout(100);
        TestStep("Clear dynamicallyDefinedDataIdentiifier",TestStepIntervalTime);
        SID2C_ClearDynamicallyDefinedDataIdentifier_withDID(DID_0x2C[i].DID,FUNCTIONAL);//清除
        CheckPosResponse_SID2C_ClearwithDID(DID_0x2C[i].DID,0,0);
        testWaitForTimeout(100);
        TestStep("Read out of dynamicallyDefinedDataIdentifier",TestStepIntervalTime);
        SID22_ReadDataByIdentifier(DID_0x2C[i].DID,FUNCTIONAL);//读取DID
        CheckNonResponse(0,0);
        testWaitForTimeout(100);
      }
      else if((gRss==NEG)&&(gTpRxData[2]==0x33))
      {
        continue;
      }
      else
      {
        CheckNegResponse(ExpectNRC,0,0,0,0);
        break;
      }
      }
    }
    
    for(i=0; i<NumOfDID2C; i++)
    {
      for(j=0;j<NumOfAddSup;j++)
      {
        TestStep("Dynamically Defined DataIdentifier)",TestStepIntervalTime);
        SID2C_DynamicallyDefinedDataIdentifier_Address_24(DID_0x2C[i].DID,Add_0x24[j].Address,Add_0x24[j].AddressLenth,PHYSICAL);//遍历DID的01子功能
        if(gRss==POS)
        {
          CheckPosResponse_SID2C_Address_24(DID_0x2C[i].DID,0,0);//检查肯定响应
          testWaitForTimeout(100);
          TestStep("Read out of dynamicallyDefinedDataIdentifier",TestStepIntervalTime);
          SID22_ReadDataByIdentifier(DID_0x2C[i].DID,FUNCTIONAL);//读取DID
          CheckPosResponse_SID22(DID_0x2C[i].DID,4,0,0);//检查肯定响应
          testWaitForTimeout(100);
          TestStep(":Clear dynamicallyDefinedDataIdentiifier",TestStepIntervalTime);
          SID2C_ClearDynamicallyDefinedDataIdentifier_withDID(DID_0x2C[i].DID,FUNCTIONAL);//清除
          CheckPosResponse_SID2C_ClearwithDID(DID_0x2C[i].DID,0,0);
          testWaitForTimeout(100);
          TestStep("Read out of dynamicallyDefinedDataIdentifier",TestStepIntervalTime);
          SID22_ReadDataByIdentifier(DID_0x2C[i].DID,FUNCTIONAL);//读取DID
          CheckNonResponse(0,0);
          testWaitForTimeout(100);
        }
        else if((gRss==NEG)&&(gTpRxData[2]==0x33))
        {
          continue;
        }
        else
        {
          CheckNonResponse(0,0);
          break;
        }
      }
    }
  }
  
  TestStep("Verify extendedSession.",TestStepIntervalTime);
  CheckCurrentSession(EXTENDEDSESSION,PHYSICAL,0,0);
  /******************************以上为测试步骤*********************************/
  Postcondition();
}
/// <APP_CommonServiceTest>
testcase Sercice_0x3D_WriteMemoryByAddress_Supported_DefaultSession_Physical()
{
  char logPath[400] = "";
  int i;
  byte Address[4]= {0x11,0x22,0x33,0x44};
  byte N1[1]=0x01;
  byte Size1[1]=0x11;
  byte Size2[2]= {0x11,0x22};
  byte ExpectNRC[2]={0x31,0x33};
  char logName[400] = "";
  char info[1024];
  
  strncat(logName,"1350961_Sercice_0x3D_WriteMemoryByAddress_Supported_DefaultSession_Physical",400);
  testCaseDescription("Verify Service WriteMemoryByAddress (0x3D) is supported.");
  testCaseTitle("1350961","Sercice_0x3D_WriteMemoryByAddress_Supported_DefaultSession_Physical");
  if(gBusFlag==3)
	{
		testStepWarning("Test","This test case does not apply to the LIN bus");
		return;
	}
  SetLog(logName);
  Precondition();

  /******************************以下为测试步骤*********************************/
  
  SessionFlag=APP;
  
  for(i=1; i<=Service_3D_For14_SupAdds; i++)
  {
    TestStep("Read memory by address",TestStepIntervalTime);
    //SID3D_WriteMemoryByAdress_14();
    //CheckPosResponse_SID3D_12();

    if(Flag_Ser_0x3D_For0x24==1)
    {
      TestStep("Read memory by address",TestStepIntervalTime);
      //SID3D_WriteMemoryByAdress_24();
      if(gRss==POS)
      {
        //CheckPosResponse_SID3D_14();检查肯定响应
      }
      else
      {
        CheckNegResponse(ExpectNRC,0,0,0,0);
        TestStep("Transition from defaultSession(0x01) to extendedDiagnosticSession(0x03)",TestStepIntervalTime);
        SID10_DiagnosticSessionControl(EXTENDEDSESSION,PHYSICAL,SPRMIB_TRUE);
        CheckNonResponse(0,0);
        TestStep("Verify extendedDiagnosticSession",TestStepIntervalTime);
        CheckCurrentSession(EXTENDEDSESSION,PHYSICAL,0,0);
        TestStep("Write memory by address",TestStepIntervalTime);
        //SID3D_ReadMemoryByAdress_24();
        CheckNegResponse(0x33,0,0);
        TestStep("Transition from defaultSession(0x01) to defaultSession(0x01)",TestStepIntervalTime);
        SID10_DiagnosticSessionControl(DEFAULTSESSION,PHYSICAL,SPRMIB_TRUE);
        CheckNonResponse(0,0);
        TestStep("Verify defaultSession(0x01)",TestStepIntervalTime);
        CheckCurrentSession(DEFAULTSESSION,PHYSICAL,0,0);
      }
    }
  }
  TestStep("Verify defaultSession(0x01)",TestStepIntervalTime);
  CheckCurrentSession(DEFAULTSESSION,PHYSICAL,0,0);
  /******************************以上为测试步骤*********************************/
  Postcondition();
   
}
/// <APP_CommonServiceTest>
testcase Sercice_0x3D_WriteMemoryByAddress_Supported_ExtendedSession_Physical()
{
  char logPath[400] = "";
  int i;
  byte Address[4]= {0x11,0x22,0x33,0x44};
  byte N1[1]=0x01;
  byte Size1[1]=0x11;
  byte Size2[2]= {0x11,0x22};
  char logName[400] = "";
  char info[1024];
  
  strncat(logName,"1350962_Sercice_0x3D_WriteMemoryByAddress_Supported_ExtendedSession_Physical",400);
  testCaseDescription("Verify Service ReadMemoryByAddress (0x3D) is supported.");
  testCaseTitle("1350962","Sercice_0x3D_WriteMemoryByAddress_Supported_ExtendedSession_Physical");
  
  SetLog(logName);
  Precondition();

  /******************************以下为测试步骤*********************************/
  
  SessionFlag=APP;
  
  TestStep("Transition from defaultSession(0x01) to extendedDiagnosticSession(0x03)",TestStepIntervalTime);
  SID10_DiagnosticSessionControl(EXTENDEDSESSION,PHYSICAL,SPRMIB_TRUE);
  CheckPosResponse_SID10(EXTENDEDSESSION,gP2Client_APP,gP2StarClientFor10Check,0,0);
  TP_TesterPresentSet(TP_ON);
  TestStep("Verify extendedDiagnosticSession",TestStepIntervalTime);
  CheckCurrentSession(EXTENDEDSESSION,PHYSICAL,0,0);

  for(i=1; i<=Service_3D_For14_SupAdds; i++)
  {
    TestStep("Read memory by address",TestStepIntervalTime);
    //SID3D_WriteMemoryByAdress_14();
    //CheckPosResponse_SID3D_12();

    if(Flag_Ser_0x3D_For0x24==1)
    {
      TestStep("Read memory by address",TestStepIntervalTime);
      //SID3D_WriteMemoryByAdress_24();
      //CheckPosResponse_SID3D_14();检查肯定响应
    }
  }
  TestStep("Verify defaultSession(0x01)",TestStepIntervalTime);
  CheckCurrentSession(DEFAULTSESSION,PHYSICAL,0,0);
  TP_TesterPresentSet(TP_OFF);
  /******************************以上为测试步骤*********************************/
  Postcondition();   
}
/// <APP_CommonServiceTest>
testcase Sercice_0x31_Valid_Physical_DefaultSession_Supported_Service()
{
  byte PID[2];
  int  i,j;
  byte StuffByte[400];
  byte ExpectNRC[4]={0x33,0x22,0x70,0x10};
  int  NumOfLenth;
  char Description[3000];
  char answer[100];
  byte Para[50];
  int tem1,tem2;
  char logName[400] = "";
  char info[1024];
  
  strncat(logName,"1350949_Sercice_0x31_Valid_Physical_DefaultSession_Supported_Service",400);
  testCaseDescription("The intent is to verify that the service RoutineControl (0x31) and sub functions is supported. RoutineType on identifier will also be verified. ");
  testCaseTitle("1350949","Sercice_0x31_Valid_Physical_DefaultSession_Supported_Service");
  
  SetLog(logName);
  Precondition();

  /******************************以下为测试步骤*********************************/
  
  SessionFlag=APP;
  
  ////判断0x31服务是否支持
  for(i=0;i<service_APP_Num;i++)
  {
    if(service_APP[i] == 0x31)
      break;
  }
  if(i==service_APP_Num)
  {
    TestStepWarning("ECU doesn't support this service , test case exit!");
    Postcondition();
    return;
  }
  
  TestStep("Transition to defaultSession",TestStepIntervalTime);
  SID10_DiagnosticSessionControl(DEFAULTSESSION,PHYSICAL,SPRMIB_FALSE);
  CheckPosResponse_SID10(DEFAULTSESSION,gP2Client_APP,gP2StarClientFor10Check,0,0);
  
  TestStep("Verify default session",TestStepIntervalTime);
  CheckCurrentSession(DEFAULTSESSION,PHYSICAL,0,0);
  
  for(i=0;i<NumOfRoutine_Sub0x01;i++)//遍历所有例程
  {
    if(Routine_Sub0x01[i].Flag_Ser01 != 1)
    {
      continue;
    }
    if(Routine_Sub0x01[i].routinetype == 1)//筛选所有例程类型为1的例程
    {
      tem1 = 0;
      PID[0]=Routine_Sub0x01[i].DID>>8;
      PID[1]=Routine_Sub0x01[i].DID&0xFF;
      for(j=0;j<NumOfRoutine_Sub0x03;j++)//找到该例程是否支持03子功能
      {
        if(Routine_Sub0x01[i].DID == Routine_Sub0x03[j].DID)
        {
          tem1 = 1;
          break;
        }   
      }
      if(tem1 == 1)//直接发送31 03
      {
        SID31_RoutineControl(RequestRoutineResult,PID,Routine_Sub0x03[j].requestData,Routine_Sub0x03[j].RequestLenth,PHYSICAL,SPRMIB_FALSE);//发送31 03
        CheckNegResponse(0x24,0,0);
      }

      SID31_RoutineControl(StartRoutine,PID,Routine_Sub0x01[i].requestData,Routine_Sub0x01[i].RequestLenth,PHYSICAL,SPRMIB_FALSE);//正常请求
      CheckPosResponse_SID31(StartRoutine,PID,0,0);
      if( (gRss==NEG) && (gTpRxData[2]==0x22))
      {
        TestStepWarning("warning","Received NRC0x22 for Service 0x31,test next RID");
        continue;
      }

      testWaitForTimeout(2000);
      
      if(tem1 == 1)
      {
        SID31_RoutineControl(RequestRoutineResult,PID,Routine_Sub0x03[j].requestData,Routine_Sub0x03[j].RequestLenth,PHYSICAL,SPRMIB_FALSE);
        CheckPosResponse_SID31(RequestRoutineResult,PID,0,0);
      }
      
    }
    else if(Routine_Sub0x01[i].routinetype == 2)//筛选所有例程类型为2的例程
    {
      TestStepFail("Fail","Routine type 2 should not be supported in default session , but RID %04x support",Routine_Sub0x01[i].DID);
    }
    else if(Routine_Sub0x01[i].routinetype == 3)//筛选所有例程类型为3的例程
    {
      TestStepFail("Fail","Routine type 3 should not be supported in default session , but RID %04x support",Routine_Sub0x01[i].DID);
    }
    
  }
  
  SID11_ECUReset(HARDRESET,PHYSICAL,SPRMIB_FALSE);
  CheckPosResponse_SID11(HARDRESET,0,0);
  ECUinitHandle(0);
  
  /******************************以上为测试步骤*********************************/
  Postcondition();
   
}
/// <APP_CommonServiceTest>
testcase Sercice_0x31_Valid_Functional_DefaultSession_Supported_Service()
{
  byte PID[2];
  int  i,j;
  byte StuffByte[400];
  byte ExpectNRC[4]={0x33,0x22,0x70,0x10};
  int  NumOfLenth;
  char Description[3000];
  char answer[100];
  byte Para[50];
  int tem1,tem2;
  char logName[400] = "";
  char info[1024];
  
  strncat(logName,"1350951_Sercice_0x31_Valid_Functional_DefaultSession_Supported_Service",400);
  testCaseDescription("The intent is to verify that the service RoutineControl (0x31) and sub functions is supported. RoutineType on identifier will also be verified.");
  testCaseTitle("1350951","Sercice_0x31_Valid_Functional_DefaultSession_Supported_Service");
  if(gBusFlag==3)
	{
		testStepWarning("Test","This test case does not apply to the LIN bus");
		return;
	}
  SetLog(logName);
  Precondition();

  /******************************以下为测试步骤*********************************/
  
  SessionFlag=APP;
  
  ////判断0x31服务是否支持
  for(i=0;i<service_APP_Num;i++)
  {
    if(service_APP[i] == 0x31)
      break;
  }
  if(i==service_APP_Num)
  {
    TestStepWarning("ECU doesn't support this service , test case exit!");
    Postcondition();
     
    return;
  }
  
  TestStep("Transition to defaultSession",TestStepIntervalTime);
  SID10_DiagnosticSessionControl(DEFAULTSESSION,PHYSICAL,SPRMIB_FALSE);
  CheckPosResponse_SID10(DEFAULTSESSION,gP2Client_APP,gP2StarClientFor10Check,0,0);
  
  TestStep("Verify default session",TestStepIntervalTime);
  CheckCurrentSession(DEFAULTSESSION,PHYSICAL,0,0);
  TP_TesterPresentSet(TP_ON);
  
  for(i=0;i<NumOfRoutine_Sub0x01;i++)//遍历所有例程
  {
    if(Routine_Sub0x01[i].Flag_Ser01 != 1)
    {
      continue;
    }
    if(Routine_Sub0x01[i].routinetype == 1)//筛选所有例程类型为1的例程
    {
      tem1 = 0;
      PID[0]=Routine_Sub0x01[i].DID>>8;
      PID[1]=Routine_Sub0x01[i].DID&0xFF;
      for(j=0;j<NumOfRoutine_Sub0x03;j++)//找到该例程是否支持03子功能
      {
        if(Routine_Sub0x01[i].DID == Routine_Sub0x03[j].DID)
        {
          tem1 = 1;
          break;
        } 
      }
      if(tem1 == 1)//直接发送31 03
      {
        
        SID31_RoutineControl(RequestRoutineResult,PID,Routine_Sub0x03[j].requestData,Routine_Sub0x03[j].RequestLenth,FUNCTIONAL,SPRMIB_FALSE);//发送31 03
        CheckNegResponse(0x24,0,0);

      }
      
      SID31_RoutineControl(StartRoutine,PID,Routine_Sub0x01[i].requestData,Routine_Sub0x01[i].RequestLenth,FUNCTIONAL,SPRMIB_FALSE);//正常请求
      CheckPosResponse_SID31(StartRoutine,PID,0,0);
      if( (gRss==NEG) && (gTpRxData[2]==0x22))
      {
        TestStepWarning("warning","Received NRC0x22 for Service 0x31,test next RID");
        continue;
      }
      testWaitForTimeout(2000);
      
      if(tem1 == 1)
      {
        SID31_RoutineControl(RequestRoutineResult,PID,Routine_Sub0x03[j].requestData,Routine_Sub0x03[j].RequestLenth,FUNCTIONAL,SPRMIB_FALSE);
        CheckPosResponse_SID31(StopRoutine,PID,0,0);
      }
    }
    else if(Routine_Sub0x01[i].routinetype == 2)//筛选所有例程类型为2的例程
    {
      TestStepFail("Fail","Routine type should not be supported in default session , but RID %04x support",Routine_Sub0x01[i].DID);
    }
    else if(Routine_Sub0x01[i].routinetype == 3)//筛选所有例程类型为3的例程
    {
      TestStepFail("Fail","Routine type should not be supported in default session , but RID %04x support",Routine_Sub0x01[i].DID);
    }
    
  }
  
  SID11_ECUReset(HARDRESET,PHYSICAL,SPRMIB_FALSE);
  CheckPosResponse_SID11(HARDRESET,0,0);
  ECUinitHandle(0);
  
  /******************************以上为测试步骤*********************************/
  Postcondition();
   

}
/// <APP_CommonServiceTest>
testcase Sercice_0x31_Valid_Physical_ExtendedSession_Supported_Service()
{
  byte PID[2];
  int  i,j,k;
  byte StuffByte[400];
  byte ExpectNRC[4]={0x33,0x22,0x70,0x10};
  int  NumOfLenth;
//  char Description[3000];
  char answer[100];
  byte Para[50];
  int tem1,tem2;
  char logName[400] = "";
  char info[1024];
  
  strncat(logName,"1350950_Sercice_0x31_Valid_Physical_ExtendedSession_Supported_Service",400);
  testCaseDescription("The intent is to verify that the service RoutineControl (0x31) and sub functions is supported. RoutineType on identifier will also be verified.");
  testCaseTitle("1350950","Sercice_0x31_Valid_Physical_ExtendedSession_Supported_Service");
  
  SetLog(logName);
  Precondition();

  /******************************以下为测试步骤*********************************/
  
  SessionFlag=APP;
  TestStep("step1-Transition from defaultSession(0x01) to extendedDiagnosticSession(0x03).",TestStepIntervalTime);
  SID10_DiagnosticSessionControl(EXTENDEDSESSION,PHYSICAL,SPRMIB_FALSE);
  CheckPosResponse_SID10(EXTENDEDSESSION,gP2Client_APP,gP2StarClientFor10Check,0,0);
  TP_TesterPresentSet(TP_ON);
  TestStep("Verify extendedDiagnosticSession.",TestStepIntervalTime);
  CheckCurrentSession(EXTENDEDSESSION,PHYSICAL,0,0);
  
  ////判断0x31服务是否支持
  for(i=0;i<service_APP_Num;i++)
  {
    if(service_APP[i] == 0x31)
      break;
  }
  if(i==service_APP_Num)
  {
    TestStepWarning("ECU doesn't support this service , test case exit!");
    Postcondition();
     
    return;
  }
  
  for(i=0;i<NumOfRoutine_Sub0x01;i++)//遍历所有例程
  {
    if(Routine_Sub0x01[i].Flag_Ser03 != 1)
    {
      continue;
    }
    if(Routine_Sub0x01[i].routinetype == 1)//筛选所有例程类型为1的例程
    {
      tem1 = 0;
      PID[0]=Routine_Sub0x01[i].DID>>8;
      PID[1]=Routine_Sub0x01[i].DID&0xFF;
      for(j=0;j<NumOfRoutine_Sub0x03;j++)//找到该例程是否支持03子功能
      {
        if(Routine_Sub0x01[i].DID == Routine_Sub0x03[j].DID)
        {
          tem1 = 1;
          break;
        }  
      }
      if(Routine_Sub0x01[i].SecuLevel!=0xFF)
      {
        SID10_DiagnosticSessionControl(EXTENDEDSESSION,PHYSICAL,SPRMIB_FALSE);
        CheckPosResponse_SID10(EXTENDEDSESSION,gP2Client_APP,gP2StarClientFor10Check,0,0);
        
        testWaitForTimeout(gTimeWaitForSecuAccess);
        
        SID27_SecurityAccess_RequestSeed(Routine_Sub0x01[i].SecuLevel,PHYSICAL);
        CheckPosResponse_SID27_ReqSeed(Routine_Sub0x01[i].SecuLevel,gSeedArray,16,0,0);
        SID27_SecurityAccess_SendKey(Routine_Sub0x01[i].SecuLevel,gKeyArray,PHYSICAL);
        CheckPosResponse_SID27_SenKey(Routine_Sub0x01[i].SecuLevel,2,0,0);
      }
      
      if(tem1 == 1)//直接发送31 03
      {
        
        SID31_RoutineControl(RequestRoutineResult,PID,Routine_Sub0x03[j].requestData,Routine_Sub0x03[j].RequestLenth,PHYSICAL,SPRMIB_FALSE);//发送31 03
        CheckNegResponse(0x24,0,0);
      }
      
      SID31_RoutineControl(StartRoutine,PID,Routine_Sub0x01[i].requestData,Routine_Sub0x01[i].RequestLenth,PHYSICAL,SPRMIB_FALSE);//正常请求
      CheckPosResponse_SID31(StartRoutine,PID,0,0);
      check_routine_type(1);
      if( (gRss==NEG) && (gTpRxData[2]==0x22))
      {
        TestStepWarning("warning","Received NRC0x22 for Service 0x31,test next RID");
        continue;
      }
      testWaitForTimeout(2000);
      
      if(tem1 == 1)
      {
        SID31_RoutineControl(RequestRoutineResult,PID,Routine_Sub0x03[j].requestData,Routine_Sub0x03[j].RequestLenth,PHYSICAL,SPRMIB_FALSE);
        CheckPosResponse_SID31(RequestRoutineResult,PID,0,0);
        check_routine_type(1);
      }
      
    }
    else if(Routine_Sub0x01[i].routinetype == 2)//筛选所有例程类型为2的例程
    {
      tem1 = 0;tem2 = 0;
      PID[0]=Routine_Sub0x01[i].DID>>8;
      PID[1]=Routine_Sub0x01[i].DID&0xFF;
      for(j=0;j<NumOfRoutine_Sub0x03;j++)//找到该例程是否支持03子功能
      {
        if(Routine_Sub0x01[i].DID == Routine_Sub0x03[j].DID)
        {
          tem1 = 1;
          break;
        }

      }
      for(k=0;k<NumOfRoutine_Sub0x02;k++)//找到该例程是否支持02子功能
      {
        if(Routine_Sub0x01[i].DID == Routine_Sub0x02[k].DID)
        {
          tem2 = 1;
          break;
        }

      }
      
      if(Routine_Sub0x01[i].SecuLevel!=0xFF)
      {
        
        SID10_DiagnosticSessionControl(EXTENDEDSESSION,PHYSICAL,SPRMIB_FALSE);
        CheckPosResponse_SID10(EXTENDEDSESSION,gP2Client_APP,gP2StarClientFor10Check,0,0);
        
        testWaitForTimeout(gTimeWaitForSecuAccess);
        SID27_SecurityAccess_RequestSeed(Routine_Sub0x01[i].SecuLevel,PHYSICAL);
        CheckPosResponse_SID27_ReqSeed(Routine_Sub0x01[i].SecuLevel,gSeedArray,16,0,0);
        SID27_SecurityAccess_SendKey(Routine_Sub0x01[i].SecuLevel,gKeyArray,PHYSICAL);
        CheckPosResponse_SID27_SenKey(Routine_Sub0x01[i].SecuLevel,2,0,0);
      
      }
      
      if(tem2 == 1)//直接发送31 02
      {
        
        SID31_RoutineControl(StopRoutine,PID,Routine_Sub0x02[k].requestData,Routine_Sub0x02[k].RequestLenth,PHYSICAL,SPRMIB_FALSE);//发送31 02
        CheckNegResponse(0x24,0,0);

      }
      
      if(tem1 == 1)//直接发送31 03
      {
        
        SID31_RoutineControl(RequestRoutineResult,PID,Routine_Sub0x03[j].requestData,Routine_Sub0x03[j].RequestLenth,PHYSICAL,SPRMIB_FALSE);//发送31 02
        CheckNegResponse(0x24,0,0);
  
      }
      
      SID31_RoutineControl(StartRoutine,PID,Routine_Sub0x01[i].requestData,Routine_Sub0x01[i].RequestLenth,PHYSICAL,SPRMIB_FALSE);//正常请求
      CheckPosResponse_SID31(StartRoutine,PID,0,0);
      check_routine_type(2);
      
      SID31_RoutineControl(RequestRoutineResult,PID,Routine_Sub0x03[j].requestData,Routine_Sub0x03[j].RequestLenth,PHYSICAL,SPRMIB_FALSE);//正常请求
      CheckPosResponse_SID31(RequestRoutineResult,PID,0,0);
      check_routine_type(2);
      if(gTpRxData[4]!= 0x22)
      {
        TestStepWarning("Chk","No 0x22 maybe routine has finished executing");
      }
      testWaitForTimeout(Routine_Sub0x01[i].runtime+10);
      
      SID31_RoutineControl(RequestRoutineResult,PID,Routine_Sub0x03[j].requestData,Routine_Sub0x03[j].RequestLenth,PHYSICAL,SPRMIB_FALSE);//正常请求
      CheckPosResponse_SID31(RequestRoutineResult,PID,0,0);
      if(gTpRxData[4]!= 0x20)
      {
        TestStepFail("Fail","Routine still not finished after running time timeout");
      }
      
      if(tem2 == 1)//直接发送31 02
      {
        
        SID31_RoutineControl(StopRoutine,PID,Routine_Sub0x02[k].requestData,Routine_Sub0x02[k].RequestLenth,PHYSICAL,SPRMIB_FALSE);//发送31 03
        CheckPosOrNegResponse(0x24,0,0);//20250313 石太佳 这里修改为 NRC24 或者 正响应都可以

      }
      
      SID31_RoutineControl(StartRoutine,PID,Routine_Sub0x01[i].requestData,Routine_Sub0x01[i].RequestLenth,PHYSICAL,SPRMIB_FALSE);//正常请求
      CheckPosResponse_SID31(StartRoutine,PID,0,0);
      
      if(tem2 == 1)//直接发送31 02
      {
        SID31_RoutineControl(StopRoutine,PID,Routine_Sub0x02[k].requestData,Routine_Sub0x02[k].RequestLenth,PHYSICAL,SPRMIB_FALSE);//正常请求
        CheckPosResponse_SID31(StopRoutine,PID,0,0);
      }
      
      SID31_RoutineControl(RequestRoutineResult,PID,Routine_Sub0x03[j].requestData,Routine_Sub0x03[j].RequestLenth,PHYSICAL,SPRMIB_FALSE);//正常请求
      CheckPosResponse_SID31(RequestRoutineResult,PID,0,0);
      if(gTpRxData[4]!= 0x20)
      {
        TestStepFail("Fail","Routine still not finished after running time timeout");
      }
    }
    else if(Routine_Sub0x01[i].routinetype == 3)//筛选所有例程类型为3的例程
    {
      tem1 = 0;tem2 = 0;
      PID[0]=Routine_Sub0x01[i].DID>>8;
      PID[1]=Routine_Sub0x01[i].DID&0xFF;
      for(j=0;j<NumOfRoutine_Sub0x03;j++)//找到该例程是否支持03子功能
      {
        if(Routine_Sub0x01[i].DID == Routine_Sub0x03[j].DID)
        {
          tem1 = 1;
          break;
        }

      }
      for(k=0;k<NumOfRoutine_Sub0x02;k++)//找到该例程是否支持02子功能
      {
        if(Routine_Sub0x01[i].DID == Routine_Sub0x02[k].DID)
        {
          tem2 = 1;
          break;
        }
      } 
      if(Routine_Sub0x01[i].SecuLevel!=0xFF)
      {
        SID10_DiagnosticSessionControl(EXTENDEDSESSION,PHYSICAL,SPRMIB_FALSE);
        CheckPosResponse_SID10(EXTENDEDSESSION,gP2Client_APP,gP2StarClientFor10Check,0,0);
        
        testWaitForTimeout(gTimeWaitForSecuAccess);
        
        SID27_SecurityAccess_RequestSeed(Routine_Sub0x01[i].SecuLevel,PHYSICAL);
        CheckPosResponse_SID27_ReqSeed(Routine_Sub0x01[i].SecuLevel,gSeedArray,16,0,0);
        SID27_SecurityAccess_SendKey(Routine_Sub0x01[i].SecuLevel,gKeyArray,PHYSICAL);
        CheckPosResponse_SID27_SenKey(Routine_Sub0x01[i].SecuLevel,2,0,0);
      }
      
      if(tem2 == 1)//直接发送31 02
      {
        SID31_RoutineControl(StopRoutine,PID,Routine_Sub0x02[k].requestData,Routine_Sub0x02[k].RequestLenth,PHYSICAL,SPRMIB_FALSE);//发送31 03
        CheckNegResponse(0x24,0,0);
      }
      
      if(tem1 == 1)//直接发送31 03
      {
        
        SID31_RoutineControl(RequestRoutineResult,PID,Routine_Sub0x03[j].requestData,Routine_Sub0x03[j].RequestLenth,PHYSICAL,SPRMIB_FALSE);//发送31 03
        CheckNegResponse(0x24,0,0);

      }
      
      SID31_RoutineControl(StartRoutine,PID,Routine_Sub0x01[i].requestData,Routine_Sub0x01[i].RequestLenth,PHYSICAL,SPRMIB_FALSE);//正常请求
      CheckPosResponse_SID31(StartRoutine,PID,0,0);
      check_routine_type(3);
      
      if(tem2 == 1)//发送31 03
      {
        SID31_RoutineControl(RequestRoutineResult,PID,Routine_Sub0x03[j].requestData,Routine_Sub0x03[j].RequestLenth,PHYSICAL,SPRMIB_FALSE);//正常请求
        CheckPosResponse_SID31(RequestRoutineResult,PID,0,0);
        check_routine_type(3);
        if(gTpRxData[4]!= 0x32)
        {
          TestStepFail("Chk","Routine can't run");
        }
      }
      
      if(tem1 == 1)//直接发送31 02
      {
        SID31_RoutineControl(StopRoutine,PID,Routine_Sub0x02[k].requestData,Routine_Sub0x02[k].RequestLenth,PHYSICAL,SPRMIB_FALSE);//正常请求
        CheckPosResponse_SID31(StopRoutine,PID,0,0);
        check_routine_type(3);
        if(gTpRxData[4]!= 0x30)
        {
          TestStepFail("Chk","Routine can't run");
        }
      }
      
      if(tem2 == 1)//发送31 03
      {
        SID31_RoutineControl(RequestRoutineResult,PID,Routine_Sub0x03[j].requestData,Routine_Sub0x03[j].RequestLenth,PHYSICAL,SPRMIB_FALSE);//正常请求
        CheckPosResponse_SID31(RequestRoutineResult,PID,0,0);
        if(gTpRxData[4]!= 0x30)
        {
          TestStepFail("Chk","Routine can't run");
        }
      }     
    }
  }
  TestStep("Verify extendedDiagnosticSession.",TestStepIntervalTime);
  CheckCurrentSession(EXTENDEDSESSION,PHYSICAL,0,0);
  
  SID11_ECUReset(HARDRESET,PHYSICAL,SPRMIB_FALSE);
  CheckPosResponse_SID11(HARDRESET,0,0);
  ECUinitHandle(0);
  /******************************以上为测试步骤*********************************/
  Postcondition();
}
/// <APP_CommonServiceTest>
testcase Sercice_0x31_Valid_Functional_ExtendedSession_Supported_Service()
{
  byte PID[2];
  int  i,j,k;
  byte StuffByte[400];
  byte ExpectNRC[4]={0x33,0x22,0x70,0x10};
  int  NumOfLenth;
  char Description[3000];
  char answer[100];
  byte Para[50];
  int tem1,tem2;
  char logName[400] = "";
  char info[1024];
  
  strncat(logName,"1350952_Sercice_0x31_Valid_Functional_ExtendedSession_Supported_Service",400);
  testCaseDescription("The intent is to verify that the service RoutineControl (0x31) and sub functions is supported. RoutineType on identifier will also be verified.");
  testCaseTitle("1350952","Sercice_0x31_Valid_Functional_ExtendedSession_Supported_Service");
  if(gBusFlag==3)
	{
		testStepWarning("Test","This test case does not apply to the LIN bus");
		return;
	}
  SetLog(logName);
  Precondition();

  /******************************以下为测试步骤*********************************/
  
  SessionFlag=APP;
  TestStep("step1-Transition from defaultSession(0x01) to extendedDiagnosticSession(0x03).",TestStepIntervalTime);
  SID10_DiagnosticSessionControl(EXTENDEDSESSION,PHYSICAL,SPRMIB_FALSE);
  CheckPosResponse_SID10(EXTENDEDSESSION,gP2Client_APP,gP2StarClientFor10Check,0,0);
  TP_TesterPresentSet(TP_ON);
  TestStep("Verify extendedDiagnosticSession.",TestStepIntervalTime);
  CheckCurrentSession(EXTENDEDSESSION,PHYSICAL,0,0);
  
  ////判断0x31服务是否支持
  for(i=0;i<service_APP_Num;i++)
  {
    if(service_APP[i] == 0x31)
      break;
  }
  if(i==service_APP_Num)
  {
    TestStepWarning("ECU doesn't support this service , test case exit!");
    Postcondition();
    return;
  }
  
  for(i=0;i<NumOfRoutine_Sub0x01;i++)//遍历所有例程
  {
    if(Routine_Sub0x01[i].Flag_Ser03 != 1)
    {
      continue;
    }
    if(Routine_Sub0x01[i].routinetype == 1)//筛选所有例程类型为1的例程
    {
      tem1 = 0;
      PID[0]=Routine_Sub0x01[i].DID>>8;
      PID[1]=Routine_Sub0x01[i].DID&0xFF;
      for(j=0;j<NumOfRoutine_Sub0x03;j++)//找到该例程是否支持03子功能
      {
        if(Routine_Sub0x01[i].DID == Routine_Sub0x03[j].DID)
        {
          tem1 = 1;
          break;
        }  
      }
      
      if(Routine_Sub0x01[i].SecuLevel!=0xFF)
      {
        
        SID10_DiagnosticSessionControl(EXTENDEDSESSION,PHYSICAL,SPRMIB_FALSE);
        CheckPosResponse_SID10(EXTENDEDSESSION,gP2Client_APP,gP2StarClientFor10Check,0,0);
        
        testWaitForTimeout(gTimeWaitForSecuAccess);
        
        SID27_SecurityAccess_RequestSeed(Routine_Sub0x01[i].SecuLevel,PHYSICAL);
        CheckPosResponse_SID27_ReqSeed(Routine_Sub0x01[i].SecuLevel,gSeedArray,16,0,0);
        SID27_SecurityAccess_SendKey(Routine_Sub0x01[i].SecuLevel,gKeyArray,PHYSICAL);
        CheckPosResponse_SID27_SenKey(Routine_Sub0x01[i].SecuLevel,2,0,0);
      
      }
      
      if(tem1 == 1)//直接发送31 03
      {
        
        SID31_RoutineControl(RequestRoutineResult,PID,Routine_Sub0x03[j].requestData,Routine_Sub0x03[j].RequestLenth,FUNCTIONAL,SPRMIB_FALSE);//发送31 03
        CheckNegResponse(0x24,0,0);
      }
      
      SID31_RoutineControl(StartRoutine,PID,Routine_Sub0x01[i].requestData,Routine_Sub0x01[i].RequestLenth,FUNCTIONAL,SPRMIB_FALSE);//正常请求
      CheckPosResponse_SID31(StartRoutine,PID,0,0);
      if((gRss==NEG) && (gTpRxData[2]==0x22))
      {
        TestStepWarning("warning","Received NRC0x22 for Service 0x31,test next RID");
        continue;
      }
      
      testWaitForTimeout(2000);
      
      if(tem1 == 1)
      {
        SID31_RoutineControl(RequestRoutineResult,PID,Routine_Sub0x03[j].requestData,Routine_Sub0x03[j].RequestLenth,FUNCTIONAL,SPRMIB_FALSE);
        CheckPosResponse_SID31(RequestRoutineResult,PID,0,0);
      }
    }
    else if(Routine_Sub0x01[i].routinetype == 2)//筛选所有例程类型为2的例程
    {
      tem1 = 0;tem2 = 0;
      PID[0]=Routine_Sub0x01[i].DID>>8;
      PID[1]=Routine_Sub0x01[i].DID&0xFF;
      for(j=0;j<NumOfRoutine_Sub0x03;j++)//找到该例程是否支持03子功能
      {
        if(Routine_Sub0x01[i].DID == Routine_Sub0x03[j].DID)
        {
          tem1 = 1;
          break;
        }
      }
      for(k=0;k<NumOfRoutine_Sub0x02;k++)//找到该例程是否支持03子功能
      {
        if(Routine_Sub0x01[i].DID == Routine_Sub0x02[k].DID)
        {
          tem2 = 1;
          break;
        }

      }
      
      if(Routine_Sub0x01[i].SecuLevel!=0xFF)
      {
        
        SID10_DiagnosticSessionControl(EXTENDEDSESSION,PHYSICAL,SPRMIB_FALSE);
        CheckPosResponse_SID10(EXTENDEDSESSION,gP2Client_APP,gP2StarClientFor10Check,0,0);
        
        testWaitForTimeout(gTimeWaitForSecuAccess);
        SID27_SecurityAccess_RequestSeed(Routine_Sub0x01[i].SecuLevel,PHYSICAL);
        CheckPosResponse_SID27_ReqSeed(Routine_Sub0x01[i].SecuLevel,gSeedArray,16,0,0);
        SID27_SecurityAccess_SendKey(Routine_Sub0x01[i].SecuLevel,gKeyArray,PHYSICAL);
        CheckPosResponse_SID27_SenKey(Routine_Sub0x01[i].SecuLevel,2,0,0);
      }
      
      if(tem2 == 1)//直接发送31 02
      {
        SID31_RoutineControl(StopRoutine,PID,Routine_Sub0x02[k].requestData,Routine_Sub0x02[k].RequestLenth,FUNCTIONAL,SPRMIB_FALSE);//发送31 03
        CheckNegResponse(0x24,0,0);
      }
      
      if(tem1 == 1)//直接发送31 03
      {   
        SID31_RoutineControl(RequestRoutineResult,PID,Routine_Sub0x03[j].requestData,Routine_Sub0x03[j].RequestLenth,FUNCTIONAL,SPRMIB_FALSE);//发送31 03
        CheckNegResponse(0x24,0,0);
      }
      
      SID31_RoutineControl(StartRoutine,PID,Routine_Sub0x01[i].requestData,Routine_Sub0x01[i].RequestLenth,FUNCTIONAL,SPRMIB_FALSE);//正常请求
      CheckPosResponse_SID31(StartRoutine,PID,0,0);
      
      SID31_RoutineControl(RequestRoutineResult,PID,Routine_Sub0x03[j].requestData,Routine_Sub0x03[j].RequestLenth,FUNCTIONAL,SPRMIB_FALSE);//正常请求
      CheckPosResponse_SID31(RequestRoutineResult,PID,0,0);
      
      if(gTpRxData[4]!= 0x22)
      {
        TestStepWarning("Chk","No 0x22 maybe routine has finished executing");
      }
      testWaitForTimeout(Routine_Sub0x01[i].runtime+10);
      
      SID31_RoutineControl(RequestRoutineResult,PID,Routine_Sub0x03[j].requestData,Routine_Sub0x03[j].RequestLenth,FUNCTIONAL,SPRMIB_FALSE);//正常请求
      CheckPosResponse_SID31(RequestRoutineResult,PID,0,0);
      if(gTpRxData[4]!= 0x20)
      {
        TestStepFail("Chk","Routine still not finished after running time timeout");
      }
      
      if(tem2 == 1)//直接发送31 02
      {
        
        SID31_RoutineControl(StopRoutine,PID,Routine_Sub0x02[k].requestData,Routine_Sub0x02[k].RequestLenth,FUNCTIONAL,SPRMIB_FALSE);//发送31 03
        CheckPosOrNegResponse(0x24,0,0);//这里修改为正响应 或者 NRC24都可以
      }
      
      SID31_RoutineControl(StartRoutine,PID,Routine_Sub0x01[i].requestData,Routine_Sub0x01[i].RequestLenth,PHYSICAL,SPRMIB_FALSE);//正常请求
      CheckPosResponse_SID31(StartRoutine,PID,0,0);
      
      if(tem2 == 1)//直接发送31 02
      {
        SID31_RoutineControl(StopRoutine,PID,Routine_Sub0x02[k].requestData,Routine_Sub0x02[k].RequestLenth,FUNCTIONAL,SPRMIB_FALSE);//正常请求
        CheckPosResponse_SID31(StopRoutine,PID,0,0);
      }
      
      SID31_RoutineControl(RequestRoutineResult,PID,Routine_Sub0x03[j].requestData,Routine_Sub0x03[j].RequestLenth,FUNCTIONAL,SPRMIB_FALSE);//正常请求
      CheckPosResponse_SID31(RequestRoutineResult,PID,0,0);
      if(gTpRxData[4]!= 0x20)
      {
        TestStepFail("Chk","Routine still not finished after running time timeout");
      }
    }
    else if(Routine_Sub0x01[i].routinetype == 3)//筛选所有例程类型为3的例程
    {
      tem1 = 0;tem2 = 0;
      PID[0]=Routine_Sub0x01[i].DID>>8;
      PID[1]=Routine_Sub0x01[i].DID&0xFF;
      for(j=0;j<NumOfRoutine_Sub0x03;j++)//找到该例程是否支持03子功能
      {
        if(Routine_Sub0x01[i].DID == Routine_Sub0x03[j].DID)
        {
          tem1 = 1;
          break;
        }

      }
      for(k=0;k<NumOfRoutine_Sub0x02;k++)//找到该例程是否支持03子功能
      {
        if(Routine_Sub0x01[i].DID == Routine_Sub0x02[k].DID)
        {
          tem2 = 1;
          break;
        }

      }
      
      if(Routine_Sub0x01[i].SecuLevel!=0xFF)
      {
        
        SID10_DiagnosticSessionControl(EXTENDEDSESSION,PHYSICAL,SPRMIB_FALSE);
        CheckPosResponse_SID10(EXTENDEDSESSION,gP2Client_APP,gP2StarClientFor10Check,0,0);
        
        testWaitForTimeout(gTimeWaitForSecuAccess);
        
        SID27_SecurityAccess_RequestSeed(Routine_Sub0x01[i].SecuLevel,PHYSICAL);
        CheckPosResponse_SID27_ReqSeed(Routine_Sub0x01[i].SecuLevel,gSeedArray,16,0,0);
        SID27_SecurityAccess_SendKey(Routine_Sub0x01[i].SecuLevel,gKeyArray,PHYSICAL);
        CheckPosResponse_SID27_SenKey(Routine_Sub0x01[i].SecuLevel,2,0,0);
      
      }
      
      if(tem2 == 1)//直接发送31 02
      {
        
        SID31_RoutineControl(StopRoutine,PID,Routine_Sub0x02[k].requestData,Routine_Sub0x02[k].RequestLenth,PHYSICAL,SPRMIB_FALSE);//发送31 03
        CheckNegResponse(0x24,0,0);

      }
      
      if(tem1 == 1)//直接发送31 03
      {
        
        SID31_RoutineControl(RequestRoutineResult,PID,Routine_Sub0x03[j].requestData,Routine_Sub0x03[j].RequestLenth,FUNCTIONAL,SPRMIB_FALSE);//发送31 03
        CheckNegResponse(0x24,0,0);

      }
      
      SID31_RoutineControl(StartRoutine,PID,Routine_Sub0x01[i].requestData,Routine_Sub0x01[i].RequestLenth,FUNCTIONAL,SPRMIB_FALSE);//正常请求
      CheckPosResponse_SID31(StartRoutine,PID,0,0);
      
      if(tem2 == 1)//发送31 03
      {
        SID31_RoutineControl(RequestRoutineResult,PID,Routine_Sub0x03[j].requestData,Routine_Sub0x03[j].RequestLenth,FUNCTIONAL,SPRMIB_FALSE);//正常请求
        CheckPosResponse_SID31(RequestRoutineResult,PID,0,0);
        if(gTpRxData[4]!= 0x32)
        {
          TestStepFail("Chk","Routine can't run");
        }
      }
      
      if(tem1 == 1)//直接发送31 02
      {
        SID31_RoutineControl(StopRoutine,PID,Routine_Sub0x02[k].requestData,Routine_Sub0x02[k].RequestLenth,FUNCTIONAL,SPRMIB_FALSE);//正常请求
        CheckPosResponse_SID31(StopRoutine,PID,0,0);
        if(gTpRxData[4]!= 0x30)
        {
          TestStepFail("Chk","Routine can't run");
        }
      }
      
      if(tem2 == 1)//发送31 03
      {
        SID31_RoutineControl(RequestRoutineResult,PID,Routine_Sub0x03[j].requestData,Routine_Sub0x03[j].RequestLenth,FUNCTIONAL,SPRMIB_FALSE);//正常请求
        CheckPosResponse_SID31(RequestRoutineResult,PID,0,0);
        if(gTpRxData[4]!= 0x30)
        {
          TestStepFail("Chk","Routine can't run");
        }
      }
    }
  }
  TestStep("Verify extendedDiagnosticSession.",TestStepIntervalTime);
  CheckCurrentSession(EXTENDEDSESSION,PHYSICAL,0,0);
  
  SID11_ECUReset(HARDRESET,PHYSICAL,SPRMIB_FALSE);
  CheckPosResponse_SID11(HARDRESET,0,0);
  ECUinitHandle(0);
  /******************************以上为测试步骤*********************************/
  Postcondition();
}
/// <石太佳>
void check_routine_type(byte type)
{
    byte typeinresp;
    if (gTpRxData[0]!=0x71)
         return;
//    typeinresp = (gTpRxData[4] & 0xf0)>>4;
//    if( typeinresp== type)
//    {
//        TestStepPass("Chk","routine type should be %d ",type);
//    }
//    else
//    {
//        TestStepFail("Chk","routine type should be %d, but routine type in response is %d ",type,typeinresp);
//    }
}

/// <APP_CommonServiceTest>
testcase Service_0x3E_Valid_Physical_DefaultSession_supported()
{
  char logName[400] = "";
  char info[1024];
  
  strncat(logName,"11350943_Service_0x3E_Valid_Physical_DefaultSession_supported",400);
  testCaseDescription("The intent is to verify TesterPresent (0x3E) and its subfunctions is supported.");
  testCaseTitle("1350943","Service_0x3E_Valid_Physical_DefaultSession_supported");
  
  SetLog(logName);
  Precondition();

  /******************************以下为测试步骤*********************************/
  
  SessionFlag=APP;
  
  TestStep("Send 3E 00",TestStepIntervalTime);
  SID3E_TesterPresent(PHYSICAL,SPRMIB_FALSE);
  CheckPosResponse_SID3E(0x00,2);
  TestStep("Send 3E 80",TestStepIntervalTime);
  SID3E_TesterPresent(PHYSICAL,SPRMIB_TRUE);
  CheckNonResponse(0,0);
  TestStep("Verify defaultSession",TestStepIntervalTime);
  CheckCurrentSession(DEFAULTSESSION,PHYSICAL,0,0);
  /******************************以上为测试步骤*********************************/
  Postcondition();
   
}
/// <APP_CommonServiceTest>
testcase Service_0x3E_Valid_Physical_ExtendedSession_Supported()
{
  char logName[400] = "";
  char info[1024];
  
  strncat(logName,"1350944_Service_0x3E_Valid_Physical_ExtendedSession_Supported",400);
  testCaseDescription("The intent is to verify TesterPresent (0x3E) and its subfunctions is supported.");
  testCaseTitle("1350944","Service_0x3E_Valid_Physical_ExtendedSession_Supported");
  
  SetLog(logName);
  Precondition();

  /******************************以下为测试步骤*********************************/
  
  SessionFlag=APP;
  
  TestStep("Transition from defaultSession(0x01) to extendedDiagnosticSession(0x03).",TestStepIntervalTime);
  SID10_DiagnosticSessionControl(EXTENDEDSESSION,PHYSICAL,SPRMIB_FALSE);
  CheckPosResponse_SID10(EXTENDEDSESSION,gP2Client_APP,gP2StarClientFor10Check,0,0);
  TestStep("Verify extendedDiagnosticSession.",TestStepIntervalTime);
  CheckCurrentSession(EXTENDEDSESSION,PHYSICAL,0,0);
  TestStep("Send 3E 00",TestStepIntervalTime);
  SID3E_TesterPresent(PHYSICAL,SPRMIB_FALSE);;
  CheckPosResponse_SID3E(0x00,2);
  TestStep("Send 3E 80",TestStepIntervalTime);
  SID3E_TesterPresent(PHYSICAL,SPRMIB_TRUE);;
  CheckNonResponse(0,0);
  TestStep("Verify extendedDiagnosticSession.",TestStepIntervalTime);
  CheckCurrentSession(EXTENDEDSESSION,PHYSICAL,0,0);
  /******************************以上为测试步骤*********************************/
  Postcondition();
   
}
/// <APP_CommonServiceTest>
testcase Service_0x3E_Valid_Functional_DefaultSession_supported()
{
  char logName[400] = "";
  char info[1024];
  
  strncat(logName,"1350945_Service_0x3E_Valid_Functional_DefaultSession_supported",400);
  testCaseDescription("The intent is to verify TesterPresent (0x3E) and its subfunctions is supported.");
  testCaseTitle("1350945","Service_0x3E_Valid_Functional_DefaultSession_supported");
  if(gBusFlag==3)
	{
		testStepWarning("Test","This test case does not apply to the LIN bus");
		return;
	}
  SetLog(logName);
  Precondition();

  /******************************以下为测试步骤*********************************/
//  SID10_DiagnosticSessionControl(DefaultSession,physical,SPRMIB_False,P2Cli_0x01_APP);
//  CheckPosResponse_SID10(0x01,P2Ser_0x01_APP,P2Serdelay_0x01_APP);
//
//  CheckCurrentSession(DEFAULTSESSION,PHYSICAL,0,0);
  SessionFlag=APP;
  
  TestStep("Send 3E 00",TestStepIntervalTime);
  SID3E_TesterPresent(FUNCTIONAL,SPRMIB_FALSE);
  CheckPosResponse_SID3E(0x00,2);
  TestStep("Send 3E 80",TestStepIntervalTime);
  SID3E_TesterPresent(FUNCTIONAL,SPRMIB_TRUE);
  CheckNonResponse(0,0);
  TestStep("Verify defaultSession",TestStepIntervalTime);
  CheckCurrentSession(DEFAULTSESSION,PHYSICAL,0,0);
  /******************************以上为测试步骤*********************************/
Postcondition();
   
}
/// <APP_CommonServiceTest>
testcase Service_0x3E_Valid_Functional_ExtendedSession_Supported()
{
  char logName[400] = "";
  char info[1024];
  
  strncat(logName,"1350946_Service_0x3E_Valid_Functional_ExtendedSession_Supported",400);
  testCaseDescription("The intent is to verify TesterPresent (0x3E) and its subfunctions is supported.");
  testCaseTitle("1350946","Service_0x3E_Valid_Functional_ExtendedSession_Supported");
  if(gBusFlag==3)
	{
		testStepWarning("Test","This test case does not apply to the LIN bus");
		return;
	}
  SetLog(logName);
  Precondition();

  /******************************以下为测试步骤*********************************/
  
  SessionFlag=APP;
  
  TestStep("Transition from defaultSession(0x01) to extendedDiagnosticSession(0x03).",TestStepIntervalTime);
  SID10_DiagnosticSessionControl(EXTENDEDSESSION,FUNCTIONAL,SPRMIB_FALSE);
  CheckPosResponse_SID10(EXTENDEDSESSION,gP2Client_APP,gP2StarClientFor10Check,0,0);
  TestStep("Verify extendedDiagnosticSession.",TestStepIntervalTime);
  CheckCurrentSession(EXTENDEDSESSION,PHYSICAL,0,0);
  TestStep("Send 3E 00",TestStepIntervalTime);
  SID3E_TesterPresent(FUNCTIONAL,SPRMIB_FALSE);
  CheckPosResponse_SID3E(0x00,2);
  TestStep("Send 3E 80",TestStepIntervalTime);
  SID3E_TesterPresent(FUNCTIONAL,SPRMIB_TRUE);
  CheckNonResponse(0,0);
  TestStep("Verify extendedDiagnosticSession.",TestStepIntervalTime);
  CheckCurrentSession(EXTENDEDSESSION,PHYSICAL,0,0);
  /******************************以上为测试步骤*********************************/
  Postcondition();
}
/// <APP_CommonServiceTest>
testcase Service_0x85_Phy_PositiveResponse()
{
  byte SubFunOf85[2]={0x01,0x02};
  char logName[400] = "";
  char info[1024];
  
  strncat(logName,"1350931_Service_0x85_Phy_PositiveResponse",400);
  testCaseTitle("1350931","Service_0x85_Phy_PositiveResponse");
	if(gBusFlag==3)//2025-11-17-石太佳-移除对LIN ECU的限制
	{
		//testStepWarning("Test","This test case does not apply to the LIN bus");
		//return;
	}
  SetLog(logName);
  Precondition();
   
  /******************************以下为测试步骤*********************************/
  TestStep("Enter defaultSession(0x01)",TestStepIntervalTime);
  SID10_DiagnosticSessionControl(DEFAULTSESSION,PHYSICAL,SPRMIB_FALSE);
  CheckPosResponse_SID10(DEFAULTSESSION,0,6);
  ECUinitHandle(0);
  TestStep("Enter extendedSession(0x03)",TestStepIntervalTime);
  SID10_DiagnosticSessionControl(EXTENDEDSESSION,PHYSICAL,SPRMIB_FALSE);
  CheckPosResponse_SID10(EXTENDEDSESSION,0,6);
  
  SID85_ControlDTCSetting(SubFunOf85[0],PHYSICAL,SPRMIB_FALSE);
  CheckPosResponse_SID85(SubFunOf85[0],0,0);
  
  SID85_ControlDTCSetting(SubFunOf85[1],PHYSICAL,SPRMIB_FALSE);
  CheckPosResponse_SID85(SubFunOf85[1],0,0);
  
  SID85_ControlDTCSetting(SubFunOf85[0],PHYSICAL,SPRMIB_TRUE);
  CheckNonResponse(0,0);
  
  SID85_ControlDTCSetting(SubFunOf85[1],PHYSICAL,SPRMIB_TRUE);
  CheckNonResponse(0,0);
  /******************************以上为测试步骤*********************************/
  PostCondition();
}
/// <APP_CommonServiceTest>
testcase Service_0x85_Func_PositiveResponse()
{
  byte SubFunOf85[2]={0x01,0x02};
  char logName[400] = "";
  char info[1024];
  
  strncat(logName,"1350932_Service_0x85_Func_PositiveResponse",400);
  testCaseTitle("1350932","Service_0x85_Func_PositiveResponse");
  if(gBusFlag==3)
	{
		testStepWarning("Test","This test case does not apply to the LIN bus");
		return;
	}
  SetLog(logName);
  Precondition();
   
  /******************************以下为测试步骤*********************************/
  TestStep("Enter defaultSession(0x01)",TestStepIntervalTime);
  SID10_DiagnosticSessionControl(DEFAULTSESSION,PHYSICAL,SPRMIB_FALSE);
  CheckPosResponse_SID10(DEFAULTSESSION,0,6);
  ECUinitHandle(0);
  TestStep("Enter extendedSession(0x03)",TestStepIntervalTime);
  SID10_DiagnosticSessionControl(EXTENDEDSESSION,PHYSICAL,SPRMIB_FALSE);
  CheckPosResponse_SID10(EXTENDEDSESSION,0,6);
  
  SID85_ControlDTCSetting(SubFunOf85[0],FUNCTIONAL,SPRMIB_FALSE);
  CheckPosResponse_SID85(SubFunOf85[0],0,0);
  
  SID85_ControlDTCSetting(SubFunOf85[1],FUNCTIONAL,SPRMIB_FALSE);
  CheckPosResponse_SID85(SubFunOf85[1],0,0);
  
  SID85_ControlDTCSetting(SubFunOf85[0],FUNCTIONAL,SPRMIB_TRUE);
  CheckNonResponse(0,0);
  
  SID85_ControlDTCSetting(SubFunOf85[1],FUNCTIONAL,SPRMIB_TRUE);
  CheckNonResponse(0,0);
  /******************************以上为测试步骤*********************************/
  PostCondition();
}

/// <APP_CommonServiceTest>
testcase Service_0x85_Phy_8501Request()
{
  byte clearDTC[3]={0xFF,0xFF,0xFF};
  byte SFOf85[2]={0x01,0x02};
  char logName[400] = "";
  char info[1024];
  
  strncat(logName,"1350933_Service_0x85_Phy_8501Request",400);
  testCaseTitle("1350933","Service_0x85_Phy_8501Request");
	if(gBusFlag==3)//2025-11-17-石太佳-移除对LIN ECU的限制
	{
		//testStepWarning("Test","This test case does not apply to the LIN bus");
		//return;
	}
  SetLog(logName);
  Precondition();
   
  /******************************以下为测试步骤*********************************/
  SimTRC();
  
  TestStep("Enter defaultSession(0x01)",TestStepIntervalTime);
  SID10_DiagnosticSessionControl(DEFAULTSESSION,PHYSICAL,SPRMIB_FALSE);
  CheckPosResponse_SID10(DEFAULTSESSION,0,6);
  ECUinitHandle(0);
  TestStep("Enter extendedSession(0x03)",TestStepIntervalTime);
  SID10_DiagnosticSessionControl(EXTENDEDSESSION,PHYSICAL,SPRMIB_FALSE);
  CheckPosResponse_SID10(EXTENDEDSESSION,0,6);
  TestStep("Tester Present on",TestStepIntervalTime);
  TestStep("Clear all DTC",TestStepIntervalTime);
  SID14_ClearDTC(clearDTC,FUNCTIONAL);
  CheckPosResponse_SID14(0,0);
  
  TestStep("Wait 10s");
  delay(10000);
  
  TestStep("Report DTCs",TestStepIntervalTime);
  SID19_Sub02_ReportDTCByStatusMask(0x27,PHYSICAL);
  CheckPosResponse_SID19_02(AvailiableMask,0,0);
  Rss1=gTpRxLength;
  if(Rss1<=3)
  {
    TestStepWarning("No avalible DTC,Test end");
    StopTRC();
    Postcondition();
    return;
  }
  TestStep("Request DTC setting off",TestStepIntervalTime);
  SID85_ControlDTCSetting(SFOf85[1],PHYSICAL,SPRMIB_FALSE);   //禁止DTC更新
  CheckPosResponse_SID85(SFOf85[1],0,0);
  TestStep("Clear all DTC",TestStepIntervalTime);
  SID14_ClearDTC(clearDTC,FUNCTIONAL);
  CheckPosResponse_SID14(0,0);
  
  TestStep("Wait 10s");
  delay(10000);
  
  TestStep("Report DTCs",TestStepIntervalTime);
  SID19_Sub02_ReportDTCByStatusMask(0x27,PHYSICAL);
  CheckPosResponse_SID19_02(AvailiableMask,0,0);
  DTCSettingCheck(2);
  TestStep("Request DTC setting on",TestStepIntervalTime);
  SID85_ControlDTCSetting(SFOf85[0],PHYSICAL,SPRMIB_FALSE);
  CheckPosResponse_SID85(SFOf85[0],0,0);
  
  TestStep("Clear all DTC",TestStepIntervalTime);
  SID14_ClearDTC(clearDTC,FUNCTIONAL);
  CheckPosResponse_SID14(0,0);
  TestStep("Wait 10s");
  delay(10000);
  
  TestStep("Report DTCs",TestStepIntervalTime);
  SID19_Sub02_ReportDTCByStatusMask(0x27,PHYSICAL);
  CheckPosResponse_SID19_02(AvailiableMask,0,0);
  DTCSettingCheck(1);
  
///////one more
  TestStep("Repeat step 1-14 once, set service 0x85 SPRMIB=True",TestStepIntervalTime);
  ResetStepIndex();
  
  TestStep("Enter defaultSession(0x01)",TestStepIntervalTime);
  SID10_DiagnosticSessionControl(DEFAULTSESSION,PHYSICAL,SPRMIB_FALSE);
  CheckPosResponse_SID10(DEFAULTSESSION,0,6);
  ECUinitHandle(0);
  TestStep("Enter extendedSession(0x03)",TestStepIntervalTime);
  SID10_DiagnosticSessionControl(EXTENDEDSESSION,PHYSICAL,SPRMIB_FALSE);
  CheckPosResponse_SID10(EXTENDEDSESSION,0,6);
  TestStep("Tester Present on",TestStepIntervalTime);
  TestStep("Clear all DTC",TestStepIntervalTime);
  SID14_ClearDTC(clearDTC,FUNCTIONAL);
  CheckPosResponse_SID14(0,0);
  
  TestStep("Wait 5s");
  delay(5000);
  
  TestStep("Report DTCs",TestStepIntervalTime);
  SID19_Sub02_ReportDTCByStatusMask(0x27,PHYSICAL);
  CheckPosResponse_SID19_02(AvailiableMask,0,0);
  Rss1=gTpRxLength;
  if(Rss1<=3)
  {
    TestStepWarning("No avalible DTC,Test end");
    StopTRC();
    Postcondition();
    return;
  }
  TestStep("Request DTC setting off",TestStepIntervalTime);
  SID85_ControlDTCSetting(SFOf85[1],PHYSICAL,SPRMIB_TRUE);   //禁止DTC更新
  CheckNonResponse(0,0);
  TestStep("Clear all DTC",TestStepIntervalTime);
  SID14_ClearDTC(clearDTC,FUNCTIONAL);
  CheckPosResponse_SID14(0,0);
  
  TestStep("Wait 10s");
  delay(10000);
  
  TestStep("Report DTCs",TestStepIntervalTime);
  SID19_Sub02_ReportDTCByStatusMask(0x27,PHYSICAL);
  CheckPosResponse_SID19_02(0xFF,0,0);
  DTCSettingCheck(2);
  TestStep("Request DTC setting on",TestStepIntervalTime);
  SID85_ControlDTCSetting(SFOf85[0],PHYSICAL,SPRMIB_TRUE);
  CheckNonResponse(0,0);
  
  TestStep("Clear all DTC",TestStepIntervalTime);
  SID14_ClearDTC(clearDTC,FUNCTIONAL);
  CheckPosResponse_SID14(0,0);
  TestStep("Wait 10s");
  delay(10000);
  
  TestStep("Report DTCs",TestStepIntervalTime);
  SID19_Sub02_ReportDTCByStatusMask(0x27,PHYSICAL);
  CheckPosResponse_SID19_02(0xFF,0,0);
  DTCSettingCheck(1);
  
  StopTRC();
  /******************************以上为测试步骤*********************************/
  PostCondition();
}
/// <APP_CommonServiceTest>
testcase Service_0x85_Func_8501Request()
{
  byte clearDTC[3]={0xFF,0xFF,0xFF};
  byte SFOf85[2]={0x01,0x02};
  char logName[400] = "";
  char info[1024];
  
  strncat(logName,"1350934_Service_0x85_Func_8501Request",400);
  testCaseTitle("1350934","Service_0x85_Func_8501Request");
  if(gBusFlag==3)
	{
		testStepWarning("Test","This test case does not apply to the LIN bus");
		return;
	}
  SetLog(logName);
  Precondition();
   
  /******************************以下为测试步骤*********************************/
  SimTRC();
  
  TestStep("Enter defaultSession(0x01)",TestStepIntervalTime);
  SID10_DiagnosticSessionControl(DEFAULTSESSION,PHYSICAL,SPRMIB_FALSE);
  CheckPosResponse_SID10(DEFAULTSESSION,0,6);
  ECUinitHandle(0);
  TestStep("Enter extendedSession(0x03)",TestStepIntervalTime);
  SID10_DiagnosticSessionControl(EXTENDEDSESSION,PHYSICAL,SPRMIB_FALSE);
  CheckPosResponse_SID10(EXTENDEDSESSION,0,6);
  TestStep("Tester Present on",TestStepIntervalTime);
  TestStep("Clear all DTC",TestStepIntervalTime);
  SID14_ClearDTC(clearDTC,FUNCTIONAL);
  CheckPosResponse_SID14(0,0);
  
  TestStep("Wait 10s");
  delay(10000);
  
  TestStep("Report DTCs",TestStepIntervalTime);
  SID19_Sub02_ReportDTCByStatusMask(0x27,FUNCTIONAL);
  CheckPosResponse_SID19_02(0xFF,0,0);
  Rss1=gTpRxLength;
  if(Rss1<=3)
  {
    TestStepWarning("No avalible DTC,Test end");
    StopTRC();
    Postcondition();
    return;
  }
  TestStep("Request DTC setting off",TestStepIntervalTime);
  SID85_ControlDTCSetting(SFOf85[1],FUNCTIONAL,SPRMIB_FALSE);   //禁止DTC更新
  CheckPosResponse_SID85(SFOf85[1],0,0);
  TestStep("Clear all DTC",TestStepIntervalTime);
  SID14_ClearDTC(clearDTC,FUNCTIONAL);
  CheckPosResponse_SID14(0,0);
  
  TestStep("Wait 10s");
  delay(10000);
  
  TestStep("Report DTCs",TestStepIntervalTime);
  SID19_Sub02_ReportDTCByStatusMask(0x27,FUNCTIONAL);
  CheckPosResponse_SID19_02(0xFF,0,0);
  DTCSettingCheck(2);
  TestStep("Request DTC setting on",TestStepIntervalTime);
  SID85_ControlDTCSetting(SFOf85[0],FUNCTIONAL,SPRMIB_FALSE);
  CheckPosResponse_SID85(SFOf85[0],0,0);
  
  TestStep("Clear all DTC",TestStepIntervalTime);
  SID14_ClearDTC(clearDTC,FUNCTIONAL);
  CheckPosResponse_SID14(0,0);
  TestStep("Wait 10s");
  delay(10000);
  
  TestStep("Report DTCs",TestStepIntervalTime);
  SID19_Sub02_ReportDTCByStatusMask(0x27,FUNCTIONAL);
  CheckPosResponse_SID19_02(0xFF,0,0);
  DTCSettingCheck(1);
  
///////one more
  TestStep("Repeat step 1-14 once, set service 0x85 SPRMIB=True",TestStepIntervalTime);
  ResetStepIndex();
  
  TestStep("Enter defaultSession(0x01)",TestStepIntervalTime);
  SID10_DiagnosticSessionControl(DEFAULTSESSION,PHYSICAL,SPRMIB_FALSE);
  CheckPosResponse_SID10(DEFAULTSESSION,0,6);
  ECUinitHandle(0);
  TestStep("Enter extendedSession(0x03)",TestStepIntervalTime);
  SID10_DiagnosticSessionControl(EXTENDEDSESSION,PHYSICAL,SPRMIB_FALSE);
  CheckPosResponse_SID10(EXTENDEDSESSION,0,6);
  TestStep("Tester Present on",TestStepIntervalTime);
  TestStep("Clear all DTC",TestStepIntervalTime);
  SID14_ClearDTC(clearDTC,FUNCTIONAL);
  CheckPosResponse_SID14(0,0);
  
  TestStep("Wait 5s");
  delay(5000);
  
  TestStep("Report DTCs",TestStepIntervalTime);
  SID19_Sub02_ReportDTCByStatusMask(0x27,FUNCTIONAL);
  CheckPosResponse_SID19_02(0xFF,0,0);
  Rss1=gTpRxLength;
  if(Rss1<=3)
  {
    TestStepWarning("No avalible DTC,Test end");
    StopTRC();
    Postcondition();
    return;
  }
  TestStep("Request DTC setting off",TestStepIntervalTime);
  SID85_ControlDTCSetting(SFOf85[1],FUNCTIONAL,SPRMIB_TRUE);   //禁止DTC更新
  CheckNonResponse(0,0);
  TestStep("Clear all DTC",TestStepIntervalTime);
  SID14_ClearDTC(clearDTC,FUNCTIONAL);
  CheckPosResponse_SID14(0,0);
  
  TestStep("Wait 10s");
  delay(10000);
  
  TestStep("Report DTCs",TestStepIntervalTime);
  SID19_Sub02_ReportDTCByStatusMask(0x27,FUNCTIONAL);
  CheckPosResponse_SID19_02(0xFF,0,0);
  DTCSettingCheck(2);
  TestStep("Request DTC setting on",TestStepIntervalTime);
  SID85_ControlDTCSetting(SFOf85[0],FUNCTIONAL,SPRMIB_TRUE);
  CheckNonResponse(0,0);
  
  TestStep("Clear all DTC",TestStepIntervalTime);
  SID14_ClearDTC(clearDTC,FUNCTIONAL);
  CheckPosResponse_SID14(0,0);
  TestStep("Wait 10s");
  delay(10000);
  
  TestStep("Report DTCs",TestStepIntervalTime);
  SID19_Sub02_ReportDTCByStatusMask(0x27,FUNCTIONAL);
  CheckPosResponse_SID19_02(0xFF,0,0);
  DTCSettingCheck(1);
  StopTRC();
  /******************************以上为测试步骤*********************************/
  PostCondition();
}
/// <APP_CommonServiceTest>
testcase Service_0x85_Phy_Timeout()
{
  byte clearDTC[3]={0xFF,0xFF,0xFF};
  byte SFOf85[2]={0x01,0x02};
  char logName[400] = "";
  char info[1024];
  
  strncat(logName,"1350935_Service_0x85_Phy_Timeout",400);
  testCaseTitle("1350935","Service_0x85_Phy_Timeout");
  
  if(gBusFlag==5 && SWRS_VERSION>=8 && EthNodeTypeNow==EdgeNode)
  {
     testStepWarning("","按照SWRS 版本>=V8,需求ID 987287定义 ,边缘节点应向车内发送3E 80 ，并维持自身的会话模式，所以不会跳转到默认会话,这个用例就不适用了");
     return;
  }
  
	if(gBusFlag==3)//2025-11-17-石太佳-移除对LIN ECU的限制
	{
		//testStepWarning("Test","This test case does not apply to the LIN bus");
		//return;
	}
  SetLog(logName);
  Precondition();
   
  /******************************以下为测试步骤*********************************/
  SimTRC();
  
  TestStep("Enter defaultSession(0x01)",TestStepIntervalTime);
  SID10_DiagnosticSessionControl(DEFAULTSESSION,PHYSICAL,SPRMIB_FALSE);
  CheckPosResponse_SID10(DEFAULTSESSION,0,6);
  ECUinitHandle(0);
  TestStep("Enter extendedSession(0x03)",TestStepIntervalTime);
  SID10_DiagnosticSessionControl(EXTENDEDSESSION,PHYSICAL,SPRMIB_FALSE);
  CheckPosResponse_SID10(EXTENDEDSESSION,0,6);
  TestStep("Tester Present on",TestStepIntervalTime);
  TestStep("Clear all DTC",TestStepIntervalTime);
  SID14_ClearDTC(clearDTC,FUNCTIONAL);
  CheckPosResponse_SID14(0,0);
  
  TestStep("Wait 10s");
  delay(10000);
  
  TestStep("Report DTCs",TestStepIntervalTime);
  SID19_Sub02_ReportDTCByStatusMask(0x27,PHYSICAL);
  CheckPosResponse_SID19_02(0xFF,0,0);
  Rss1=gTpRxLength;
  if(Rss1<=3)
  {
    TestStepWarning("No avalible DTC,Test end");
    StopTRC();
    Postcondition();
    return;
  }
  TestStep("Request DTC setting off",TestStepIntervalTime);
  SID85_ControlDTCSetting(SFOf85[1],PHYSICAL,SPRMIB_FALSE);   //禁止DTC更新
  CheckPosResponse_SID85(SFOf85[1],0,0);
  TestStep("Clear all DTC",TestStepIntervalTime);
  SID14_ClearDTC(clearDTC,FUNCTIONAL);
  CheckPosResponse_SID14(0,0);
  
  TestStep("Wait 10s");
  delay(10000);
  
  TestStep("Tester Present off",TestStepIntervalTime);
  TP_TesterPresentSet(TP_OFF);
  
  TestStep("Report DTCs",TestStepIntervalTime);
  SID19_Sub02_ReportDTCByStatusMask(0x27,PHYSICAL);
  CheckPosResponse_SID19_02(0xFF,0,0);
  DTCSettingCheck(2);
  TestStep("Wait for S3+5s");
  delay(10000);
  CheckCurrentSession(DEFAULTSESSION,PHYSICAL,0,0);
  TestStep("Report DTCs",TestStepIntervalTime);
  SID19_Sub02_ReportDTCByStatusMask(0x27,PHYSICAL);
  CheckPosResponse_SID19_02(0xFF,0,0);
  DTCSettingCheck(1);
  
///////one more
  TestStep("Repeat step 1-12 once, set service 0x85 SPRMIB=True",TestStepIntervalTime);
  ResetStepIndex();
  TestStep("Tester Present on");
  
  TestStep("Enter defaultSession(0x01)",TestStepIntervalTime);
  SID10_DiagnosticSessionControl(DEFAULTSESSION,PHYSICAL,SPRMIB_FALSE);
  CheckPosResponse_SID10(DEFAULTSESSION,0,6);
  ECUinitHandle(0);
  TestStep("Enter extendedSession(0x03)",TestStepIntervalTime);
  SID10_DiagnosticSessionControl(EXTENDEDSESSION,PHYSICAL,SPRMIB_FALSE);
  CheckPosResponse_SID10(EXTENDEDSESSION,0,6);
  
  TestStep("Tester Present on");
  TP_TesterPresentSet(TP_ON);
  
  TestStep("Clear all DTC",TestStepIntervalTime);
  SID14_ClearDTC(clearDTC,FUNCTIONAL);
  CheckPosResponse_SID14(0,0);
  
  TestStep("Wait 5s");
  delay(5000);
  
  TestStep("Report DTCs",TestStepIntervalTime);
  SID19_Sub02_ReportDTCByStatusMask(0x27,PHYSICAL);
  CheckPosResponse_SID19_02(0xFF,0,0);
  Rss1=gTpRxLength;
  if(Rss1<=3)
  {
    TestStepWarning("No avalible DTC,Test end");
    StopTRC();
    Postcondition();
    return;
  }
  TestStep("Request DTC setting off",TestStepIntervalTime);
  SID85_ControlDTCSetting(SFOf85[1],PHYSICAL,SPRMIB_TRUE);   //禁止DTC更新
  CheckNonResponse(0,0);
  TestStep("Clear all DTC",TestStepIntervalTime);
  SID14_ClearDTC(clearDTC,FUNCTIONAL);
  CheckPosResponse_SID14(0,0);
  
  TestStep("Wait 10s");
  delay(10000);
  
  TestStep("Tester Present off",TestStepIntervalTime);
  TP_TesterPresentSet(TP_OFF);
  
  TestStep("Report DTCs",TestStepIntervalTime);
  SID19_Sub02_ReportDTCByStatusMask(0x27,PHYSICAL);
  CheckPosResponse_SID19_02(0xFF,0,0);
  DTCSettingCheck(2);
  TestStep("Wait for S3+5s");
  delay(10000);
  CheckCurrentSession(DEFAULTSESSION,PHYSICAL,0,0);
  TestStep("Report DTCs",TestStepIntervalTime);
  SID19_Sub02_ReportDTCByStatusMask(0x27,PHYSICAL);
  CheckPosResponse_SID19_02(0xFF,0,0);
  DTCSettingCheck(1);
  StopTRC();
  
  /******************************以上为测试步骤*********************************/
  PostCondition();
}
/// <APP_CommonServiceTest>
testcase Service_0x85_Func_Timeout()
{
  byte clearDTC[3]={0xFF,0xFF,0xFF};
  byte SFOf85[2]={0x01,0x02};
  char logName[400] = "";
  char info[1024];
  
  strncat(logName,"1350936_Service_0x85_Func_Timeout",400);
  testCaseTitle("1350936","Service_0x85_Func_Timeout");
  
  if(gBusFlag==5 && SWRS_VERSION>=8 && EthNodeTypeNow==EdgeNode)
  {
     testStepWarning("","按照SWRS 版本>=V8,需求ID 987287定义 ,边缘节点应向车内发送3E 80 ，并维持自身的会话模式，所以不会跳转到默认会话,这个用例就不适用了");
     return;
  }
  
  
  if(gBusFlag==3)
	{
		testStepWarning("Test","This test case does not apply to the LIN bus");
		return;
	}
  SetLog(logName);
  Precondition();
   
  /******************************以下为测试步骤*********************************/
  SimTRC();
  
  TestStep("Enter defaultSession(0x01)",TestStepIntervalTime);
  SID10_DiagnosticSessionControl(DEFAULTSESSION,PHYSICAL,SPRMIB_FALSE);
  CheckPosResponse_SID10(DEFAULTSESSION,0,6);
  ECUinitHandle(0);
  TestStep("Enter extendedSession(0x03)",TestStepIntervalTime);
  SID10_DiagnosticSessionControl(EXTENDEDSESSION,PHYSICAL,SPRMIB_FALSE);
  CheckPosResponse_SID10(EXTENDEDSESSION,0,6);
  TestStep("Tester Present on",TestStepIntervalTime);
  TestStep("Clear all DTC",TestStepIntervalTime);
  SID14_ClearDTC(clearDTC,FUNCTIONAL);
  CheckPosResponse_SID14(0,0);
  
  TestStep("Wait 10s");
  delay(10000);
  
  TestStep("Report DTCs",TestStepIntervalTime);
  SID19_Sub02_ReportDTCByStatusMask(0x27,FUNCTIONAL);
  CheckPosResponse_SID19_02(0xFF,0,0);
  Rss1=gTpRxLength;
  if(Rss1<=3)
  {
    TestStepWarning("No avalible DTC,Test end");
    StopTRC();
    Postcondition();
    return;
  }
  TestStep("Request DTC setting off",TestStepIntervalTime);
  SID85_ControlDTCSetting(SFOf85[1],FUNCTIONAL,SPRMIB_FALSE);   //禁止DTC更新
  CheckPosResponse_SID85(SFOf85[1],0,0);
  TestStep("Clear all DTC",TestStepIntervalTime);
  SID14_ClearDTC(clearDTC,FUNCTIONAL);
  CheckPosResponse_SID14(0,0);
  
  TestStep("Wait 10s");
  delay(10000);

  TestStep("Tester Present off",TestStepIntervalTime);
  TP_TesterPresentSet(TP_OFF);
  
  TestStep("Report DTCs",TestStepIntervalTime);
  SID19_Sub02_ReportDTCByStatusMask(0x27,FUNCTIONAL);
  CheckPosResponse_SID19_02(0xFF,0,0);
  DTCSettingCheck(2);
  TestStep("Wait for S3+5s");
  delay(10000);
  
  TestStep("Report DTCs",TestStepIntervalTime);
  SID19_Sub02_ReportDTCByStatusMask(0x27,FUNCTIONAL);
  CheckPosResponse_SID19_02(0xFF,0,0);
  DTCSettingCheck(1);
  
///////one more
  TestStep("Repeat step 1-12 once, set service 0x85 SPRMIB=True",TestStepIntervalTime);
  ResetStepIndex();
  
  TestStep("Enter defaultSession(0x01)",TestStepIntervalTime);
  SID10_DiagnosticSessionControl(DEFAULTSESSION,PHYSICAL,SPRMIB_FALSE);
  CheckPosResponse_SID10(DEFAULTSESSION,0,6);
  ECUinitHandle(0);
  TestStep("Enter extendedSession(0x03)",TestStepIntervalTime);
  SID10_DiagnosticSessionControl(EXTENDEDSESSION,PHYSICAL,SPRMIB_FALSE);
  CheckPosResponse_SID10(EXTENDEDSESSION,0,6);
  TestStep("Tester Present on",TestStepIntervalTime);
  TP_TesterPresentSet(TP_ON);
  
  TestStep("Clear all DTC",TestStepIntervalTime);
  SID14_ClearDTC(clearDTC,FUNCTIONAL);
  CheckPosResponse_SID14(0,0);
  
  TestStep("Wait 5s");
  delay(5000);
  
  TestStep("Report DTCs",TestStepIntervalTime);
  SID19_Sub02_ReportDTCByStatusMask(0x27,FUNCTIONAL);
  CheckPosResponse_SID19_02(0xFF,0,0);
  Rss1=gTpRxLength;
  if(Rss1<=3)
  {
    TestStepWarning("No avalible DTC,Test end");
    StopTRC();
    Postcondition();
    return;
  }
  TestStep("Request DTC setting off",TestStepIntervalTime);
  SID85_ControlDTCSetting(SFOf85[1],FUNCTIONAL,SPRMIB_TRUE);   //禁止DTC更新
  CheckNonResponse(0,0);
  TestStep("Clear all DTC",TestStepIntervalTime);
  SID14_ClearDTC(clearDTC,FUNCTIONAL);
  CheckPosResponse_SID14(0,0);
  
  TestStep("Wait 10s");
  delay(10000);

  TestStep("Tester Present off",TestStepIntervalTime);
  TP_TesterPresentSet(TP_OFF);
  
  TestStep("Report DTCs",TestStepIntervalTime);
  SID19_Sub02_ReportDTCByStatusMask(0x27,FUNCTIONAL);
  CheckPosResponse_SID19_02(0xFF,0,0);
  DTCSettingCheck(2);
  TestStep("Wait for S3+5s");
  delay(10000);
  
  TestStep("Report DTCs",TestStepIntervalTime);
  SID19_Sub02_ReportDTCByStatusMask(0x27,FUNCTIONAL);
  CheckPosResponse_SID19_02(0xFF,0,0);
  DTCSettingCheck(1);
  StopTRC();
  /******************************以上为测试步骤*********************************/
  PostCondition();
}
/// <APP_CommonServiceTest>
testcase Service_0x85_Phy_HardRest()
{
  byte clearDTC[3]={0xFF,0xFF,0xFF};
  byte SFOf85[2]={0x01,0x02};
  char logName[400] = "";
  char info[1024];
  
  strncat(logName,"1350937_Service_0x85_Phy_HardRest",400); 
  testCaseTitle("1350937","Service_0x85_Phy_HardRest");
	if(gBusFlag==3)//2025-11-17-石太佳-移除对LIN ECU的限制
	{
		//testStepWarning("Test","This test case does not apply to the LIN bus");
		//return;
	}
  SetLog(logName);
  Precondition();
   
  /******************************以下为测试步骤*********************************/
  SimTRC();
  
  TestStep("Enter defaultSession(0x01)",TestStepIntervalTime);
  SID10_DiagnosticSessionControl(DEFAULTSESSION,PHYSICAL,SPRMIB_FALSE);
  CheckPosResponse_SID10(DEFAULTSESSION,0,6);
  ECUinitHandle(0);
  TestStep("Enter extendedSession(0x03)",TestStepIntervalTime);
  SID10_DiagnosticSessionControl(EXTENDEDSESSION,PHYSICAL,SPRMIB_FALSE);
  CheckPosResponse_SID10(EXTENDEDSESSION,0,6);
  TestStep("Tester Present on",TestStepIntervalTime);
  TestStep("Clear all DTC",TestStepIntervalTime);
  SID14_ClearDTC(clearDTC,FUNCTIONAL);
  CheckPosResponse_SID14(0,0);
  
  TestStep("Wait 10s");
  delay(10000);
  
  TestStep("Report DTCs",TestStepIntervalTime);
  SID19_Sub02_ReportDTCByStatusMask(0x27,PHYSICAL);
  CheckPosResponse_SID19_02(0xFF,0,0);
  Rss1=gTpRxLength;
  if(Rss1<=3)
  {
    TestStepWarning("No avalible DTC,Test end");
    StopTRC();
    Postcondition();
    return;
  }
  TestStep("Request DTC setting off",TestStepIntervalTime);
  SID85_ControlDTCSetting(SFOf85[1],PHYSICAL,SPRMIB_FALSE);   //禁止DTC更新
  CheckPosResponse_SID85(SFOf85[1],0,0);
  TestStep("Clear all DTC",TestStepIntervalTime);
  SID14_ClearDTC(clearDTC,FUNCTIONAL);
  CheckPosResponse_SID14(0,0);
  
  TestStep("Wait 10s");
  delay(10000);
  
  TestStep("Report DTCs",TestStepIntervalTime);
  SID19_Sub02_ReportDTCByStatusMask(0x27,PHYSICAL);
  CheckPosResponse_SID19_02(0xFF,0,0);
  DTCSettingCheck(2);
  TestStep("ECU Reset (hard reset)",TestStepIntervalTime);
  SID11_ECUReset(HARDRESET,PHYSICAL,SPRMIB_FALSE);
  CheckPosResponse_SID11(HARDRESET,0,0);
  
  TestStep("Wait for ECU Inittime+5000ms");
  delay(ECUIniTime+5000);
  
  TestStep("Report DTCs",TestStepIntervalTime);
  SID19_Sub02_ReportDTCByStatusMask(0x27,PHYSICAL);
  CheckPosResponse_SID19_02(0xFF,0,0);
  DTCSettingCheck(1);
  
///////one more
  TestStep("Repeat step 1-13 once, set service 0x85 SPRMIB=True",TestStepIntervalTime);
  ResetStepIndex();
  
  TestStep("Enter defaultSession(0x01)",TestStepIntervalTime);
  SID10_DiagnosticSessionControl(DEFAULTSESSION,PHYSICAL,SPRMIB_FALSE);
  CheckPosResponse_SID10(DEFAULTSESSION,0,6);
  ECUinitHandle(0);
  TestStep("Enter extendedSession(0x03)",TestStepIntervalTime);
  SID10_DiagnosticSessionControl(EXTENDEDSESSION,PHYSICAL,SPRMIB_FALSE);
  CheckPosResponse_SID10(EXTENDEDSESSION,0,6);
  TestStep("Tester Present on",TestStepIntervalTime);
  TestStep("Clear all DTC",TestStepIntervalTime);
  SID14_ClearDTC(clearDTC,FUNCTIONAL);
  CheckPosResponse_SID14(0,0);
  
  TestStep("Wait 5s");
  delay(5000);
  
  TestStep("Report DTCs",TestStepIntervalTime);
  SID19_Sub02_ReportDTCByStatusMask(0x27,PHYSICAL);
  CheckPosResponse_SID19_02(0xFF,0,0);
  Rss1=gTpRxLength;
  if(Rss1<=3)
  {
    TestStepWarning("No avalible DTC,Test end");
    StopTRC();
    Postcondition();
    return;
  }
  TestStep("Request DTC setting off",TestStepIntervalTime);
  SID85_ControlDTCSetting(SFOf85[1],PHYSICAL,SPRMIB_TRUE);   //禁止DTC更新
  CheckNonResponse(0,0);
  TestStep("Clear all DTC",TestStepIntervalTime);
  SID14_ClearDTC(clearDTC,FUNCTIONAL);
  CheckPosResponse_SID14(0,0);
  
  TestStep("Wait 10s");
  delay(10000);
  
  TestStep("Report DTCs",TestStepIntervalTime);
  SID19_Sub02_ReportDTCByStatusMask(0x27,PHYSICAL);
  CheckPosResponse_SID19_02(0xFF,0,0);
  DTCSettingCheck(2);
  TestStep("ECU Reset (hard reset)",TestStepIntervalTime);
  SID11_ECUReset(HARDRESET,PHYSICAL,SPRMIB_FALSE);
  CheckPosResponse_SID11(HARDRESET,0,0);
  
  TestStep("Wait for ECU Inittime+5000ms");
  delay(ECUIniTime+5000);
  
  TestStep("Report DTCs",TestStepIntervalTime);
  SID19_Sub02_ReportDTCByStatusMask(0x27,PHYSICAL);
  CheckPosResponse_SID19_02(0xFF,0,0);
  DTCSettingCheck(1);
  StopTRC();
  /******************************以上为测试步骤*********************************/
  PostCondition();
}
/// <APP_CommonServiceTest>
testcase Service_0x85_Func_HardRest()
{
  byte clearDTC[3]={0xFF,0xFF,0xFF};
  byte SFOf85[2]={0x01,0x02};
  char logName[400] = "";
  char info[1024];
  
  strncat(logName,"1350938_Service_0x85_Func_HardRest",400);
  testCaseTitle("1350938","Service_0x85_Func_HardRest");
  if(gBusFlag==3)
	{
		testStepWarning("Test","This test case does not apply to the LIN bus");
		return;
	}
  SetLog(logName);
  Precondition();
   
  /******************************以下为测试步骤*********************************/
  SimTRC();
  
  TestStep("Enter defaultSession(0x01)",TestStepIntervalTime);
  SID10_DiagnosticSessionControl(DEFAULTSESSION,PHYSICAL,SPRMIB_FALSE);
  CheckPosResponse_SID10(DEFAULTSESSION,0,6);
  ECUinitHandle(0);
  TestStep("Enter extendedSession(0x03)",TestStepIntervalTime);
  SID10_DiagnosticSessionControl(EXTENDEDSESSION,PHYSICAL,SPRMIB_FALSE);
  CheckPosResponse_SID10(EXTENDEDSESSION,0,6);
  TestStep("Tester Present on",TestStepIntervalTime);
  TestStep("Clear all DTC",TestStepIntervalTime);
  SID14_ClearDTC(clearDTC,FUNCTIONAL);
  CheckPosResponse_SID14(0,0);
  
  TestStep("Wait 10s");
  delay(10000);
  
  TestStep("Report DTCs",TestStepIntervalTime);
  SID19_Sub02_ReportDTCByStatusMask(0x27,FUNCTIONAL);
  CheckPosResponse_SID19_02(0xFF,0,0);
  Rss1=gTpRxLength;
  if(Rss1<=3)
  {
    TestStepWarning("No avalible DTC,Test end");
    StopTRC();
    Postcondition();
    return;
  }
  TestStep("Request DTC setting off",TestStepIntervalTime);
  SID85_ControlDTCSetting(SFOf85[1],FUNCTIONAL,SPRMIB_FALSE);   //禁止DTC更新
  CheckPosResponse_SID85(SFOf85[1],0,0);
  TestStep("Clear all DTC",TestStepIntervalTime);
  SID14_ClearDTC(clearDTC,FUNCTIONAL);
  CheckPosResponse_SID14(0,0);
  
  TestStep("Wait 10s");
  delay(10000);
  
  TestStep("Report DTCs",TestStepIntervalTime);
  SID19_Sub02_ReportDTCByStatusMask(0x27,FUNCTIONAL);
  CheckPosResponse_SID19_02(0xFF,0,0);
  DTCSettingCheck(2);
  TestStep("ECU Reset (hard reset)",TestStepIntervalTime);
  SID11_ECUReset(HARDRESET,FUNCTIONAL,SPRMIB_FALSE);
  CheckPosResponse_SID11(HARDRESET,0,0);
  
  TestStep("Wait for ECU Inittime+5000ms");
  delay(ECUIniTime+5000);
  
  TestStep("Report DTCs",TestStepIntervalTime);
  SID19_Sub02_ReportDTCByStatusMask(0x27,FUNCTIONAL);
  CheckPosResponse_SID19_02(0xFF,0,0);
  DTCSettingCheck(1);
  
///////one more
  TestStep("Repeat step 1-13 once, set service 0x85 SPRMIB=True",TestStepIntervalTime);
  ResetStepIndex();
  
  TestStep("Enter defaultSession(0x01)",TestStepIntervalTime);
  SID10_DiagnosticSessionControl(DEFAULTSESSION,PHYSICAL,SPRMIB_FALSE);
  CheckPosResponse_SID10(DEFAULTSESSION,0,6);
  ECUinitHandle(0);
  TestStep("Enter extendedSession(0x03)",TestStepIntervalTime);
  SID10_DiagnosticSessionControl(EXTENDEDSESSION,PHYSICAL,SPRMIB_FALSE);
  CheckPosResponse_SID10(EXTENDEDSESSION,0,6);
  TestStep("Tester Present on",TestStepIntervalTime);
  TestStep("Clear all DTC",TestStepIntervalTime);
  SID14_ClearDTC(clearDTC,FUNCTIONAL);
  CheckPosResponse_SID14(0,0);
  
  TestStep("Wait 5s");
  delay(5000);
  
  TestStep("Report DTCs",TestStepIntervalTime);
  SID19_Sub02_ReportDTCByStatusMask(0x27,FUNCTIONAL);
  CheckPosResponse_SID19_02(0xFF,0,0);
  Rss1=gTpRxLength;
  if(Rss1<=3)
  {
    TestStepWarning("No avalible DTC,Test end");
    StopTRC();
    Postcondition();
    return;
  }
  TestStep("Request DTC setting off",TestStepIntervalTime);
  SID85_ControlDTCSetting(SFOf85[1],FUNCTIONAL,SPRMIB_TRUE);   //禁止DTC更新
  CheckNonResponse(0,0);
  TestStep("Clear all DTC",TestStepIntervalTime);
  SID14_ClearDTC(clearDTC,FUNCTIONAL);
  CheckPosResponse_SID14(0,0);
  
  TestStep("Wait 10s");
  delay(10000);
  
  TestStep("Report DTCs",TestStepIntervalTime);
  SID19_Sub02_ReportDTCByStatusMask(0x27,FUNCTIONAL);
  CheckPosResponse_SID19_02(0xFF,0,0);
  DTCSettingCheck(2);
  TestStep("ECU Reset (hard reset)",TestStepIntervalTime);
  SID11_ECUReset(HARDRESET,FUNCTIONAL,SPRMIB_FALSE);
  CheckPosResponse_SID11(HARDRESET,0,0);
  
  TestStep("Wait for ECU Inittime+5000ms");
  delay(ECUIniTime+5000);
  
  TestStep("Report DTCs",TestStepIntervalTime);
  SID19_Sub02_ReportDTCByStatusMask(0x27,FUNCTIONAL);
  CheckPosResponse_SID19_02(0xFF,0,0);
  DTCSettingCheck(1);
  StopTRC();
  /******************************以上为测试步骤*********************************/
  PostCondition();
}
/// <APP_CommonServiceTest>
testcase Service_0x85_Phy_KL30()
{
  byte clearDTC[3]={0xFF,0xFF,0xFF};
  byte SFOf85[2]={0x01,0x02};
  char logName[400] = "";
  char info[1024];
  
  strncat(logName,"1350939_Service_0x85_Phy_KL30",400);
  testCaseTitle("1350939","Service_0x85_Phy_KL30");
	if(gBusFlag==3)//2025-11-17-石太佳-移除对LIN ECU的限制
	{
		//testStepWarning("Test","This test case does not apply to the LIN bus");
		//return;
	}
  SetLog(logName);
  Precondition();
   
  /******************************以下为测试步骤*********************************/
  SimTRC();
  
  TestStep("Enter defaultSession(0x01)",TestStepIntervalTime);
  SID10_DiagnosticSessionControl(DEFAULTSESSION,PHYSICAL,SPRMIB_FALSE);
  CheckPosResponse_SID10(DEFAULTSESSION,0,6);
  ECUinitHandle(0);
  TestStep("Enter extendedSession(0x03)",TestStepIntervalTime);
  SID10_DiagnosticSessionControl(EXTENDEDSESSION,PHYSICAL,SPRMIB_FALSE);
  CheckPosResponse_SID10(EXTENDEDSESSION,0,6);
  TestStep("Tester Present on",TestStepIntervalTime);
  TestStep("Clear all DTC",TestStepIntervalTime);
  SID14_ClearDTC(clearDTC,FUNCTIONAL);
  CheckPosResponse_SID14(0,0);
  
  TestStep("Wait 10s");
  delay(10000);
  
  TestStep("Report DTCs",TestStepIntervalTime);
  SID19_Sub02_ReportDTCByStatusMask(0x27,PHYSICAL);
  CheckPosResponse_SID19_02(0xFF,0,0);
  Rss1=gTpRxLength;
  if(Rss1<=3)
  {
    TestStepWarning("No avalible DTC,Test end");
    StopTRC();
    Postcondition();
    return;
  }
  TestStep("Request DTC setting off",TestStepIntervalTime);
  SID85_ControlDTCSetting(SFOf85[1],PHYSICAL,SPRMIB_FALSE);   //禁止DTC更新
  CheckPosResponse_SID85(SFOf85[1],0,0);
  TestStep("Clear all DTC",TestStepIntervalTime);
  SID14_ClearDTC(clearDTC,FUNCTIONAL);
  CheckPosResponse_SID14(0,0);
  
  TestStep("Wait 10s");
  delay(10000);
  
  TestStep("Report DTCs",TestStepIntervalTime);
  SID19_Sub02_ReportDTCByStatusMask(0x27,PHYSICAL);
  CheckPosResponse_SID19_02(0xFF,0,0);
  DTCSettingCheck(2);
  TestStep("Power reset",TestStepIntervalTime);
  kl30(T_off);
  kl15(T_off);
  delay(1000);
  kl30(T_on);
  kl15(T_on);
  
  TestStep("Wait for ECU Inittime+5000ms");
  delay(ECUIniTime+5000);
  
  TestStep("Report DTCs",TestStepIntervalTime);
  SID19_Sub02_ReportDTCByStatusMask(0x27,PHYSICAL);
  CheckPosResponse_SID19_02(0xFF,0,0);
  DTCSettingCheck(1);
  
///////one more
  TestStep("Repeat step 1-13 once, set service 0x85 SPRMIB=True",TestStepIntervalTime);
  ResetStepIndex();
  
  TestStep("Enter defaultSession(0x01)",TestStepIntervalTime);
  SID10_DiagnosticSessionControl(DEFAULTSESSION,PHYSICAL,SPRMIB_FALSE);
  CheckPosResponse_SID10(DEFAULTSESSION,0,6);
  ECUinitHandle(0);
  TestStep("Enter extendedSession(0x03)",TestStepIntervalTime);
  SID10_DiagnosticSessionControl(EXTENDEDSESSION,PHYSICAL,SPRMIB_FALSE);
  CheckPosResponse_SID10(EXTENDEDSESSION,0,6);
  TestStep("Tester Present on",TestStepIntervalTime);
  TestStep("Clear all DTC",TestStepIntervalTime);
  SID14_ClearDTC(clearDTC,FUNCTIONAL);
  CheckPosResponse_SID14(0,0);
  
  TestStep("Wait 5s");
  delay(5000);
  
  TestStep("Report DTCs",TestStepIntervalTime);
  SID19_Sub02_ReportDTCByStatusMask(0x27,PHYSICAL);
  CheckPosResponse_SID19_02(0xFF,0,0);
  Rss1=gTpRxLength;
  if(Rss1<=3)
  {
    TestStepWarning("No avalible DTC,Test end");
    StopTRC();
    Postcondition();
    return;
  }
  TestStep("Request DTC setting off",TestStepIntervalTime);
  SID85_ControlDTCSetting(SFOf85[1],PHYSICAL,SPRMIB_TRUE);   //禁止DTC更新
  CheckNonResponse(0,0);
  TestStep("Clear all DTC",TestStepIntervalTime);
  SID14_ClearDTC(clearDTC,FUNCTIONAL);
  CheckPosResponse_SID14(0,0);
  
  TestStep("Wait 10s");
  delay(10000);
  
  TestStep("Report DTCs",TestStepIntervalTime);
  SID19_Sub02_ReportDTCByStatusMask(0x27,PHYSICAL);
  CheckPosResponse_SID19_02(0xFF,0,0);
  DTCSettingCheck(2);
  TestStep("Power reset",TestStepIntervalTime);
  kl30(T_off);
  kl15(T_off);
  testWaitForTimeout(1000);
  kl30(T_on);
  kl15(T_on);
  
  TestStep("Wait for ECU Inittime+5000ms");
  delay(ECUIniTime+5000);
  
  TestStep("Report DTCs",TestStepIntervalTime);
  SID19_Sub02_ReportDTCByStatusMask(0x27,PHYSICAL);
  CheckPosResponse_SID19_02(0xFF,0,0);
  DTCSettingCheck(1);
  StopTRC();
  /******************************以上为测试步骤*********************************/
  PostCondition();
}
/// <APP_CommonServiceTest>
testcase Service_0x85_Func_KL30()
{
  byte clearDTC[3]={0xFF,0xFF,0xFF};
  byte SFOf85[2]={0x01,0x02};
  char logName[400] = "";
  char info[1024];
  
  strncat(logName,"1350940_Service_0x85_Func_KL30",400);
  testCaseTitle("1350940","Service_0x85_Func_KL30");
  if(gBusFlag==3)
	{
		testStepWarning("Test","This test case does not apply to the LIN bus");
		return;
	}
  SetLog(logName);
  Precondition();
   
  /******************************以下为测试步骤*********************************/
  SimTRC();
  
  TestStep("Enter defaultSession(0x01)",TestStepIntervalTime);
  SID10_DiagnosticSessionControl(DEFAULTSESSION,PHYSICAL,SPRMIB_FALSE);
  CheckPosResponse_SID10(DEFAULTSESSION,0,6);
  ECUinitHandle(0);
  TestStep("Enter extendedSession(0x03)",TestStepIntervalTime);
  SID10_DiagnosticSessionControl(EXTENDEDSESSION,PHYSICAL,SPRMIB_FALSE);
  CheckPosResponse_SID10(EXTENDEDSESSION,0,6);
  TestStep("Tester Present on",TestStepIntervalTime);
  TestStep("Clear all DTC",TestStepIntervalTime);
  SID14_ClearDTC(clearDTC,FUNCTIONAL);
  CheckPosResponse_SID14(0,0);
  
  TestStep("Wait 10s");
  delay(10000);
  
  TestStep("Report DTCs",TestStepIntervalTime);
  SID19_Sub02_ReportDTCByStatusMask(0x27,FUNCTIONAL);
  CheckPosResponse_SID19_02(0xFF,0,0);
  Rss1=gTpRxLength;
  if(Rss1<=3)
  {
    TestStepWarning("No avalible DTC,Test end");
    StopTRC();
    Postcondition();
    return;
  }
  TestStep("Request DTC setting off",TestStepIntervalTime);
  SID85_ControlDTCSetting(SFOf85[1],FUNCTIONAL,SPRMIB_FALSE);   //禁止DTC更新
  CheckPosResponse_SID85(SFOf85[1],0,0);
  TestStep("Clear all DTC",TestStepIntervalTime);
  SID14_ClearDTC(clearDTC,FUNCTIONAL);
  CheckPosResponse_SID14(0,0);
  
  TestStep("Wait 10s");
  delay(10000);
  
  TestStep("Report DTCs",TestStepIntervalTime);
  SID19_Sub02_ReportDTCByStatusMask(0x27,FUNCTIONAL);
  CheckPosResponse_SID19_02(0xFF,0,0);
  DTCSettingCheck(2);
  TestStep("Power reset",TestStepIntervalTime);
  kl30(T_off);
  kl15(T_off);
  testWaitForTimeout(1000);
  kl30(T_on);
  kl15(T_on);
  
  TestStep("Wait for ECU Inittime+5000ms");
  delay(ECUIniTime+5000);
  
  TestStep("Report DTCs",TestStepIntervalTime);
  SID19_Sub02_ReportDTCByStatusMask(0x27,FUNCTIONAL);
  CheckPosResponse_SID19_02(0xFF,0,0);
  DTCSettingCheck(1);
  
///////one more
  TestStep("Repeat step 1-13 once, set service 0x85 SPRMIB=True",TestStepIntervalTime);
  ResetStepIndex();
  
  TestStep("Enter defaultSession(0x01)",TestStepIntervalTime);
  SID10_DiagnosticSessionControl(DEFAULTSESSION,PHYSICAL,SPRMIB_FALSE);
  CheckPosResponse_SID10(DEFAULTSESSION,0,6);
  ECUinitHandle(0);
  TestStep("Enter extendedSession(0x03)",TestStepIntervalTime);
  SID10_DiagnosticSessionControl(EXTENDEDSESSION,PHYSICAL,SPRMIB_FALSE);
  CheckPosResponse_SID10(EXTENDEDSESSION,0,6);
  TestStep("Tester Present on",TestStepIntervalTime);
  TestStep("Clear all DTC",TestStepIntervalTime);
  SID14_ClearDTC(clearDTC,FUNCTIONAL);
  CheckPosResponse_SID14(0,0);
  
  TestStep("Wait 5s");
  delay(5000);
  
  TestStep("Report DTCs",TestStepIntervalTime);
  SID19_Sub02_ReportDTCByStatusMask(0x27,FUNCTIONAL);
  CheckPosResponse_SID19_02(0xFF,0,0);
  Rss1=gTpRxLength;
  if(Rss1<=3)
  {
    TestStepWarning("No avalible DTC,Test end");
    StopTRC();
    Postcondition();
    return;
  }
  TestStep("Request DTC setting off",TestStepIntervalTime);
  SID85_ControlDTCSetting(SFOf85[1],FUNCTIONAL,SPRMIB_TRUE);   //禁止DTC更新
  CheckNonResponse(0,0);
  TestStep("Clear all DTC",TestStepIntervalTime);
  SID14_ClearDTC(clearDTC,FUNCTIONAL);
  CheckPosResponse_SID14(0,0);
  
  TestStep("Wait 10s");
  delay(10000);
  
  TestStep("Report DTCs",TestStepIntervalTime);
  SID19_Sub02_ReportDTCByStatusMask(0x27,FUNCTIONAL);
  CheckPosResponse_SID19_02(0xFF,0,0);
  DTCSettingCheck(2);
  TestStep("Power reset",TestStepIntervalTime);
  kl30(T_off);
  kl15(T_off);
  testWaitForTimeout(1000);
  kl30(T_on);
  kl15(T_on);
  
  TestStep("Wait for ECU Inittime+5000ms");
  delay(ECUIniTime+5000);
  
  TestStep("Report DTCs",TestStepIntervalTime);
  SID19_Sub02_ReportDTCByStatusMask(0x27,FUNCTIONAL);
  CheckPosResponse_SID19_02(0xFF,0,0);
  DTCSettingCheck(1);
  StopTRC();
  /******************************以上为测试步骤*********************************/
  PostCondition();
}
/// <APP_CommonServiceTest>
testcase Service_0x85_Phy_SessionChange()
{
  byte clearDTC[3]={0xFF,0xFF,0xFF};
  byte SFOf85[2]={0x01,0x02};
  char logName[400] = "";
  char info[1024];
  
  strncat(logName,"1350941_Service_0x85_Phy_SessionChange",400);
  testCaseTitle("1350941","Service_0x85_Phy_SessionChange");
	if(gBusFlag==3)//2025-11-17-石太佳-移除对LIN ECU的限制
	{
		//testStepWarning("Test","This test case does not apply to the LIN bus");
		//return;
	}
  SetLog(logName);
  Precondition();
   
  /******************************以下为测试步骤*********************************/
  SimTRC();
  
  TestStep("Enter defaultSession(0x01)",TestStepIntervalTime);
  SID10_DiagnosticSessionControl(DEFAULTSESSION,PHYSICAL,SPRMIB_FALSE);
  CheckPosResponse_SID10(DEFAULTSESSION,0,6);
  ECUinitHandle(0);
  TestStep("Enter extendedSession(0x03)",TestStepIntervalTime);
  SID10_DiagnosticSessionControl(EXTENDEDSESSION,PHYSICAL,SPRMIB_FALSE);
  CheckPosResponse_SID10(EXTENDEDSESSION,0,6);
  TestStep("Tester Present on",TestStepIntervalTime);
  TestStep("Clear all DTC",TestStepIntervalTime);
  SID14_ClearDTC(clearDTC,FUNCTIONAL);
  CheckPosResponse_SID14(0,0);
  
  TestStep("Wait 10s");
  delay(10000);
  
  TestStep("Report DTCs",TestStepIntervalTime);
  SID19_Sub02_ReportDTCByStatusMask(0x27,PHYSICAL);
  CheckPosResponse_SID19_02(0xFF,0,0);
  Rss1=gTpRxLength;
  if(Rss1<=3)
  {
    TestStepWarning("No avalible DTC,Test end");
    StopTRC();
    Postcondition();
    return;
  }
  TestStep("Request DTC setting off",TestStepIntervalTime);
  SID85_ControlDTCSetting(SFOf85[1],PHYSICAL,SPRMIB_FALSE);   //禁止DTC更新
  CheckPosResponse_SID85(SFOf85[1],0,0);
  TestStep("Clear all DTC",TestStepIntervalTime);
  SID14_ClearDTC(clearDTC,FUNCTIONAL);
  CheckPosResponse_SID14(0,0);
  
  TestStep("Wait 10s");
  delay(10000);
  
  TestStep("Report DTCs",TestStepIntervalTime);
  SID19_Sub02_ReportDTCByStatusMask(0x27,PHYSICAL);
  CheckPosResponse_SID19_02(0xFF,0,0);
  DTCSettingCheck(2);
  TestStep("Enter extendedSession(0x03)",TestStepIntervalTime);
  SID10_DiagnosticSessionControl(EXTENDEDSESSION,PHYSICAL,SPRMIB_FALSE);
  CheckPosResponse_SID10(EXTENDEDSESSION,0,6);
  
  TestStep("Wait for 2s");
  testWaitForTimeout(2000);
  
  TestStep("Report DTCs",TestStepIntervalTime);
  SID19_Sub02_ReportDTCByStatusMask(0x27,PHYSICAL);
  CheckPosResponse_SID19_02(0xFF,0,0);
  DTCSettingCheck(2);
  
///////one more
  TestStep("Repeat step 1-13 once, set service 0x85 SPRMIB=True",TestStepIntervalTime);
  ResetStepIndex();
  
  TestStep("Enter defaultSession(0x01)",TestStepIntervalTime);
  SID10_DiagnosticSessionControl(DEFAULTSESSION,PHYSICAL,SPRMIB_FALSE);
  CheckPosResponse_SID10(DEFAULTSESSION,0,6);
  ECUinitHandle(0);
  TestStep("Enter extendedSession(0x03)",TestStepIntervalTime);
  SID10_DiagnosticSessionControl(EXTENDEDSESSION,PHYSICAL,SPRMIB_FALSE);
  CheckPosResponse_SID10(EXTENDEDSESSION,0,6);
  TestStep("Tester Present on",TestStepIntervalTime);
  TestStep("Clear all DTC",TestStepIntervalTime);
  SID14_ClearDTC(clearDTC,FUNCTIONAL);
  CheckPosResponse_SID14(0,0);
  
  TestStep("Wait 5s");
  delay(5000);
  
  TestStep("Report DTCs",TestStepIntervalTime);
  SID19_Sub02_ReportDTCByStatusMask(0x27,PHYSICAL);
  CheckPosResponse_SID19_02(0xFF,0,0);
  Rss1=gTpRxLength;
  if(Rss1<=3)
  {
    TestStepWarning("No avalible DTC,Test end");
    StopTRC();
    Postcondition();
    return;
  }
  TestStep("Request DTC setting off",TestStepIntervalTime);
  SID85_ControlDTCSetting(SFOf85[1],PHYSICAL,SPRMIB_TRUE);   //禁止DTC更新
  CheckNonResponse(0,0);
  TestStep("Clear all DTC",TestStepIntervalTime);
  SID14_ClearDTC(clearDTC,FUNCTIONAL);
  CheckPosResponse_SID14(0,0);
  
  TestStep("Wait 10s");
  delay(10000);
  
  TestStep("Report DTCs",TestStepIntervalTime);
  SID19_Sub02_ReportDTCByStatusMask(0x27,PHYSICAL);
  CheckPosResponse_SID19_02(0xFF,0,0);
  DTCSettingCheck(2);
  TestStep("Enter extendedSession(0x03)",TestStepIntervalTime);
  SID10_DiagnosticSessionControl(EXTENDEDSESSION,PHYSICAL,SPRMIB_FALSE);
  CheckPosResponse_SID10(EXTENDEDSESSION,0,6);
  
  TestStep("Wait for 2s");
  testWaitForTimeout(1000);
  
  TestStep("Report DTCs",TestStepIntervalTime);
  SID19_Sub02_ReportDTCByStatusMask(0x27,PHYSICAL);
  CheckPosResponse_SID19_02(0xFF,0,0);
  DTCSettingCheck(2);
  StopTRC();
  /******************************以上为测试步骤*********************************/
  PostCondition();
}
/// <APP_CommonServiceTest>
testcase Service_0x85_Func_SessionChange()
{
  byte clearDTC[3]={0xFF,0xFF,0xFF};
  byte SFOf85[2]={0x01,0x02};
  char logName[400] = "";
  char info[1024];
  
  strncat(logName,"1350942_Service_0x85_Func_SessionChange",400);
  testCaseTitle("1350942","Service_0x85_Func_SessionChange");
  if(gBusFlag==3)
	{
		testStepWarning("Test","This test case does not apply to the LIN bus");
		return;
	}
  SetLog(logName);
  Precondition();
   
  /******************************以下为测试步骤*********************************/
  SimTRC();
  
  TestStep("Enter defaultSession(0x01)",TestStepIntervalTime);
  SID10_DiagnosticSessionControl(DEFAULTSESSION,PHYSICAL,SPRMIB_FALSE);
  CheckPosResponse_SID10(DEFAULTSESSION,0,6);
  ECUinitHandle(0);
  TestStep("Enter extendedSession(0x03)",TestStepIntervalTime);
  SID10_DiagnosticSessionControl(EXTENDEDSESSION,PHYSICAL,SPRMIB_FALSE);
  CheckPosResponse_SID10(EXTENDEDSESSION,0,6);
  TestStep("Tester Present on",TestStepIntervalTime);
  TestStep("Clear all DTC",TestStepIntervalTime);
  SID14_ClearDTC(clearDTC,FUNCTIONAL);
  CheckPosResponse_SID14(0,0);
  
  TestStep("Wait 10s");
  delay(10000);
  
  TestStep("Report DTCs",TestStepIntervalTime);
  SID19_Sub02_ReportDTCByStatusMask(0x27,FUNCTIONAL);
  CheckPosResponse_SID19_02(0xFF,0,0);
  Rss1=gTpRxLength;
  if(Rss1<=3)
  {
    TestStepWarning("No avalible DTC,Test end");
    StopTRC();
    Postcondition();
    return;
  }
  TestStep("Request DTC setting off",TestStepIntervalTime);
  SID85_ControlDTCSetting(SFOf85[1],FUNCTIONAL,SPRMIB_FALSE);   //禁止DTC更新
  CheckPosResponse_SID85(SFOf85[1],0,0);
  TestStep("Clear all DTC",TestStepIntervalTime);
  SID14_ClearDTC(clearDTC,FUNCTIONAL);
  CheckPosResponse_SID14(0,0);
  
  TestStep("Wait 10s");
  delay(10000);
  
  TestStep("Report DTCs",TestStepIntervalTime);
  SID19_Sub02_ReportDTCByStatusMask(0x27,FUNCTIONAL);
  CheckPosResponse_SID19_02(0xFF,0,0);
  DTCSettingCheck(2);
  TestStep("Enter extendedSession(0x03)",TestStepIntervalTime);
  SID10_DiagnosticSessionControl(EXTENDEDSESSION,PHYSICAL,SPRMIB_FALSE);
  CheckPosResponse_SID10(EXTENDEDSESSION,0,6);
  
  TestStep("Wait for 1s");
  testWaitForTimeout(1000);
  
  TestStep("Report DTCs",TestStepIntervalTime);
  SID19_Sub02_ReportDTCByStatusMask(0x27,FUNCTIONAL);
  CheckPosResponse_SID19_02(0xFF,0,0);
  DTCSettingCheck(2);
  
///////one more
  TestStep("Repeat step 1-13 once, set service 0x85 SPRMIB=True",TestStepIntervalTime);
  ResetStepIndex();
  
  TestStep("Enter defaultSession(0x01)",TestStepIntervalTime);
  SID10_DiagnosticSessionControl(DEFAULTSESSION,PHYSICAL,SPRMIB_FALSE);
  CheckPosResponse_SID10(DEFAULTSESSION,0,6);
  ECUinitHandle(0);
  TestStep("Enter extendedSession(0x03)",TestStepIntervalTime);
  SID10_DiagnosticSessionControl(EXTENDEDSESSION,PHYSICAL,SPRMIB_FALSE);
  CheckPosResponse_SID10(EXTENDEDSESSION,0,6);
  TestStep("Tester Present on",TestStepIntervalTime);
  TestStep("Clear all DTC",TestStepIntervalTime);
  SID14_ClearDTC(clearDTC,FUNCTIONAL);
  CheckPosResponse_SID14(0,0);
  
  TestStep("Wait 5s");
  delay(5000);
  
  TestStep("Report DTCs",TestStepIntervalTime);
  SID19_Sub02_ReportDTCByStatusMask(0x27,FUNCTIONAL);
  CheckPosResponse_SID19_02(0xFF,0,0);
  Rss1=gTpRxLength;
  if(Rss1<=3)
  {
    TestStepWarning("No avalible DTC,Test end");
    StopTRC();
    Postcondition();
    return;
  }
  TestStep("Request DTC setting off",TestStepIntervalTime);
  SID85_ControlDTCSetting(SFOf85[1],FUNCTIONAL,SPRMIB_TRUE);   //禁止DTC更新
  CheckNonResponse(0,0);
  TestStep("Clear all DTC",TestStepIntervalTime);
  SID14_ClearDTC(clearDTC,FUNCTIONAL);
  CheckPosResponse_SID14(0,0);
  
  TestStep("Wait 10s");
  delay(10000);
  
  TestStep("Report DTCs",TestStepIntervalTime);
  SID19_Sub02_ReportDTCByStatusMask(0x27,FUNCTIONAL);
  CheckPosResponse_SID19_02(0xFF,0,0);
  DTCSettingCheck(2);
  TestStep("Enter extendedSession(0x03)",TestStepIntervalTime);
  SID10_DiagnosticSessionControl(EXTENDEDSESSION,FUNCTIONAL,SPRMIB_FALSE);
  CheckPosResponse_SID10(EXTENDEDSESSION,0,6);
  
  TestStep("Wait for 1s");
  testWaitForTimeout(1000);
  
  TestStep("Report DTCs",TestStepIntervalTime);
  SID19_Sub02_ReportDTCByStatusMask(0x27,FUNCTIONAL);
  CheckPosResponse_SID19_02(0xFF,0,0);
  DTCSettingCheck(2);
  StopTRC();
  /******************************以上为测试步骤*********************************/
  PostCondition();
}
/// <APP_GeneralTest>
testcase Power_Up_Default_Session_Test_APP()
{
  char logName[400] = "";
  char info[1024];
  
  strncat(logName,"1350963_Power_Up_Default_Session_Test_APP",400);
  testCaseDescription("The intent is to verify that the ECU is in defaultSession after power cycle off/on. ");
  testCaseTitle("1350963","Power_Up_Default_Session_Test_APP");
  
  SetLog(logName);
  Precondition();
   
  /******************************以下为测试步骤*********************************/
  
  SessionFlag=APP;
  TestStep("Transition from defaultSession(0x01) to extendedDiagnosticSession(0x03).",TestStepIntervalTime);
  SID10_DiagnosticSessionControl(EXTENDEDSESSION,PHYSICAL,SPRMIB_FALSE);
  CheckPosResponse_SID10(EXTENDEDSESSION,gP2Client_APP,gP2StarClientFor10Check,0,0);
  TestStep("Verify extendedDiagnosticSession.",TestStepIntervalTime);
  CheckCurrentSession(EXTENDEDSESSION,PHYSICAL,0,0);
  TestStep("Cycle the power to the ECU.",TestStepIntervalTime);
  
//  testWaitForTesterConfirmation("Please recycle the power of the ECU");
  kl30(T_off);
  kl15(T_off);
  testWaitForTimeout(1000);
  kl30(T_on);
  kl15(T_on);

  TestStep("Wait to operation start.");
  ECUinitHandle(0);

  TestStep("Verify defaultSession.",TestStepIntervalTime);
  CheckCurrentSession(DEFAULTSESSION,PHYSICAL,0,0);
  TestStep("Transition from defaultSession(0x01) to extendedDiagnosticSession(0x03).",TestStepIntervalTime);
  SID10_DiagnosticSessionControl(EXTENDEDSESSION,PHYSICAL,SPRMIB_FALSE);
  CheckPosResponse_SID10(EXTENDEDSESSION,gP2Client_APP,gP2StarClientFor10Check,0,0);
  TestStep("Verify extendedDiagnosticSession.",TestStepIntervalTime);
  CheckCurrentSession(EXTENDEDSESSION,PHYSICAL,0,0);
  TestStep("ECU Reset (hard reset)",TestStepIntervalTime);
  //SID11_ECUReset(HardReset,SPRMIB_False,PHYSICAL);
  SID11_ECUReset(HARDRESET,PHYSICAL,SPRMIB_FALSE);
  CheckPosResponse_SID11(HARDRESET,0,0);
  
  TestStep("Wait to operation cycle start");
  ECUinitHandle(0);
  TestStep("Verify defaultSession.",TestStepIntervalTime);
  CheckCurrentSession(DEFAULTSESSION,PHYSICAL,0,0);
  /******************************以上为测试步骤*********************************/
  Postcondition();
   
}
/// <APP_GeneralTest>
testcase S3_Timeout_Test_App()
{
  char logName[400] = "";
  char info[1024];
  
  strncat(logName,"1350967_S3_Timeout_Test_APP",400);
  testCaseDescription("The intent of the test to verify:1.S3Server parameter timeout value. 2.The ECU returns to defaultSession from any non defaultSession when S3 timer times out.");
  testCaseTitle("1350967","S3_Timeout_Test_APP");
  
  SetLog(logName);
  Precondition();
   
  /******************************以下为测试步骤*********************************/
  
  SessionFlag=APP;
  
  TestStep("Transition from defaultSession(0x01) to extendedDiagnosticSession(0x03).",TestStepIntervalTime);
  SID10_DiagnosticSessionControl(EXTENDEDSESSION,PHYSICAL,SPRMIB_FALSE);
  CheckPosResponse_SID10(EXTENDEDSESSION,gP2Client_APP,gP2StarClientFor10Check,0,0);
  TestStep("Verify extendedDiagnosticSession.",TestStepIntervalTime);
  CheckCurrentSession(EXTENDEDSESSION,PHYSICAL,0,0);
  
  TP_TesterPresentSet(TP_OFF);
  TestStep("Wait for 4800 ms, from last final response.");
  delay(4800);
  TestStep("Send 3E 80",TestStepIntervalTime);
  SID3E_TesterPresent(PHYSICAL,SPRMIB_TRUE);
  //CheckNonResponse(0,0);//20250214 这里不判断无响应
  TestStep("Verify extendedDiagnosticSession.",TestStepIntervalTime);
  CheckCurrentSession(EXTENDEDSESSION,PHYSICAL,0,0);
  TestStep("Wait for 5500 ms, from last final response.");
  delay(5500);
  
  
  if(gBusFlag==5 && SWRS_VERSION>=8 && EthNodeTypeNow==EdgeNode)
  {
     TestStep("Verify defaultSession.",TestStepIntervalTime);
     testStepWarning("","按照需求ID 987287,边缘节点应向车内发送3E 80 ，并维持自身的会话模式，所以不会跳转到默认会话");
     CheckCurrentSession(EXTENDEDSESSION,PHYSICAL,0,0);
    
  }
  else
  {
       ECUinitHandle(0,0);//20251210  这里
      TestStep("Verify defaultSession.",TestStepIntervalTime);
      CheckCurrentSession(DEFAULTSESSION,PHYSICAL,0,0);
  }
  
  /******************************以上为测试步骤*********************************/
  Postcondition();
   
}
/// <APP_GeneralTest>
testcase Check_Programming_Pre_conditions_Precondition_fulfilled_Valid_Physical_DefaultSession_Supported_Service()
{
  byte Data[4]={0x31,0x01,0x02,0x06};
  int  i,j,k,m,n,count;
  char logName[400] = "";
  char info[1024];
  
  strncat(logName,"28299_Check_Programming_Pre_conditions_Precondition_fulfilled_Valid_Physical_DefaultSession_Supported_Service",400);
  testCaseDescription(" The intent of the test is to verify that control routine 0206 is supported and response correct to precondition.");
  testCaseTitle("28299","Check_Programming_Pre_conditions_Precondition_fulfilled_Valid_Physical_DefaultSession_Supported_Service");

  SetLog(logName);
  Precondition();

  /******************************以下为测试步骤*********************************/
  SessionFlag=APP;
  /* 获取所有待测信号的数量并将信号值设置成有效值 */
  for(i=0;i<E2E_FRAME_NUM;i++) 
  { 
  	for(j=0;j<elcount(e2eFrameList[i].e2eSigGroupList);j++)
  	{
  		if(strncmp(e2eFrameList[i].e2eSigGroupList[j].sigGroupName,"",elcount(e2eFrameList[i].e2eSigGroupList[j].sigGroupName)) == 0) { break; }
  		else
  		{
  			for(k=0;k<e2eFrameList[i].e2eSigGroupList[j].sigNum;k++)
  			{
  				if(e2eFrameList[i].e2eSigGroupList[j].e2eSignalList[k].sigUsed & SIGNALPROGRAMMING == SIGNALPROGRAMMING) 
          { 
            snprintf(info,elCount(info),"%s%s = %02X(Fulfilled)\n",info,e2eFrameList[i].e2eSigGroupList[j].e2eSignalList[k].sigName,
  					e2eFrameList[i].e2eSigGroupList[j].e2eSignalList[k].sigValue_Fulfilled);
            e2eFrameList[i].e2eSigGroupList[j].e2eSignalList[k].sigValue = e2eFrameList[i].e2eSigGroupList[j].e2eSignalList[k].sigValue_Fulfilled;
            e2eFrameList[i].simFrFlg = 1; e2eFrameList[i].simFrImtFlg = 1;
            count++; 
          }
  			}
  		}
  	}
  }
  if(count == 0) { testStepWarning("Test","No Signal About Programming Precondition in ParameterOfSigGroups.cin !!!"); }
  
  snprintf(info,elCount(info),"Set condition: \n%s",info);
  teststep(info); 
  
  if(gTestTypeFlag==1) { SimTRC(); }
  else                 { testWaitForTesterConfirmation(info); }

  delay(5000);
  
  TestStep("Check Programming Pre-condition",TestStepIntervalTime);
  TPSendRawMessage(Data,PHYSICAL);
  CheckPosResponse(0x31,0,0);
  if(gRss == POS)
  {
    if(gTpRxData[5] != 0x01)
    {
      TestStepFail("","The response data is not right , expect 71 01 02 06 10 01");
    }
  }
  
  TestStep("Transition to programmingSession(0x02)",TestStepIntervalTime);
  SID10_DiagnosticSessionControl(PROGRAMMINGSESSION,PHYSICAL,SPRMIB_FALSE);
  CheckPosResponse_SID10(PROGRAMMINGSESSION,gP2Client_BOOT,gP2StarClientFor10Check,0,0);
  ECUinitHandle(0);
  SessionFlag=BOOT;
  
  TestStep("Verify programmingSession",TestStepIntervalTime);
  CheckCurrentSession(PROGRAMMINGSESSION,PHYSICAL,0,0);
  
  if(gTestTypeFlag==1) { StopTRC(); }
  else                 { testWaitForTesterConfirmation("Stop simulation signals"); }
  /******************************以上为测试步骤*********************************/
  
  Postcondition();
}
/// <APP_GeneralTest>
testcase Check_Programming_Pre_conditions_Precondition_fulfilled_Valid_Functional_DefaultSession_Supported_Service()
{
  byte Data[4]={0x31,0x01,0x02,0x06};
  int  i,j,k,m,n,count;
  char logName[400] = "";
  char info[1024];
  
  strncat(logName,"28301_Check_Programming_Pre_conditions_Precondition_fulfilled_Valid_Functional_DefaultSession_Supported_Service",400);
  testCaseDescription("The intent of the test is to verify that control routine 0206 is supported and response correct to precondition.");
  testCaseTitle("28301","Check_Programming_Pre_conditions_Precondition_fulfilled_Valid_Functional_DefaultSession_Supported_Service");
  if(gBusFlag==3)
	{
		testStepWarning("Test","This test case does not apply to the LIN bus");
		return;
	}
  SetLog(logName);
  Precondition();

  /******************************以下为测试步骤*********************************/
  SessionFlag=APP;
  /* 获取所有待测信号的数量并将信号值设置成有效值 */
  for(i=0;i<E2E_FRAME_NUM;i++) 
  { 
  	for(j=0;j<elcount(e2eFrameList[i].e2eSigGroupList);j++)
  	{
  		if(strncmp(e2eFrameList[i].e2eSigGroupList[j].sigGroupName,"",elcount(e2eFrameList[i].e2eSigGroupList[j].sigGroupName)) == 0) { break; }
  		else
  		{
  			for(k=0;k<e2eFrameList[i].e2eSigGroupList[j].sigNum;k++)
  			{
  				if(e2eFrameList[i].e2eSigGroupList[j].e2eSignalList[k].sigUsed & SIGNALPROGRAMMING == SIGNALPROGRAMMING) 
          { 
            snprintf(info,elCount(info),"%s%s = %02X(Fulfilled)\n",info,e2eFrameList[i].e2eSigGroupList[j].e2eSignalList[k].sigName,
  					e2eFrameList[i].e2eSigGroupList[j].e2eSignalList[k].sigValue_Fulfilled);
            e2eFrameList[i].e2eSigGroupList[j].e2eSignalList[k].sigValue = e2eFrameList[i].e2eSigGroupList[j].e2eSignalList[k].sigValue_Fulfilled;
            e2eFrameList[i].simFrFlg = 1; e2eFrameList[i].simFrImtFlg = 1;
            count++; 
          }
  			}
  		}
  	}
  }
  if(count == 0) { testStepWarning("Test","No Signal About Programming Precondition in ParameterOfSigGroups.cin !!!"); }
  
  snprintf(info,elCount(info),"Set condition: \n%s",info);
  teststep(info); 
  
  if(gTestTypeFlag==1) { SimTRC(); }
  else                 { testWaitForTesterConfirmation(info); }
  
  delay(5000);
  TestStep("Check Programming Pre-condition",TestStepIntervalTime);
  TPSendRawMessage(Data,FUNCTIONAL);
  CheckPosResponse(0x31,0,0);
  if(gRss == POS)
  {
    if(gTpRxData[5] != 0x01)
    {
      TestStepFail("","The response data is not right , expect 71 01 02 06 10 01");
    }
  }
  
  SessionFlag=BOOT;
  TestStep("Transition to programmingSession(0x02)",TestStepIntervalTime);
  SID10_DiagnosticSessionControl(PROGRAMMINGSESSION,PHYSICAL,SPRMIB_FALSE);
  CheckPosResponse_SID10(PROGRAMMINGSESSION,gP2Client_BOOT,gP2StarClientFor10Check,0,0);
  ECUinitHandle(0);
  TestStep("Verify programmingSession",TestStepIntervalTime);
  CheckCurrentSession(PROGRAMMINGSESSION,PHYSICAL,0,0);
  
  if(gTestTypeFlag==1) { StopTRC(); }
  else                 { testWaitForTesterConfirmation("Stop simulation signals"); }
  /******************************以上为测试步骤*********************************/
  
  Postcondition();
}
/// <APP_GeneralTest>
testcase Check_Programming_Pre_conditions_Precondition_fulfilled_Valid_Physical_ExtendedSession_Supported_Service()
{
  byte Data[4]={0x31,0x01,0x02,0x06};
  int  i,j,k,m,n,count;
  char logName[400] = "";
  char info[1024];
  
  strncat(logName,"28300_Check_Programming_Pre_conditions_Precondition_fulfilled_Valid_Physical_ExtendedSession_Supported_Service",400);
  testCaseDescription("The intent of the test is to verify that control routine 0206 is supported and response correct to precondition.");
  testCaseTitle("28300","Check_Programming_Pre_conditions_Precondition_fulfilled_Valid_Physical_ExtendedSession_Supported_Service");
  
  SetLog(logName);
  Precondition();

  /******************************以下为测试步骤*********************************/
  SessionFlag=APP;
  /* 获取所有待测信号的数量并将信号值设置成有效值 */
  for(i=0;i<E2E_FRAME_NUM;i++) 
  { 
  	for(j=0;j<elcount(e2eFrameList[i].e2eSigGroupList);j++)
  	{
  		if(strncmp(e2eFrameList[i].e2eSigGroupList[j].sigGroupName,"",elcount(e2eFrameList[i].e2eSigGroupList[j].sigGroupName)) == 0) { break; }
  		else
  		{
  			for(k=0;k<e2eFrameList[i].e2eSigGroupList[j].sigNum;k++)
  			{
  				if(e2eFrameList[i].e2eSigGroupList[j].e2eSignalList[k].sigUsed & SIGNALPROGRAMMING == SIGNALPROGRAMMING) 
          { 
            snprintf(info,elCount(info),"%s%s = %02X(Fulfilled)\n",info,e2eFrameList[i].e2eSigGroupList[j].e2eSignalList[k].sigName,
  					e2eFrameList[i].e2eSigGroupList[j].e2eSignalList[k].sigValue_Fulfilled);
            e2eFrameList[i].e2eSigGroupList[j].e2eSignalList[k].sigValue = e2eFrameList[i].e2eSigGroupList[j].e2eSignalList[k].sigValue_Fulfilled;
            e2eFrameList[i].simFrFlg = 1; e2eFrameList[i].simFrImtFlg = 1;
            count++; 
          }
  			}
  		}
  	}
  }
  if(count == 0) { testStepWarning("Test","No Signal About Programming Precondition in ParameterOfSigGroups.cin !!!"); }
  
  snprintf(info,elCount(info),"Set condition: \n%s",info);
  teststep(info); 
  
  if(gTestTypeFlag==1) { SimTRC(); }
  else                 { testWaitForTesterConfirmation(info); }
  
  delay(5000);

  TestStep("Transition from defaultSession(0x01) to extendedDiagnosticSession(0x03).",TestStepIntervalTime);
  SID10_DiagnosticSessionControl(EXTENDEDSESSION,PHYSICAL,SPRMIB_FALSE);
  CheckPosResponse_SID10(EXTENDEDSESSION,gP2Client_APP,gP2StarClientFor10Check,0,0);
  TestStep("Verify extendedDiagnosticSession.",TestStepIntervalTime);
  CheckCurrentSession(EXTENDEDSESSION,PHYSICAL,0,0);
  
  TestStep("Check Programming Pre-condition",TestStepIntervalTime);
  TPSendRawMessage(Data,PHYSICAL);
  CheckPosResponse(0x31,0,0);
  if(gRss == POS)
  {
    if(gTpRxData[5] != 0x01)
    {
      TestStepFail("","The response data is not right , expect 71 01 02 06 10 01");
    }
  }
  SessionFlag=BOOT;
  
  TestStep("Transition to programmingSession(0x02)",TestStepIntervalTime);
  SID10_DiagnosticSessionControl(PROGRAMMINGSESSION,PHYSICAL,SPRMIB_FALSE);
  CheckPosResponse_SID10(PROGRAMMINGSESSION,gP2Client_BOOT,gP2StarClientFor10Check,0,0);
  ECUinitHandle(0);
  TestStep("Verify programmingSession",TestStepIntervalTime);
  CheckCurrentSession(PROGRAMMINGSESSION,PHYSICAL,0,0);
  
  if(gTestTypeFlag==1) { StopTRC(); }
  else                 { testWaitForTesterConfirmation("Stop simulation signals"); }
  /******************************以上为测试步骤*********************************/
  
  Postcondition();
}
/// <APP_GeneralTest>
testcase Check_Programming_Pre_conditions_Precondition_fulfilled_Valid_Functional_ExtendedSession_Supported_Service()
{
  byte Data[4]={0x31,0x01,0x02,0x06};
  int  i,j,k,m,n,count;
  char logName[400] = "";
  char info[1024];
  
  strncat(logName,"28302_Check_Programming_Pre_conditions_Precondition_fulfilled_Valid_Functional_ExtendedSession_Supported_Service",400);
  testCaseDescription("The intent of the test is to verify that control routine 0206 is supported and response correct to precondition.");
  testCaseTitle("28302","Check_Programming_Pre_conditions_Precondition_fulfilled_Valid_Functional_ExtendedSession_Supported_Service");
  if(gBusFlag==3)
	{
		testStepWarning("Test","This test case does not apply to the LIN bus");
		return;
	}
  SetLog(logName);
  Precondition();

  /******************************以下为测试步骤*********************************/
  SessionFlag=APP;
  /* 获取所有待测信号的数量并将信号值设置成有效值 */
  for(i=0;i<E2E_FRAME_NUM;i++) 
  { 
  	for(j=0;j<elcount(e2eFrameList[i].e2eSigGroupList);j++)
  	{
  		if(strncmp(e2eFrameList[i].e2eSigGroupList[j].sigGroupName,"",elcount(e2eFrameList[i].e2eSigGroupList[j].sigGroupName)) == 0) { break; }
  		else
  		{
  			for(k=0;k<e2eFrameList[i].e2eSigGroupList[j].sigNum;k++)
  			{
  				if(e2eFrameList[i].e2eSigGroupList[j].e2eSignalList[k].sigUsed & SIGNALPROGRAMMING == SIGNALPROGRAMMING) 
          { 
            snprintf(info,elCount(info),"%s%s = %02X(Fulfilled)\n",info,e2eFrameList[i].e2eSigGroupList[j].e2eSignalList[k].sigName,
  					e2eFrameList[i].e2eSigGroupList[j].e2eSignalList[k].sigValue_Fulfilled);
            e2eFrameList[i].e2eSigGroupList[j].e2eSignalList[k].sigValue = e2eFrameList[i].e2eSigGroupList[j].e2eSignalList[k].sigValue_Fulfilled;
            e2eFrameList[i].simFrFlg = 1; e2eFrameList[i].simFrImtFlg = 1;
            count++; 
          }
  			}
  		}
  	}
  }
  if(count == 0) { testStepWarning("Test","No Signal About Programming Precondition in ParameterOfSigGroups.cin !!!"); }
  
  snprintf(info,elCount(info),"Set condition: \n%s",info);
  teststep(info); 
  
  if(gTestTypeFlag==1) { SimTRC(); }
  else                 { testWaitForTesterConfirmation(info); }
  
  delay(5000);
  
  TestStep("Transition from defaultSession(0x01) to extendedDiagnosticSession(0x03).",TestStepIntervalTime);
  SID10_DiagnosticSessionControl(EXTENDEDSESSION,PHYSICAL,SPRMIB_FALSE);
  CheckPosResponse_SID10(EXTENDEDSESSION,gP2Client_APP,gP2StarClientFor10Check,0,0);
  TestStep("Verify extendedDiagnosticSession.",TestStepIntervalTime);
  CheckCurrentSession(EXTENDEDSESSION,PHYSICAL,0,0);
  
  TestStep("Check Programming Pre-condition",TestStepIntervalTime);
  TPSendRawMessage(Data,FUNCTIONAL);
  CheckPosResponse(0x31,0,0);
  if(gRss == POS)
  {
    if(gTpRxData[5] != 0x01)
    {
      TestStepFail("","The response data is not right , expect 71 01 02 06 10 01");
    }
  }
  SessionFlag=BOOT;
  
  TestStep("Transition to programmingSession(0x02)",TestStepIntervalTime);
  SID10_DiagnosticSessionControl(PROGRAMMINGSESSION,PHYSICAL,SPRMIB_FALSE);
  CheckPosResponse_SID10(PROGRAMMINGSESSION,gP2Client_BOOT,gP2StarClientFor10Check,0,0);
  ECUinitHandle(0);
  TestStep("Verify programmingSession",TestStepIntervalTime);
  CheckCurrentSession(PROGRAMMINGSESSION,PHYSICAL,0,0);
  
  if(gTestTypeFlag==1) { StopTRC(); }
  else                 { testWaitForTesterConfirmation("Stop simulation signals"); }
  /******************************以上为测试步骤*********************************/
  
  Postcondition(); 
}
/// <APP_GeneralTest>
testcase Check_Programming_Pre_conditions_Precondition_Notfulfilled_Valid_Physical_DefaultSession_Supported_Service()
{
  byte Data[4]={0x31,0x01,0x02,0x06};
  int  i,j,k,m,n,count;
  char logName[400] = "";
  char info[1024];
  byte nrc;
  
  strncat(logName,"28317_Check_Programming_Pre_conditions_Precondition_Notfulfilled_Valid_Physical_DefaultSession_Supported_Service",400);
  testCaseDescription("The intent of the test is to verify that control routin 0206 is supported and response correct to precondition.");
  testCaseTitle("28317","Check_Programming_Pre_conditions_Precondition_Notfulfilled_Valid_Physical_DefaultSession_Supported_Service");
  
  SetLog(logName);
  Precondition();

  /******************************以下为测试步骤*********************************/
  SessionFlag=APP;
  /* 获取所有待测信号的数量 */
  for(i=0;i<E2E_FRAME_NUM;i++) 
  { 
  	for(j=0;j<elcount(e2eFrameList[i].e2eSigGroupList);j++)
  	{
  		if(strncmp(e2eFrameList[i].e2eSigGroupList[j].sigGroupName,"",elcount(e2eFrameList[i].e2eSigGroupList[j].sigGroupName)) == 0) { break; }
  		else
  		{
  			for(k=0;k<e2eFrameList[i].e2eSigGroupList[j].sigNum;k++)
  			{
  				if(e2eFrameList[i].e2eSigGroupList[j].e2eSignalList[k].sigUsed & SIGNALPROGRAMMING == SIGNALPROGRAMMING) { count++; }
  			}
  		}
  	}
  }
  if(count == 0) { testStepFail("Test","No Signal About Programming Precondition in ParameterOfSigGroups.cin, Test Abort!!!"); return;  }
  
  /* 遍历所有待测的信号，信号值不满足场景 */
  for(m=0;m<count;m++) 
  {
  	n = 0;
  	strncpy(info,"",elCount(info));   //清空打印信息
  	for(i=0;i<E2E_FRAME_NUM;i++) 
  	{ 
      e2eFrameList[i].simFrFlg = 0; e2eFrameList[i].simFrImtFlg = 0;
  		for(j=0;j<elcount(e2eFrameList[i].e2eSigGroupList);j++)
  		{
  			if(strncmp(e2eFrameList[i].e2eSigGroupList[j].sigGroupName,"",elcount(e2eFrameList[i].e2eSigGroupList[j].sigGroupName)) == 0) { break; }
  			else
  			{
          
  				for(k=0;k<e2eFrameList[i].e2eSigGroupList[j].sigNum;k++)
  				{
  					if(e2eFrameList[i].e2eSigGroupList[j].e2eSignalList[k].sigUsed & SIGNALPROGRAMMING == SIGNALPROGRAMMING) 
  					{ 
  						if(m == n) //当前测试信号设置成不满足条件值
  						{ 
                nrc=e2eFrameList[i].e2eSigGroupList[j].nrc;
  							snprintf(info,elCount(info),"%s%s = %02X(NotFulfilled)\n",info,e2eFrameList[i].e2eSigGroupList[j].e2eSignalList[k].sigName,
  							e2eFrameList[i].e2eSigGroupList[j].e2eSignalList[k].sigValue_NotFulfilled);
  							e2eFrameList[i].e2eSigGroupList[j].e2eSignalList[k].sigValue = e2eFrameList[i].e2eSigGroupList[j].e2eSignalList[k].sigValue_NotFulfilled; 
  						}
  						else //其余测试信号设置成满足条件值
  						{ 
  							snprintf(info,elCount(info),"%s%s = %02X(Fulfilled)\n",info,e2eFrameList[i].e2eSigGroupList[j].e2eSignalList[k].sigName,
  							e2eFrameList[i].e2eSigGroupList[j].e2eSignalList[k].sigValue_Fulfilled);
  							e2eFrameList[i].e2eSigGroupList[j].e2eSignalList[k].sigValue = e2eFrameList[i].e2eSigGroupList[j].e2eSignalList[k].sigValue_Fulfilled; 
  						}
  						n++;
              e2eFrameList[i].simFrFlg = 1; e2eFrameList[i].simFrImtFlg = 1;
  					}
  				}
  			}
  		}
  	}
    snprintf(info,elCount(info),"Set condition %d: \n%s",m+1,info);
    
    TestStep(info);
    if(gTestTypeFlag == 1) { SimTRC(); }
    else                   { testWaitForTesterConfirmation(info); }
    delay(5000);
    
    TestStep("Check Programming Pre-condition",TestStepIntervalTime);
    TPSendRawMessage(Data,PHYSICAL);
    CheckPosResponse(0x31,0,0);
    if(gRss == POS)
    {
      if(gTpRxData[5] != 0x02 || gTpRxData[4] != 0x10) { TestStepFail("","The response data is not right , expect 71 01 02 06 10 02"); }
    }
    
    TestStep("Transition to ProgrammingSession(0x02)",TestStepIntervalTime);
    SID10_DiagnosticSessionControl(PROGRAMMINGSESSION,PHYSICAL,SPRMIB_FALSE);
    CheckNegResponse(nrc,0,0);
    if(gRss == POS)
    {
      ECUinitHandle(0);
      SID10_DiagnosticSessionControl(DEFAULTSESSION,PHYSICAL,SPRMIB_FALSE);
      CheckPosResponse_SID10(DEFAULTSESSION,gP2Client_APP,gP2StarClientFor10Check,0,0);
      ECUinitHandle(0);
    }
    
    TestStep("Transition to ProgrammingSession(0x82)",TestStepIntervalTime);
    SID10_DiagnosticSessionControl(PROGRAMMINGSESSION,PHYSICAL,SPRMIB_TRUE);
    CheckNegResponse(nrc,0,0);
    if(gRss == POS || gRss == TIMEOUT)
    {
      ECUinitHandle(0);
      SID10_DiagnosticSessionControl(DEFAULTSESSION,PHYSICAL,SPRMIB_FALSE);
      CheckPosResponse_SID10(DEFAULTSESSION,gP2Client_APP,gP2StarClientFor10Check,0,0);
      ECUinitHandle(0);
    }
    
    TestStep("11 01",TestStepIntervalTime);
    SID11_ECUReset(HARDRESET,PHYSICAL,SPRMIB_FALSE);
    CheckNegResponse(nrc,0,0);
    if(gRss == POS) { ECUinitHandle(0); }
    
    TestStep("11 81",TestStepIntervalTime);
    SID11_ECUReset(HARDRESET,PHYSICAL,SPRMIB_TRUE);
    CheckNegResponse(nrc,0,0);
    if(gRss == POS || gRss == TIMEOUT) { ECUinitHandle(0); }  
    
    if(m == count-1)     { TestStep("All different Entry conditions(not fulfilled) Completed!",TestStepIntervalTime); }
    else if(m < count-1) { TestStep("Repeat steps with different Entry conditions(not fulfilled)",TestStepIntervalTime,1); }
  }
  
  TestStep("Remove All Entry conditions and wait 5s",TestStepIntervalTime);
  if(gTestTypeFlag == 1) { StopTRC(); }
  else                   { testWaitForTesterConfirmation("Remove All Entry conditions and wait 5s"); }
  delay(5000);
  
  TestStep("Check Programming Pre-condition",TestStepIntervalTime);
  TPSendRawMessage(Data,PHYSICAL);
  CheckPosResponse(0x31,0,0);
  if(gRss == POS)
  {
    if(gTpRxData[5] != 0x01)
    {
      TestStepFail("","The response data is not right, expect 71 01 02 06 10 01");
    }
  }
  
  TestStep("Transition to programmingSession(0x02)",TestStepIntervalTime);
  SID10_DiagnosticSessionControl(PROGRAMMINGSESSION,PHYSICAL,SPRMIB_FALSE);
  CheckPosResponse_SID10(PROGRAMMINGSESSION,gP2Client_BOOT,gP2StarClientFor10Check,0,0);
  ECUinitHandle(0);
  SessionFlag=BOOT;
  
  TestStep("Verify programmingSession",TestStepIntervalTime);
  CheckCurrentSession(PROGRAMMINGSESSION,PHYSICAL,0,0);

  SID11_ECUReset(HARDRESET,PHYSICAL,SPRMIB_FALSE);
  CheckPosResponse(0x11,0,0);
  ECUinitHandle(0);
  /******************************以上为测试步骤*********************************/
  
  Postcondition();
}
/// <APP_GeneralTest>
testcase Check_Programming_Pre_conditions_Precondition_Notfulfilled_Valid_Functional_DefaultSession_Supported_Service()
{
  byte Data[4]={0x31,0x01,0x02,0x06};
  int  i,j,k,m,n,count;
  char logName[400] = "";
  char info[1024];
  byte nrc;
  
  strncat(logName,"28319_Check_Programming_Pre_conditions_Precondition_Notfulfilled_Valid_Functional_DefaultSession_Supported_Service",400);
  testCaseDescription("The intent of the test is to verify that control routin 0206 is supported and response correct to precondition.");
  testCaseTitle("28319","Check_Programming_Pre_conditions_Precondition_Notfulfilled_Valid_Functional_DefaultSession_Supported_Service");
  if(gBusFlag==3)
	{
		testStepWarning("Test","This test case does not apply to the LIN bus");
		return;
	}
  SetLog(logName);
  Precondition();

  /******************************以下为测试步骤*********************************/
  SessionFlag=APP;
  /* 获取所有待测信号的数量 */
  for(i=0;i<E2E_FRAME_NUM;i++) 
  { 
  	for(j=0;j<elcount(e2eFrameList[i].e2eSigGroupList);j++)
  	{
  		if(strncmp(e2eFrameList[i].e2eSigGroupList[j].sigGroupName,"",elcount(e2eFrameList[i].e2eSigGroupList[j].sigGroupName)) == 0) { break; }
  		else
  		{
  			for(k=0;k<e2eFrameList[i].e2eSigGroupList[j].sigNum;k++)
  			{
  				if(e2eFrameList[i].e2eSigGroupList[j].e2eSignalList[k].sigUsed & SIGNALPROGRAMMING == SIGNALPROGRAMMING) { count++; }
  			}
  		}
  	}
  }
  if(count == 0) { testStepFail("Test","No Signal About Programming Precondition in ParameterOfSigGroups.cin, Test Abort!!!"); return;  }
  
  /* 遍历所有待测的信号，信号值不满足场景 */
  for(m=0;m<count;m++) 
  {
  	n = 0;
  	strncpy(info,"",elCount(info));   //清空打印信息
  	for(i=0;i<E2E_FRAME_NUM;i++) 
  	{ 
      e2eFrameList[i].simFrFlg = 0; e2eFrameList[i].simFrImtFlg = 0;
  		for(j=0;j<elcount(e2eFrameList[i].e2eSigGroupList);j++)
  		{
  			if(strncmp(e2eFrameList[i].e2eSigGroupList[j].sigGroupName,"",elcount(e2eFrameList[i].e2eSigGroupList[j].sigGroupName)) == 0) { break; }
  			else
  			{
          
  				for(k=0;k<e2eFrameList[i].e2eSigGroupList[j].sigNum;k++)
  				{
  					if(e2eFrameList[i].e2eSigGroupList[j].e2eSignalList[k].sigUsed & SIGNALPROGRAMMING == SIGNALPROGRAMMING) 
  					{ 
  						if(m == n) //当前测试信号设置成不满足条件值
  						{ 
                nrc=e2eFrameList[i].e2eSigGroupList[j].nrc;
  							snprintf(info,elCount(info),"%s%s = %02X(NotFulfilled)\n",info,e2eFrameList[i].e2eSigGroupList[j].e2eSignalList[k].sigName,
  							e2eFrameList[i].e2eSigGroupList[j].e2eSignalList[k].sigValue_NotFulfilled);
  							e2eFrameList[i].e2eSigGroupList[j].e2eSignalList[k].sigValue = e2eFrameList[i].e2eSigGroupList[j].e2eSignalList[k].sigValue_NotFulfilled; 
  						}
  						else //其余测试信号设置成满足条件值
  						{ 
  							snprintf(info,elCount(info),"%s%s = %02X(Fulfilled)\n",info,e2eFrameList[i].e2eSigGroupList[j].e2eSignalList[k].sigName,
  							e2eFrameList[i].e2eSigGroupList[j].e2eSignalList[k].sigValue_Fulfilled);
  							e2eFrameList[i].e2eSigGroupList[j].e2eSignalList[k].sigValue = e2eFrameList[i].e2eSigGroupList[j].e2eSignalList[k].sigValue_Fulfilled; 
  						}
  						n++;
              e2eFrameList[i].simFrFlg = 1; e2eFrameList[i].simFrImtFlg = 1;
  					}
  				}
  			}
  		}
  	}
    snprintf(info,elCount(info),"Set condition %d: \n%s",m+1,info);
    
    TestStep(info);
    if(gTestTypeFlag == 1) { SimTRC(); }
    else                   { testWaitForTesterConfirmation(info); }
    delay(5000);
    
    TestStep("Check Programming Pre-condition",TestStepIntervalTime);
    TPSendRawMessage(Data,FUNCTIONAL);
    CheckPosResponse(0x31,0,0);
    if(gRss == POS)
    {
      if(gTpRxData[5] != 0x02 || gTpRxData[4] != 0x10) { TestStepFail("","The response data is not right , expect 71 01 02 06 10 02"); }
    }
    
    TestStep("Transition to ProgrammingSession(0x02)",TestStepIntervalTime);
    SID10_DiagnosticSessionControl(PROGRAMMINGSESSION,FUNCTIONAL,SPRMIB_FALSE);
    CheckNegResponse(nrc,0,0);
    if(gRss == POS)
    {
      ECUinitHandle(0);
      SID10_DiagnosticSessionControl(DEFAULTSESSION,PHYSICAL,SPRMIB_FALSE);
      CheckPosResponse_SID10(DEFAULTSESSION,gP2Client_APP,gP2StarClientFor10Check,0,0);
      ECUinitHandle(0);
    }
    
    TestStep("Transition to ProgrammingSession(0x82)",TestStepIntervalTime);
    SID10_DiagnosticSessionControl(PROGRAMMINGSESSION,FUNCTIONAL,SPRMIB_TRUE);
    CheckNegResponse(nrc,0,0);
    if(gRss == POS || gRss == TIMEOUT)
    {
      ECUinitHandle(0);
      SID10_DiagnosticSessionControl(DEFAULTSESSION,PHYSICAL,SPRMIB_FALSE);
      CheckPosResponse_SID10(DEFAULTSESSION,gP2Client_APP,gP2StarClientFor10Check,0,0);
      ECUinitHandle(0);
    }
    
    TestStep("11 01",TestStepIntervalTime);
    SID11_ECUReset(HARDRESET,FUNCTIONAL,SPRMIB_FALSE);
    CheckNegResponse(nrc,0,0);
    if(gRss == POS) { ECUinitHandle(0); }
    
    TestStep("11 81",TestStepIntervalTime);
    SID11_ECUReset(HARDRESET,FUNCTIONAL,SPRMIB_TRUE);
    CheckNegResponse(nrc,0,0);
    if(gRss == POS || gRss == TIMEOUT) { ECUinitHandle(0); }  
    
    if(m == count-1)     { TestStep("All different Entry conditions(not fulfilled) Completed!",TestStepIntervalTime); }
    else if(m < count-1) { TestStep("Repeat steps with different Entry conditions(not fulfilled)",TestStepIntervalTime,1); }
  }
  
  TestStep("Remove All Entry conditions and wait 5s",TestStepIntervalTime);
  if(gTestTypeFlag == 1) { StopTRC(); }
  else                   { testWaitForTesterConfirmation("Remove All Entry conditions and wait 5s"); }
  delay(5000);
  
  TestStep("Check Programming Pre-condition",TestStepIntervalTime);
  TPSendRawMessage(Data,FUNCTIONAL);
  CheckPosResponse(0x31,0,0);
  if(gRss == POS)
  {
    if(gTpRxData[5] != 0x01)
    {
      TestStepFail("","The response data is not right, expect 71 01 02 06 10 01");
    }
  }
  
  TestStep("Transition to programmingSession(0x02)",TestStepIntervalTime);
  SID10_DiagnosticSessionControl(PROGRAMMINGSESSION,FUNCTIONAL,SPRMIB_FALSE);
  CheckPosResponse_SID10(PROGRAMMINGSESSION,gP2Client_BOOT,gP2StarClientFor10Check,0,0);
  ECUinitHandle(0);
  SessionFlag=BOOT;
  
  TestStep("Verify programmingSession",TestStepIntervalTime);
  CheckCurrentSession(PROGRAMMINGSESSION,PHYSICAL,0,0);

  SID11_ECUReset(HARDRESET,FUNCTIONAL,SPRMIB_FALSE);
  CheckPosResponse(0x11,0,0);
  ECUinitHandle(0);
  /******************************以上为测试步骤*********************************/
  
  Postcondition();
}
/// <APP_GeneralTest>
testcase Check_Programming_Pre_conditions_Precondition_Notfulfilled_Valid_Physical_ExtendedSession_Supported_Service()
{
  byte Data[4]={0x31,0x01,0x02,0x06};
  int  i,j,k,m,n,count;
  char logName[400] = "";
  char info[1024];
  byte nrc;
  
  strncat(logName,"28318_Check_Programming_Pre_conditions_Precondition_Notfulfilled_Valid_Physical_ExtendedSession_Supported_Service",400);
  testCaseDescription("The intent of the test is to verify that control routin 0206 is supported and response correct to precondition.");
  testCaseTitle("28318","Check_Programming_Pre_conditions_Precondition_Notfulfilled_Valid_Physical_ExtendedSession_Supported_Service");
  
  SetLog(logName);
  Precondition();

  /******************************以下为测试步骤*********************************/
  SessionFlag=APP;
  /* 获取所有待测信号的数量 */
  for(i=0;i<E2E_FRAME_NUM;i++) 
  { 
  	for(j=0;j<elcount(e2eFrameList[i].e2eSigGroupList);j++)
  	{
  		if(strncmp(e2eFrameList[i].e2eSigGroupList[j].sigGroupName,"",elcount(e2eFrameList[i].e2eSigGroupList[j].sigGroupName)) == 0) { break; }
  		else
  		{
  			for(k=0;k<e2eFrameList[i].e2eSigGroupList[j].sigNum;k++)
  			{
  				if(e2eFrameList[i].e2eSigGroupList[j].e2eSignalList[k].sigUsed & SIGNALPROGRAMMING == SIGNALPROGRAMMING) { count++; }
  			}
  		}
  	}
  }
  if(count == 0) { testStepFail("Test","No Signal About Programming Precondition in ParameterOfSigGroups.cin, Test Abort!!!"); return;  }
  
  /* 遍历所有待测的信号，信号值不满足场景 */
  for(m=0;m<count;m++) 
  {
  	n = 0;
  	strncpy(info,"",elCount(info));   //清空打印信息
  	for(i=0;i<E2E_FRAME_NUM;i++) 
  	{ 
      e2eFrameList[i].simFrFlg = 0; e2eFrameList[i].simFrImtFlg = 0;
  		for(j=0;j<elcount(e2eFrameList[i].e2eSigGroupList);j++)
  		{
  			if(strncmp(e2eFrameList[i].e2eSigGroupList[j].sigGroupName,"",elcount(e2eFrameList[i].e2eSigGroupList[j].sigGroupName)) == 0) { break; }
  			else
  			{
          
  				for(k=0;k<e2eFrameList[i].e2eSigGroupList[j].sigNum;k++)
  				{
  					if(e2eFrameList[i].e2eSigGroupList[j].e2eSignalList[k].sigUsed & SIGNALPROGRAMMING == SIGNALPROGRAMMING) 
  					{ 
  						if(m == n) //当前测试信号设置成不满足条件值
  						{ 
                nrc=e2eFrameList[i].e2eSigGroupList[j].nrc;
  							snprintf(info,elCount(info),"%s%s = %02X(NotFulfilled)\n",info,e2eFrameList[i].e2eSigGroupList[j].e2eSignalList[k].sigName,
  							e2eFrameList[i].e2eSigGroupList[j].e2eSignalList[k].sigValue_NotFulfilled);
  							e2eFrameList[i].e2eSigGroupList[j].e2eSignalList[k].sigValue = e2eFrameList[i].e2eSigGroupList[j].e2eSignalList[k].sigValue_NotFulfilled; 
  						}
  						else //其余测试信号设置成满足条件值
  						{ 
  							snprintf(info,elCount(info),"%s%s = %02X(Fulfilled)\n",info,e2eFrameList[i].e2eSigGroupList[j].e2eSignalList[k].sigName,
  							e2eFrameList[i].e2eSigGroupList[j].e2eSignalList[k].sigValue_Fulfilled);
  							e2eFrameList[i].e2eSigGroupList[j].e2eSignalList[k].sigValue = e2eFrameList[i].e2eSigGroupList[j].e2eSignalList[k].sigValue_Fulfilled; 
  						}
  						n++;
              e2eFrameList[i].simFrFlg = 1; e2eFrameList[i].simFrImtFlg = 1;
  					}
  				}
  			}
  		}
  	}
    snprintf(info,elCount(info),"Set condition %d: \n%s",m+1,info);
    
    TestStep(info);
    if(gTestTypeFlag == 1) { SimTRC(); }
    else                   { testWaitForTesterConfirmation(info); }
    delay(5000);
    
    TestStep("Transition to extendedSession(0x03)",TestStepIntervalTime);
    SID10_DiagnosticSessionControl(EXTENDEDSESSION,PHYSICAL,SPRMIB_FALSE);
    CheckPosResponse_SID10(EXTENDEDSESSION,gP2Client_APP,gP2StarClientFor10Check,0,0);
    
    TestStep("Verify extendedSession",TestStepIntervalTime);
    CheckCurrentSession(EXTENDEDSESSION,PHYSICAL,0,0);
    
    TestStep("Check Programming Pre-condition",TestStepIntervalTime);
    TPSendRawMessage(Data,PHYSICAL);
    CheckPosResponse(0x31,0,0);
    if(gRss == POS)
    {
      if(gTpRxData[5] != 0x02 || gTpRxData[4] != 0x10) { TestStepFail("","The response data is not right , expect 71 01 02 06 10 02"); }
    }
    
    TestStep("Transition to ProgrammingSession(0x02)",TestStepIntervalTime);
    SID10_DiagnosticSessionControl(PROGRAMMINGSESSION,PHYSICAL,SPRMIB_FALSE);
    CheckNegResponse(nrc,0,0);
    if(gRss == POS)
    {
      ECUinitHandle(0);
      SID10_DiagnosticSessionControl(DEFAULTSESSION,PHYSICAL,SPRMIB_FALSE);
      CheckPosResponse_SID10(DEFAULTSESSION,gP2Client_APP,gP2StarClientFor10Check,0,0);
      ECUinitHandle(0);
      SID10_DiagnosticSessionControl(EXTENDEDSESSION,PHYSICAL,SPRMIB_FALSE);
      CheckPosResponse_SID10(EXTENDEDSESSION,gP2Client_APP,gP2StarClientFor10Check,0,0);
      CheckCurrentSession(EXTENDEDSESSION,PHYSICAL,0,0);
    }
    
    TestStep("Transition to ProgrammingSession(0x82)",TestStepIntervalTime);
    SID10_DiagnosticSessionControl(PROGRAMMINGSESSION,PHYSICAL,SPRMIB_TRUE);
    CheckNegResponse(nrc,0,0);
    if(gRss == POS || gRss == TIMEOUT)
    {
      ECUinitHandle(0);
      SID10_DiagnosticSessionControl(DEFAULTSESSION,PHYSICAL,SPRMIB_FALSE);
      CheckPosResponse_SID10(DEFAULTSESSION,gP2Client_APP,gP2StarClientFor10Check,0,0);
      ECUinitHandle(0);
      SID10_DiagnosticSessionControl(EXTENDEDSESSION,PHYSICAL,SPRMIB_FALSE);
      CheckPosResponse_SID10(EXTENDEDSESSION,gP2Client_APP,gP2StarClientFor10Check,0,0);
      CheckCurrentSession(EXTENDEDSESSION,PHYSICAL,0,0);
    }
    
    TestStep("11 01",TestStepIntervalTime);
    SID11_ECUReset(HARDRESET,PHYSICAL,SPRMIB_FALSE);
    CheckNegResponse(nrc,0,0);
    if(gRss == POS) 
    { 
      ECUinitHandle(0); 
      SID10_DiagnosticSessionControl(EXTENDEDSESSION,PHYSICAL,SPRMIB_FALSE);
      CheckPosResponse_SID10(EXTENDEDSESSION,gP2Client_APP,gP2StarClientFor10Check,0,0);
      CheckCurrentSession(EXTENDEDSESSION,PHYSICAL,0,0);
    }
    /*  5  */
    TestStep("11 81",TestStepIntervalTime);
    SID11_ECUReset(HARDRESET,PHYSICAL,SPRMIB_TRUE);
    CheckNegResponse(nrc,0,0);
    if(gRss == POS || gRss == TIMEOUT) 
    { 
      ECUinitHandle(0); 
      SID10_DiagnosticSessionControl(EXTENDEDSESSION,PHYSICAL,SPRMIB_FALSE);
      CheckPosResponse_SID10(EXTENDEDSESSION,gP2Client_APP,gP2StarClientFor10Check,0,0);
      CheckCurrentSession(EXTENDEDSESSION,PHYSICAL,0,0);
    }  
    
    if(m == count-1)     { TestStep("All different Entry conditions(not fulfilled) Completed!",TestStepIntervalTime); }
    else if(m < count-1) { TestStep("Repeat steps with different Entry conditions(not fulfilled)",TestStepIntervalTime,1); }
  }
  
  TestStep("Remove All Entry conditions and wait 5s",TestStepIntervalTime);
  if(gTestTypeFlag == 1) { StopTRC(); }
  else                   { testWaitForTesterConfirmation("Remove All Entry conditions and wait 5s"); }
  delay(5000);
  
  TestStep("Transition to extendedDiagnosticSession(0x03).",TestStepIntervalTime);
  SID10_DiagnosticSessionControl(EXTENDEDSESSION,PHYSICAL,SPRMIB_FALSE);
  CheckPosResponse_SID10(EXTENDEDSESSION,gP2Client_APP,gP2StarClientFor10Check,0,0);

  TestStep("Check Programming Pre-condition",TestStepIntervalTime);
  TPSendRawMessage(Data,PHYSICAL);
  CheckPosResponse(0x31,0,0);
  if(gRss == POS)
  {
    if(gTpRxData[5] != 0x01)
    {
      TestStepFail("","The response data is not right , expect 71 01 02 06 10 01");
    }
  }
  
  TestStep("Transition to programmingSession(0x02)",TestStepIntervalTime);
  SID10_DiagnosticSessionControl(PROGRAMMINGSESSION,PHYSICAL,SPRMIB_FALSE);
  CheckPosResponse_SID10(PROGRAMMINGSESSION,gP2Client_BOOT,gP2StarClientFor10Check,0,0);
  ECUinitHandle(0);
  SessionFlag=BOOT;
  
  TestStep("Verify programmingSession",TestStepIntervalTime);
  CheckCurrentSession(PROGRAMMINGSESSION,PHYSICAL,0,0);
  
  SID11_ECUReset(HARDRESET,PHYSICAL,SPRMIB_FALSE);
  CheckPosResponse(0x11,0,0);
  ECUinitHandle(0);
  /******************************以上为测试步骤*********************************/
  
  Postcondition();
}
/// <APP_GeneralTest>
testcase Check_Programming_Pre_conditions_Precondition_Notfulfilled_Valid_Functional_ExtendedSession_Supported_Service()
{
  byte Data[4]={0x31,0x01,0x02,0x06};
  int  i,j,k,m,n,count;
  char logName[400] = "";
  char info[1024];
  byte nrc;
  
  strncat(logName,"28320_Check_Programming_Pre_conditions_Precondition_Notfulfilled_Valid_Functional_ExtendedSession_Supported_Service",400);
  testCaseDescription("The intent of the test is to verify that control routin 0206 is supported and response correct to precondition.");
  testCaseTitle("28320","Check_Programming_Pre_conditions_Precondition_Notfulfilled_Valid_Functional_ExtendedSession_Supported_Service");
  if(gBusFlag==3)
	{
		testStepWarning("Test","This test case does not apply to the LIN bus");
		return;
	}
  SetLog(logName);
  Precondition();

  /******************************以下为测试步骤*********************************/
  SessionFlag=APP;
  /* 获取所有待测信号的数量 */
  for(i=0;i<E2E_FRAME_NUM;i++) 
  { 
  	for(j=0;j<elcount(e2eFrameList[i].e2eSigGroupList);j++)
  	{
  		if(strncmp(e2eFrameList[i].e2eSigGroupList[j].sigGroupName,"",elcount(e2eFrameList[i].e2eSigGroupList[j].sigGroupName)) == 0) { break; }
  		else
  		{
  			for(k=0;k<e2eFrameList[i].e2eSigGroupList[j].sigNum;k++)
  			{
  				if(e2eFrameList[i].e2eSigGroupList[j].e2eSignalList[k].sigUsed & SIGNALPROGRAMMING == SIGNALPROGRAMMING) { count++; }
  			}
  		}
  	}
  }
  if(count == 0) { testStepFail("Test","No Signal About Programming Precondition in ParameterOfSigGroups.cin, Test Abort!!!"); return;  }
  
  /* 遍历所有待测的信号，信号值不满足场景 */
  for(m=0;m<count;m++) 
  {
  	n = 0;
  	strncpy(info,"",elCount(info));   //清空打印信息
  	for(i=0;i<E2E_FRAME_NUM;i++) 
  	{ 
      e2eFrameList[i].simFrFlg = 0; e2eFrameList[i].simFrImtFlg = 0;
  		for(j=0;j<elcount(e2eFrameList[i].e2eSigGroupList);j++)
  		{
  			if(strncmp(e2eFrameList[i].e2eSigGroupList[j].sigGroupName,"",elcount(e2eFrameList[i].e2eSigGroupList[j].sigGroupName)) == 0) { break; }
  			else
  			{
          
  				for(k=0;k<e2eFrameList[i].e2eSigGroupList[j].sigNum;k++)
  				{
  					if(e2eFrameList[i].e2eSigGroupList[j].e2eSignalList[k].sigUsed & SIGNALPROGRAMMING == SIGNALPROGRAMMING) 
  					{ 
  						if(m == n) //当前测试信号设置成不满足条件值
  						{ 
                nrc=e2eFrameList[i].e2eSigGroupList[j].nrc;
  							snprintf(info,elCount(info),"%s%s = %02X(NotFulfilled)\n",info,e2eFrameList[i].e2eSigGroupList[j].e2eSignalList[k].sigName,
  							e2eFrameList[i].e2eSigGroupList[j].e2eSignalList[k].sigValue_NotFulfilled);
  							e2eFrameList[i].e2eSigGroupList[j].e2eSignalList[k].sigValue = e2eFrameList[i].e2eSigGroupList[j].e2eSignalList[k].sigValue_NotFulfilled; 
  						}
  						else //其余测试信号设置成满足条件值
  						{ 
  							snprintf(info,elCount(info),"%s%s = %02X(Fulfilled)\n",info,e2eFrameList[i].e2eSigGroupList[j].e2eSignalList[k].sigName,
  							e2eFrameList[i].e2eSigGroupList[j].e2eSignalList[k].sigValue_Fulfilled);
  							e2eFrameList[i].e2eSigGroupList[j].e2eSignalList[k].sigValue = e2eFrameList[i].e2eSigGroupList[j].e2eSignalList[k].sigValue_Fulfilled; 
  						}
  						n++;
              e2eFrameList[i].simFrFlg = 1; e2eFrameList[i].simFrImtFlg = 1;
  					}
  				}
  			}
  		}
  	}
    snprintf(info,elCount(info),"Set condition %d: \n%s",m+1,info);
    
    TestStep(info);
    if(gTestTypeFlag == 1) { SimTRC(); }
    else                   { testWaitForTesterConfirmation(info); }
    delay(5000);
    
    TestStep("Transition to extendedSession(0x03)",TestStepIntervalTime);
    SID10_DiagnosticSessionControl(EXTENDEDSESSION,PHYSICAL,SPRMIB_FALSE);
    CheckPosResponse_SID10(EXTENDEDSESSION,gP2Client_APP,gP2StarClientFor10Check,0,0);
    
    TestStep("Verify extendedSession",TestStepIntervalTime);
    CheckCurrentSession(EXTENDEDSESSION,PHYSICAL,0,0);
    
    TestStep("Check Programming Pre-condition",TestStepIntervalTime);
    TPSendRawMessage(Data,FUNCTIONAL);
    CheckPosResponse(0x31,0,0);
    if(gRss == POS)
    {
      if(gTpRxData[5] != 0x02 || gTpRxData[4] != 0x10) { TestStepFail("","The response data is not right , expect 71 01 02 06 10 02"); }
    }
    
    TestStep("Transition to ProgrammingSession(0x02)",TestStepIntervalTime);
    SID10_DiagnosticSessionControl(PROGRAMMINGSESSION,FUNCTIONAL,SPRMIB_FALSE);
    CheckNegResponse(nrc,0,0);
    if(gRss == POS)
    {
      ECUinitHandle(0);
      SID10_DiagnosticSessionControl(DEFAULTSESSION,PHYSICAL,SPRMIB_FALSE);
      CheckPosResponse_SID10(DEFAULTSESSION,gP2Client_APP,gP2StarClientFor10Check,0,0);
      ECUinitHandle(0);
      SID10_DiagnosticSessionControl(EXTENDEDSESSION,PHYSICAL,SPRMIB_FALSE);
      CheckPosResponse_SID10(EXTENDEDSESSION,gP2Client_APP,gP2StarClientFor10Check,0,0);
      CheckCurrentSession(EXTENDEDSESSION,PHYSICAL,0,0);
    }
    
    TestStep("Transition to ProgrammingSession(0x82)",TestStepIntervalTime);
    SID10_DiagnosticSessionControl(PROGRAMMINGSESSION,FUNCTIONAL,SPRMIB_TRUE);
    CheckNegResponse(nrc,0,0);
    if(gRss == POS || gRss == TIMEOUT)
    {
      ECUinitHandle(0);
      SID10_DiagnosticSessionControl(DEFAULTSESSION,PHYSICAL,SPRMIB_FALSE);
      CheckPosResponse_SID10(DEFAULTSESSION,gP2Client_APP,gP2StarClientFor10Check,0,0);
      ECUinitHandle(0);
      SID10_DiagnosticSessionControl(EXTENDEDSESSION,PHYSICAL,SPRMIB_FALSE);
      CheckPosResponse_SID10(EXTENDEDSESSION,gP2Client_APP,gP2StarClientFor10Check,0,0);
      CheckCurrentSession(EXTENDEDSESSION,PHYSICAL,0,0);
    }
    
    TestStep("11 01",TestStepIntervalTime);
    SID11_ECUReset(HARDRESET,FUNCTIONAL,SPRMIB_FALSE);
    CheckNegResponse(nrc,0,0);
    if(gRss == POS) 
    { 
      ECUinitHandle(0); 
      SID10_DiagnosticSessionControl(EXTENDEDSESSION,PHYSICAL,SPRMIB_FALSE);
      CheckPosResponse_SID10(EXTENDEDSESSION,gP2Client_APP,gP2StarClientFor10Check,0,0);
      CheckCurrentSession(EXTENDEDSESSION,PHYSICAL,0,0);
    }
    /*  5  */
    TestStep("11 81",TestStepIntervalTime);
    SID11_ECUReset(HARDRESET,FUNCTIONAL,SPRMIB_TRUE);
    CheckNegResponse(nrc,0,0);
    if(gRss == POS || gRss == TIMEOUT) 
    { 
      ECUinitHandle(0); 
      SID10_DiagnosticSessionControl(EXTENDEDSESSION,PHYSICAL,SPRMIB_FALSE);
      CheckPosResponse_SID10(EXTENDEDSESSION,gP2Client_APP,gP2StarClientFor10Check,0,0);
      CheckCurrentSession(EXTENDEDSESSION,PHYSICAL,0,0);
    }  
    
    if(m == count-1)     { TestStep("All different Entry conditions(not fulfilled) Completed!",TestStepIntervalTime); }
    else if(m < count-1) { TestStep("Repeat steps with different Entry conditions(not fulfilled)",TestStepIntervalTime,1); }
  }
  
  set_trc_valid();//20251021 石太佳：这里要把所有的仿真信号设置会fulfilled
  TestStep("Remove All Entry conditions and wait 5s",TestStepIntervalTime);
  if(gTestTypeFlag == 1) { StopTRC(); }
  else                   { testWaitForTesterConfirmation("Remove All Entry conditions and wait 5s"); }
  delay(5000);
  
  TestStep("Transition to extendedDiagnosticSession(0x03).",TestStepIntervalTime);
  SID10_DiagnosticSessionControl(EXTENDEDSESSION,PHYSICAL,SPRMIB_FALSE);
  CheckPosResponse_SID10(EXTENDEDSESSION,gP2Client_APP,gP2StarClientFor10Check,0,0);

  TestStep("Check Programming Pre-condition",TestStepIntervalTime);
  TPSendRawMessage(Data,FUNCTIONAL);
  CheckPosResponse(0x31,0,0);
  if(gRss == POS)
  {
    if(gTpRxData[5] != 0x01)
    {
      TestStepFail("","The response data is not right , expect 71 01 02 06 10 01");
    }
  }
  
  TestStep("Transition to programmingSession(0x02)",TestStepIntervalTime);
  SID10_DiagnosticSessionControl(PROGRAMMINGSESSION,FUNCTIONAL,SPRMIB_FALSE);
  CheckPosResponse_SID10(PROGRAMMINGSESSION,gP2Client_BOOT,gP2StarClientFor10Check,0,0);
  ECUinitHandle(0);
  SessionFlag=BOOT;
  
  TestStep("Verify programmingSession",TestStepIntervalTime);
  CheckCurrentSession(PROGRAMMINGSESSION,PHYSICAL,0,0);
  
  SID11_ECUReset(HARDRESET,FUNCTIONAL,SPRMIB_FALSE);
  CheckPosResponse(0x11,0,0);
  ECUinitHandle(0);
  /******************************以上为测试步骤*********************************/
  Postcondition();
}

/// <APP_GeneralTest>
testcase Seed_and_Key_Validity_Details_Test_Physical_ExtendedSession()
{
  int  L1,LX,B;
  byte ExpectNRC[2]={0x12,0x7E};
  int  i,j=0;
  char logName[400] = "";
  char info[1024];
  byte tempseedarray[16];
  
  struct SecurtiyLevelToTest{
    byte levelTestRecord;
    byte TestedFlag;
  };
  struct SecurtiyLevelToTest APP_SecurityTestLevel[50];
  byte levelToTestNum,levelToTestNumNow;
  
  strncat(logName,"1022762_Seed_and_Key_Validity_Details_Test_Physical_ExtendedSession",400);
  testCaseDescription("The intent of this test is to verify that the security access requirements are implemented correctly.");
  testCaseTitle("1022762","Seed_and_Key_Validity_Details_Test_Physical_ExtendedSession");
  
  SetLog(logName);
  Precondition();
   
  /******************************以下为测试步骤*********************************/
  SessionFlag=APP;
  
  TestStep("Transition from defaultSession(0x01) to Extendedsession(0x03).",TestStepIntervalTime);
  SID10_DiagnosticSessionControl(EXTENDEDSESSION,PHYSICAL,SPRMIB_FALSE);
  CheckPosResponse_SID10(EXTENDEDSESSION,gP2Client_APP,gP2StarClientFor10Check,0,0);
  
  TestStep("Verify ExtendedSession.",TestStepIntervalTime);
  CheckCurrentSession(EXTENDEDSESSION,PHYSICAL,0,0);
  
  testWaitForTimeout(gTimeWaitForSecuAccess);
  
  levelToTestNum=0;
  for(i=0; i<NumOfSecurityLv; i++)
  {
    if(SELevel[i].SEFlagPBL == 1)
    {
      continue;
    }
    APP_SecurityTestLevel[levelToTestNum].levelTestRecord=SELevel[i].SElevel;
    APP_SecurityTestLevel[levelToTestNum].TestedFlag=0;
    levelToTestNum++;
  }
  
  levelToTestNumNow=levelToTestNum;
  for(i=0; i<levelToTestNum; i++)
  {
    if(i==0)
      TestStep("Let L1 = First security level from the configured security level array from configured list. ",TestStepIntervalTime);
    else
    {
      SID10_DiagnosticSessionControl(EXTENDEDSESSION,PHYSICAL,SPRMIB_FALSE);
      CheckPosResponse_SID10(EXTENDEDSESSION,gP2Client_APP,gP2StarClientFor10Check,0,0);
      TestStep("If more security levels are supported jump to step 3 and let L1 be the next supported requestSeed level in ascending order after the last tested level. Note this means that L2 shall also increase level with same amount as L1.  ",TestStepIntervalTime,3);
    }
  
    L1=APP_SecurityTestLevel[i].levelTestRecord;
    
    if(levelToTestNumNow>=2)
    {
      TestStep("If more than one security level is implemented in current session, then go to step 5, else go to step 12",TestStepIntervalTime,5);
    
      TestStep("Request seed L1",TestStepIntervalTime);
      SID27_SecurityAccess_RequestSeed(L1,PHYSICAL);
      CheckPosResponse_SID27_ReqSeed(L1,gSeedArray,16,0,0);
      PID27_Parameters_Seeds_Chk(NotAllZero,gSeedArray);
      
      TestStep("Let LX be next security level from configured security level array list");
      LX=APP_SecurityTestLevel[i+1].levelTestRecord;

      TestStep("Send key LX",TestStepIntervalTime);
      SID27_SecurityAccess_SendKey(LX,gKeyArray,PHYSICAL);
      CheckNegResponse(0x24,0,0);

      TestStep("Send key L1",TestStepIntervalTime);
      SID27_SecurityAccess_SendKey(L1,gKeyArray,PHYSICAL);
      CheckNegResponse(0x24,0,0);
        
      TestStep("Request seed L1.",TestStepIntervalTime);
      SID27_SecurityAccess_RequestSeed(L1,PHYSICAL);
      CheckPosResponse_SID27_ReqSeed(L1,gSeedArray,16,0,0);
      PID27_Parameters_Seeds_Chk(NotAllZero,gSeedArray);

      TestStep("Request seed LX.",TestStepIntervalTime);
      SID27_SecurityAccess_RequestSeed(LX,PHYSICAL);
      CheckPosResponse_SID27_ReqSeed(LX,tempseedarray,16,0,0);
      PID27_Parameters_Seeds_Chk(NotAllZero,tempseedarray);
      
      TestStep("Send key L1",TestStepIntervalTime);
      SID27_SecurityAccess_SendKey(L1,gKeyArray,PHYSICAL);
      CheckNegResponse(0x24,0,0);

    }
    else
    {
      TestStep("If more than one security level is implemented in current session, then go to step 5, else go to step 12",TestStepIntervalTime,12);
    }

    TestStep("Request seed L1.",TestStepIntervalTime);
    SID27_SecurityAccess_RequestSeed(L1,PHYSICAL);
    CheckPosResponse_SID27_ReqSeed(L1,gSeedArray,16,0,0);
    PID27_Parameters_Seeds_Chk(NotAllZero,gSeedArray);
    
    TestStep("Send key L1",TestStepIntervalTime);
    SID27_SecurityAccess_SendKey(L1,gKeyArray,PHYSICAL);
    CheckPosResponse_SID27_SenKey(L1,0,0);
    
    TestStep("Disable functionally addressed periodic testerPresent. Wait for 6 seconds.Resume functionally addressed periodic testerPresent.");
    TP_TesterPresentSet(TP_OFF); 
    delay(6000);
    TP_TesterPresentSet(TP_ON);
    
    TestStep("Verify DefaultSession.",TestStepIntervalTime);
    CheckCurrentSession(DEFAULTSESSION,PHYSICAL,0,0);

    TestStep("Transition from defaultSession(0x01) to ExtendedSession(0x03).",TestStepIntervalTime);
    SID10_DiagnosticSessionControl(EXTENDEDSESSION,PHYSICAL,SPRMIB_TRUE);
    CheckNonResponse(0,0);
    
    ECUinitHandle(0);
    TestStep("Verify ExtendedSession.",TestStepIntervalTime);
    CheckCurrentSession(EXTENDEDSESSION,PHYSICAL,0,0);
    
    TestStep("Request Seed L1",TestStepIntervalTime);
    SID27_SecurityAccess_RequestSeed(L1,PHYSICAL);
    CheckPosResponse_SID27_ReqSeed(L1,gSeedArray,16,0,0);
    
    TestStep("Disable functionally addressed periodic testerPresent. Wait for 6 seconds.Resume functionally addressed periodic testerPresent.");
    TP_TesterPresentSet(TP_OFF); 
    delay(6000);
    TP_TesterPresentSet(TP_ON);
    
    TestStep("Verify DefaultSession.",TestStepIntervalTime);
    CheckCurrentSession(DEFAULTSESSION,PHYSICAL,0,0);

    TestStep("Transition from defaultSession(0x01) to ExtendedSession(0x03).",TestStepIntervalTime);
    SID10_DiagnosticSessionControl(EXTENDEDSESSION,PHYSICAL,SPRMIB_TRUE);
    CheckNonResponse(0,0);
    
    ECUinitHandle(0);
    TestStep("Verify ExtendedSession.",TestStepIntervalTime);
    CheckCurrentSession(EXTENDEDSESSION,PHYSICAL,0,0);
    
    TestStep("Send key L1",TestStepIntervalTime);
    SID27_SecurityAccess_SendKey(L1,gKeyArray,PHYSICAL);
    CheckNegResponse(0x24,0,0);
    
    
    
    TestStep("The following test cases verify Invalid Key and false access attempts.");
    TestStep("Check minimum false attemps without time delay starts.");
    TestStep("Let B=1");
    
    for(B=1;B<2;B++)
    {
      TestStep("Request seed L1.",TestStepIntervalTime);
      SID27_SecurityAccess_RequestSeed(L1,PHYSICAL);
      CheckPosResponse_SID27_ReqSeed(L1,gSeedArray,16,0,0);
      PID27_Parameters_Seeds_Chk(NotAllZero,gSeedArray);
      
      gSeedArray[15]=~gSeedArray[15];
      TestStep("Send wrong key L1",TestStepIntervalTime);
      SID27_SecurityAccess_SendKey(L1,gKeyArray,PHYSICAL);
      CheckNegResponse(0x35,0,0); 
      
      if(B<2)
        TestStep(" if B<2, repeat step 27 & step 28, with no delay between requests. ",TestStepIntervalTime,27);
      else
      {
        TestStep(" if B<2, repeat step 27 & step 28, with no delay between requests. ",TestStepIntervalTime);
      }
    }
    
      TestStep("Request seed L1.",TestStepIntervalTime);
      SID27_SecurityAccess_RequestSeed(L1,PHYSICAL);
      CheckPosResponse_SID27_ReqSeed(L1,gSeedArray,16,0,0);
      PID27_Parameters_Seeds_Chk(NotAllZero,gSeedArray);

      TestStep("Send key L1",TestStepIntervalTime);
      SID27_SecurityAccess_SendKey(L1,gKeyArray,PHYSICAL);
      CheckPosResponse_SID27_SenKey(L1,0,0);

      TestStep("Verify ExtendedSession.",TestStepIntervalTime);
      CheckCurrentSession(EXTENDEDSESSION,PHYSICAL,0,0);
    
      TestStep("The following test cases verify that server will relock after transitioning to same session");

      TestStep("Transition to ExtendedSession(0x03).",TestStepIntervalTime);
      SID10_DiagnosticSessionControl(EXTENDEDSESSION,PHYSICAL,SPRMIB_TRUE);
      CheckNonResponse(0,0);

      TestStep("Verify ExtendedSession.",TestStepIntervalTime);
      CheckCurrentSession(EXTENDEDSESSION,PHYSICAL,0,0);
    
      TestStep("Request seed L1",TestStepIntervalTime);
      SID27_SecurityAccess_RequestSeed(L1,PHYSICAL);
      CheckPosResponse_SID27_ReqSeed(L1,gSeedArray,16,0,0);
      if(levelToTestNumNow>=2)
      {
        TestStep("If more than one security level is implemented the following sequence will verify that a currently open security session will lock if an other level is open. ");
        TestStep("Request seed L1.",TestStepIntervalTime);
        SID27_SecurityAccess_RequestSeed(L1,PHYSICAL);
        CheckPosResponse_SID27_ReqSeed(L1,gSeedArray,16,0,0);
        PID27_Parameters_Seeds_Chk(NotAllZero,gSeedArray);

        TestStep("Send key L1",TestStepIntervalTime);
        SID27_SecurityAccess_SendKey(L1,gKeyArray,PHYSICAL);
        CheckPosResponse_SID27_SenKey(L1,0,0);
        
        TestStep("Request seed LX.",TestStepIntervalTime);
        SID27_SecurityAccess_RequestSeed(LX,PHYSICAL);
        CheckPosResponse_SID27_ReqSeed(LX,gSeedArray,16,0,0);
        PID27_Parameters_Seeds_Chk(NotAllZero,gSeedArray);

        TestStep("Send key LX",TestStepIntervalTime);
        SID27_SecurityAccess_SendKey(LX,gKeyArray,PHYSICAL);
        CheckPosResponse_SID27_SenKey(LX,0,0);
        
        TestStep("Request seed L1.",TestStepIntervalTime);
        SID27_SecurityAccess_RequestSeed(L1,PHYSICAL);
        CheckPosResponse_SID27_ReqSeed(L1,gSeedArray,16,0,0);
        PID27_Parameters_Seeds_Chk(NotAllZero,gSeedArray);
        
        TestStep("Verify ExtendedSession.",TestStepIntervalTime);
        CheckCurrentSession(EXTENDEDSESSION,PHYSICAL,0,0);
      }
      else 
      {
        TestStep("If only one security level is implemented jump to step 44. ",TestStepIntervalTime,44);
       
      }
   levelToTestNumNow--;
  }
  
  /******************************以上为测试步骤*********************************/
  Postcondition();
   
}
/// <APP_GeneralTest>
testcase Unsupported_Diagnostic_Service_Test_APP_Valid_Physical_DefaultSesion()
{
  int i,j,k;
  byte TestSD_service[1]= {0x00};
  int Flag,startFlag=0;
  int StartService;
  char logName[400] = "";
  char info[1024];
  byte expectNRC[2]={0x11,0x7F};
  byte SID28Sup=0,SID85Sup=0;
  
  strncat(logName,"1350979_Unsupported_Diagnostic_Service_Test_APP_Valid_Physical_DefaultSesion",400);
  testCaseDescription("To ensure that no other services is implemented than those in configured list.");
  testCaseTitle("1350979","Unsupported_Diagnostic_Service_Test_APP_Valid_Physical_DefaultSesion");
  
  SetLog(logName);
  Precondition();

  /******************************以下为测试步骤*********************************/

  if(gBusFlag!=3)
	{
    for(k=0;k<service_APP_Num;k++)
    {
      if(service_APP[k]==0x28)
        SID28Sup=1;
      if(service_APP[k]==0x85)
        SID85Sup=1;
    }
    if(SID28Sup!=1)
    {
      testStepFail("Fail","Service 0x28 expect support according SWRS,but not support in SDDB");
    }
    if(SID85Sup!=1)
    {
      testStepFail("Fail","Service 0x85 expect support according SWRS,but not support in SDDB");
    }
	}

  SessionFlag=APP;
  
  if(Flag_OBDNode == 1)
    StartService = 0x10;
  else
    StartService = 0x00;
  
  for(i=StartService; i<=0xFF; i++)
  {
    Flag = 0;
    
    if((i==0x10||i==0)&&startFlag==0)
    {
      startFlag=1;
      snprintf(info,elcount(info),"Let SV=%02x",StartService);
      TestStep(info,TestStepIntervalTime);
    }
    else
    {
      TestStep("If SV<0xFF add 1 to SV and jump to Step 2",TestStepIntervalTime,2);
    }
    
    for(j=0;j<service_APP_Num;j++)
    {
      if(service_APP[j] == i)
        Flag = 1;
    }
    if(Flag == 1)
    {
      TestStep("If SV equals a service from configured list jump to Step 4",TestStepIntervalTime,4);
      continue;
    }
      
    TestSD_service[0]=i;
    TestStep("Request unsupported service",TestStepIntervalTime);
    TPSendRawMessage(TestSD_service,PHYSICAL);
    CheckNegResponse(expectNRC,0,0,0,0);
  }
  TestStep("Verify defaultSession",TestStepIntervalTime);
  CheckCurrentSession(DEFAULTSESSION,PHYSICAL,0,0);
  /******************************以上为测试步骤*********************************/
  Postcondition();
}
/// <APP_GeneralTest>
testcase Unsupported_Diagnostic_Service_Test_APP_Valid_Functional_DefaultSesion()
{
  int i,j,k;
  byte TestSD_service[1]= {0x00};
  int Flag,startFlag=0;
  int StartService;
  char logName[400] = "";
  char info[1024];
  byte SID28Sup=0,SID85Sup=0;
  
  strncat(logName,"1350981_Unsupported_Diagnostic_Service_Test_APP_Valid_Functional_DefaultSesion",400);
  testCaseDescription("To ensure that no other services is implemented than those in configured list.");
  testCaseTitle("1350981","Unsupported_Diagnostic_Service_Test_APP_Valid_Functional_DefaultSesion");
  if(gBusFlag==3)
	{
		testStepWarning("Test","This test case does not apply to the LIN bus");
		return;
	}
  SetLog(logName);
  Precondition();

  /******************************以下为测试步骤*********************************/
  if(gBusFlag!=3)
	{
    for(k=0;k<service_APP_Num;k++)
    {
      if(service_APP[k]==0x28)
        SID28Sup=1;
      if(service_APP[k]==0x85)
        SID85Sup=1;
    }
    if(SID28Sup!=1)
    {
      testStepFail("Fail","Service 0x28 expect support according SWRS,but not support in SDDB");
    }
    if(SID85Sup!=1)
    {
      testStepFail("Fail","Service 0x85 expect support according SWRS,but not support in SDDB");
    }
	}
  
  SessionFlag=APP;
  
  if(Flag_OBDNode == 1)
    StartService = 0x10;
  else
    StartService = 0x00;
  
  for(i=StartService; i<=0xFF; i++)
  {
    Flag = 0;
    
    if((i==0x10||i==0)&&startFlag==0)
    {
      startFlag=1;
      snprintf(info,elcount(info),"Let SV=%02x",StartService);
      TestStep(info,TestStepIntervalTime);
    }
    else
    {
      TestStep("If SV<0xFF add 1 to SV and jump to Step 2",TestStepIntervalTime,2);
    }
    
    for(j=0;j<service_APP_Num;j++)
    {
      if(service_APP[j] == i)
        Flag = 1;
    }
    if(Flag == 1)
    {
      TestStep("If SV equals a service from configured list jump to Step 4",TestStepIntervalTime,4);
      continue;
    }
    
    TestSD_service[0]=i;
    TestStep("Request unsupported service",TestStepIntervalTime);
    TPSendRawMessage(TestSD_service,FUNCTIONAL);
    CheckNonResponse(0,0);
  }
  TestStep("Verify defaultSession",TestStepIntervalTime);
  CheckCurrentSession(DEFAULTSESSION,PHYSICAL,0,0);
  /******************************以上为测试步骤*********************************/
  Postcondition();
   
}
/// <APP_GeneralTest>
testcase Unsupported_Diagnostic_Service_Test_APP_Valid_Physical_ExtendedSesion()
{
  int i,j,k;
  byte TestSD_service[1]= {0x00};
  int Flag,startFlag=0;
  int StartService;
  char logName[400] = "";
  char info[1024];
  byte expectNRC[2]={0x11,0x7F};
  byte SID28Sup=0,SID85Sup=0;
  
  strncat(logName,"1350980_Unsupported_Diagnostic_Service_Test_APP_Valid_Physical_ExtendedSesion",400);
  testCaseDescription("To ensure that no other services is implemented than those in configured list.");
  testCaseTitle("1350980","Unsupported_Diagnostic_Service_Test_APP_Valid_Physical_ExtendedSesion");
  
  SetLog(logName);
  Precondition();

  /******************************以下为测试步骤*********************************/
  if(gBusFlag!=3)
	{
    for(k=0;k<service_APP_Num;k++)
    {
      if(service_APP[k]==0x28)
        SID28Sup=1;
      if(service_APP[k]==0x85)
        SID85Sup=1;
    }
    if(SID28Sup!=1)
    {
      testStepFail("Fail","Service 0x28 expect support according SWRS,but not support in SDDB");
    }
    if(SID85Sup!=1)
    {
      testStepFail("Fail","Service 0x85 expect support according SWRS,but not support in SDDB");
    }
	}
  
  SessionFlag=APP;
  
  TestStep("Transition from defaultSession(0x01) to extendedDiagnosticSession(0x03).",TestStepIntervalTime);
  SID10_DiagnosticSessionControl(EXTENDEDSESSION,PHYSICAL,SPRMIB_FALSE);
  CheckPosResponse_SID10(EXTENDEDSESSION,gP2Client_APP,gP2StarClientFor10Check,0,0);
  TestStep("Verify extendedDiagnosticSession.",TestStepIntervalTime);
  CheckCurrentSession(EXTENDEDSESSION,PHYSICAL,0,0);
  
  if(Flag_OBDNode == 1)
    StartService = 0x10;
  else
    StartService = 0x00;
  
  for(i=StartService; i<=0xFF; i++)
  {
    Flag = 0;
    
    if((i==0x10||i==0)&&startFlag==0)
    {
      startFlag=1;
      snprintf(info,elcount(info),"Let SV=%02x",StartService);
      TestStep(info,TestStepIntervalTime);
    }
    else
    {
      TestStep("If SV<0xFF add 1 to SV and jump to Step 2",TestStepIntervalTime,2);
    }
    
    for(j=0;j<service_APP_Num;j++)
    {
      if(service_APP[j] == i)
        Flag = 1;
    }
    if(Flag == 1)
    {
      TestStep("If SV equals a service from configured list jump to Step 4",TestStepIntervalTime,4);
      continue;
    }
    TestSD_service[0]=i;
    TestStep("Request unsupported service",TestStepIntervalTime);
    TPSendRawMessage(TestSD_service,PHYSICAL);
    CheckNegResponse(expectNRC,0,0,0,0);
  }
  TestStep("Verify extendedSession",TestStepIntervalTime);
  CheckCurrentSession(EXTENDEDSESSION,PHYSICAL,0,0);
  /******************************以上为测试步骤*********************************/
  Postcondition();
   
}
/// <APP_GeneralTest>
testcase Unsupported_Diagnostic_Service_Test_APP_Valid_Functional_ExtendedSesion()
{
  int i,j,k;
  byte TestSD_service[1]= {0x00};
  int Flag,startFlag=0;
  int StartService;
  char logName[400] = "";
  char info[1024];
  byte SID28Sup=0,SID85Sup=0;
  
  strncat(logName,"1350982_Unsupported_Diagnostic_Service_Test_APP_Valid_Functional_ExtendedSesion",400);
  testCaseDescription("To ensure that no other services is implemented than those in configured list.");
  testCaseTitle("1350982","Unsupported_Diagnostic_Service_Test_APP_Valid_Functional_ExtendedSesion");
  if(gBusFlag==3)
	{
		testStepWarning("Test","This test case does not apply to the LIN bus");
		return;
	}
  SetLog(logName);
  Precondition();

  /******************************以下为测试步骤*********************************/
  if(gBusFlag!=3)
	{
    for(k=0;k<service_APP_Num;k++)
    {
      if(service_APP[k]==0x28)
        SID28Sup=1;
      if(service_APP[k]==0x85)
        SID85Sup=1;
    }
    if(SID28Sup!=1)
    {
      testStepFail("Fail","Service 0x28 expect support according SWRS,but not support in SDDB");
    }
    if(SID85Sup!=1)
    {
      testStepFail("Fail","Service 0x85 expect support according SWRS,but not support in SDDB");
    }
	}
  
  SessionFlag=APP;
  
  TestStep("Transition from defaultSession(0x01) to extendedDiagnosticSession(0x03).",TestStepIntervalTime);
  SID10_DiagnosticSessionControl(EXTENDEDSESSION,PHYSICAL,SPRMIB_FALSE);
  CheckPosResponse_SID10(EXTENDEDSESSION,gP2Client_APP,gP2StarClientFor10Check,0,0);
  TestStep("Verify extendedDiagnosticSession.",TestStepIntervalTime);
  CheckCurrentSession(EXTENDEDSESSION,PHYSICAL,0,0);
  
  if(Flag_OBDNode == 1)
    StartService = 0x10;
  else
    StartService = 0x00;
  
  for(i=StartService; i<=0xFF; i++)
  {
    Flag = 0;
    
    if((i==0x10||i==0)&&startFlag==0)
    {
      startFlag=1;
      snprintf(info,elcount(info),"Let SV=%02x",StartService);
      TestStep(info,TestStepIntervalTime);
    }
    else
    {
      TestStep("If SV<0xFF add 1 to SV and jump to Step 2",TestStepIntervalTime,2);
    }
    
    for(j=0;j<service_APP_Num;j++)
    {
      if(service_APP[j] == i)
        Flag = 1;
    }
    if(Flag == 1)
    {
      TestStep("If SV equals a service from configured list jump to Step 4",TestStepIntervalTime,4);
      continue;
    }
    TestSD_service[0]=i;
    TestStep("Request unsupported service",TestStepIntervalTime);
    TPSendRawMessage(TestSD_service,FUNCTIONAL);
    CheckNonResponse(0,0);
  }
  TestStep("Verify extendedSession",TestStepIntervalTime);
  CheckCurrentSession(EXTENDEDSESSION,PHYSICAL,0,0);
  /******************************以上为测试步骤*********************************/
  Postcondition();
   
}
/// <APP_GeneralTest>
testcase Unsupported_Diagnostic_Subfunction_Test_APP_Valid_Physical_DefaultSession()
{
  int  i;
  byte data[2]={0x3e,0x01};
  byte ExpectNRC[2]={0x12,0x7E};
  char logName[400] = "";
  char info[1024];
  
  strncat(logName,"1350983_Unsupported_Diagnostic_Subfunction_Test_APP_Valid_Physical_DefaultSession",400);
  testCaseDescription("To see if correct NRC is implemented.");
  testCaseTitle("1350983","Unsupported_Diagnostic_Subfunction_Test_APP_DefaultSession_Physical");
  
  SetLog(logName);
  Precondition();

  /******************************以下为测试步骤*********************************/
  
  SessionFlag=APP;
  
  for(i=1; i<=0xFF; i++)
  {
    if(i==1)
    {
      TestStep("Let SF=00",TestStepIntervalTime);
    }
    else
    {
      TestStep("If SF<0xFF add 1 to SF and jump to Step 2",TestStepIntervalTime,2);
    }
    
    if(i!=0x80)
    {
      data[1]=i;
    }
    else
    {
      TestStep("If SF equals a subfunction supported to service 0x3E from configured list jump to Step 4",TestStepIntervalTime,4);
    }
    TestStep("Send service 0x3E with unsupported subfunction",TestStepIntervalTime);
    TPSendRawMessage(data,PHYSICAL);
    CheckNegResponse(ExpectNRC,0,0,0,0);
  }
  TestStep("Verify defaultSession",TestStepIntervalTime);
  CheckCurrentSession(DEFAULTSESSION,PHYSICAL,0,0);
  /******************************以上为测试步骤*********************************/
  Postcondition();
   
}

/// <APP_GeneralTest>
testcase Unsupported_Diagnostic_Subfunction_Test_APP_Valid_Functional_DefaultSession()
{
  int  i;
  byte data[2]={0x3e,0x01};
  byte ExpectNRC[2]={0x12,0x7E};
  char logName[400] = "";
  char info[1024];
  
  strncat(logName,"1350985_Unsupported_Diagnostic_Subfunction_Test_APP_Valid_Physical_DefaultSession",400);
  testCaseDescription("To see if correct NRC is implemented.");
  testCaseTitle("1350985","Unsupported_Diagnostic_Subfunction_Test_APP_Valid_Functional_DefaultSession");
  if(gBusFlag==3)
	{
		testStepWarning("Test","This test case does not apply to the LIN bus");
		return;
	}
  SetLog(logName);
  Precondition();

  /******************************以下为测试步骤*********************************/
  
  SessionFlag=APP;
  
  for(i=1; i<=0xFF; i++)
  {
    if(i==1)
    {
      TestStep("Let SF=00",TestStepIntervalTime);
    }
    else
    {
      TestStep("If SF<0xFF add 1 to SF and jump to Step 2",TestStepIntervalTime,2);
    }
    if(i!=0x80)
    {
      data[1]=i;
    }
    else
    {
      TestStep("If SF equals a subfunction supported to service 0x3E from configured list jump to Step 4",TestStepIntervalTime,4);
    }
    TestStep("Send service 0x3E with unsupported subfunction",TestStepIntervalTime);
    TPSendRawMessage(data,FUNCTIONAL);
    CheckNonResponse(0,0);
  }
  TestStep("Verify defaultSession",TestStepIntervalTime);
  CheckCurrentSession(DEFAULTSESSION,PHYSICAL,0,0);
  /******************************以上为测试步骤*********************************/
  Postcondition();
}
/// <APP_GeneralTest>
testcase Unsupported_Diagnostic_Subfunction_Test_APP_Valid_Physical_ExtendedSession()
{
  int  i;
  byte data[2]={0x3e,0x01};
  byte ExpectNRC[2]={0x12,0x7E};
  char logName[400] = "";
  char info[1024];
  
  strncat(logName,"1350984_Unsupported_Diagnostic_Subfunction_Test_APP_Valid_Physical_ExtendedSession",400);
  testCaseDescription("To see if correct NRC is implemented.");
  testCaseTitle("1350984","Unsupported_Diagnostic_Subfunction_Test_APP_Valid_Physical_ExtendedSession");
  
  SetLog(logName);
  Precondition();

  /******************************以下为测试步骤*********************************/
  
  SessionFlag=APP;
  
  TestStep("Transition from defaultSession(0x01) to extendedDiagnosticSession(0x03).",TestStepIntervalTime);
  SID10_DiagnosticSessionControl(EXTENDEDSESSION,PHYSICAL,SPRMIB_FALSE);
  CheckPosResponse_SID10(EXTENDEDSESSION,gP2Client_APP,gP2StarClientFor10Check,0,0);
  TestStep("Verify extendedDiagnosticSession.",TestStepIntervalTime);
  CheckCurrentSession(EXTENDEDSESSION,PHYSICAL,0,0);
  for(i=1; i<=0xFF; i++)
  {
    if(i==1)
    {
      TestStep("Let SF=00",TestStepIntervalTime);
    }
    else
    {
      TestStep("If SF<0xFF add 1 to SF and jump to Step 2",TestStepIntervalTime,2);
    }
    if(i!=0x80)
    {
      data[1]=i;
    }
    else
    {
      TestStep("If SF equals a subfunction supported to service 0x3E from configured list jump to Step 4",TestStepIntervalTime,4);
    }
    TestStep("Send service 0x3E with unsupported subfunction",TestStepIntervalTime);
    TPSendRawMessage(data,PHYSICAL);
    CheckNegResponse(ExpectNRC,0,0,0,0);
  }
  TestStep("Verify extendedDiagnosticSession.",TestStepIntervalTime);
  CheckCurrentSession(EXTENDEDSESSION,PHYSICAL,0,0);
  /******************************以上为测试步骤*********************************/
  Postcondition();
   
}
/// <APP_GeneralTest>
testcase Unsupported_Diagnostic_Subfunction_Test_APP_Valid_Functional_ExtendedSession()
{
  int  i;
  byte data[2]={0x3e,0x01};
  byte ExpectNRC[2]={0x12,0x7E};
  char logName[400] = "";
  char info[1024];
  
  strncat(logName,"1350986_Unsupported_Diagnostic_Subfunction_Test_APP_Valid_Functional_ExtendedSession",400);
  testCaseDescription("To see if correct NRC is implemented.");
  testCaseTitle("1350986","Unsupported_Diagnostic_Subfunction_Test_APP_Valid_Functional_ExtendedSession");
  
  if(gBusFlag==3)
	{
		testStepWarning("Test","This test case does not apply to the LIN bus");
		return;
	}
  SetLog(logName);
  Precondition();

  /******************************以下为测试步骤*********************************/
  SessionFlag=APP;
  
  TestStep("Transition from defaultSession(0x01) to extendedDiagnosticSession(0x03).",TestStepIntervalTime);
  SID10_DiagnosticSessionControl(EXTENDEDSESSION,PHYSICAL,SPRMIB_FALSE);
  CheckPosResponse_SID10(EXTENDEDSESSION,gP2Client_APP,gP2StarClientFor10Check,0,0);
  TestStep("Verify extendedDiagnosticSession.",TestStepIntervalTime);
  CheckCurrentSession(EXTENDEDSESSION,PHYSICAL,0,0);
  for(i=1; i<=0xFF; i++)
  {
    if(i==1)
    {
      TestStep("Let SF=00",TestStepIntervalTime);
    }
    else
    {
      TestStep("If SF<0xFF add 1 to SF and jump to Step 2",TestStepIntervalTime,2);
    }
    if(i!=0x80)
    {
      data[1]=i;
    }
    else
    {
      TestStep("If SF equals a subfunction supported to service 0x3E from configured list jump to Step 4",TestStepIntervalTime,4);
    }
    TestStep("Send service 0x3E with unsupported subfunction",TestStepIntervalTime);
    TPSendRawMessage(data,FUNCTIONAL);
    CheckNonResponse(0,0);
  }
  TestStep("Verify extendedDiagnosticSession.",TestStepIntervalTime);
  CheckCurrentSession(EXTENDEDSESSION,PHYSICAL,0,0);
  /******************************以上为测试步骤*********************************/
  Postcondition();

}

/// <APP_GeneralTest>
testcase Read_Multiple_DataIdentifiers_Test_Valid_Physical_DefaultSession()
{
  byte MulDID[41]= {0x22,0xF1,0x86,0xF1,0x86,0xF1,0x86,0xF1,0x86,0xF1,0x86,0xF1,0x86,0xF1,0x86,0xF1,0x86,0xF1,0x86,0xF1,0x86,0xF1,0x86,0xF1,0x86,0xF1,0x86,0xF1,0x86,0xF1,0x86,0xF1,0x86,0xF1,0x86,0xF1,0x86,0xF1,0x86,0xF1,0x86};
  char logName[400] = "";
  char info[1024];
  
  strncat(logName,"1350991_Read_Multiple_DataIdentifiers_Test_Valid_Physical_DefaultSession",400);
  testCaseDescription("The intent of the test is to verify that multiple number of data identifiers can be readout with the service ReadDataByIdentifier (0x22)");
  testCaseTitle("1350991","Read_Multiple_DataIdentifiers_Test_Valid_Physical_DefaultSession");
  
  SetLog(logName);
  Precondition();

  /******************************以下为测试步骤*********************************/
  
  SessionFlag=APP;
  
  TestStep("Request multiple DIDs",TestStepIntervalTime);
  if(gMaxNumberOfDIDsForReadDID_Default < 20)
  {
  TPSendRawMessage(MulDID,((gMaxNumberOfDIDsForReadDID_Default*2)+1),PHYSICAL);
  CheckPosResponse(0x22,((gMaxNumberOfDIDsForReadDID_Default*3)+1),0,0);
  }
  else
  {
    TPSendRawMessage(MulDID,((20*2)+1),PHYSICAL);
    CheckPosResponse(0x22,((20*3)+1),0,0);
  }
  TestStep("Verify defaultSession",TestStepIntervalTime);
  CheckCurrentSession(DEFAULTSESSION,PHYSICAL,0,0);
  /******************************以上为测试步骤*********************************/
  Postcondition();
}

/// <APP_GeneralTest>
testcase Read_Multiple_DataIdentifiers_Test_Valid_Physical_ExtendedSession()
{
  byte MulDID[41]= {0x22,0xF1,0x86,0xF1,0x86,0xF1,0x86,0xF1,0x86,0xF1,0x86,0xF1,0x86,0xF1,0x86,0xF1,0x86,0xF1,0x86,0xF1,0x86,0xF1,0x86,0xF1,0x86,0xF1,0x86,0xF1,0x86,0xF1,0x86,0xF1,0x86,0xF1,0x86,0xF1,0x86,0xF1,0x86,0xF1,0x86};
  char logName[400] = "";
  char info[1024];
  
  strncat(logName,"1350992_Read_Multiple_DataIdentifiers_Test_Valid_Physical_ExtendedSession",400);
  testCaseDescription("");
  testCaseTitle("1350992","Read_Multiple_DataIdentifiers_Test_Valid_Physical_ExtendedSession");
  
  SetLog(logName);
  Precondition();

  /******************************以下为测试步骤*********************************/
  
  SessionFlag=APP;
  
  TestStep("Transition from defaultSession(0x01) to extendedDiagnosticSession(0x03).",TestStepIntervalTime);
  SID10_DiagnosticSessionControl(EXTENDEDSESSION,PHYSICAL,SPRMIB_FALSE);
  CheckPosResponse_SID10(EXTENDEDSESSION,gP2Client_APP,gP2StarClientFor10Check,0,0);
  TestStep("Verify extendedDiagnosticSession.",TestStepIntervalTime);
  CheckCurrentSession(EXTENDEDSESSION,PHYSICAL,0,0);
  TestStep("Request multiple DIDs",TestStepIntervalTime);
  if(gMaxNumberOfDIDsForReadDID_Extended < 20)
  {
  TPSendRawMessage(MulDID,((gMaxNumberOfDIDsForReadDID_Extended*2)+1),PHYSICAL);
  CheckPosResponse(0x22,((gMaxNumberOfDIDsForReadDID_Extended*3)+1),0,0);
  }
  else
  {
    TPSendRawMessage(MulDID,((20*2)+1),PHYSICAL);
    CheckPosResponse(0x22,((20*3)+1),0,0);
  }
  TestStep("Verify extendedDiagnosticSession.",TestStepIntervalTime);
  CheckCurrentSession(EXTENDEDSESSION,PHYSICAL,0,0);
  /******************************以上为测试步骤*********************************/
  Postcondition();
   
}
/// <APP_GeneralTest>
testcase ECU_Identification_Verification_Test_Physical_Allsession()
{
  #pragma warning(disable: 2058)
  int  i=0,j=0;
  byte PID[2];
  char logName[400] = "";
  char info[1024];
  struct Identifier{
    word DID;
    byte sessionFlag;//1-app,2-boot,3-all
    byte dataLen[3];//0-default,1-extend,2-boot
    byte dataRecord[3][255];//0-default,1-extend,2-boot
    byte readRsult[3];//0-default,1-extend,2-boot
  };
  const int didNum=15;
  struct Identifier ECU_Identifier[didNum]={
    {0xF1A1,2,{8,8,8}},
    {0xF121,2,{7,7,7}},
    {0xF1A5,2,{8,8,8}},
    {0xF125,2,{7,7,7}},
    {0xF1AA,3,{8,8,8}},
    {0xF12A,3,{7,7,7}},
    {0xF1AB,3,{8,8,8}},
    {0xF12B,3,{7,7,7}},
    {0xF18A,3,{6,6,6}},
    {0xF18C,3,{4,4,4}},
    {0xED20,3,{0xFF,0xFF,0xFF}},
    {0xEDA0,3,{0xFF,0xFF,0xFF}},
    {0xF1A0,1,{8,8,8}},
    {0xF1AE,1,{0xFF,0xFF,0xFF}},
    {0xF12E,1,{0XFF,0XFF,0XFF}}
  };
  int compareResult1=0;//default会话与extend会话对比结果
  int compareResult2=0;//boot与app会话对比结果
  
  char inputchar[500];
  char tempstr[5];
  byte F18A[6];
  
  strncat(logName,"1350993_ECU_Identification_Verification_Test_Physical_Allsession",400);
  testCaseDescription("ECU supports ECU mandatory identification dataidentifiers (DIDs).ECU responds with negative response code (NRC) to dataidentifiers not supported.");
  testCaseTitle("1350993","ECU_Identification_Verification_Test_Physical_Allsession");

  SetLog(logName);
  Precondition();

  /******************************以下为测试步骤*********************************/  
  
  SessionFlag=APP;

  //DefaultSession
  SID10_DiagnosticSessionControl(DEFAULTSESSION,PHYSICAL,SPRMIB_FALSE);
  CheckPosResponse_SID10(DEFAULTSESSION,gP2Client_APP,gP2StarClientFor10Check,0,0);
  CheckCurrentSession(DEFAULTSESSION,PHYSICAL,0,0);
  for(i=0;i<didNum;i++)
  {
    if(ECU_Identifier[i].sessionFlag==1||ECU_Identifier[i].sessionFlag==3)
    {
      
    }
    else   
    {
      continue;
    }
    PID[0]=ECU_Identifier[i].DID>>8;
    PID[1]=ECU_Identifier[i].DID&0xFF;
    
    TestStep("Request DID:",TestStepIntervalTime);
    SID22_ReadDataByIdentifier(PID,PHYSICAL);
    if(ECU_Identifier[i].dataLen[0]!=0xFF)
    {
      if(CheckPosResponse_SID22(PID,ECU_Identifier[i].dataLen[0],0,0)>0)
      {
        ECU_Identifier[i].dataLen[0]=gTpRxLength-3;
        for(j=0;j<ECU_Identifier[i].dataLen[0];j++)
        {
          ECU_Identifier[i].dataRecord[0][j]=gTpRxData[j+3];
        }
        ECU_Identifier[i].readRsult[0]=1;
      }
      else
      {
        teststepfail("Fail","Fail to read did:%x",ECU_Identifier[i].DID);
        ECU_Identifier[i].readRsult[0]=0;
      }
    }
    else
    {
      if(CheckPosResponse(0x22,0,0)>0)
      {
        ECU_Identifier[i].dataLen[0]=gTpRxLength-3;
        for(j=0;j<ECU_Identifier[i].dataLen[0];j++)
        {
          ECU_Identifier[i].dataRecord[0][j]=gTpRxData[j+3];
        }
        ECU_Identifier[i].readRsult[0]=1;
      }
      else
      {
        teststepfail("Fail","Fail to read did:%x",ECU_Identifier[i].DID);
        ECU_Identifier[i].readRsult[0]=0;
      }
    }
  }
  //DefaultSession
  
  //ExtendedSession
  SID10_DiagnosticSessionControl(EXTENDEDSESSION,PHYSICAL,SPRMIB_FALSE);
  CheckPosResponse_SID10(EXTENDEDSESSION,gP2Client_APP,gP2StarClientFor10Check,0,0);
  CheckCurrentSession(EXTENDEDSESSION,PHYSICAL,0,0);
  for(i=0;i<didNum;i++)
  {
    if(ECU_Identifier[i].sessionFlag==1||ECU_Identifier[i].sessionFlag==3)
    {
      
    }
    else   
    {
      continue;
    }
    PID[0]=ECU_Identifier[i].DID>>8;
    PID[1]=ECU_Identifier[i].DID&0xFF;
    
    TestStep("Request DID:",TestStepIntervalTime);
    SID22_ReadDataByIdentifier(PID,PHYSICAL);
    if(ECU_Identifier[i].dataLen[1]!=0xFF)
    {
      if(CheckPosResponse_SID22(PID,ECU_Identifier[i].dataLen[1],0,0)>0)
      {
        ECU_Identifier[i].dataLen[1]=gTpRxLength-3;
        for(j=0;j<ECU_Identifier[i].dataLen[1];j++)
        {
          ECU_Identifier[i].dataRecord[1][j]=gTpRxData[j+3];
        }
        ECU_Identifier[i].readRsult[1]=1;
      }
      else
      {
        teststepfail("Fail","Fail to read did:%x",ECU_Identifier[i].DID);
        ECU_Identifier[i].readRsult[1]=0;
      }
    }
    else
    {
      if(CheckPosResponse(0x22,0,0)>0)
      {
        ECU_Identifier[i].dataLen[1]=gTpRxLength-3;
        for(j=0;j<ECU_Identifier[i].dataLen[0];j++)
        {
          ECU_Identifier[i].dataRecord[1][j]=gTpRxData[j+3];
        }
        ECU_Identifier[i].readRsult[1]=1;
      }
      else
      {
        teststepfail("Fail","Fail to read did:%x",ECU_Identifier[i].DID);
        ECU_Identifier[i].readRsult[1]=0;
      }
    }
  }
  //ExtendedSession
  
  //ProgrammingSession
  SessionFlag=BOOT;
  SID10_DiagnosticSessionControl(PROGRAMMINGSESSION,PHYSICAL,SPRMIB_FALSE);
  CheckPosResponse_SID10(PROGRAMMINGSESSION,gP2Client_BOOT,gP2StarClientFor10Check,0,0);
  ECUinitHandle(0);
  CheckCurrentSession(PROGRAMMINGSESSION,PHYSICAL,0,0);
  for(i=0;i<didNum;i++)
  {
    if(ECU_Identifier[i].sessionFlag==2||ECU_Identifier[i].sessionFlag==3)
    {
      
    }
    else   
    {
      continue;
    }
    PID[0]=ECU_Identifier[i].DID>>8;
    PID[1]=ECU_Identifier[i].DID&0xFF;
    
    TestStep("Request DID:",TestStepIntervalTime);
    SID22_ReadDataByIdentifier(PID,PHYSICAL);
    if(ECU_Identifier[i].dataLen[2]!=0xFF)
    {
      if(CheckPosResponse_SID22(PID,ECU_Identifier[i].dataLen[2],0,0)>0)
      {
        ECU_Identifier[i].dataLen[2]=gTpRxLength-3;
        for(j=0;j<ECU_Identifier[i].dataLen[2];j++)
        {
          ECU_Identifier[i].dataRecord[2][j]=gTpRxData[j+3];
        }
        ECU_Identifier[i].readRsult[2]=1;
      }
      else
      {
        teststepfail("Fail","Fail to read did:%x",ECU_Identifier[i].DID);
        ECU_Identifier[i].readRsult[2]=0;
      }
    }
    else
    {
      if(CheckPosResponse(0x22,0,0)>0)
      {
        ECU_Identifier[i].dataLen[2]=gTpRxLength-3;
        for(j=0;j<ECU_Identifier[i].dataLen[2];j++)
        {
          ECU_Identifier[i].dataRecord[2][j]=gTpRxData[j+3];
        }
        ECU_Identifier[i].readRsult[2]=1;
      }
      else
      {
        teststepfail("Fail","Fail to read did:%x",ECU_Identifier[i].DID);
        ECU_Identifier[i].readRsult[2]=0;
      }
    }
  }
  //ProgrammingSession
  
  //Compare
  
  for(i=0;i<didNum;i++)
  {
    if(ECU_Identifier[i].sessionFlag==3)
    {
      Teststep("Info","DID_%x_Data:",ECU_Identifier[i].DID);
      if(ECU_Identifier[i].readRsult[0]==1)
      {
        PrintPID("Info","DefaultSession:",ECU_Identifier[i].dataRecord[0],ECU_Identifier[i].dataLen[0]);
      }
      else
      {
        TestStep("Info","DefaultSession:Read Fail");
      }
      if(ECU_Identifier[i].readRsult[1]==1)
      {
        PrintPID("Info","Extend Session:",ECU_Identifier[i].dataRecord[1],ECU_Identifier[i].dataLen[1]);
      }
      else
      {
        TestStep("Info","Extend Session:Read Fail");
      }
      if(ECU_Identifier[i].readRsult[2]==1)
      {
        PrintPID("Info","ProgramSession:",ECU_Identifier[i].dataRecord[2],ECU_Identifier[i].dataLen[2]);
      }
      else
      {
        TestStep("Info","ProgramSession:Read Fail");
      }
      compareResult1=CompareByte(ECU_Identifier[i].dataRecord[0],ECU_Identifier[i].dataRecord[1],ECU_Identifier[i].dataLen[0]);
      compareResult2=CompareByte(ECU_Identifier[i].dataRecord[1],ECU_Identifier[i].dataRecord[2],ECU_Identifier[i].dataLen[1]);
      if(ECU_Identifier[i].DID == 0xED20 || ECU_Identifier[i].DID == 0xEDA0) //0xED20和0xEDA0特殊处理，APP和BOOT下数据需要不一致
      {
        if(compareResult1==2) { TeststepPass("Pass","The value of DID:%x are same between DefaultSession and ExtendedSession :",ECU_Identifier[i].DID); }
        else                  { TeststepFail("Fail","The value of DID:%x are different between DefaultSession and ExtendedSession :",ECU_Identifier[i].DID); }
        if(compareResult2==2) { TeststepFail("Fail","The value of DID:%x are same between APP and Boot :",ECU_Identifier[i].DID); }
        //else                  { TeststepPass("Fail","The value of DID:%x are different between APP and Boot :",ECU_Identifier[i].DID); }
      }
      else
      {
        if(compareResult1==2)
        {
          TeststepPass("Pass","The value of DID:%x are same between DefaultSession and ExtendedSession :",ECU_Identifier[i].DID);
        }
        else
        {
          TeststepFail("Fail","The value of DID:%x are different between DefaultSession and ExtendedSession :",ECU_Identifier[i].DID);
        }
        if(compareResult2==2)
        {
          TeststepPass("Pass","The value of DID:%x are same between APP and Boot :",ECU_Identifier[i].DID);
        }
        else
        {
          TeststepFail("Fail","The value of DID:%x are different between APP and Boot :",ECU_Identifier[i].DID);
        }
      }
    }
    else if(ECU_Identifier[i].sessionFlag==1)
    {
      Teststep("Info","DID_%x_Data:",ECU_Identifier[i].DID);
      if(ECU_Identifier[i].readRsult[0]==1)
      {
        PrintPID("Info","DefaultSession:",ECU_Identifier[i].dataRecord[0],ECU_Identifier[i].dataLen[0]);
      }
      else
      {
        TestStep("Info","DefaultSession:Read Fail");
      }
      if(ECU_Identifier[i].readRsult[1]==1)
      {
        PrintPID("Info","Extend Session:",ECU_Identifier[i].dataRecord[1],ECU_Identifier[i].dataLen[1]);
      }
      else
      {
        TestStep("Info","Extend Session:Read Fail");
      }
      compareResult1=CompareByte(ECU_Identifier[i].dataRecord[0],ECU_Identifier[i].dataRecord[1],ECU_Identifier[i].dataLen[0]);
      if(compareResult1==2)
      {
        TeststepPass("Pass","The value of DID:%x are same between DefaultSession and ExtendedSession :",ECU_Identifier[i].DID);
      }
      else
      {
        TeststepFail("Fail","The value of DID:%x are different between DefaultSession and ExtendedSession :",ECU_Identifier[i].DID);
      }
    }
    else if(ECU_Identifier[i].sessionFlag==2)
    {
      Teststep("Info","DID:%x is only supported in programmingsession,not need to be compared",ECU_Identifier[i].DID);
    }
  }
  //Compare

  if(strlen(F18AValue)==0)// 这里改为由strlen判断长度
  {
  	if(1==testWaitForStringInput("Please input F18A(System Supplier Identifier,HEX 格式如供应商代码123456，请先将ascii转换为16进制，输入313233343536) ExpectValue:"))
  	{
  		testGetStringInput(inputchar,elcount(inputchar));

  		str_replace(inputchar," ","");
  		str_replace(inputchar,",","");
  		str_replace(inputchar,"0x","");
  		str_replace(inputchar,"0X","");
  		str_replace(inputchar,":","");

  		if(strlen(inputchar)!=12)
  		{
        testStepFail("Error","Length of the input F18A(System Supplier Identifier) is not correct,skip check F18A Value.");
        testWaitForTesterConfirmation("Length of the input F18A(System Supplier Identifier) is not correct,skip this testcase.");
        Postcondition(); 
        return;
  		}

  		tempstr[0] = '0';
  		tempstr[1] = 'x';
      
  		for(i=0; 2*i<strlen(inputchar); i++)
  		{
  			tempstr[2] = inputchar[2*i];
  			tempstr[3] = inputchar[2*i+1];
  			tempstr[4] = 0;
  			F18A[i] = atol(tempstr);
  		}
      for(i=0;i<didNum;i++)
      {
        if(ECU_Identifier[i].DID==0xF18A)
          Break;
      }
      PrintPID("Info","F18A defaultsession:",ECU_Identifier[i].dataRecord[0],ECU_Identifier[i].dataLen[0]);
      PrintPID("Info","F18A extendsession:",ECU_Identifier[i].dataRecord[1],ECU_Identifier[i].dataLen[1]);
      PrintPID("Info","F18A programmingsession:",ECU_Identifier[i].dataRecord[2],ECU_Identifier[i].dataLen[2]);
      PrintPID("Info","F18A expected:",F18A,ECU_Identifier[i].dataLen[0]);
      
      compareResult1=CompareByte(F18A,ECU_Identifier[i].dataRecord[0],ECU_Identifier[i].dataLen[0]);
      if(compareResult1!=2)
      {
        testStepFail("Fail","F18A defaultsession mismatech expected");
      }
      compareResult1=CompareByte(F18A,ECU_Identifier[i].dataRecord[1],ECU_Identifier[i].dataLen[1]);
      if(compareResult1!=2)
      {
        testStepFail("Fail","F18A extendsession mismatech expected");
      }
      compareResult1=CompareByte(F18A,ECU_Identifier[i].dataRecord[2],ECU_Identifier[i].dataLen[2]);
      if(compareResult1!=2)
      {
        testStepFail("Fail","F18A programmingsession mismatech expected");
      }
  	}
  }
  else
  {
//  		testGetStringInput(F18AValue,elcount(F18AValue));

  		str_replace(F18AValue," ","");
  		str_replace(F18AValue,",","");
  		str_replace(F18AValue,"0x","");
  		str_replace(F18AValue,"0X","");
  		str_replace(F18AValue,":","");

  		if(strlen(F18AValue)!=12)
  		{
        testStepFail("Error","Length of the input F18A(System Supplier Identifier) is not correct,skip check F18A Value.");
//        testWaitForTesterConfirmation("Length of the input F18A(System Supplier Identifier) is not correct,skip this testcase.");
        Postcondition(); 
        return;
  		}

  		tempstr[0] = '0';
  		tempstr[1] = 'x';
      
  		for(i=0; 2*i<strlen(F18AValue); i++)
  		{
  			tempstr[2] = F18AValue[2*i];
  			tempstr[3] = F18AValue[2*i+1];
  			tempstr[4] = 0;
  			F18A[i] = atol(tempstr);
  		}
      for(i=0;i<didNum;i++)
      {
        if(ECU_Identifier[i].DID==0xF18A)
          Break;
      }
      PrintPID("Info","F18A defaultsession:",ECU_Identifier[i].dataRecord[0],ECU_Identifier[i].dataLen[0]);
      PrintPID("Info","F18A extendsession:",ECU_Identifier[i].dataRecord[1],ECU_Identifier[i].dataLen[1]);
      PrintPID("Info","F18A programmingsession:",ECU_Identifier[i].dataRecord[2],ECU_Identifier[i].dataLen[2]);
      PrintPID("Info","F18A expected:",F18A,ECU_Identifier[i].dataLen[0]);
      
      compareResult1=CompareByte(F18A,ECU_Identifier[i].dataRecord[0],ECU_Identifier[i].dataLen[0]);
      if(compareResult1!=2)
      {
        testStepFail("Fail","F18A defaultsession mismatech expected");
      }
      compareResult1=CompareByte(F18A,ECU_Identifier[i].dataRecord[1],ECU_Identifier[i].dataLen[1]);
      if(compareResult1!=2)
      {
        testStepFail("Fail","F18A extendsession mismatech expected");
      }
      compareResult1=CompareByte(F18A,ECU_Identifier[i].dataRecord[2],ECU_Identifier[i].dataLen[2]);
      if(compareResult1!=2)
      {
        testStepFail("Fail","F18A programmingsession mismatech expected");
      }
  }
  
  /******************************以上为测试步骤*********************************/
  Postcondition(); 
}
/// <APP_GeneralTest>
testcase ECU_Identification_Verification_Test_Functional_Allsession()
{
  #pragma warning(disable: 2058)
  int  i=0,j=0;
  byte PID[2];
  char logName[400] = "";
  char info[1024];
  struct Identifier{
    word DID;
    byte sessionFlag;//1-app,2-boot,3-all
    byte dataLen[3];//0-default,1-extend,2-boot
    byte dataRecord[3][255];//0-default,1-extend,2-boot
    byte readRsult[3];//0-default,1-extend,2-boot
  };
  const int didNum=15;
  struct Identifier ECU_Identifier[didNum]={
    {0xF1A1,2,{8,8,8}},
    {0xF121,2,{7,7,7}},
    {0xF1A5,2,{8,8,8}},
    {0xF125,2,{7,7,7}},
    {0xF1AA,3,{8,8,8}},
    {0xF12A,3,{7,7,7}},
    {0xF1AB,3,{8,8,8}},
    {0xF12B,3,{7,7,7}},
    {0xF18A,3,{6,6,6}},
    {0xF18C,3,{4,4,4}},
    {0xED20,3,{0xFF,0xFF,0xFF}},
    {0xEDA0,3,{0xFF,0xFF,0xFF}},
    {0xF1A0,1,{8,8,8}},
    {0xF1AE,1,{0xFF,0xFF,0xFF}},
    {0xF12E,1,{0XFF,0XFF,0XFF}}
  };
  int compareResult1=0;//default会话与extend会话对比结果
  int compareResult2=0;//boot与app会话对比结果
  char inputchar[500];
  char tempstr[5];
  byte F18A[6];
  
  strncat(logName,"1350994_ECU_ECU_Identification_Verification_Test_Functional_Allsession",400);
  testCaseDescription("ECU supports ECU mandatory identification dataidentifiers (DIDs).ECU responds with negative response code (NRC) to dataidentifiers not supported.");
  testCaseTitle("1350994","ECU_Identification_Verification_Test_Functional_Allsession");

  SetLog(logName);
  Precondition();

  /******************************以下为测试步骤*********************************/  
  
  SessionFlag=APP;

  //DefaultSession
  SID10_DiagnosticSessionControl(DEFAULTSESSION,FUNCTIONAL,SPRMIB_FALSE);
  CheckPosResponse_SID10(DEFAULTSESSION,gP2Client_APP,gP2StarClientFor10Check,0,0);
  CheckCurrentSession(DEFAULTSESSION,FUNCTIONAL,0,0);
  for(i=0;i<didNum;i++)
  {
    if(ECU_Identifier[i].sessionFlag==1||ECU_Identifier[i].sessionFlag==3)
    {
      
    }
    else   
    {
      continue;
    }
    PID[0]=ECU_Identifier[i].DID>>8;
    PID[1]=ECU_Identifier[i].DID&0xFF;
    
    TestStep("Request DID:",TestStepIntervalTime);
    SID22_ReadDataByIdentifier(PID,FUNCTIONAL);
    if(ECU_Identifier[i].dataLen[0]!=0xFF)
    {
      if(CheckPosResponse_SID22(PID,ECU_Identifier[i].dataLen[0],0,0)>0)
      {
        ECU_Identifier[i].dataLen[0]=gTpRxLength-3;
        for(j=0;j<ECU_Identifier[i].dataLen[0];j++)
        {
          ECU_Identifier[i].dataRecord[0][j]=gTpRxData[j+3];
        }
        ECU_Identifier[i].readRsult[0]=1;
      }
      else
      {
        teststepfail("Fail","Fail to read did:%x",ECU_Identifier[i].DID);
        ECU_Identifier[i].readRsult[0]=0;
      }
    }
    else
    {
      if(CheckPosResponse(0x22,0,0)>0)
      {
        ECU_Identifier[i].dataLen[0]=gTpRxLength-3;
        for(j=0;j<ECU_Identifier[i].dataLen[0];j++)
        {
          ECU_Identifier[i].dataRecord[0][j]=gTpRxData[j+3];
        }
        ECU_Identifier[i].readRsult[0]=1;
      }
      else
      {
        teststepfail("Fail","Fail to read did:%x",ECU_Identifier[i].DID);
        ECU_Identifier[i].readRsult[0]=0;
      }
    }
  }
  //DefaultSession
  
  //ExtendedSession
  SID10_DiagnosticSessionControl(EXTENDEDSESSION,FUNCTIONAL,SPRMIB_FALSE);
  CheckPosResponse_SID10(EXTENDEDSESSION,gP2Client_APP,gP2StarClientFor10Check,0,0);
  CheckCurrentSession(EXTENDEDSESSION,FUNCTIONAL,0,0);
  for(i=0;i<didNum;i++)
  {
    if(ECU_Identifier[i].sessionFlag==1||ECU_Identifier[i].sessionFlag==3)
    {
      
    }
    else   
    {
      continue;
    }
    PID[0]=ECU_Identifier[i].DID>>8;
    PID[1]=ECU_Identifier[i].DID&0xFF;
    
    TestStep("Request DID:",TestStepIntervalTime);
    SID22_ReadDataByIdentifier(PID,FUNCTIONAL);
    if(ECU_Identifier[i].dataLen[1]!=0xFF)
    {
      if(CheckPosResponse_SID22(PID,ECU_Identifier[i].dataLen[1],0,0)>0)
      {
        ECU_Identifier[i].dataLen[1]=gTpRxLength-3;
        for(j=0;j<ECU_Identifier[i].dataLen[1];j++)
        {
          ECU_Identifier[i].dataRecord[1][j]=gTpRxData[j+3];
        }
        ECU_Identifier[i].readRsult[1]=1;
      }
      else
      {
        teststepfail("Fail","Fail to read did:%x",ECU_Identifier[i].DID);
        ECU_Identifier[i].readRsult[1]=0;
      }
    }
    else
    {
      if(CheckPosResponse(0x22,0,0)>0)
      {
        ECU_Identifier[i].dataLen[1]=gTpRxLength-3;
        for(j=0;j<ECU_Identifier[i].dataLen[1];j++)
        {
          ECU_Identifier[i].dataRecord[1][j]=gTpRxData[j+3];
        }
        ECU_Identifier[i].readRsult[1]=1;
      }
      else
      {
        teststepfail("Fail","Fail to read did:%x",ECU_Identifier[i].DID);
        ECU_Identifier[i].readRsult[1]=0;
      }
    }
  }
  //ExtendedSession
  
  //ProgrammingSession
  SessionFlag=BOOT;
  SID10_DiagnosticSessionControl(PROGRAMMINGSESSION,FUNCTIONAL,SPRMIB_FALSE);
  CheckPosResponse_SID10(PROGRAMMINGSESSION,gP2Client_BOOT,gP2StarClientFor10Check,0,0);
  ECUinitHandle(0);
  CheckCurrentSession(PROGRAMMINGSESSION,FUNCTIONAL,0,0);
  for(i=0;i<didNum;i++)
  {
    if(ECU_Identifier[i].sessionFlag==2||ECU_Identifier[i].sessionFlag==3)
    {
      
    }
    else   
    {
      continue;
    }
    PID[0]=ECU_Identifier[i].DID>>8;
    PID[1]=ECU_Identifier[i].DID&0xFF;
    
    TestStep("Request DID:",TestStepIntervalTime);
    SID22_ReadDataByIdentifier(PID,FUNCTIONAL);
    if(ECU_Identifier[i].dataLen[2]!=0xFF)
    {
      if(CheckPosResponse_SID22(PID,ECU_Identifier[i].dataLen[2],0,0)>0)
      {
        ECU_Identifier[i].dataLen[2]=gTpRxLength-3;
        for(j=0;j<ECU_Identifier[i].dataLen[2];j++)
        {
          ECU_Identifier[i].dataRecord[2][j]=gTpRxData[j+3];
        }
        ECU_Identifier[i].readRsult[2]=1;
      }
      else
      {
        teststepfail("Fail","Fail to read did:%x",ECU_Identifier[i].DID);
        ECU_Identifier[i].readRsult[2]=0;
      }
    }
    else
    {
      if(CheckPosResponse(0x22,0,0)>0)
      {
        ECU_Identifier[i].dataLen[2]=gTpRxLength-3;
        for(j=0;j<ECU_Identifier[i].dataLen[2];j++)
        {
          ECU_Identifier[i].dataRecord[2][j]=gTpRxData[j+3];
        }
        ECU_Identifier[i].readRsult[2]=1;
      }
      else
      {
        teststepfail("Fail","Fail to read did:%x",ECU_Identifier[i].DID);
        ECU_Identifier[i].readRsult[2]=0;
      }
    }
  }
  //ProgrammingSession
  
  //Compare
  
  for(i=0;i<didNum;i++)
  {
    if(ECU_Identifier[i].sessionFlag==3)
    {
      Teststep("Info","DID_%x_Data:",ECU_Identifier[i].DID);
      if(ECU_Identifier[i].readRsult[0]==1)
      {
        PrintPID("Info","DefaultSession:",ECU_Identifier[i].dataRecord[0],ECU_Identifier[i].dataLen[0]);
      }
      else
      {
        TestStep("Info","DefaultSession:Read Fail");
      }
      if(ECU_Identifier[i].readRsult[1]==1)
      {
        PrintPID("Info","Extend Session:",ECU_Identifier[i].dataRecord[1],ECU_Identifier[i].dataLen[1]);
      }
      else
      {
        TestStep("Info","Extend Session:Read Fail");
      }
      if(ECU_Identifier[i].readRsult[2]==1)
      {
        PrintPID("Info","ProgramSession:",ECU_Identifier[i].dataRecord[2],ECU_Identifier[i].dataLen[2]);
      }
      else
      {
        TestStep("Info","ProgramSession:Read Fail");
      }
      compareResult1=CompareByte(ECU_Identifier[i].dataRecord[0],ECU_Identifier[i].dataRecord[1],ECU_Identifier[i].dataLen[0]);
      compareResult2=CompareByte(ECU_Identifier[i].dataRecord[1],ECU_Identifier[i].dataRecord[2],ECU_Identifier[i].dataLen[1]);
      if(ECU_Identifier[i].DID == 0xED20 || ECU_Identifier[i].DID == 0xEDA0) //0xED20和0xEDA0特殊处理，APP和BOOT下数据需要不一致
      {
        if(compareResult1==2) { TeststepPass("Pass","The value of DID:%x are same between DefaultSession and ExtendedSession :",ECU_Identifier[i].DID); }
        else                  { TeststepFail("Fail","The value of DID:%x are different between DefaultSession and ExtendedSession :",ECU_Identifier[i].DID); }
        if(compareResult2==2) { TeststepFail("Fail","The value of DID:%x are same between APP and Boot :",ECU_Identifier[i].DID); }
        else                  { TeststepPass("Pass","The value of DID:%x are different between APP and Boot :",ECU_Identifier[i].DID); }
      }
      else
      {
        if(compareResult1==2)
        {
          TeststepPass("Pass","The value of DID:%x are same between DefaultSession and ExtendedSession :",ECU_Identifier[i].DID);
        }
        else
        {
          TeststepFail("Fail","The value of DID:%x are different between DefaultSession and ExtendedSession :",ECU_Identifier[i].DID);
        }
        if(compareResult2==2)
        {
          TeststepPass("Pass","The value of DID:%x are same between APP and Boot :",ECU_Identifier[i].DID);
        }
        else
        {
          TeststepFail("Fail","The value of DID:%x are different between APP and Boot :",ECU_Identifier[i].DID);
        }
      }
    }
    else if(ECU_Identifier[i].sessionFlag==1)
    {
      Teststep("Info","DID_%x_Data:",ECU_Identifier[i].DID);
      if(ECU_Identifier[i].readRsult[0]==1)
      {
        PrintPID("Info","DefaultSession:",ECU_Identifier[i].dataRecord[0],ECU_Identifier[i].dataLen[0]);
      }
      else
      {
        TestStep("Info","DefaultSession:Read Fail");
      }
      if(ECU_Identifier[i].readRsult[1]==1)
      {
        PrintPID("Info","Extend Session:",ECU_Identifier[i].dataRecord[1],ECU_Identifier[i].dataLen[1]);
      }
      else
      {
        TestStep("Info","Extend Session:Read Fail");
      }
      compareResult1=CompareByte(ECU_Identifier[i].dataRecord[0],ECU_Identifier[i].dataRecord[1],ECU_Identifier[i].dataLen[0]);
      if(compareResult1==2)
      {
        TeststepPass("Pass","The value of DID:%x are same between DefaultSession and ExtendedSession :",ECU_Identifier[i].DID);
      }
      else
      {
        TeststepFail("Fail","The value of DID:%x are different between DefaultSession and ExtendedSession :",ECU_Identifier[i].DID);
      }
    }
    else if(ECU_Identifier[i].sessionFlag==2)
    {
      Teststep("Info","DID:%x is only supported in programmingsession,not need to be compared",ECU_Identifier[i].DID);
    }
  }
  //Compare
  if(elCount(F18AValue)==0)
  {
  	if(1==testWaitForStringInput("Please input F18A(System Supplier Identifier) ExpectValue:"))
  	{
  		testGetStringInput(inputchar,elcount(inputchar));

  		str_replace(inputchar," ","");
  		str_replace(inputchar,",","");
  		str_replace(inputchar,"0x","");
  		str_replace(inputchar,"0X","");
  		str_replace(inputchar,":","");

  		if(strlen(inputchar)!=12)
  		{
        testStepFail("Error","Length of the input F18A(System Supplier Identifier) is not correct,skip check F18A Value.");
        testWaitForTesterConfirmation("Length of the input F18A(System Supplier Identifier) is not correct,skip this testcase.");
        Postcondition(); 
        return;
  		}

  		tempstr[0] = '0';
  		tempstr[1] = 'x';
      
  		for(i=0; 2*i<strlen(inputchar); i++)
  		{
  			tempstr[2] = inputchar[2*i];
  			tempstr[3] = inputchar[2*i+1];
  			tempstr[4] = 0;
  			F18A[i] = atol(tempstr);
  		}
      for(i=0;i<didNum;i++)
      {
        if(ECU_Identifier[i].DID==0xF18A)
          Break;
      }
      PrintPID("Info","F18A defaultsession:",ECU_Identifier[i].dataRecord[0],ECU_Identifier[i].dataLen[0]);
      PrintPID("Info","F18A extendsession:",ECU_Identifier[i].dataRecord[1],ECU_Identifier[i].dataLen[1]);
      PrintPID("Info","F18A programmingsession:",ECU_Identifier[i].dataRecord[2],ECU_Identifier[i].dataLen[2]);
      PrintPID("Info","F18A expected:",F18A,ECU_Identifier[i].dataLen[0]);
      
      compareResult1=CompareByte(F18A,ECU_Identifier[i].dataRecord[0],ECU_Identifier[i].dataLen[0]);
      if(compareResult1!=2)
      {
        testStepFail("Fail","F18A defaultsession mismatech expected");
      }
      compareResult1=CompareByte(F18A,ECU_Identifier[i].dataRecord[1],ECU_Identifier[i].dataLen[1]);
      if(compareResult1!=2)
      {
        testStepFail("Fail","F18A extendsession mismatech expected");
      }
      compareResult1=CompareByte(F18A,ECU_Identifier[i].dataRecord[2],ECU_Identifier[i].dataLen[2]);
      if(compareResult1!=2)
      {
        testStepFail("Fail","F18A programmingsession mismatech expected");
      }
  	}
  }
  else
  {
//  		testGetStringInput(F18AValue,elcount(F18AValue));

  		str_replace(F18AValue," ","");
  		str_replace(F18AValue,",","");
  		str_replace(F18AValue,"0x","");
  		str_replace(F18AValue,"0X","");
  		str_replace(F18AValue,":","");

  		if(strlen(F18AValue)!=12)
  		{
        testStepFail("Error","Length of the input F18A(System Supplier Identifier) is not correct,skip check F18A Value.");
//        testWaitForTesterConfirmation("Length of the input F18A(System Supplier Identifier) is not correct,skip this testcase.");
        Postcondition(); 
        return;
  		}

  		tempstr[0] = '0';
  		tempstr[1] = 'x';
      
  		for(i=0; 2*i<strlen(F18AValue); i++)
  		{
  			tempstr[2] = F18AValue[2*i];
  			tempstr[3] = F18AValue[2*i+1];
  			tempstr[4] = 0;
  			F18A[i] = atol(tempstr);
  		}
      for(i=0;i<didNum;i++)
      {
        if(ECU_Identifier[i].DID==0xF18A)
          Break;
      }
      PrintPID("Info","F18A defaultsession:",ECU_Identifier[i].dataRecord[0],ECU_Identifier[i].dataLen[0]);
      PrintPID("Info","F18A extendsession:",ECU_Identifier[i].dataRecord[1],ECU_Identifier[i].dataLen[1]);
      PrintPID("Info","F18A programmingsession:",ECU_Identifier[i].dataRecord[2],ECU_Identifier[i].dataLen[2]);
      PrintPID("Info","F18A expected:",F18A,ECU_Identifier[i].dataLen[0]);
      
      compareResult1=CompareByte(F18A,ECU_Identifier[i].dataRecord[0],ECU_Identifier[i].dataLen[0]);
      if(compareResult1!=2)
      {
        testStepFail("Fail","F18A defaultsession mismatech expected");
      }
      compareResult1=CompareByte(F18A,ECU_Identifier[i].dataRecord[1],ECU_Identifier[i].dataLen[1]);
      if(compareResult1!=2)
      {
        testStepFail("Fail","F18A extendsession mismatech expected");
      }
      compareResult1=CompareByte(F18A,ECU_Identifier[i].dataRecord[2],ECU_Identifier[i].dataLen[2]);
      if(compareResult1!=2)
      {
        testStepFail("Fail","F18A programmingsession mismatech expected");
      }
  }
  /******************************以上为测试步骤*********************************/
  Postcondition(); 
}
/// <APP_GeneralTest>
testcase Short_message_Test_DefaultSession_Physical()
{
  byte data[1]={0x3e};
  char logName[400] = "";
  char info[1024];
  
  strncat(logName,"1350987_Short_message_Test_DefaultSession_Physical",400);
  testCaseDescription("Send a message that is short (data length short) to the ECU.");
  testCaseTitle("1350987","Short_message_Test_DefaultSession_Physical");
  
  
  SetLog(logName);
  Precondition();

  /******************************以下为测试步骤*********************************/
  
  SessionFlag=APP;
  
  TestStep("Let DL value be to short for the actual message");
  TestStep("Send short message",TestStepIntervalTime);
  TPSendRawMessage(data,PHYSICAL);
  CheckNegResponse(0x13,0,0);
  TestStep("Verify defaultSession",TestStepIntervalTime);
  CheckCurrentSession(DEFAULTSESSION,PHYSICAL,0,0);
  /******************************以上为测试步骤*********************************/
   Postcondition();
   
}
/// <APP_GeneralTest>
testcase Short_message_Test_DefaultSession_Functional()
{
  byte data[1]={0x3E};
  char logName[400] = "";
  char info[1024];
  
  strncat(logName,"1350989_Short_message_Test_DefaultSession_Functional",400);
  testCaseDescription("Send a message that is short (data length short) to the ECU.");
  testCaseTitle("1350989","Short_message_Test_DefaultSession_Functional");
  if(gBusFlag==3)
	{
		testStepWarning("Test","This test case does not apply to the LIN bus");
		return;
	}
  SetLog(logName);
  Precondition();

  /******************************以下为测试步骤*********************************/
  
  SessionFlag=APP;
  TestStep("Let DL value be to short for the actual message");
  TestStep("Send short message",TestStepIntervalTime);
  TPSendRawMessage(data,FUNCTIONAL);
  CheckNegResponse(0x13,0,0);
  TestStep("Verify defaultSession",TestStepIntervalTime);
  CheckCurrentSession(DEFAULTSESSION,PHYSICAL,0,0);
  /******************************以上为测试步骤*********************************/
  Postcondition();
   
}
/// <APP_GeneralTest>
testcase Short_message_Test_ExtendedSession_Physical()
{
  byte data[1]={0x3E};
  char logName[400] = "";
  char info[1024];
  
  strncat(logName,"1350988_Short_message_Test_ExtendedSession_Physical",400);
  testCaseDescription("Send a message that is short (data length short) to the ECU.");
  testCaseTitle("1350988","Short_message_Test_ExtendedSession_Physical");
  
  SetLog(logName);
  Precondition();

  /******************************以下为测试步骤*********************************/
  
  SessionFlag=APP;
  
  TestStep("Transition from defaultSession(0x01) to extendedDiagnosticSession(0x03).",TestStepIntervalTime);
  SID10_DiagnosticSessionControl(EXTENDEDSESSION,PHYSICAL,SPRMIB_FALSE);
  CheckPosResponse_SID10(EXTENDEDSESSION,gP2Client_APP,gP2StarClientFor10Check,0,0);
  TestStep("Verify extendedDiagnosticSession.",TestStepIntervalTime);
  CheckCurrentSession(EXTENDEDSESSION,PHYSICAL,0,0);
  TestStep("Let DL value be to short for the actual message");
  TestStep("Send short message",TestStepIntervalTime);
  TPSendRawMessage(data,PHYSICAL);
  CheckNegResponse(0x13,0,0);
  TestStep("Verify extendedDiagnosticSession.",TestStepIntervalTime);
  CheckCurrentSession(EXTENDEDSESSION,PHYSICAL,0,0);
  /******************************以上为测试步骤*********************************/
  Postcondition();
   
}
/// <APP_GeneralTest>
testcase Short_message_Test_ExtndedSession_Functional()
{
  byte data[1]={0x3E};
  char logName[400] = "";
  char info[1024];
  
  strncat(logName,"1350990_Short_message_Test_ExtndedSession_Functional",400);
  testCaseDescription("Send a message that is short (data length short) to the ECU.");
  testCaseTitle("1350990","Short_message_Test_ExtndedSession_Functional");
  if(gBusFlag==3)
	{
		testStepWarning("Test","This test case does not apply to the LIN bus");
		return;
	}
  SetLog(logName);
  Precondition();

  /******************************以下为测试步骤*********************************/
  
  SessionFlag=APP;
  
  TestStep("Transition from defaultSession(0x01) to extendedDiagnosticSession(0x03).",TestStepIntervalTime);
  SID10_DiagnosticSessionControl(EXTENDEDSESSION,PHYSICAL,SPRMIB_FALSE);
  CheckPosResponse_SID10(EXTENDEDSESSION,gP2Client_APP,gP2StarClientFor10Check,0,0);
  TestStep("Verify extendedDiagnosticSession.",TestStepIntervalTime);
  CheckCurrentSession(EXTENDEDSESSION,PHYSICAL,0,0);
  TestStep("Let DL value be to short for the actual message");
  TestStep("Send short message",TestStepIntervalTime);
  TPSendRawMessage(data,FUNCTIONAL);
  CheckNegResponse(0x13,0,0);
  TestStep("Verify extendedDiagnosticSession.",TestStepIntervalTime);
  CheckCurrentSession(EXTENDEDSESSION,PHYSICAL,0,0);
  /******************************以上为测试步骤*********************************/
  Postcondition();
}
/// <APP_GeneralTest>
testcase S3_Server_SuspensionDuringSegmentedResponseTest_Valid_Physical_ExtendedSession()
{
  long res,msgdlc,CFNum;
  message 0x1 TpRes;
  int i=0;
  char logName[400] = "";
  char info[1024];
  byte testPreFillFlag=0;

  strncat(logName,"1350964_S3_Server_SuspensionDuringSegmentedResponseTest_Valid_Physical_ExtendedSession",400);
  testCaseDescription("The intent is to verify that S3Server timer is suspended during segmented response and the ECU do not time out.");
  testCaseTitle("1350964","S3_Server_SuspensionDuringSegmentedResponseTest_Valid_Physical_ExtendedSession");
  
  if((gBusFlag!=1)&&(gBusFlag!=2))
	{
		testStepWarning("Test","This test case only apply to the CAN or CANFD bus");
		return;
	}
  SetLog(logName);
  Precondition();

  /******************************以下为测试步骤*********************************/
  
  SessionFlag=APP;
  TPMsgInit(0);
  
  TestStep("Disable functional addressed TesterPresent (0x3E) during the test.",TestStepIntervalTime);
  TP_TesterPresentSet(TP_OFF);
  
  TestStep("Transition from defaultSession(0x01) to extendedDiagnosticSession(0x03)",TestStepIntervalTime);
  SID10_DiagnosticSessionControl(EXTENDEDSESSION,PHYSICAL,SPRMIB_FALSE);
  CheckPosResponse_SID10(EXTENDEDSESSION,gP2Client_APP,gP2StarClientFor10Check,0,0);
  TestStep("Verify extendedDiagnosticSession",TestStepIntervalTime);
  CheckCurrentSession(EXTENDEDSESSION,PHYSICAL,0,0);
  TestStep("Read data by data identifer",TestStepIntervalTime);
  
  CloseCANConnection();
  testJoinMessageEvent(gCAN_ResponseID);
  testStep("Chk","Send a SF to request MultiFrame");
  output(TP_RequestMultiFrame);
  
  res= testWaitForAnyJoinedEvent(1000);
  if(res>0)
  {
    testGetWaitEventMsgData(TpRes);
    CheckNRC78(TpRes);//判断收到的报文是否为NRC78
  }
  else
  testStepFail("Chk","DUT doesn't response FF during test");

  if(res>0)
  {
    testGetWaitEventMsgData(TpRes);
    if((TpRes.byte(0)&0xF0) == 0x10 )
    {
      testStepPass("Chk","DUT Response a FF");
      msgdlc=((TpRes.byte(0) & 0x0F)<<8) + TpRes.byte(1);
      if(gBusFlag==2)
      {
        if((msgdlc-62)%63 > 0)//CFNum = 有多少CF帧
        { 
          CFNum = (msgdlc-62) / 63 + 1;  
        }
        else
          CFNum = (msgdlc-62) / 63;   
      }
      else if(gBusFlag==1)
      {
        if((msgdlc-6)%8 > 0)//CFNum = 有多少CF帧
        { 
          CFNum = (msgdlc-6) / 8 + 1;  
        }
        else
          CFNum = (msgdlc-6) / 8;   
      }
      TestStep("Wait (N_Bs timeout * 0.95) after receiving first frame and before sending flow control frame continue to send");
      testWaitForTimeout(950);
      
      output(TP_FC_CTS);
      testStep("Chk","Send FC(CTS)");
      for(i=1;i<=CFNum;i++)
      {
        testJoinMessageEvent(gCAN_ResponseID);
        res= testWaitForAnyJoinedEvent(1000);
        if(res>0)
        {
          testGetWaitEventMsgData(TpRes);
          if((TpRes.byte(0)) == (0x20|(i)) )
          {
            testStepPass("Chk","DUT Response CF%d",i);
          }
          if(i==CFNum)
          {
            testPreFillFlag=1;
            testStepPass("Chk","ALL CF received");
            TestStep("After last frame response in step 5 wait 4900 ms ");
            testWaitForTimeout(4900);
          }
        }
        else if(i==1)
        {
          testPreFillFlag=0;
          testStepFail("Chk","DUT not response CF");
          break;
        }
        else
        {
          testPreFillFlag=0;
          testStepFail("Chk","Not receive all CF");
          break;
        } 
      }
      OpenCANConnection();
      if(testPreFillFlag==1)
      {
        TestStep("Verify extendedDiagnosticSession",TestStepIntervalTime);
        CheckCurrentSession(EXTENDEDSESSION,PHYSICAL,0,0);
      }
      else 
      {
        testStepFail("Fail","DUT Response Wrong,Test precondition not fullfilled,test end");
      }
    }
    else
    {
      testPreFillFlag=0;
      OpenCANConnection();
      testStepFail("Chk","DUT doesn't response FF during test");
    }
  }
  else
  {
    testPreFillFlag=0;
    OpenCANConnection();
    testStepFail("Chk","DUT doesn't response FF during test");
  }

  /******************************以上为测试步骤*********************************/
  Postcondition();
   
}
/// <APP_GeneralTest>
testcase S3_Server_SuspensionDuringSegmentedResponseTest_Valid_Functional_ExtendedSession()
{
  long res,msgdlc,CFNum;
  message 0x1 TpRes;
  int i=0;
  char logName[400] = "";
  char info[1024];
  byte testPreFillFlag=0;

  strncat(logName,"1350965_S3_Server_SuspensionDuringSegmentedResponseTest_Valid_Functional_ExtendedSession",400);
  testCaseDescription("The intent is to verify that S3Server timer is suspended during segmented response and the ECU do not time out.");
  testCaseTitle("1350965","S3_Server_SuspensionDuringSegmentedResponseTest_Valid_Functional_ExtendedSession");
  if((gBusFlag!=1)&&(gBusFlag!=2))
	{
		testStepWarning("Test","This test case only apply to the CAN or CANFD bus");
		return;
	}
  SetLog(logName);
  Precondition();

  /******************************以下为测试步骤*********************************/
  
  SessionFlag=APP;
  TPMsgInit(1);
  
  TestStep("Disable functional addressed TesterPresent (0x3E) during the test.",TestStepIntervalTime);
  TP_TesterPresentSet(TP_OFF);
  
  TestStep("Transition from defaultSession(0x01) to extendedDiagnosticSession(0x03)",TestStepIntervalTime);
  SID10_DiagnosticSessionControl(EXTENDEDSESSION,PHYSICAL,SPRMIB_FALSE);
  CheckPosResponse_SID10(EXTENDEDSESSION,gP2Client_APP,gP2StarClientFor10Check,0,0);
  TestStep("Verify extendedDiagnosticSession",TestStepIntervalTime);
  CheckCurrentSession(EXTENDEDSESSION,PHYSICAL,0,0);
  TestStep("Read data by data identifer",TestStepIntervalTime);
  
  CloseCANConnection();
  testJoinMessageEvent(gCAN_ResponseID);
  testStep("Chk","Send a SF to request MultiFrame");
  output(TP_RequestMultiFrame);
  
  res= testWaitForAnyJoinedEvent(1000);
  if(res>0)
  {
    testGetWaitEventMsgData(TpRes);
    CheckNRC78(TpRes);//判断收到的报文是否为NRC78
  }
  else
  testStepFail("Chk","DUT doesn't response FF during test");

  if(res>0)
  {
    testGetWaitEventMsgData(TpRes);
    if((TpRes.byte(0)&0xF0) == 0x10 )
    {
      testStepPass("Chk","DUT Response a FF");
      msgdlc=((TpRes.byte(0) & 0x0F)<<8) + TpRes.byte(1);
      if(gBusFlag==2)
      {
        if((msgdlc-62)%63 > 0)//CFNum = 有多少CF帧
        { 
          CFNum = (msgdlc-62) / 63 + 1;  
        }
        else
          CFNum = (msgdlc-62) / 63;   
      }
      else if(gBusFlag==1)
      {
        if((msgdlc-6)%8 > 0)//CFNum = 有多少CF帧
        { 
          CFNum = (msgdlc-6) / 8 + 1;  
        }
        else
          CFNum = (msgdlc-6) / 8;   
      }
      TestStep("Wait (N_Bs timeout * 0.95) after receiving first frame and before sending flow control frame continue to send");
      testWaitForTimeout(950);
      
      output(TP_FC_CTS);
      testStep("Chk","Send FC(CTS)");
      for(i=1;i<=CFNum;i++)
      {
        testJoinMessageEvent(gCAN_ResponseID);
        res= testWaitForAnyJoinedEvent(1000);
        if(res>0)
        {
          testGetWaitEventMsgData(TpRes);
          if((TpRes.byte(0)) == (0x20|(i)) )
          {
            testStepPass("Chk","DUT Response CF%d",i);
          }
          if(i==CFNum)
          {
            testPreFillFlag=1;
            testStepPass("Chk","ALL CF received");
            TestStep("After last frame response in step 5 wait 4900 ms ");
            testWaitForTimeout(4900);
          }
        }
        else if(i==1)
        {
          testPreFillFlag=0;
          testStepFail("Chk","DUT not response CF");
          break;
        }
        else
        {
          testPreFillFlag=0;
          testStepFail("Chk","Not receive all CF");
          break;
        } 
      }
      OpenCANConnection();
      if(testPreFillFlag==1)
      {
        TestStep("Verify extendedDiagnosticSession",TestStepIntervalTime);
        CheckCurrentSession(EXTENDEDSESSION,PHYSICAL,0,0);
      }
      else 
      {
        testStepFail("Fail","DUT Response Wrong,Test precondition not fullfilled,test end");
      }
    }
    else
    {
      testPreFillFlag=0;
      OpenCANConnection();
      testStepFail("Chk","DUT doesn't response FF during test");
    }
  }
  else
  {
    testPreFillFlag=0;
    OpenCANConnection();
    testStepFail("Chk","DUT doesn't response FF during test");
  }
  /******************************以上为测试步骤*********************************/
  Postcondition();
}
/// <APP_GeneralTest>
testcase S3_Server_SuspensionDuringSegmentedRequestTest_Valid_Physical_ExtendedSession()
{
  long res,msgdlc,CFNum,Stmin;
  message 0x1 TpRes;
  int i=0;
  char logName[400] = "";
  char info[1024];
  byte testPreFillFlag=0;
  
  strncat(logName,"1350966_S3_Server_SuspensionDuringSegmentedRequestTest_Valid_Physical_ExtendedSession",400);
  testCaseDescription("The intent of this test is to verify that the S3Server timer in the ECU is suspended during segmented request.");
  testCaseTitle("1350966","S3_Server_SuspensionDuringSegmentedRequestTest_Valid_Physical_ExtendedSession");
  if((gBusFlag!=1)&&(gBusFlag!=2))
	{
		testStepWarning("Test","This test case only apply to the CAN or CANFD bus");
		return;
	}
  SetLog(logName);
  Precondition();

  /******************************以下为测试步骤*********************************/
  
  SessionFlag=APP;
  TPMsgInit(0);
  
  TestStep("Transition from defaultSession(0x01) to extendedDiagnosticSession(0x03).");
  SID10_DiagnosticSessionControl(EXTENDEDSESSION,PHYSICAL,SPRMIB_FALSE);
  CheckPosResponse_SID10(EXTENDEDSESSION,gP2Client_APP,gP2StarClientFor10Check,0,0);
  TestStep("Verify extendedDiagnosticSession",TestStepIntervalTime);
  CheckCurrentSession(EXTENDEDSESSION,PHYSICAL,0,0);
  TestStep("Send MultiFrame with an unsupported diagnostic service.");
  
  CloseCANConnection();
  testStep("Chk","Send FF");
  output(TP_FirstFrame);
  
  testJoinMessageEvent(gCAN_ResponseID);
  res= testWaitForAnyJoinedEvent(1000);
  if(res>0)
  {
    testGetWaitEventMsgData(TpRes);
    CheckNRC78(TpRes);//判断收到的报文是否为NRC78
  }
  else
    testStepFail("Fail","DUT doesn't response FF during test");

  if(res>0)
  {
    testGetWaitEventMsgData(TpRes);
    if((TpRes.byte(0)&0xF0) == 0x30 )
    {
      testStepPass("Pass","Receiced FC");
      Stmin=TpRes.byte(2);
      if(Stmin<=0x7F||Stmin>=0)
      {
      }
      else
      {
        Stmin=0;
      }
    }
    else 
    {
      testStepFail("Fail","Dut don't Send a FC");
    }
  }
  testWaitForTimeout(Stmin+1);
  testStep("Chk","Wait for N_Cr Timeout*0.95, then Send CF");
  output(TP_CF1);
  OpenCANConnection();
  
  CheckNegResponse(0x11,0,0);
  
  
  
  TestStep("Wait for 4800 ms");
  testWaitForTimeout(4800);
  TestStep("Verify extendedDiagnosticSession");
  CheckCurrentSession(EXTENDEDSESSION,PHYSICAL,0,0);
  /******************************以上为测试步骤*********************************/
  Postcondition();
}

/// <APP_GeneralTest>
testcase VersionNumberCannotBeWritten()
{
  #pragma warning(disable: 2058)
  long res,msgdlc,CFNum,Stmin;
  message 0x1 TpRes;
  int i=0,j=0;
  char logName[400] = "";
  char info[1024];
  byte WriteDataRaw[0xFF];
  byte PID[2];
  byte gres;
  
  struct Identifier{
    word DID;
    byte sessionFlag;//1-app,2-boot,3-all
    byte dataLen[3];//0-default,1-extend,2-boot
    byte dataRecord[3][255];//0-default,1-extend,2-boot
    byte readRsult[3];//0-default,1-extend,2-boot
  };
  const int didNum=15;
  struct Identifier ECU_Identifier[didNum]={
    {0xF1A1,2,{8,8,8}},
    {0xF121,2,{7,7,7}},
    {0xF1A5,2,{8,8,8}},
    {0xF125,2,{7,7,7}},
    {0xF1AA,3,{8,8,8}},
    {0xF12A,3,{7,7,7}},
    {0xF1AB,3,{8,8,8}},
    {0xF12B,3,{7,7,7}},
    {0xF18A,3,{6,6,6}},
    {0xF18C,3,{4,4,4}},
    {0xED20,3,{8,8,8}},
    {0xEDA0,3,{9,9,9}},
    {0xF1A0,1,{8,8,8}},
    {0xF1AE,1,{9,9,9}},
    {0xF12E,1,{8,8,8}}
  };
  strncat(logName,"1351038_VersionNumberCannotBeWritten",400);
  testCaseDescription("The intent of this test is to verify that the version number can not be Written.");
  testCaseTitle("1351038","VersionNumberCannotBeWritten");
  
  SetLog(logName);
  Precondition();

  /******************************以下为测试步骤*********************************/

  //DefaultSession
  SessionFlag=APP;
  TestStep("Transition to defaultSesion(0x01)",TestStepIntervalTime);
  SID10_DiagnosticSessionControl(DEFAULTSESSION,PHYSICAL,SPRMIB_FALSE);
  CheckPosResponse_SID10(DEFAULTSESSION,gP2Client_APP,gP2StarClientFor10Check,0,0);
  TestStep("Verify defaultSession",TestStepIntervalTime);
  CheckCurrentSession(DEFAULTSESSION,PHYSICAL,0,0);
  for(i=0;i<didNum;i++)
  {
    if(ECU_Identifier[i].sessionFlag==1||ECU_Identifier[i].sessionFlag==3)
    {
      
    }
    else   
    {
      continue;
    }
    PID[0]=ECU_Identifier[i].DID>>8;
    PID[1]=ECU_Identifier[i].DID&0xFF;
    
    TestStep("Request Write DID:",TestStepIntervalTime);
    SID2E_WriteDataByIdentifier(PID,WriteDataRaw,ECU_Identifier[i].dataLen[0],PHYSICAL);
    gres=GetECUResponse();
    if(gres==NEG)
    {
      if(gTpRxData[2]==0x13)
      {
        PrintPID("UDS","Neg.Response",gTpRxData,gTpRxLength);
        testStepFail("Fail","Expect to respond NRC other than NRC0x13,but get negative response 0x13");
      }
      else
      {
        PrintPID("UDS","Neg.Response",gTpRxData,gTpRxLength);
        testStepPass("Pass","Get expectd response");
      }
    }
    else if(gres==POS)
    {
      PrintPID("UDS","Pos.Response",gTpRxData,gTpRxLength);
      testStepFail("Fail","Get unexpectd postive response");
    }
    else if(gres==TIMEOUT)
    {
      testStepFail("Fail","Timeout no response recived when request service 0x2E");
    }
  }
  //DefaultSession
  
  //ExtendedSession
  TestStep("Transition from defaultSession(0x01) to extendedDiagnosticSession(0x03).");
  SID10_DiagnosticSessionControl(EXTENDEDSESSION,PHYSICAL,SPRMIB_FALSE);
  CheckPosResponse_SID10(EXTENDEDSESSION,gP2Client_APP,gP2StarClientFor10Check,0,0);
  TestStep("Verify extendedDiagnosticSession",TestStepIntervalTime);
  CheckCurrentSession(EXTENDEDSESSION,PHYSICAL,0,0);
  for(i=0;i<didNum;i++)
  {
    if(ECU_Identifier[i].sessionFlag==1||ECU_Identifier[i].sessionFlag==3)
    {
      
    }
    else   
    {
      continue;
    }
    PID[0]=ECU_Identifier[i].DID>>8;
    PID[1]=ECU_Identifier[i].DID&0xFF;
    
    TestStep("Request Write DID:",TestStepIntervalTime);
    SID2E_WriteDataByIdentifier(PID,WriteDataRaw,ECU_Identifier[i].dataLen[1],PHYSICAL);
    gres=GetECUResponse();
    if(gres==NEG)
    {
      if(gTpRxData[2]==0x13)
      {
        PrintPID("UDS","Neg.Response",gTpRxData,gTpRxLength);
        testStepFail("Fail","Expect to respond NRC other than NRC0x13,but get negative response 0x13");
      }
      else
      {
        PrintPID("UDS","Neg.Response",gTpRxData,gTpRxLength);
        testStepPass("Pass","Get expectd response");
      }
    }
    else if(gres==POS)
    {
      PrintPID("UDS","Pos.Response",gTpRxData,gTpRxLength);
      testStepFail("Fail","Get unexpectd postive response");
    }
    else if(gres==TIMEOUT)
    {
      testStepFail("Fail","Timeout no response recived when request service 0x2E");
    }
  }
  //遍历解锁等级、遍历各DID
  for(j=0; j<NumOfSecurityLv; j++)
  {
    if(j==0)
      TestStep("Let L1 = First security level from the configured security level array from configured list. ",TestStepIntervalTime);
    else
      TestStep("Let L1 be equal to next security level",TestStepIntervalTime);
    
    if(SELevel[j].SEFlagPBL == 1)
    {
      continue;
    }
    
    Level1=SELevel[j].SElevel;
    write("Level1 is %02x",Level1);
    testWaitForTimeout(gTimeWaitForSecuAccess);
    
    //执行解锁以确保控制器的错误计数器为0
    SID27_SecurityAccess_RequestSeed(Level1,PHYSICAL);
    CheckPosResponse_SID27_ReqSeed(Level1,gSeedArray,16,0,0);
    PID27_Parameters_Seeds_Chk(NotAllZero,gSeedArray);
    SID27_SecurityAccess_SendKey(Level1,gKeyArray,PHYSICAL);
    CheckPosResponse_SID27_SenKey(Level1,0,0);
    
    for(i=0;i<didNum;i++)
    {
      if(ECU_Identifier[i].sessionFlag==1||ECU_Identifier[i].sessionFlag==3)
      {
        
      }
      else   
      {
        continue;
      }
      PID[0]=ECU_Identifier[i].DID>>8;
      PID[1]=ECU_Identifier[i].DID&0xFF;
      
      TestStep("Request Write DID:",TestStepIntervalTime);
      SID2E_WriteDataByIdentifier(PID,WriteDataRaw,ECU_Identifier[i].dataLen[1],PHYSICAL);
      gres=GetECUResponse();
      if(gres==NEG)
      {
        if(gTpRxData[2]==0x13)
        {
          PrintPID("UDS","Neg.Response",gTpRxData,gTpRxLength);
          testStepFail("Fail","Expect to respond NRC other than NRC0x13,but get negative response 0x13");
        }
        else
        {
          PrintPID("UDS","Neg.Response",gTpRxData,gTpRxLength);
          testStepPass("Pass","Get expectd response");
        }
      }
      else if(gres==POS)
      {
        PrintPID("UDS","Pos.Response",gTpRxData,gTpRxLength);
        testStepFail("Fail","Get unexpectd postive response");
      }
      else if(gres==TIMEOUT)
      {
        testStepFail("Fail","Timeout no response recived when request service 0x2E");
      }
    }
  }
  //ExtendedSession
  
  //ProgrammingSession
  SessionFlag=BOOT;
  TestStep("Transition from extendedDiagnosticSession(0x03) to programmingSession(0x02).");
  SID10_DiagnosticSessionControl(PROGRAMMINGSESSION,PHYSICAL,SPRMIB_FALSE);
  CheckPosResponse_SID10(PROGRAMMINGSESSION,gP2Client_BOOT,gP2StarClientFor10Check,0,0);
  ECUinitHandle(0);
  TestStep("Verify ProgrammingSession",TestStepIntervalTime);
  CheckCurrentSession(PROGRAMMINGSESSION,PHYSICAL,0,0);
  for(i=0;i<didNum;i++)
  {
    if(ECU_Identifier[i].sessionFlag==2||ECU_Identifier[i].sessionFlag==3)
    {
      
    }
    else   
    {
      continue;
    }
    PID[0]=ECU_Identifier[i].DID>>8;
    PID[1]=ECU_Identifier[i].DID&0xFF;
    
    TestStep("Request Write DID:",TestStepIntervalTime);
    SID2E_WriteDataByIdentifier(PID,WriteDataRaw,ECU_Identifier[i].dataLen[2],PHYSICAL);
    gres=GetECUResponse();
    if(gres==NEG)
    {
      if(gTpRxData[2]==0x13)
      {
        PrintPID("UDS","Neg.Response",gTpRxData,gTpRxLength);
        testStepFail("Fail","Expect to respond NRC other than NRC0x13,but get negative response 0x13");
      }
      else
      {
        PrintPID("UDS","Neg.Response",gTpRxData,gTpRxLength);
        testStepPass("Pass","Get expectd response");
      }
    }
    else if(gres==POS)
    {
      PrintPID("UDS","Pos.Response",gTpRxData,gTpRxLength);
      testStepFail("Fail","Get unexpectd postive response");
    }
    else if(gres==TIMEOUT)
    {
      testStepFail("Fail","Timeout no response recived when request service 0x2E");
    }
  }
  //遍历解锁等级、遍历各DID
  for(j=0; j<NumOfSecurityLv; j++)
  {
    if(j==0)
      TestStep("Let L1 = First security level from the configured security level array from configured list. ",TestStepIntervalTime);
    else
      TestStep("Let L1 be equal to next security level",TestStepIntervalTime);
    
    if(SELevel[j].SEFlagAPP == 1)
    {
      continue;
    }
    
    Level1=SELevel[j].SElevel;
    write("Level1 is %02x",Level1);
    testWaitForTimeout(gTimeWaitForSecuAccess);
    
    //执行解锁以确保控制器的错误计数器为0
    SID27_SecurityAccess_RequestSeed(Level1,PHYSICAL);
    CheckPosResponse_SID27_ReqSeed(Level1,gSeedArray,16,0,0);
    PID27_Parameters_Seeds_Chk(NotAllZero,gSeedArray);
    SID27_SecurityAccess_SendKey(Level1,gKeyArray,PHYSICAL);
    CheckPosResponse_SID27_SenKey(Level1,0,0);
    
    for(i=0;i<didNum;i++)
    {
      if(ECU_Identifier[i].sessionFlag==1||ECU_Identifier[i].sessionFlag==3)
      {
        
      }
      else   
      {
        continue;
      }
      PID[0]=ECU_Identifier[i].DID>>8;
      PID[1]=ECU_Identifier[i].DID&0xFF;
      
      TestStep("Request Write DID:",TestStepIntervalTime);
      SID2E_WriteDataByIdentifier(PID,WriteDataRaw,ECU_Identifier[i].dataLen[2],PHYSICAL);
      gres=GetECUResponse();
      if(gres==NEG)
      {
        if(gTpRxData[2]==0x13)
        {
          PrintPID("UDS","Neg.Response",gTpRxData,gTpRxLength);
          testStepFail("Fail","Expect to respond NRC other than NRC0x13,but get negative response 0x13");
        }
        else
        {
          PrintPID("UDS","Neg.Response",gTpRxData,gTpRxLength);
          testStepPass("Pass","Get expectd response");
        }
      }
      else if(gres==POS)
      {
        PrintPID("UDS","Pos.Response",gTpRxData,gTpRxLength);
        testStepFail("Fail","Get unexpectd postive response");
      }
      else if(gres==TIMEOUT)
      {
        testStepFail("Fail","Timeout no response recived when request service 0x2E");
      }
    }
  }
  //ProgrammingSession
  
  /******************************以上为测试步骤*********************************/
  Postcondition();
}

/// <APP_SecurityAccessAlgorithm>
testcase  ReadandWriteSecurityConstant_APP()
{
  int  i;
  byte DID[2];
  int support_11_19_flag=0;
  byte SecurityConstantTest[16]={0x11,0x22,0x33,0x44,0x55,0x66,0x77,0x88,0x99,0x00,0x11,0x22,0x33,0x44,0x55,0x66};
  byte notApplicableFlag=1;
  
  char logName[400] = "";
  char info[1024];
  
  strncat(logName,"1023148_ReadandWriteSecurityConstant_APP",400);
  testCaseTitle("1023148","ReadandWriteSecurityConstant_APP");
  
  SetLog(logName);
  Precondition();
  
  /******************************以下为测试步骤*********************************/  
  SessionFlag=APP;
  
  for(i=0; i<NumOfSecurityLv; i++)
  {
    if(SELevel[i].SEFlagPBL == 1)
    {
      continue;
    }
    Level1=SELevel[i].SElevel;
    notApplicableFlag=0;
    
    if((Level1==0x11)||(Level1==0x19))
    {
      support_11_19_flag=1;
      if(Level1==0x11)
      {
        DID[0]=0xF1;
        DID[1]=0x0A;
      }
      else if(Level1==0x19)
      {
        DID[0]=0xF1;
        DID[1]=0x0B;
      }
      TestStep("Transition from defaultSession(0x01) to extendedDiagnosticSession(0x03)",TestStepIntervalTime);
      SID10_DiagnosticSessionControl(EXTENDEDSESSION,PHYSICAL,SPRMIB_TRUE);
      CheckNonResponse(0,0);
      
      TestStep("Verify ExtendedSession.",TestStepIntervalTime);
      CheckCurrentSession(EXTENDEDSESSION,PHYSICAL,0,0);
      
      SID27_SecurityAccess_RequestSeed(Level1,PHYSICAL);
      CheckPosResponse_SID27_ReqSeed(Level1,gSeedArray,16,0,0);
      PID27_Parameters_Seeds_Chk(NotAllZero,gSeedArray);
      
      SID27_SecurityAccess_SendKey(Level1,gKeyArray,PHYSICAL);
      CheckPosResponse_SID27_SenKey(Level1,0,0);
      
      TestStep("Read security constant",TestStepIntervalTime);
      SID22_ReadDataByIdentifier(DID,PHYSICAL);
      CheckNegResponse(0x31,0,0);
      
      TestStep("Write security constant",TestStepIntervalTime);
      SID2E_WriteDataByIdentifier(DID,SecurityConstantTest,PHYSICAL);
      CheckPosResponse_SID2E(DID,0,0);
      
      SID10_DiagnosticSessionControl(EXTENDEDSESSION,PHYSICAL,SPRMIB_FALSE);
      CheckPosResponse_SID10(EXTENDEDSESSION,gP2Client_APP,gP2StarClientFor10Check,0,0);
      
      PrintPID("Info","Execute Security access,use security constant:",SELevel[i].SEconstant,16);
      SID27_SecurityAccess_RequestSeed(Level1,PHYSICAL);
      CheckPosResponse_SID27_ReqSeed(Level1,gSeedArray,16,0,0);
      PID27_Parameters_Seeds_Chk(NotAllZero,gSeedArray);
      
      SID27_SecurityAccess_SendKey(Level1,gKeyArray,PHYSICAL);
      CheckNegResponse(0x35,0,0);
      
      memcpy_off(SELevel[i].SEconstant,0,SecurityConstantTest,0,16);
      PrintPID("Info","Execute Security access,use security constant:",SELevel[i].SEconstant,16);
      
      SID27_SecurityAccess_RequestSeed(Level1,PHYSICAL);
      CheckPosResponse_SID27_ReqSeed(Level1,gSeedArray,16,0,0);
      PID27_Parameters_Seeds_Chk(NotAllZero,gSeedArray);
      
      SID27_SecurityAccess_SendKey(Level1,gKeyArray,PHYSICAL);
      CheckPosResponse_SID27_SenKey(Level1,0,0);
      
      TestStep("Write security constant again",TestStepIntervalTime);
      SID2E_WriteDataByIdentifier(DID,SecurityConstantTest,PHYSICAL);
      CheckNegResponse(0x22,0,0);
      
    }
    else
    {
      if((i==(NumOfSecurityLv-1))&&(notApplicableFlag==1))
      {
        testStepWarning("Warning","ECU not support Securirty access level 0x11&0x19,this test is not applicable");
      }
    }
  }
  
  if(support_11_19_flag==1)
  {
    TestStep("Verify ExtendedSession.",TestStepIntervalTime);
    CheckCurrentSession(EXTENDEDSESSION,PHYSICAL,0,0);
  }
  /******************************以上为测试步骤*********************************/
  Postcondition();
   
}
/// <APP_SecurityAccessAlgorithm>
testcase DelayTimerAfterFalseAttempts_APP()
{
  int i,B;
  dword t;
  int N = 2;
  float TempT1,TempT2;
  char logName[400] = "";
  char info[1024];
  
  strncat(logName,"1023149_DelayTimerAfterFalseAttempts_APP",400);
  testCaseTitle("1023149","DelayTimerAfterFalseAttempts_APP");
  
  SetLog(logName);
  Precondition();
  /******************************以下为测试步骤*********************************/
  
  SessionFlag=APP;
  
  for(i=0; i<NumOfSecurityLv; i++)
  {
    if(SELevel[i].SEFlagPBL == 1)
    {
      continue;
    }
    TestStep("Transition from defaultSession(0x01) to extendedDiagnosticSession(0x03).",TestStepIntervalTime);
    SID10_DiagnosticSessionControl(EXTENDEDSESSION,PHYSICAL,SPRMIB_FALSE);
    CheckPosResponse_SID10(EXTENDEDSESSION,gP2Client_APP,gP2StarClientFor10Check,0,0);
    TestStep("Verify extendedDiagnosticSession.",TestStepIntervalTime);
    CheckCurrentSession(EXTENDEDSESSION,PHYSICAL,0,0);
    
    Level1=SELevel[i].SElevel;    
    testWaitForTimeout(gTimeWaitForSecuAccess);
    
   //1) Test no delay after N-1 false attempts:
    for(B=0; B<N-1; B++)
    {
      TestStep("ECU response with seed. Verify that S1...S16 not equal to 0x000000.",TestStepIntervalTime);
      SID27_SecurityAccess_RequestSeed(Level1,PHYSICAL);
      CheckPosResponse_SID27_ReqSeed(Level1,gSeedArray,16,0,0);
      PID27_Parameters_Seeds_Chk(NotAllZero,gSeedArray);
      TestStep("Generate wrong key from response.",TestStepIntervalTime);
      gSeedArray[2]=gSeedArray[2]+1;//产生错误的秘钥
      
      TestStep("Send invalid key.",TestStepIntervalTime);
      SID27_SecurityAccess_SendKey(Level1,gKeyArray,PHYSICAL);
      CheckNegResponse(0x35,0,0);
    }
    
    TestStep("ECU response with seed. Verify that S1...S16 not equal to 0x000000.",TestStepIntervalTime);
    SID27_SecurityAccess_RequestSeed(Level1,PHYSICAL);
    CheckPosResponse_SID27_ReqSeed(Level1,gSeedArray,16,0,0);
    PID27_Parameters_Seeds_Chk(NotAllZero,gSeedArray);
    TestStep("ECU unlock.",TestStepIntervalTime);
    SID27_SecurityAccess_SendKey(Level1,gKeyArray,PHYSICAL);
    CheckPosResponse_SID27_SenKey(Level1,0,0);
    
    //2) Test the delay timer after false attempts:
    TestStep("Transition from defaultSession(0x01) to extendedDiagnosticSession(0x03).",TestStepIntervalTime);
    SID10_DiagnosticSessionControl(EXTENDEDSESSION,PHYSICAL,SPRMIB_FALSE);
    CheckPosResponse_SID10(EXTENDEDSESSION,gP2Client_APP,gP2StarClientFor10Check,0,0);
    TestStep("Verify extendedDiagnosticSession.",TestStepIntervalTime);
    CheckCurrentSession(EXTENDEDSESSION,PHYSICAL,0,0);
    
    for(B=0; B<N; B++)
    {
      TestStep("ECU response with seed. Verify that S1...S16 not equal to 0x000000.",TestStepIntervalTime);
      SID27_SecurityAccess_RequestSeed(Level1,PHYSICAL);
      CheckPosResponse_SID27_ReqSeed(Level1,gSeedArray,16,0,0);
      PID27_Parameters_Seeds_Chk(NotAllZero,gSeedArray);
      TestStep("Generate wrong key from response.",TestStepIntervalTime);
      gSeedArray[2]=gSeedArray[2]+1;//产生错误的秘钥
      
      TestStep("Send invalid key.",TestStepIntervalTime);
      if(B != N-1)
      {
        SID27_SecurityAccess_SendKey(Level1,gKeyArray,PHYSICAL);
        CheckNegResponse(0x35,0,0);
      }
      else
      {
        SID27_SecurityAccess_SendKey(Level1,gKeyArray,PHYSICAL);
        CheckNegResponse(0x36,0,0);
      }
    }
    
    for(t=0; t<DelayTimer;)
    {
      SID27_SecurityAccess_RequestSeed(Level1,PHYSICAL);
      CheckNegResponse(0x37,0,0);
      t = t + 1005;
      testWaitForTimeout(1005);
    }
    SID27_SecurityAccess_RequestSeed(Level1,PHYSICAL);
    CheckPosResponse_SID27_ReqSeed(Level1,gSeedArray,16,0,0);
    PID27_Parameters_Seeds_Chk(NotAllZero,gSeedArray);
    
    SID27_SecurityAccess_SendKey(Level1,gKeyArray,PHYSICAL);
    CheckPosResponse_SID27_SenKey(Level1,0,0);
    
    SID10_DiagnosticSessionControl(EXTENDEDSESSION,PHYSICAL,SPRMIB_FALSE);
    CheckPosResponse_SID10(EXTENDEDSESSION,gP2Client_APP,gP2StarClientFor10Check,0,0);
    
    TestStep("===Below steps is to verify false attempts counter shall be reset to zero after ECU reset===");
    for(B=0; B<N-1; B++)
    {
      TestStep("ECU response with seed. Verify that S1...S16 not equal to 0x000000.",TestStepIntervalTime);
      SID27_SecurityAccess_RequestSeed(Level1,PHYSICAL);
      CheckPosResponse_SID27_ReqSeed(Level1,gSeedArray,16,0,0);
      PID27_Parameters_Seeds_Chk(NotAllZero,gSeedArray);
      TestStep("Generate wrong key from response.",TestStepIntervalTime);
      gSeedArray[2]=gSeedArray[2]+1;//产生错误的秘钥
      
      TestStep("Send invalid key.",TestStepIntervalTime);
      if(B != N-1)
      {
        SID27_SecurityAccess_SendKey(Level1,gKeyArray,PHYSICAL);
        CheckNegResponse(0x35,0,0);
      }
      else
      {
        SID27_SecurityAccess_SendKey(Level1,gKeyArray,PHYSICAL);
        CheckNegResponse(0x36,0,0);
      }
    }
    testWaitForTimeout(50);//增加50ms延时
    SID11_ECUReset(HARDRESET,PHYSICAL,SPRMIB_FALSE);
    CheckPosResponse_SID11(HARDRESET,0,0);

    ECUinitHandle(0);
    
    SID10_DiagnosticSessionControl(EXTENDEDSESSION,PHYSICAL,SPRMIB_FALSE);
    CheckPosResponse_SID10(EXTENDEDSESSION,gP2Client_APP,gP2StarClientFor10Check,0,0);
    
    for(B=0; B<N; B++)
    {
      TestStep("ECU response with seed. Verify that S1...S16 not equal to 0x000000.",TestStepIntervalTime);
      SID27_SecurityAccess_RequestSeed(Level1,PHYSICAL);
      CheckPosResponse_SID27_ReqSeed(Level1,gSeedArray,16,0,0);
      PID27_Parameters_Seeds_Chk(NotAllZero,gSeedArray);
      TestStep("Generate wrong key from response.",TestStepIntervalTime);
      gSeedArray[2]=gSeedArray[2]+1;//产生错误的秘钥
      
      TestStep("Send invalid key.",TestStepIntervalTime);
      if(B != N-1)
      {
        SID27_SecurityAccess_SendKey(Level1,gKeyArray,PHYSICAL);
        CheckNegResponse(0x35,0,0);
      }
      else
      {
        SID27_SecurityAccess_SendKey(Level1,gKeyArray,PHYSICAL);
        CheckNegResponse(0x36,0,0);
      }
    }
    
    testWaitForTimeout(DelayTimer+2000);

    SID27_SecurityAccess_RequestSeed(Level1,PHYSICAL);
    CheckPosResponse_SID27_ReqSeed(Level1,gSeedArray,16,0,0);
    PID27_Parameters_Seeds_Chk(NotAllZero,gSeedArray);
    
    SID27_SecurityAccess_SendKey(Level1,gKeyArray,PHYSICAL);
    CheckPosResponse_SID27_SenKey(Level1,0,0);
    
    SID10_DiagnosticSessionControl(EXTENDEDSESSION,PHYSICAL,SPRMIB_FALSE);
    CheckPosResponse_SID10(EXTENDEDSESSION,gP2Client_APP,gP2StarClientFor10Check,0,0);
    
    TestStep("===Below steps is to verify Delay timer will not lost after ECU Reset===");
    
    for(B=0; B<N; B++)
    {
      TestStep("ECU response with seed. Verify that S1...S16 not equal to 0x000000.",TestStepIntervalTime);
      SID27_SecurityAccess_RequestSeed(Level1,PHYSICAL);
      CheckPosResponse_SID27_ReqSeed(Level1,gSeedArray,16,0,0);
      PID27_Parameters_Seeds_Chk(NotAllZero,gSeedArray);
      TestStep("Generate wrong key from response.",TestStepIntervalTime);
      gSeedArray[2]=gSeedArray[2]+1;//产生错误的秘钥
      
      TestStep("Send invalid key.",TestStepIntervalTime);
      if(B != N-1)
      {
        SID27_SecurityAccess_SendKey(Level1,gKeyArray,PHYSICAL);
        CheckNegResponse(0x35,0,0);
      }
      else
      {
        SID27_SecurityAccess_SendKey(Level1,gKeyArray,PHYSICAL);
        CheckNegResponse(0x36,0,0);
      }
    }
    testWaitForTimeout(50);//增加50ms延时
    SID11_ECUReset(HARDRESET,PHYSICAL,SPRMIB_FALSE);
    CheckPosResponse_SID11(HARDRESET,0,0);

    ECUinitHandle(0);
    
    SID10_DiagnosticSessionControl(EXTENDEDSESSION,PHYSICAL,SPRMIB_FALSE);
    CheckPosResponse_SID10(EXTENDEDSESSION,gP2Client_APP,gP2StarClientFor10Check,0,0);
    
    SID27_SecurityAccess_RequestSeed(Level1,PHYSICAL);
    CheckNegResponse(0x37,0,0);
//    CheckPosResponse_SID27_ReqSeed(Level1,gSeedArray,16,0,0);
//    PID27_Parameters_Seeds_Chk(NotAllZero,gSeedArray);
//    
//    SID27_SecurityAccess_SendKey(Level1,gKeyArray,PHYSICAL);
//    CheckNegResponse(0x37,0,0);
      
    delaywithreq(DelayTimer+2000);
    
    SID27_SecurityAccess_RequestSeed(Level1,PHYSICAL);
    CheckPosResponse_SID27_ReqSeed(Level1,gSeedArray,16,0,0);
    PID27_Parameters_Seeds_Chk(NotAllZero,gSeedArray);
    
    SID27_SecurityAccess_SendKey(Level1,gKeyArray,PHYSICAL);
    CheckPosResponse_SID27_SenKey(Level1,0,0);
    
    SID10_DiagnosticSessionControl(EXTENDEDSESSION,PHYSICAL,SPRMIB_FALSE);
    CheckPosResponse_SID10(EXTENDEDSESSION,gP2Client_APP,gP2StarClientFor10Check,0,0);

    TestStep("===Below steps is to verify false attempts counter will return 0 after Delay timer time-out===");
    for(B=0; B<N; B++)
    {
      TestStep("ECU response with seed. Verify that S1...S16 not equal to 0x000000.",TestStepIntervalTime);
      SID27_SecurityAccess_RequestSeed(Level1,PHYSICAL);
      CheckPosResponse_SID27_ReqSeed(Level1,gSeedArray,16,0,0);
      PID27_Parameters_Seeds_Chk(NotAllZero,gSeedArray);
      TestStep("Generate wrong key from response.",TestStepIntervalTime);
      gSeedArray[2]=gSeedArray[2]+1;//产生错误的秘钥
      
      TestStep("Send invalid key.",TestStepIntervalTime);
      if(B != N-1)
      {
        SID27_SecurityAccess_SendKey(Level1,gKeyArray,PHYSICAL);
        CheckNegResponse(0x35,0,0);
      }
      else
      {
        SID27_SecurityAccess_SendKey(Level1,gKeyArray,PHYSICAL);
        CheckNegResponse(0x36,0,0);
      }
    }
    SID27_SecurityAccess_RequestSeed(Level1,PHYSICAL);
    CheckNegResponse(0x37,0,0);
    
    delaywithreq(DelayTimer+100);
    
    for(B=0; B<N-1; B++)
    {
      TestStep("ECU response with seed. Verify that S1...S16 not equal to 0x000000.",TestStepIntervalTime);
      SID27_SecurityAccess_RequestSeed(Level1,PHYSICAL);
      CheckPosResponse_SID27_ReqSeed(Level1,gSeedArray,16,0,0);
      PID27_Parameters_Seeds_Chk(NotAllZero,gSeedArray);
      TestStep("Generate wrong key from response.",TestStepIntervalTime);
      gSeedArray[2]=gSeedArray[2]+1;//产生错误的秘钥
      
      TestStep("Send invalid key.",TestStepIntervalTime);
      if(B != N-1)
      {
        SID27_SecurityAccess_SendKey(Level1,gKeyArray,PHYSICAL);
        CheckNegResponse(0x35,0,0);
      }
      else
      {
        SID27_SecurityAccess_SendKey(Level1,gKeyArray,PHYSICAL);
        CheckNegResponse(0x36,0,0);
      }
    }
    delaywithreq(DelayTimer+2000);
    
    SID27_SecurityAccess_RequestSeed(Level1,PHYSICAL);
    CheckPosResponse_SID27_ReqSeed(Level1,gSeedArray,16,0,0);
    PID27_Parameters_Seeds_Chk(NotAllZero,gSeedArray);
    
    SID27_SecurityAccess_SendKey(Level1,gKeyArray,PHYSICAL);
    CheckPosResponse_SID27_SenKey(Level1,0,0);
    
    
  }

//  TestStep("Verify extendedDiagnosticSession.",TestStepIntervalTime);
//  CheckCurrentSession(EXTENDEDSESSION,PHYSICAL,0,0);

  /******************************以上为测试步骤*********************************/
  Postcondition();
   
}
/// <APP_SecurityAccessAlgorithm>
testcase CountersForFalseAttemptsExtendedSession()
{
  int i,j;
  char logName[400] = "";
  char info[1024];
  
  strncat(logName,"1023150_CountersForFalseAttemptsExtendedSession",400);
  testCaseTitle("1023150","CountersForFalseAttemptsExtendedSession");
  
  SetLog(logName);
  Precondition();
  /******************************以下为测试步骤*********************************/
  
  SessionFlag=APP;
   
  for(i=0; i<NumOfSecurityLv; i++)
  {
    if(SELevel[i].SEFlagPBL == 1)
    {
      continue;
    }
    Level1=SELevel[i].SElevel;    
    
    TestStep("Transition from defaultSession(0x01) to extendedDiagnosticSession(0x03).",TestStepIntervalTime);
    SID10_DiagnosticSessionControl(EXTENDEDSESSION,PHYSICAL,SPRMIB_FALSE);
    CheckPosResponse_SID10(EXTENDEDSESSION,gP2Client_APP,gP2StarClientFor10Check,0,0);
    TestStep("Verify extendedDiagnosticSession.",TestStepIntervalTime);
    CheckCurrentSession(EXTENDEDSESSION,PHYSICAL,0,0);
    
	  testWaitForTimeout(gTimeWaitForSecuAccess);
	
    TestStep("ECU response with seed. Verify that S1...S16 not equal to 0x000000.",TestStepIntervalTime);
    SID27_SecurityAccess_RequestSeed(Level1,PHYSICAL);
    CheckPosResponse_SID27_ReqSeed(Level1,gSeedArray,16,0,0);
    PID27_Parameters_Seeds_Chk(NotAllZero,gSeedArray);
    
    gSeedArray[0] = ~gSeedArray[0];
    
    SID27_SecurityAccess_SendKey(Level1,gKeyArray,PHYSICAL);
    CheckNegResponse(0x35,0,0);
    
    //TestStep("ECU response with seed. Verify that S1...S16 not equal to 0x000000.",TestStepIntervalTime);
    SID27_SecurityAccess_RequestSeed(Level1,PHYSICAL);
    CheckPosResponse_SID27_ReqSeed(Level1,gSeedArray,16,0,0);
    PID27_Parameters_Seeds_Chk(NotAllZero,gSeedArray);
    
    SID27_SecurityAccess_SendKey(Level1,gKeyArray,PHYSICAL);
    CheckPosResponse_SID27_SenKey(Level1,0,0);
    
    TestStep("Transition from defaultSession(0x01) to extendedDiagnosticSession(0x03).",TestStepIntervalTime);
    SID10_DiagnosticSessionControl(EXTENDEDSESSION,PHYSICAL,SPRMIB_FALSE);
    CheckPosResponse_SID10(EXTENDEDSESSION,gP2Client_APP,gP2StarClientFor10Check,0,0);
    TestStep("Verify extendedDiagnosticSession.",TestStepIntervalTime);
    CheckCurrentSession(EXTENDEDSESSION,PHYSICAL,0,0);
    
    TestStep("ECU response with seed. Verify that S1...S16 not equal to 0x000000.",TestStepIntervalTime);
    SID27_SecurityAccess_RequestSeed(Level1,PHYSICAL);
    CheckPosResponse_SID27_ReqSeed(Level1,gSeedArray,16,0,0);
    PID27_Parameters_Seeds_Chk(NotAllZero,gSeedArray);
    
    gSeedArray[0] = ~gSeedArray[0];
    
    SID27_SecurityAccess_SendKey(Level1,gKeyArray,PHYSICAL);
    CheckNegResponse(0x35,0,0);
    
    TestStep("ECU response with seed. Verify that S1...S16 not equal to 0x000000.",TestStepIntervalTime);
    SID27_SecurityAccess_RequestSeed(Level1,PHYSICAL);
    CheckPosResponse_SID27_ReqSeed(Level1,gSeedArray,16,0,0);
    PID27_Parameters_Seeds_Chk(NotAllZero,gSeedArray);
    
    gSeedArray[0] = ~gSeedArray[0];
    
    SID27_SecurityAccess_SendKey(Level1,gKeyArray,PHYSICAL);
    CheckNegResponse(0x36,0,0);
    
    for(j=0;j<9;j++)
    {
    
    SID27_SecurityAccess_RequestSeed(Level1,PHYSICAL);
    CheckNegResponse(0x37,0,0);
    
    testWaitForTimeout(1000);
    }
    
    delay(2000);
    
    SID27_SecurityAccess_RequestSeed(Level1,PHYSICAL);
    CheckPosResponse_SID27_ReqSeed(Level1,gSeedArray,16,0,0);
    PID27_Parameters_Seeds_Chk(NotAllZero,gSeedArray);
    
    SID27_SecurityAccess_SendKey(Level1,gKeyArray,PHYSICAL);
    CheckPosResponse_SID27_SenKey(Level1,0,0);
    
  }
}
/// <APP_SecurityAccessAlgorithm>
testcase Basic_Random_Seed_Test_extendedDiagnosticSession()
{
  int i;
  char logName[400] = "";
  char info[1024];
  
  strncat(logName,"1023151_Basic_Random_Seed_Test_extendedDiagnosticSession",400);
  testCaseTitle("1023151","Basic_Random_Seed_Test_extendedDiagnosticSession");
  
  SetLog(logName);
  Precondition();
  /******************************以下为测试步骤*********************************/
  
  SessionFlag=APP;
  
  TestStep("Transition from defaultSession(0x01) to extendedDiagnosticSession(0x03).",TestStepIntervalTime);
  SID10_DiagnosticSessionControl(EXTENDEDSESSION,PHYSICAL,SPRMIB_FALSE);
  CheckPosResponse_SID10(EXTENDEDSESSION,gP2Client_APP,gP2StarClientFor10Check,0,0);
  TestStep("Verify extendedDiagnosticSession.",TestStepIntervalTime);
  CheckCurrentSession(EXTENDEDSESSION,PHYSICAL,0,0);
  
  testWaitForTimeout(gTimeWaitForSecuAccess);
  
  for(i=0; i<NumOfSecurityLv; i++)
  { 
    if(SELevel[i].SEFlagPBL == 1)
    {
      continue;
    }
    
    Level1=SELevel[i].SElevel;    
    
    TestStep("ECU response with seed. Verify that S1...S16 not equal to 0x000000.",TestStepIntervalTime);
    SID27_SecurityAccess_RequestSeed(Level1,PHYSICAL);
    CheckPosResponse_SID27_ReqSeed(Level1,gSeedArray,16,0,0);
    PID27_Parameters_Seeds_Chk(NotAllZero,gSeedArray);
    TestStep("ECU response with seed. Verify that S1...S16 not equal to 0x000000.",TestStepIntervalTime);
    SID27_SecurityAccess_RequestSeed(Level1,PHYSICAL);
    CheckPosResponse_SID27_ReqSeed(Level1,gSeedArray,16,0,0);
    PID27_Parameters_Seeds_Chk(NotAllZero,gSeedArray);
    
    TestStep("Transition from defaultSession(0x01) to extendedDiagnosticSession(0x03).",TestStepIntervalTime);
    SID10_DiagnosticSessionControl(EXTENDEDSESSION,PHYSICAL,SPRMIB_FALSE);
    CheckPosResponse_SID10(EXTENDEDSESSION,gP2Client_APP,gP2StarClientFor10Check,0,0);
    TestStep("Verify extendedDiagnosticSession.",TestStepIntervalTime);
    CheckCurrentSession(EXTENDEDSESSION,PHYSICAL,0,0);
    
    TestStep("ECU response with seed. Verify that S1...S16 not equal to 0x000000.",TestStepIntervalTime);
    SID27_SecurityAccess_RequestSeed(Level1,PHYSICAL);
    CheckPosResponse_SID27_ReqSeed(Level1,gSeedArray,16,0,0);
    PID27_Parameters_Seeds_Chk(NotAllZero,gSeedArray);
    //testWaitForTimeout(50);//增加50ms延时
    TestStep("ECU Reset (hard reset)",TestStepIntervalTime);
    SID11_ECUReset(HARDRESET,PHYSICAL,SPRMIB_FALSE);
    CheckPosResponse_SID11(HARDRESET,0,0);
    ECUinitHandle(0);
    
    delay(5000);
    
    TestStep("Transition from defaultSession(0x01) to extendedDiagnosticSession(0x03).",TestStepIntervalTime);
    SID10_DiagnosticSessionControl(EXTENDEDSESSION,PHYSICAL,SPRMIB_FALSE);
    CheckPosResponse_SID10(EXTENDEDSESSION,gP2Client_APP,gP2StarClientFor10Check,0,0);
    TestStep("Verify extendedDiagnosticSession.",TestStepIntervalTime);
    CheckCurrentSession(EXTENDEDSESSION,PHYSICAL,0,0);
    
    TestStep("ECU response with seed. Verify that S1...S16 not equal to 0x000000.",TestStepIntervalTime);
    SID27_SecurityAccess_RequestSeed(Level1,PHYSICAL);
    CheckPosResponse_SID27_ReqSeed(Level1,gSeedArray,16,0,0);
    PID27_Parameters_Seeds_Chk(NotAllZero,gSeedArray);
  }
  TP_TesterPresentSet(TP_OFF);
  /******************************以上为测试步骤*********************************/
  Postcondition();
   
}
/// <APP_SecurityAccessAlgorithm>
testcase Extended_Random_Seed_Test_extendedDiagnosticSession()
{
  int i,j,k,n=0;
  byte AllSeeds[20000][16];
  int repeatFlag=0;
  struct seedinforecord
  {
    byte seedinfo[16];
    int  seedtime;
  };
  
  struct seedinforecord seedrecord[10000];
  int  seednum = 0;
  int  checkflag;
  char logName[400] = "";
  char info[1024];
  
  strncat(logName,"1023152_Extended_Random_Seed_Test_extendedDiagnosticSession",400);
  testCaseTitle("1023152","Extended_Random_Seed_Test_extendedDiagnosticSession");
  
  SetLog(logName);
  Precondition();
  /******************************以下为测试步骤*********************************/
  
  SessionFlag=APP;
  for(n=0; n<NumOfSecurityLv; n++)
  {
    if(SELevel[n].SEFlagPBL == 1)
    {
      continue;
    }
    Level1=SELevel[n].SElevel;  
    
    TestStep("Transition from defaultSession(0x01) to extendedDiagnosticSession(0x03).",TestStepIntervalTime);
    SID10_DiagnosticSessionControl(EXTENDEDSESSION,PHYSICAL,SPRMIB_FALSE);
    CheckPosResponse_SID10(EXTENDEDSESSION,gP2Client_APP,gP2StarClientFor10Check,0,0);
    
    TestStep("Verify extendedDiagnosticSession.",TestStepIntervalTime);
    CheckCurrentSession(EXTENDEDSESSION,PHYSICAL,0,0);
    
    testWaitForTimeout(gTimeWaitForSecuAccess);
    
    for(i=0; i<5000; i++)
    {
      SID27_SecurityAccess_RequestSeed(Level1,PHYSICAL);
      CheckPosResponse_SID27_ReqSeed(Level1,gSeedArray,16,0,0);
      for(j=0; j<i; j++)
      {
        if((AllSeeds[j][0] == gSeedArray[0]) && (AllSeeds[j][1] == gSeedArray[1]) && (AllSeeds[j][2] == gSeedArray[2])&& (AllSeeds[j][3] == gSeedArray[3])&& (AllSeeds[j][4] == gSeedArray[4])&& (AllSeeds[j][5] == gSeedArray[5])&& (AllSeeds[j][6] == gSeedArray[6])&& (AllSeeds[j][7] == gSeedArray[7])&& (AllSeeds[j][8] == gSeedArray[8])&& (AllSeeds[j][9] == gSeedArray[9])&& (AllSeeds[j][10] == gSeedArray[10])&& (AllSeeds[j][11] == gSeedArray[11])&& (AllSeeds[j][12] == gSeedArray[12])&& (AllSeeds[j][13] == gSeedArray[13])&& (AllSeeds[j][14] == gSeedArray[14])&& (AllSeeds[j][15] == gSeedArray[15]))
        {
          repeatFlag = 1;
          TestStepFail("Fail","Generated seed is repeated.");
          checkflag = 0;
            for(k = 0;k < seednum;k++)
            {
              if((seedrecord[k].seedinfo[0] == gSeedArray[0])&& (seedrecord[k].seedinfo[1] == gSeedArray[1]) && (seedrecord[k].seedinfo[2] == gSeedArray[2])&& (seedrecord[k].seedinfo[3] == gSeedArray[3])&& (seedrecord[k].seedinfo[4] == gSeedArray[4])&& (seedrecord[k].seedinfo[5] == gSeedArray[5])&& (seedrecord[k].seedinfo[6] == gSeedArray[6])&& (seedrecord[k].seedinfo[7] == gSeedArray[7])&& (seedrecord[k].seedinfo[8] == gSeedArray[8])&& (seedrecord[k].seedinfo[9] == gSeedArray[9])&& (seedrecord[k].seedinfo[10] == gSeedArray[10])&& (seedrecord[k].seedinfo[11] == gSeedArray[11])&& (seedrecord[k].seedinfo[12] == gSeedArray[12])&& (seedrecord[k].seedinfo[13] == gSeedArray[13])&& (seedrecord[k].seedinfo[14] == gSeedArray[14])&& (seedrecord[k].seedinfo[15] == gSeedArray[15]))
              {
                seedrecord[k].seedtime++;
                checkflag = 1;
              }
            }
            if(checkflag == 1)
            {
              
            }
            else
            {
              seedrecord[seednum].seedinfo[0] = gSeedArray[0];
              seedrecord[seednum].seedinfo[1] = gSeedArray[1];
              seedrecord[seednum].seedinfo[2] = gSeedArray[2];
              seedrecord[seednum].seedinfo[3] = gSeedArray[3];
              seedrecord[seednum].seedinfo[4] = gSeedArray[4];
              seedrecord[seednum].seedinfo[5] = gSeedArray[5];
              seedrecord[seednum].seedinfo[6] = gSeedArray[6];
              seedrecord[seednum].seedinfo[7] = gSeedArray[7];
              seedrecord[seednum].seedinfo[8] = gSeedArray[8];
              seedrecord[seednum].seedinfo[9] = gSeedArray[9];
              seedrecord[seednum].seedinfo[10] = gSeedArray[10];
              seedrecord[seednum].seedinfo[11] = gSeedArray[11];
              seedrecord[seednum].seedinfo[12] = gSeedArray[12];
              seedrecord[seednum].seedinfo[13] = gSeedArray[13];
              seedrecord[seednum].seedinfo[14] = gSeedArray[14];
              seedrecord[seednum].seedinfo[15] = gSeedArray[15];
              seedrecord[seednum].seedtime = 1;
              seednum++;
            }
        }
      }
      if(repeatFlag == 0)
      {
        AllSeeds[i][0] = gSeedArray[0];
        AllSeeds[i][1] = gSeedArray[1];
        AllSeeds[i][2] = gSeedArray[2];
        AllSeeds[i][3] = gSeedArray[3];
        AllSeeds[i][4] = gSeedArray[4];
        AllSeeds[i][5] = gSeedArray[5];
        AllSeeds[i][6] = gSeedArray[6];
        AllSeeds[i][7] = gSeedArray[7];
        AllSeeds[i][8] = gSeedArray[8];
        AllSeeds[i][9] = gSeedArray[9];
        AllSeeds[i][10] = gSeedArray[10];
        AllSeeds[i][11] = gSeedArray[11];
        AllSeeds[i][12] = gSeedArray[12];
        AllSeeds[i][13] = gSeedArray[13];
        AllSeeds[i][14] = gSeedArray[14];
        AllSeeds[i][15] = gSeedArray[15];
      }
    }
    TestStep("ECU Reset (hard reset)",TestStepIntervalTime);
    SID11_ECUReset(HARDRESET,PHYSICAL,SPRMIB_FALSE);
    CheckPosResponse_SID11(HARDRESET,0,0);
    ECUinitHandle(0);
    
    TestStep("Transition from defaultSession(0x01) to extendedDiagnosticSession(0x03).",TestStepIntervalTime);
    SID10_DiagnosticSessionControl(EXTENDEDSESSION,PHYSICAL,SPRMIB_FALSE);
    CheckPosResponse_SID10(EXTENDEDSESSION,gP2Client_APP,gP2StarClientFor10Check,0,0);
    TestStep("Verify extendedDiagnosticSession.",TestStepIntervalTime);
    
    testWaitForTimeout(gTimeWaitForSecuAccess);
    
    for(i=5000; i<10000; i++)
    {
      SID27_SecurityAccess_RequestSeed(Level1,PHYSICAL);
      CheckPosResponse_SID27_ReqSeed(Level1,gSeedArray,16,0,0);
      for(j=0; j<i; j++)
      {
        if((AllSeeds[j][0] == gSeedArray[0]) && (AllSeeds[j][1] == gSeedArray[1]) && (AllSeeds[j][2] == gSeedArray[2])&& (AllSeeds[j][3] == gSeedArray[3])&& (AllSeeds[j][4] == gSeedArray[4])&& (AllSeeds[j][5] == gSeedArray[5])&& (AllSeeds[j][6] == gSeedArray[6])&& (AllSeeds[j][7] == gSeedArray[7])&& (AllSeeds[j][8] == gSeedArray[8])&& (AllSeeds[j][9] == gSeedArray[9])&& (AllSeeds[j][10] == gSeedArray[10])&& (AllSeeds[j][11] == gSeedArray[11])&& (AllSeeds[j][12] == gSeedArray[12])&& (AllSeeds[j][13] == gSeedArray[13])&& (AllSeeds[j][14] == gSeedArray[14])&& (AllSeeds[j][15] == gSeedArray[15]))
        {
          repeatFlag = 1;
          TestStepFail("Fail","Generated seed is repeated.");
          checkflag = 0;
            for(k = 0;k < seednum;k++)
            {
              if((seedrecord[k].seedinfo[0] == gSeedArray[0])&& (seedrecord[k].seedinfo[1] == gSeedArray[1]) && (seedrecord[k].seedinfo[2] == gSeedArray[2])&& (seedrecord[k].seedinfo[3] == gSeedArray[3])&& (seedrecord[k].seedinfo[4] == gSeedArray[4])&& (seedrecord[k].seedinfo[5] == gSeedArray[5])&& (seedrecord[k].seedinfo[6] == gSeedArray[6])&& (seedrecord[k].seedinfo[7] == gSeedArray[7])&& (seedrecord[k].seedinfo[8] == gSeedArray[8])&& (seedrecord[k].seedinfo[9] == gSeedArray[9])&& (seedrecord[k].seedinfo[10] == gSeedArray[10])&& (seedrecord[k].seedinfo[11] == gSeedArray[11])&& (seedrecord[k].seedinfo[12] == gSeedArray[12])&& (seedrecord[k].seedinfo[13] == gSeedArray[13])&& (seedrecord[k].seedinfo[14] == gSeedArray[14])&& (seedrecord[k].seedinfo[15] == gSeedArray[15]))
              {
                seedrecord[k].seedtime++;
                checkflag = 1;
              }
            }
            if(checkflag == 1)
            {
              
            }
            else
            {
              seedrecord[seednum].seedinfo[0] = gSeedArray[0];
              seedrecord[seednum].seedinfo[1] = gSeedArray[1];
              seedrecord[seednum].seedinfo[2] = gSeedArray[2];
              seedrecord[seednum].seedinfo[3] = gSeedArray[3];
              seedrecord[seednum].seedinfo[4] = gSeedArray[4];
              seedrecord[seednum].seedinfo[5] = gSeedArray[5];
              seedrecord[seednum].seedinfo[6] = gSeedArray[6];
              seedrecord[seednum].seedinfo[7] = gSeedArray[7];
              seedrecord[seednum].seedinfo[8] = gSeedArray[8];
              seedrecord[seednum].seedinfo[9] = gSeedArray[9];
              seedrecord[seednum].seedinfo[10] = gSeedArray[10];
              seedrecord[seednum].seedinfo[11] = gSeedArray[11];
              seedrecord[seednum].seedinfo[12] = gSeedArray[12];
              seedrecord[seednum].seedinfo[13] = gSeedArray[13];
              seedrecord[seednum].seedinfo[14] = gSeedArray[14];
              seedrecord[seednum].seedinfo[15] = gSeedArray[15];
              seedrecord[seednum].seedtime = 1;
              seednum++;
            }
        }
      }
      if(repeatFlag == 0)
      {
        AllSeeds[i][0] = gSeedArray[0];
        AllSeeds[i][1] = gSeedArray[1];
        AllSeeds[i][2] = gSeedArray[2];
        AllSeeds[i][3] = gSeedArray[3];
        AllSeeds[i][4] = gSeedArray[4];
        AllSeeds[i][5] = gSeedArray[5];
        AllSeeds[i][6] = gSeedArray[6];
        AllSeeds[i][7] = gSeedArray[7];
        AllSeeds[i][8] = gSeedArray[8];
        AllSeeds[i][9] = gSeedArray[9];
        AllSeeds[i][10] = gSeedArray[10];
        AllSeeds[i][11] = gSeedArray[11];
        AllSeeds[i][12] = gSeedArray[12];
        AllSeeds[i][13] = gSeedArray[13];
        AllSeeds[i][14] = gSeedArray[14];
        AllSeeds[i][15] = gSeedArray[15];
      }
    }
    
    TestStep("Info","本次测试共计出现%d个重复种子",seednum);
    for(k=0;k<seednum;k++)
    {
      TestStep("Info","%d.种子%02X %02X %02X %02X %02X %02X %02X %02X %02X %02X %02X %02X %02X %02X %02X %02X出现%d次",k,seedrecord[k].seedinfo[0],seedrecord[k].seedinfo[1],seedrecord[k].seedinfo[2],seedrecord[k].seedinfo[3],seedrecord[k].seedinfo[4],seedrecord[k].seedinfo[5],seedrecord[k].seedinfo[6],seedrecord[k].seedinfo[7],seedrecord[k].seedinfo[8],seedrecord[k].seedinfo[9],seedrecord[k].seedinfo[10],seedrecord[k].seedinfo[11],seedrecord[k].seedinfo[12],seedrecord[k].seedinfo[13],seedrecord[k].seedinfo[14],seedrecord[k].seedinfo[15],seedrecord[k].seedtime);
    }
  }
  /******************************以上为测试步骤*********************************/
  Postcondition();
}

/// <APP_SecurityAccessAlgorithm>
testcase DelayTimer_activated_at_every_start_APP()
{
  int i,j;
  float T3,T4,Delta;
  char logName[400] = "";
  char info[1024];
  message 0x1 TpRes;
  int counter=0;
  
  strncat(logName,"1088590_DelayTimer_activated_at_every_start_APP",400);
  testCaseTitle("1088590","DelayTimer_activated_at_every_start_APP");
  
  SetLog(logName);
  Precondition();
  
  /******************************以下为测试步骤*********************************/
  
  SessionFlag=APP;
  TPMsgInit(0);
  
  for(i=0; i<NumOfSecurityLv; i++)
  {
    if(i==0)
      TestStep("Let L1 = First security level from the configured security level array from configured list. ",TestStepIntervalTime);
    else
      TestStep("Start Test",TestStepIntervalTime);
    
    if(SELevel[i].SEFlagPBL == 1)
    {
      continue;
    }
    
    Level1=SELevel[i].SElevel;
    
    TestStep("SEInfo","SELevel1 is %02x",Level1);

    SID10_DiagnosticSessionControl(PROGRAMMINGSESSION,FUNCTIONAL,SPRMIB_TRUE);
    testWaitForTimeout(ECUIniTime);
    
    SessionFlag=BOOT;
    TestStep("Verify programmingSession",TestStepIntervalTime);
    CheckCurrentSession(PROGRAMMINGSESSION,PHYSICAL,0,0);
    
    TestStep("Transition to defaultSesion(0x01)",TestStepIntervalTime);
    SID10_DiagnosticSessionControl(DEFAULTSESSION,PHYSICAL,SPRMIB_FALSE);
    CheckPosResponse_SID10(DEFAULTSESSION,gP2Client_APP,gP2StarClientFor10Check,0,0);
    
    SessionFlag=APP;
    TestStep("ECU reset");
    if((gBusFlag==1)||(gBusFlag==2))
    {
      msgF186.id=gCAN_RequestID;
      TestStep("10ms cycle send 22 F1 86");
      T4 = timeNowFloat()/10000;
      setTimerCyclic(SendF186,10);
//      output(msgF186);

      //write("Response ID is %03x",ResponseID);
      while(counter<1000)
      {
        counter++;
        testJoinMessageEvent(gCAN_ResponseID);
        if(TestWaitForAnyJoinedEvent(10)>0)
        {
          testGetWaitEventMsgData(TpRes);
//          write("byte(1)=%x,byte(4)=%x",TpRes.byte(1),TpRes.byte(4));
          if((TpRes.byte(1)==0x62)&&(TpRes.byte(4)==0x01))
          {
            T3 = timeNowFloat()/10000;
            break;
          }
        }
      }
      cancelTimer(SendF186);
      if(counter==1000)
      {
        TestStepFail("","ECU Reset timeout");
      }
      else
      {
        Delta = (T3-T4)*100;
        TestStep("","**********\nThe ECU reset time is %f ms\n**********",Delta);
      }
      counter=0;
    }
    else
    {
      ECUinitHandle(0);
    }
    testWaitForTimeout(10);
    TestStep("Verify defaultSession.",TestStepIntervalTime);
    CheckCurrentSession(DEFAULTSESSION,PHYSICAL,0,0);
    
    TestStep("Transition to extendedDiagnosticSession(0x03)",TestStepIntervalTime);
    SID10_DiagnosticSessionControl(EXTENDEDSESSION,PHYSICAL,SPRMIB_FALSE);
    CheckPosResponse_SID10(EXTENDEDSESSION,gP2Client_APP,gP2StarClientFor10Check,0,0);
    
    testWaitForTimeout(gTimeWaitForSecuAccess);
    
    TestStep("ECU response with seed. Verify that S1...S16 not equal to 0x000000.",TestStepIntervalTime);
    SID27_SecurityAccess_RequestSeed(Level1,PHYSICAL);
    CheckPosResponse_SID27_ReqSeed(Level1,gSeedArray,16,0,0);
    PID27_Parameters_Seeds_Chk(NotAllZero,gSeedArray);
    SID27_SecurityAccess_SendKey(Level1,gKeyArray,PHYSICAL);
    CheckPosResponse_SID27_SenKey(Level1,0,0);
    
    TestStep("Repet the above steps with other level again",TestStepIntervalTime);
  }
  for(i=0; i<NumOfSecurityLv; i++)
  {
    if(SELevel[i].SEFlagPBL == 1)
    {
      continue;
    }
    
    Level1=SELevel[i].SElevel;
    
    
    TestStep("SEInfo","SELevel1 is %02x",Level1);
    
    SessionFlag=APP;
    TestStep("Transition to ExtendedSession(0x03)",TestStepIntervalTime);
    SID10_DiagnosticSessionControl(EXTENDEDSESSION,PHYSICAL,SPRMIB_FALSE);
    CheckPosResponse_SID10(EXTENDEDSESSION,gP2Client_APP,gP2StarClientFor10Check,0,0);
    
    TestStep("Verify ExtendedSession",TestStepIntervalTime);
    CheckCurrentSession(EXTENDEDSESSION,PHYSICAL,0,0);
 
    
    TestStep("ECU Reset (hard reset)",TestStepIntervalTime);
    SID11_ECUReset(HARDRESET,PHYSICAL,SPRMIB_FALSE);
    CheckPosResponse_SID11(HARDRESET,0,0);
    
    
    SessionFlag=APP;
    TestStep("ECU reset");
    if((gBusFlag==1)||(gBusFlag==2))
    {
      msgF186.id=gCAN_RequestID;
      TestStep("10ms cycle send 22 F1 86");
      T4 = timeNowFloat()/10000;
      setTimerCyclic(SendF186,10);

      
      //write("Response ID is %03x",ResponseID);
      while(counter<1000)
      {
        counter++;
        testJoinMessageEvent(gCAN_ResponseID);
        if(TestWaitForAnyJoinedEvent(10)>0)
        {
          testGetWaitEventMsgData(TpRes);
          if((TpRes.byte(1)==0x62)&&(TpRes.byte(4)==0x01))
          {
            T3 = timeNowFloat()/10000;
            break;
          }
        }
      }
      cancelTimer(SendF186);
      if(counter==1000)
      {
        TestStepFail("","ECU Reset timeout");
      }
      else
      {
        Delta = (T3-T4)*100;
        TestStep("","**********\nThe ECU reset time is %f ms\n**********",Delta);
      }
      counter=0;
    }
    else
    {
      ECUinitHandle(0);
    }
    testWaitForTimeout(10);
    TestStep("Verify defaultSession.");
    CheckCurrentSession(DEFAULTSESSION,PHYSICAL,0,0);
    
    TestStep("Transition to extendedDiagnosticSession(0x03)",TestStepIntervalTime);
    SID10_DiagnosticSessionControl(EXTENDEDSESSION,PHYSICAL,SPRMIB_FALSE);
    CheckPosResponse_SID10(EXTENDEDSESSION,gP2Client_APP,gP2StarClientFor10Check,0,0);
    
    testWaitForTimeout(gTimeWaitForSecuAccess);
    
    TestStep("ECU response with seed. Verify that S1...S16 not equal to 0x000000.",TestStepIntervalTime);
    SID27_SecurityAccess_RequestSeed(Level1,PHYSICAL);
    CheckPosResponse_SID27_ReqSeed(Level1,gSeedArray,16,0,0);
    PID27_Parameters_Seeds_Chk(NotAllZero,gSeedArray);
    SID27_SecurityAccess_SendKey(Level1,gKeyArray,PHYSICAL);
    CheckPosResponse_SID27_SenKey(Level1,0,0);
    
    TestStep("Repet the above steps with other level again",TestStepIntervalTime);
  }
  /******************************以上为测试步骤*********************************/
  Postcondition(); 
}

/// <PBL_SecurityAccessAlgorithm>
testcase ReadOfSecurityConstant_PBL()
{
  byte DID[2] = {0xF1,0x09};
  char logName[400] = "";
  char info[1024];
  
  strncat(logName,"1023154_ReadOfSecurityConstant_PBL",400);
  testCaseTitle("1023154","ReadOfSecurityConstant_PBL");
  
  
  SetLog(logName);
  Precondition();
  SessionFlag=APP;
  
  TestStep("Transition from defaultSession(0x01) to ProgrammingDiagnosticSession(0x02).",TestStepIntervalTime);
  SID10_DiagnosticSessionControl(PROGRAMMINGSESSION,PHYSICAL,SPRMIB_FALSE);
  CheckPosResponse_SID10(PROGRAMMINGSESSION,gP2Client_BOOT,gP2StarClientFor10Check,0,0);
  
  ECUinitHandle(0);
  
  TestStep("Verify programmingDiagnosticSession.",TestStepIntervalTime);
  CheckCurrentSession(PROGRAMMINGSESSION,PHYSICAL,0,0);
  
  TestStep("Read security constant",TestStepIntervalTime);
  SID22_ReadDataByIdentifier(DID,PHYSICAL);
  CheckNegResponse(0x31,0,0);
  TestStep("Verify programmingDiagnosticSession.",TestStepIntervalTime);
  CheckCurrentSession(PROGRAMMINGSESSION,PHYSICAL,0,0);
  
  Postcondition();
}
/// <PBL_SecurityAccessAlgorithm>
testcase DelayTimerAfterFalseAttempts_PBL()
{
  int i,B;
  dword t;
  int N = 2;
  char logName[400] = "";
  char info[1024];
  
  strncat(logName,"1023155_DelayTimerAfterFalseAttempts_PBL",400);
  testCaseTitle("1023155","DelayTimerAfterFalseAttempts_PBL");
  
  SetLog(logName);
  Precondition();
  /******************************以下为测试步骤*********************************/
  
  SessionFlag=APP;

  TestStep("Transition from defaultSession(0x01) to ProgrammingDiagnosticSession(0x02).",TestStepIntervalTime);
  SID10_DiagnosticSessionControl(PROGRAMMINGSESSION,PHYSICAL,SPRMIB_FALSE);
  CheckPosResponse_SID10(PROGRAMMINGSESSION,gP2Client_BOOT,gP2StarClientFor10Check,0,0);
  
  ECUinitHandle(0);
  
  TestStep("Verify programmingDiagnosticSession.",TestStepIntervalTime);
  CheckCurrentSession(PROGRAMMINGSESSION,PHYSICAL,0,0);
  
  Level1=0x01;  
  testWaitForTimeout(gTimeWaitForSecuAccess);
 //1) Test no delay after N-1 false attempts:
  for(B=0; B<N-1; B++)
  {
    TestStep("ECU response with seed. Verify that S1...S16 not equal to 0x000000.",TestStepIntervalTime);
    SID27_SecurityAccess_RequestSeed(Level1,PHYSICAL);
    CheckPosResponse_SID27_ReqSeed(Level1,gSeedArray,16,0,0);
    PID27_Parameters_Seeds_Chk(NotAllZero,gSeedArray);
    TestStep("Generate wrong key from response.",TestStepIntervalTime);
    gSeedArray[2]=gSeedArray[2]+1;//产生错误的秘钥
    
    TestStep("Send invalid key.",TestStepIntervalTime);
    SID27_SecurityAccess_SendKey(Level1,gKeyArray,PHYSICAL);
    CheckNegResponse(0x35,0,0);
  }
  
  TestStep("ECU response with seed. Verify that S1...S16 not equal to 0x000000.",TestStepIntervalTime);
  SID27_SecurityAccess_RequestSeed(Level1,PHYSICAL);
  CheckPosResponse_SID27_ReqSeed(Level1,gSeedArray,16,0,0);
  PID27_Parameters_Seeds_Chk(NotAllZero,gSeedArray);
  TestStep("ECU unlock.",TestStepIntervalTime);
  SID27_SecurityAccess_SendKey(Level1,gKeyArray,PHYSICAL);
  CheckPosResponse_SID27_SenKey(Level1,0,0);
  
  //2) Test the delay timer after false attempts:
  TestStep("Transition from defaultSession(0x01) to ProgrammingDiagnosticSession(0x02).",TestStepIntervalTime);
  SID10_DiagnosticSessionControl(PROGRAMMINGSESSION,PHYSICAL,SPRMIB_FALSE);
  CheckPosResponse_SID10(PROGRAMMINGSESSION,gP2Client_BOOT,gP2StarClientFor10Check,0,0);
  
  ECUinitHandle(0);
  
  TestStep("Verify programmingDiagnosticSession.",TestStepIntervalTime);
  CheckCurrentSession(PROGRAMMINGSESSION,PHYSICAL,0,0);
  
  for(B=0; B<N; B++)
  {
    TestStep("ECU response with seed. Verify that S1...S16 not equal to 0x000000.",TestStepIntervalTime);
    SID27_SecurityAccess_RequestSeed(Level1,PHYSICAL);
    CheckPosResponse_SID27_ReqSeed(Level1,gSeedArray,16,0,0);
    PID27_Parameters_Seeds_Chk(NotAllZero,gSeedArray);
    TestStep("Generate wrong key from response.",TestStepIntervalTime);
    gSeedArray[2]=gSeedArray[2]+1;//产生错误的秘钥
    
    TestStep("Send invalid key.",TestStepIntervalTime);
    if(B != N-1)
    {
      SID27_SecurityAccess_SendKey(Level1,gKeyArray,PHYSICAL);
      CheckNegResponse(0x35,0,0);
    }
    else
    {
      SID27_SecurityAccess_SendKey(Level1,gKeyArray,PHYSICAL);
      CheckNegResponse(0x36,0,0);
    }
  }
  
  for(t=0; t<DelayTimer;)
  {
    SID27_SecurityAccess_RequestSeed(Level1,PHYSICAL);
    CheckNegResponse(0x37,0,0);
    t = t + 1005;
    testWaitForTimeout(1005);
  }
  
  testWaitForTimeout(65);
  SID27_SecurityAccess_RequestSeed(Level1,PHYSICAL);
  CheckPosResponse_SID27_ReqSeed(Level1,gSeedArray,16,0,0);
  PID27_Parameters_Seeds_Chk(NotAllZero,gSeedArray);
  
  SID27_SecurityAccess_SendKey(Level1,gKeyArray,PHYSICAL);
  CheckPosResponse_SID27_SenKey(Level1,0,0);
  
  TestStep("===Below steps is to verify false attempts counter shall be reset to zero after ECU reset===");
  
  SID10_DiagnosticSessionControl(PROGRAMMINGSESSION,PHYSICAL,SPRMIB_FALSE);
  CheckPosResponse_SID10(PROGRAMMINGSESSION,gP2Client_BOOT,gP2StarClientFor10Check,0,0);
  ECUinitHandle(0);
  for(B=0; B<N-1; B++)
  {
    TestStep("ECU response with seed. Verify that S1...S16 not equal to 0x000000.",TestStepIntervalTime);
    SID27_SecurityAccess_RequestSeed(Level1,PHYSICAL);
    CheckPosResponse_SID27_ReqSeed(Level1,gSeedArray,16,0,0);
    PID27_Parameters_Seeds_Chk(NotAllZero,gSeedArray);
    TestStep("Generate wrong key from response.",TestStepIntervalTime);
    gSeedArray[2]=gSeedArray[2]+1;//产生错误的秘钥
    
    TestStep("Send invalid key.",TestStepIntervalTime);
    if(B != N-1)
    {
      SID27_SecurityAccess_SendKey(Level1,gKeyArray,PHYSICAL);
      CheckNegResponse(0x35,0,0);
    }
    else
    {
      SID27_SecurityAccess_SendKey(Level1,gKeyArray,PHYSICAL);
      CheckNegResponse(0x36,0,0);
    }
  }
  testWaitForTimeout(50);//增加50ms延时
  SID11_ECUReset(HARDRESET,PHYSICAL,SPRMIB_FALSE);
  CheckPosResponse_SID11(HARDRESET,0,0);

  ECUinitHandle(0);
  
  SID10_DiagnosticSessionControl(PROGRAMMINGSESSION,PHYSICAL,SPRMIB_FALSE);
  CheckPosResponse_SID10(PROGRAMMINGSESSION,gP2Client_BOOT,gP2StarClientFor10Check,0,0);
  
  ECUinitHandle(0);
  
  for(B=0; B<N; B++)
  {
    TestStep("ECU response with seed. Verify that S1...S16 not equal to 0x000000.",TestStepIntervalTime);
    SID27_SecurityAccess_RequestSeed(Level1,PHYSICAL);
    CheckPosResponse_SID27_ReqSeed(Level1,gSeedArray,16,0,0);
    PID27_Parameters_Seeds_Chk(NotAllZero,gSeedArray);
    TestStep("Generate wrong key from response.",TestStepIntervalTime);
    gSeedArray[2]=gSeedArray[2]+1;//产生错误的秘钥
    
    TestStep("Send invalid key.",TestStepIntervalTime);
    if(B != N-1)
    {
      SID27_SecurityAccess_SendKey(Level1,gKeyArray,PHYSICAL);
      CheckNegResponse(0x35,0,0);
    }
    else
    {
      SID27_SecurityAccess_SendKey(Level1,gKeyArray,PHYSICAL);
      CheckNegResponse(0x36,0,0);
    }
  }
  
  testWaitForTimeout(DelayTimer+2000);

  SID27_SecurityAccess_RequestSeed(Level1,PHYSICAL);
  CheckPosResponse_SID27_ReqSeed(Level1,gSeedArray,16,0,0);
  PID27_Parameters_Seeds_Chk(NotAllZero,gSeedArray);
  
  SID27_SecurityAccess_SendKey(Level1,gKeyArray,PHYSICAL);
  CheckPosResponse_SID27_SenKey(Level1,0,0);
  
  TestStep("===Below steps is to verify Delay timer will not lost after ECU Reset===");
  
  SID10_DiagnosticSessionControl(PROGRAMMINGSESSION,PHYSICAL,SPRMIB_FALSE);
  CheckPosResponse_SID10(PROGRAMMINGSESSION,gP2Client_BOOT,gP2StarClientFor10Check,0,0);
  ECUinitHandle(0);
  for(B=0; B<N; B++)
  {
    TestStep("ECU response with seed. Verify that S1...S16 not equal to 0x000000.",TestStepIntervalTime);
    SID27_SecurityAccess_RequestSeed(Level1,PHYSICAL);
    CheckPosResponse_SID27_ReqSeed(Level1,gSeedArray,16,0,0);
    PID27_Parameters_Seeds_Chk(NotAllZero,gSeedArray);
    TestStep("Generate wrong key from response.",TestStepIntervalTime);
    gSeedArray[2]=gSeedArray[2]+1;//产生错误的秘钥
    
    TestStep("Send invalid key.",TestStepIntervalTime);
    if(B != N-1)
    {
      SID27_SecurityAccess_SendKey(Level1,gKeyArray,PHYSICAL);
      CheckNegResponse(0x35,0,0);
    }
    else
    {
      SID27_SecurityAccess_SendKey(Level1,gKeyArray,PHYSICAL);
      CheckNegResponse(0x36,0,0);
    }
  }
  testWaitForTimeout(50);//增加50ms延时
  SID11_ECUReset(HARDRESET,PHYSICAL,SPRMIB_FALSE);
  CheckPosResponse_SID11(HARDRESET,0,0);

  ECUinitHandle(0);
  
  SID10_DiagnosticSessionControl(PROGRAMMINGSESSION,PHYSICAL,SPRMIB_FALSE);
  CheckPosResponse_SID10(PROGRAMMINGSESSION,gP2Client_BOOT,gP2StarClientFor10Check,0,0);
  
  ECUinitHandle(0);
  
  SID27_SecurityAccess_RequestSeed(Level1,PHYSICAL);
  CheckNegResponse(0x37,0,0);
//  CheckPosResponse_SID27_ReqSeed(Level1,gSeedArray,16,0,0);
//  PID27_Parameters_Seeds_Chk(NotAllZero,gSeedArray);
//  
//  SID27_SecurityAccess_SendKey(Level1,gKeyArray,PHYSICAL);
//  CheckNegResponse(0x37,0,0);
  
  delaywithreq(DelayTimer+2000);
  
  SID27_SecurityAccess_RequestSeed(Level1,PHYSICAL);
  CheckPosResponse_SID27_ReqSeed(Level1,gSeedArray,16,0,0);
  PID27_Parameters_Seeds_Chk(NotAllZero,gSeedArray);
  
  SID27_SecurityAccess_SendKey(Level1,gKeyArray,PHYSICAL);
  CheckPosResponse_SID27_SenKey(Level1,0,0);
  
  TestStep("===Below steps is to verify false attempts counter will return 0 after Delay timer time-out===");
  
  SID10_DiagnosticSessionControl(PROGRAMMINGSESSION,PHYSICAL,SPRMIB_FALSE);
  CheckPosResponse_SID10(PROGRAMMINGSESSION,gP2Client_BOOT,gP2StarClientFor10Check,0,0);
  ECUinitHandle(0);
  
  for(B=0; B<N; B++)
  {
    TestStep("ECU response with seed. Verify that S1...S16 not equal to 0x000000.",TestStepIntervalTime);
    SID27_SecurityAccess_RequestSeed(Level1,PHYSICAL);
    CheckPosResponse_SID27_ReqSeed(Level1,gSeedArray,16,0,0);
    PID27_Parameters_Seeds_Chk(NotAllZero,gSeedArray);
    TestStep("Generate wrong key from response.",TestStepIntervalTime);
    gSeedArray[2]=gSeedArray[2]+1;//产生错误的秘钥
    
    TestStep("Send invalid key.",TestStepIntervalTime);
    if(B != N-1)
    {
      SID27_SecurityAccess_SendKey(Level1,gKeyArray,PHYSICAL);
      CheckNegResponse(0x35,0,0);
    }
    else
    {
      SID27_SecurityAccess_SendKey(Level1,gKeyArray,PHYSICAL);
      CheckNegResponse(0x36,0,0);
    }
  }
  SID27_SecurityAccess_RequestSeed(Level1,PHYSICAL);
  CheckNegResponse(0x37,0,0);
  
  delaywithreq(DelayTimer+100);
  
  for(B=0; B<N-1; B++)
  {
    TestStep("ECU response with seed. Verify that S1...S16 not equal to 0x000000.",TestStepIntervalTime);
    SID27_SecurityAccess_RequestSeed(Level1,PHYSICAL);
    CheckPosResponse_SID27_ReqSeed(Level1,gSeedArray,16,0,0);
    PID27_Parameters_Seeds_Chk(NotAllZero,gSeedArray);
    TestStep("Generate wrong key from response.",TestStepIntervalTime);
    gSeedArray[2]=gSeedArray[2]+1;//产生错误的秘钥
    
    TestStep("Send invalid key.",TestStepIntervalTime);
    if(B != N-1)
    {
      SID27_SecurityAccess_SendKey(Level1,gKeyArray,PHYSICAL);
      CheckNegResponse(0x35,0,0);
    }
    else
    {
      SID27_SecurityAccess_SendKey(Level1,gKeyArray,PHYSICAL);
      CheckNegResponse(0x36,0,0);
    }
  }
  delaywithreq(DelayTimer+2000);
  
  SID27_SecurityAccess_RequestSeed(Level1,PHYSICAL);
  CheckPosResponse_SID27_ReqSeed(Level1,gSeedArray,16,0,0);
  PID27_Parameters_Seeds_Chk(NotAllZero,gSeedArray);
  
  SID27_SecurityAccess_SendKey(Level1,gKeyArray,PHYSICAL);
  CheckPosResponse_SID27_SenKey(Level1,0,0);
  
  TestStep("Verify programmingDiagnosticSession.",TestStepIntervalTime);
  CheckCurrentSession(PROGRAMMINGSESSION,PHYSICAL,0,0);

  /******************************以上为测试步骤*********************************/
  Postcondition();
   
}
/// <APP_SecurityAccessAlgorithm>
//testcase Counters_for_False_Attempts_ExtendSession_Programming()
//{
//  int i,j,N,B;
//  char logName[400] = "";
//  char info[1024];
//  
//  strncat(logName,"1023153_Counters_for_False_Attempts_ExtendSession_Programming",400);
//  testCaseTitle("1023153","Counters_for_False_Attempts_ExtendSession_Programming");
//  
//  
//  SetLog(logName);
//  Precondition();
//  
//  TestStep("Prepare","The following test step performs the correct unlock step to clear the wrong unlock records");
//  
//  TestStep("Prepare","Transition to programmingSession(0x02)");
//  SessionFlag=APP;
//  for(i=0; i<NumOfSecurityLv; i++)
//  {
//    if(SELevel[i].SEFlagPBL == 1)
//    {
//      TestStep("Prepare","Transition to programmingSession(0x02)");
//      SID10_DiagnosticSessionControl(PROGRAMMINGSESSION,PHYSICAL,SPRMIB_FALSE);
//      CheckPosResponse_SID10(PROGRAMMINGSESSION,gP2Client_BOOT,gP2StarClientFor10Check,0,0);
//      
//      ECUinitHandle(0);
//
//      SessionFlag=BOOT;
//      Level1=0x01;
//      
//      TestStep("Prepare","Request 0x%X level seed.",Level1);
//      SID27_SecurityAccess_RequestSeed(Level1,PHYSICAL);
//      CheckPosResponse_SID27_ReqSeed(Level1,gSeedArray,16,0,0);
//      
//      TestStep("Prepare","Send 0x%X level key.",Level1);
//      SID27_SecurityAccess_SendKey(Level1,gKeyArray,PHYSICAL);
//      CheckPosResponse_SID27_SenKey(Level1,2,0,0);
//      
//      SID10_DiagnosticSessionControl(DEFAULTSESSION,PHYSICAL,SPRMIB_FALSE);
//      CheckPosResponse_SID10(DEFAULTSESSION,gP2Client_APP,gP2StarClientFor10Check,0,0);
//      
//      ECUinitHandle(0);
//      
//      continue;
//    }
//    Level1=SELevel[i].SElevel;
//    TestStep("Prepare","Transition  to extendedDiagnosticSession(0x03).");
//    SID10_DiagnosticSessionControl(EXTENDEDSESSION,PHYSICAL,SPRMIB_FALSE);
//    CheckPosResponse_SID10(EXTENDEDSESSION,gP2Client_APP,gP2StarClientFor10Check,0,0);
//    
//    TestStep("Prepare","Verify extendedDiagnosticSession.");
//    CheckCurrentSession(EXTENDEDSESSION,PHYSICAL,0,0);
//
//    TestStep("Prepare","Request seed.");
//    SID27_SecurityAccess_RequestSeed(Level1,PHYSICAL);
//    CheckPosResponse_SID27_ReqSeed(Level1,gSeedArray,16,0,0);
//    
//    TestStep("Prepare","Send key.");
//    SID27_SecurityAccess_SendKey(Level1,gKeyArray,PHYSICAL);
//    CheckPosResponse_SID27_SenKey(Level1,2,0,0);
//  }
//  
//  TestStep("Prepare","The above test steps perform the correct unlocking step to clear the wrong unlocking records");
//  /******************************以下为测试步骤*********************************/
//  TestStep("Transition to DefaultSession(0x01).",TestStepIntervalTime);
//  SID10_DiagnosticSessionControl(DEFAULTSESSION,PHYSICAL,SPRMIB_FALSE);
//  CheckPosResponse_SID10(DEFAULTSESSION,gP2Client_APP,gP2StarClientFor10Check,0,0);
//  
//  SessionFlag=APP;
//  for(i=0; i<NumOfSecurityLv; i++)
//  {
//    if(i==0)
//      TestStep("Let L1 = First security level from the configured security level array from configured list. ",TestStepIntervalTime);
//    else
//      TestStep("Let L1 be equal to next security level and jump to Step 4. ",TestStepIntervalTime,4);
//    
//    if(SELevel[i].SEFlagPBL == 1)
//    {
//      continue;
//    }
//    Level1=SELevel[i].SElevel;
//    TestStep("With N='Configured number of false attempts before delay timer is activated'. \n 1)Verify that the counter value is not incremented after afaskse attempt in another security access area:\n -perform N-1 false attempts in area L1\n -perform false attempt in another area\n -oerform correct attempt fr area L1, ECU unlocks.",TestStepIntervalTime);
//    N=2;
//    
//    TestStep("Transition  to extendedDiagnosticSession(0x03).",TestStepIntervalTime);
//    SID10_DiagnosticSessionControl(EXTENDEDSESSION,PHYSICAL,SPRMIB_FALSE);
//    CheckPosResponse_SID10(EXTENDEDSESSION,gP2Client_APP,gP2StarClientFor10Check,0,0);
//    
//    TestStep("Verify extendedDiagnosticSession.",TestStepIntervalTime);
//    CheckCurrentSession(EXTENDEDSESSION,PHYSICAL,0,0);
//   
//    TestStep("Set B=1.",TestStepIntervalTime);
//    B=0;
//    do{
//      B=B+1;
//    TestStep("ECU response with seed. Verify that S1...S16 not equal to 0x000000.",TestStepIntervalTime);
//    SID27_SecurityAccess_RequestSeed(Level1,PHYSICAL);
//    CheckPosResponse_SID27_ReqSeed(Level1,gSeedArray,16,0,0);
//    PID27_Parameters_Seeds_Chk(NotAllZero,gSeedArray);
//    gSeedArray[2]=gSeedArray[2]+2;    
//    
//    TestStep("Generate wrong key from response.",TestStepIntervalTime);
//    SID27_SecurityAccess_SendKey(Level1,gKeyArray,PHYSICAL);
//    CheckNegResponse(0x35,0,0); 
//      TestStep("While B<N-1\n set B=B+1 and repeat steps 6-8 with no dealy between requests.",TestStepIntervalTime,6);
//    }while (B<N-1);
//
//    TestStep("Transition from programmingSession(0x02) to programmingSession(0x02)",TestStepIntervalTime);
//    SID10_DiagnosticSessionControl(PROGRAMMINGSESSION,PHYSICAL,SPRMIB_FALSE);
//    CheckPosResponse_SID10(PROGRAMMINGSESSION,gP2Client_BOOT,gP2StarClientFor10Check,0,0);
//    
//    ECUinitHandle(0);
//   
//    SessionFlag=BOOT;
//    Level1=0x01;
//    SID27_SecurityAccess_RequestSeed(Level1,PHYSICAL);
//    if(i<2)
//    {
//      CheckPosResponse_SID27_ReqSeed(Level1,gSeedArray,16,0,0);
//      PID27_Parameters_Seeds_Chk(NotAllZero,gSeedArray);
//    }
//    else
//    {
//      CheckNegResponse(0x37,0,0);
//    }
//    gSeedArray[2]=~gSeedArray[2];
//    
//    TestStep("Generate wrong key from response.",TestStepIntervalTime);
//    SID27_SecurityAccess_SendKey(Level1,gKeyArray,PHYSICAL);
//    if(i==0)
//      CheckNegResponse(0x35,0,0);
//    else if(i==1)
//      CheckNegResponse(0x36,0,0);
//    else
//      CheckNegResponse(0x24,0,0);
// 
//    TestStep("Transition to defaultSession(0x01)",TestStepIntervalTime);
//    SID10_DiagnosticSessionControl(DEFAULTSESSION,PHYSICAL,SPRMIB_FALSE);
//    CheckPosResponse_SID10(DEFAULTSESSION,gP2Client_APP,gP2StarClientFor10Check,0,0);
//    
//    ECUinitHandle(0);
//    SessionFlag=APP;
//    
//    ECUinitHandle(0);
//    TestStep("Transition from defaultSession(0x01) to extendedSession(0x03)",TestStepIntervalTime);
//    SID10_DiagnosticSessionControl(EXTENDEDSESSION,PHYSICAL,SPRMIB_FALSE);
//    CheckPosResponse_SID10(EXTENDEDSESSION,gP2Client_APP,gP2StarClientFor10Check,0,0);
//    
//    TestStep("Verify extendedDiagnosticSession.",TestStepIntervalTime);
//    CheckCurrentSession(EXTENDEDSESSION,PHYSICAL,0,0);
//    Level1=SELevel[i].SElevel;
//    TestStep("ECU response with seed. Verify that S1...S16 not equal to 0x000000.",TestStepIntervalTime);
//    SID27_SecurityAccess_RequestSeed(Level1,PHYSICAL);
//    CheckPosResponse_SID27_ReqSeed(Level1,gSeedArray,16,0,0);
//    PID27_Parameters_Seeds_Chk(CheckRandom,gSeedArray);
//    
//    gSeedArray[2]=gSeedArray[2]+2;       
//    TestStep("Generate wrong key from response.",TestStepIntervalTime);
//    SID27_SecurityAccess_SendKey(Level1,gKeyArray,PHYSICAL);
//    CheckNegResponse(0x36,0,0);
//
//    TestStep("Number of attempts exceeded, delay timer is active.",TestStepIntervalTime);
//    SID27_SecurityAccess_RequestSeed(Level1,PHYSICAL);
//    CheckNegResponse(0x37,0,0);
//  }
//  
//  ////////
//  
//  for(i=0; i<NumOfSecurityLv; i++)
//  { 
//    if(SELevel[i].SEFlagAPP == 1)
//    {
//      continue;
//    }
//    
//    Level1=SELevel[i].SElevel;    
//    testWaitForTimeout(gTimeWaitForSecuAccess);
//    
//    TestStep("Transition from defaultSession(0x01) to extendedDiagnosticSession(0x03).",TestStepIntervalTime);
//    SID10_DiagnosticSessionControl(PROGRAMMINGSESSION,PHYSICAL,SPRMIB_FALSE);
//    CheckPosResponse_SID10(PROGRAMMINGSESSION,gP2Client_BOOT,gP2StarClientFor10Check,0,0);
//    
//    ECUinitHandle(0);
//    TestStep("Verify extendedDiagnosticSession.",TestStepIntervalTime);
//    CheckCurrentSession(PROGRAMMINGSESSION,PHYSICAL,0,0);
//    
//    testWaitForTimeout(gTimeWaitForSecuAccess);
//    
//    TestStep("ECU response with seed. Verify that S1...S16 not equal to 0x000000.",TestStepIntervalTime);
//    SID27_SecurityAccess_RequestSeed(Level1,PHYSICAL);
//    CheckPosResponse_SID27_ReqSeed(Level1,gSeedArray,16,0,0);
//    PID27_Parameters_Seeds_Chk(NotAllZero,gSeedArray);
//    
//    gSeedArray[0] = ~gSeedArray[0];
//    
//    SID27_SecurityAccess_SendKey(Level1,gKeyArray,PHYSICAL);
//    CheckNegResponse(0x35,0,0);
//    
//    //TestStep("ECU response with seed. Verify that S1...S16 not equal to 0x000000.",TestStepIntervalTime);
//    SID27_SecurityAccess_RequestSeed(Level1,PHYSICAL);
//    CheckPosResponse_SID27_ReqSeed(Level1,gSeedArray,16,0,0);
//    PID27_Parameters_Seeds_Chk(NotAllZero,gSeedArray);
//    
//    SID27_SecurityAccess_SendKey(Level1,gKeyArray,PHYSICAL);
//    CheckPosResponse_SID27_SenKey(Level1,0,0);
//    
//    TestStep("Transition from defaultSession(0x01) to extendedDiagnosticSession(0x03).",TestStepIntervalTime);
//    SID10_DiagnosticSessionControl(PROGRAMMINGSESSION,PHYSICAL,SPRMIB_FALSE);
//    CheckPosResponse_SID10(PROGRAMMINGSESSION,gP2Client_BOOT,gP2StarClientFor10Check,0,0);
//    TestStep("Verify extendedDiagnosticSession.",TestStepIntervalTime);
//    CheckCurrentSession(PROGRAMMINGSESSION,PHYSICAL,0,0);
//    
//    TestStep("ECU response with seed. Verify that S1...S16 not equal to 0x000000.",TestStepIntervalTime);
//    SID27_SecurityAccess_RequestSeed(Level1,PHYSICAL);
//    CheckPosResponse_SID27_ReqSeed(Level1,gSeedArray,16,0,0);
//    PID27_Parameters_Seeds_Chk(NotAllZero,gSeedArray);
//    
//    gSeedArray[0] = ~gSeedArray[0];
//    
//    SID27_SecurityAccess_SendKey(Level1,gKeyArray,PHYSICAL);
//    CheckNegResponse(0x35,0,0);
//    
//    TestStep("ECU response with seed. Verify that S1...S16 not equal to 0x000000.",TestStepIntervalTime);
//    SID27_SecurityAccess_RequestSeed(Level1,PHYSICAL);
//    CheckPosResponse_SID27_ReqSeed(Level1,gSeedArray,16,0,0);
//    PID27_Parameters_Seeds_Chk(NotAllZero,gSeedArray);
//    
//    gSeedArray[0] = ~gSeedArray[0];
//    
//    SID27_SecurityAccess_SendKey(Level1,gKeyArray,PHYSICAL);
//    CheckNegResponse(0x36,0,0);
//    
//    for(j=0;j<9;j++)
//    {
//    
//    SID27_SecurityAccess_RequestSeed(Level1,PHYSICAL);
//    CheckNegResponse(0x37,0,0);
//    
//    testWaitForTimeout(1000);
//    }
//    
//    testWaitForTimeout(2000);
//    
//    SID27_SecurityAccess_RequestSeed(Level1,PHYSICAL);
//    CheckPosResponse_SID27_ReqSeed(Level1,gSeedArray,16,0,0);
//    PID27_Parameters_Seeds_Chk(NotAllZero,gSeedArray);
//    
//    SID27_SecurityAccess_SendKey(Level1,gKeyArray,PHYSICAL);
//    CheckPosResponse_SID27_SenKey(Level1,0,0);
//  }
//  /******************************以上为测试步骤*********************************/
//  Postcondition();
//}
/// <PBL_SecurityAccessAlgorithm>
testcase Basic_Random_Seed_Test_ProgrammingSession()
{
  int i;
  char logName[400] = "";
  char info[1024];
  
  strncat(logName,"1023156_Basic_Random_Seed_Test_ProgrammingSession",400);
  testCaseTitle("1023156","Basic_Random_Seed_Test_ProgrammingSession");
  
  SetLog(logName);
  Precondition();
  /******************************以下为测试步骤*********************************/
  
  SessionFlag=APP;

  TestStep("Transition from defaultSession(0x01) to ProgrammingDiagnosticSession(0x02).",TestStepIntervalTime);
  SID10_DiagnosticSessionControl(PROGRAMMINGSESSION,PHYSICAL,SPRMIB_FALSE);
  CheckPosResponse_SID10(PROGRAMMINGSESSION,gP2Client_BOOT,gP2StarClientFor10Check,0,0);
  
  ECUinitHandle(0); 
 
  TestStep("Verify programmingDiagnosticSession.",TestStepIntervalTime);
  CheckCurrentSession(PROGRAMMINGSESSION,PHYSICAL,0,0);
  
  Level1=0x01;  
  testWaitForTimeout(gTimeWaitForSecuAccess);
  
  TestStep("ECU response with seed. Verify that S1...S16 not equal to 0x000000.",TestStepIntervalTime);
  SID27_SecurityAccess_RequestSeed(Level1,PHYSICAL);
  CheckPosResponse_SID27_ReqSeed(Level1,gSeedArray,16,0,0);
  PID27_Parameters_Seeds_Chk(NotAllZero,gSeedArray);
  TestStep("ECU response with seed. Verify that S1...S16 not equal to 0x000000.",TestStepIntervalTime);
  SID27_SecurityAccess_RequestSeed(Level1,PHYSICAL);
  CheckPosResponse_SID27_ReqSeed(Level1,gSeedArray,16,0,0);
  PID27_Parameters_Seeds_Chk(NotAllZero,gSeedArray);
  
  TestStep("Transition from defaultSession(0x01) to ProgrammingDiagnosticSession(0x02).",TestStepIntervalTime);
  SID10_DiagnosticSessionControl(PROGRAMMINGSESSION,PHYSICAL,SPRMIB_FALSE);
  CheckPosResponse_SID10(PROGRAMMINGSESSION,gP2Client_BOOT,gP2StarClientFor10Check,0,0);
  
  ECUinitHandle(0);
  
  TestStep("Verify programmingDiagnosticSession.",TestStepIntervalTime);
  CheckCurrentSession(PROGRAMMINGSESSION,PHYSICAL,0,0);
  
  testWaitForTimeout(gTimeWaitForSecuAccess);
  
  TestStep("ECU response with seed. Verify that S1...S16 not equal to 0x000000.",TestStepIntervalTime);
  SID27_SecurityAccess_RequestSeed(Level1,PHYSICAL);
  CheckPosResponse_SID27_ReqSeed(Level1,gSeedArray,16,0,0);
  PID27_Parameters_Seeds_Chk(NotAllZero,gSeedArray);
  TestStep("ECU Reset (hard reset)",TestStepIntervalTime);
  SID11_ECUReset(HARDRESET,PHYSICAL,SPRMIB_FALSE);
  CheckPosResponse_SID11(HARDRESET,0,0);
  ECUinitHandle(0);
  
  TestStep("Transition from defaultSession(0x01) to ProgrammingDiagnosticSession(0x02).",TestStepIntervalTime);
  SID10_DiagnosticSessionControl(PROGRAMMINGSESSION,PHYSICAL,SPRMIB_FALSE);
  CheckPosResponse_SID10(PROGRAMMINGSESSION,gP2Client_BOOT,gP2StarClientFor10Check,0,0);
  
  ECUinitHandle(0);
  
  TestStep("Verify programmingDiagnosticSession.",TestStepIntervalTime);
  CheckCurrentSession(PROGRAMMINGSESSION,PHYSICAL,0,0);
  
  testWaitForTimeout(gTimeWaitForSecuAccess);
  
  TestStep("ECU response with seed. Verify that S1...S16 not equal to 0x000000.",TestStepIntervalTime);
  SID27_SecurityAccess_RequestSeed(Level1,PHYSICAL);
  CheckPosResponse_SID27_ReqSeed(Level1,gSeedArray,16,0,0);
  PID27_Parameters_Seeds_Chk(NotAllZero,gSeedArray);
  /******************************以上为测试步骤*********************************/
  Postcondition();
   
}
/// <PBL_SecurityAccessAlgorithm>
testcase Extended_Random_Seed_Test_ProgrammingSession()
{
  int i,j,k,n=0;
  byte AllSeeds_PBL[20000][16];
  int repeatFlag=0;
  struct seedinforecord
  {
    byte seedinfo[16];
    int  seedtime;
  };
  
  struct seedinforecord seedrecord[10000];
  int  seednum = 0;
  int  checkflag;
  char logName[400] = "";
  char info[1024];
  
  strncat(logName,"1023157_Extended_Random_Seed_Test_ProgrammingSession",400);
  testCaseTitle("1023157","Extended_Random_Seed_Test_ProgrammingSession");
  
  SetLog(logName);
  Precondition();
  /******************************以下为测试步骤*********************************/
  
  SessionFlag=APP;

  TestStep("Transition from defaultSession(0x01) to ProgrammingDiagnosticSession(0x02).",TestStepIntervalTime);
  SID10_DiagnosticSessionControl(PROGRAMMINGSESSION,PHYSICAL,SPRMIB_FALSE);
  CheckPosResponse_SID10(PROGRAMMINGSESSION,gP2Client_BOOT,gP2StarClientFor10Check,0,0);
  
  ECUinitHandle(0);
  
  TestStep("Verify programmingDiagnosticSession.",TestStepIntervalTime);
  CheckCurrentSession(PROGRAMMINGSESSION,PHYSICAL,0,0);
    
  Level1=0x01;    
  testWaitForTimeout(gTimeWaitForSecuAccess);
  
  for(i=0; i<5000; i++)
  {
    SID27_SecurityAccess_RequestSeed(Level1,PHYSICAL);
    CheckPosResponse_SID27_ReqSeed(Level1,gSeedArray,16,0,0);
    for(j=0; j<i; j++)
    {
      if((AllSeeds_PBL[j][0] == gSeedArray[0]) && (AllSeeds_PBL[j][1] == gSeedArray[1]) && (AllSeeds_PBL[j][2] == gSeedArray[2])&& (AllSeeds_PBL[j][3] == gSeedArray[3])&& (AllSeeds_PBL[j][4] == gSeedArray[4])&& (AllSeeds_PBL[j][5] == gSeedArray[5])&& (AllSeeds_PBL[j][6] == gSeedArray[6])&& (AllSeeds_PBL[j][7] == gSeedArray[7])&& (AllSeeds_PBL[j][8] == gSeedArray[8])&& (AllSeeds_PBL[j][9] == gSeedArray[9])&& (AllSeeds_PBL[j][10] == gSeedArray[10])&& (AllSeeds_PBL[j][11] == gSeedArray[11])&& (AllSeeds_PBL[j][12] == gSeedArray[12])&& (AllSeeds_PBL[j][13] == gSeedArray[13])&& (AllSeeds_PBL[j][14] == gSeedArray[14])&& (AllSeeds_PBL[j][15] == gSeedArray[15]))
      {
        repeatFlag = 1;
        TestStepFail("Fail","Generated seed is repeated.");
        checkflag = 0;
          for(k = 0;k < seednum;k++)
          {
            if((seedrecord[k].seedinfo[0] == gSeedArray[0])&& (seedrecord[k].seedinfo[1] == gSeedArray[1]) && (seedrecord[k].seedinfo[2] == gSeedArray[2])&& (seedrecord[k].seedinfo[3] == gSeedArray[3])&& (seedrecord[k].seedinfo[4] == gSeedArray[4])&& (seedrecord[k].seedinfo[5] == gSeedArray[5])&& (seedrecord[k].seedinfo[6] == gSeedArray[6])&& (seedrecord[k].seedinfo[7] == gSeedArray[7])&& (seedrecord[k].seedinfo[8] == gSeedArray[8])&& (seedrecord[k].seedinfo[9] == gSeedArray[9])&& (seedrecord[k].seedinfo[10] == gSeedArray[10])&& (seedrecord[k].seedinfo[11] == gSeedArray[11])&& (seedrecord[k].seedinfo[12] == gSeedArray[12])&& (seedrecord[k].seedinfo[13] == gSeedArray[13])&& (seedrecord[k].seedinfo[14] == gSeedArray[14])&& (seedrecord[k].seedinfo[15] == gSeedArray[15]))
            {
              seedrecord[k].seedtime++;
              checkflag = 1;
            }
          }
          if(checkflag == 1)
          {
            
          }
          else
          {
            seedrecord[seednum].seedinfo[0] = gSeedArray[0];
            seedrecord[seednum].seedinfo[1] = gSeedArray[1];
            seedrecord[seednum].seedinfo[2] = gSeedArray[2];
            seedrecord[seednum].seedinfo[3] = gSeedArray[3];
            seedrecord[seednum].seedinfo[4] = gSeedArray[4];
            seedrecord[seednum].seedinfo[5] = gSeedArray[5];
            seedrecord[seednum].seedinfo[6] = gSeedArray[6];
            seedrecord[seednum].seedinfo[7] = gSeedArray[7];
            seedrecord[seednum].seedinfo[8] = gSeedArray[8];
            seedrecord[seednum].seedinfo[9] = gSeedArray[9];
            seedrecord[seednum].seedinfo[10] = gSeedArray[10];
            seedrecord[seednum].seedinfo[11] = gSeedArray[11];
            seedrecord[seednum].seedinfo[12] = gSeedArray[12];
            seedrecord[seednum].seedinfo[13] = gSeedArray[13];
            seedrecord[seednum].seedinfo[14] = gSeedArray[14];
            seedrecord[seednum].seedinfo[15] = gSeedArray[15];
            seedrecord[seednum].seedtime = 1;
            seednum++;
          }
      }
    }
    if(repeatFlag == 0)
    {
      AllSeeds_PBL[i][0] = gSeedArray[0];
      AllSeeds_PBL[i][1] = gSeedArray[1];
      AllSeeds_PBL[i][2] = gSeedArray[2];
      AllSeeds_PBL[i][3] = gSeedArray[3];
      AllSeeds_PBL[i][4] = gSeedArray[4];
      AllSeeds_PBL[i][5] = gSeedArray[5];
      AllSeeds_PBL[i][6] = gSeedArray[6];
      AllSeeds_PBL[i][7] = gSeedArray[7];
      AllSeeds_PBL[i][8] = gSeedArray[8];
      AllSeeds_PBL[i][9] = gSeedArray[9];
      AllSeeds_PBL[i][10] = gSeedArray[10];
      AllSeeds_PBL[i][11] = gSeedArray[11];
      AllSeeds_PBL[i][12] = gSeedArray[12];
      AllSeeds_PBL[i][13] = gSeedArray[13];
      AllSeeds_PBL[i][14] = gSeedArray[14];
      AllSeeds_PBL[i][15] = gSeedArray[15];
    }
  }
  TestStep("ECU Reset (hard reset)",TestStepIntervalTime);
  SID11_ECUReset(HARDRESET,PHYSICAL,SPRMIB_FALSE);
  CheckPosResponse_SID11(HARDRESET,0,0);
  ECUinitHandle(0);
  
  TestStep("Transition from defaultSession(0x01) to ProgrammingDiagnosticSession(0x02).",TestStepIntervalTime);
  SID10_DiagnosticSessionControl(PROGRAMMINGSESSION,PHYSICAL,SPRMIB_FALSE);
  CheckPosResponse_SID10(PROGRAMMINGSESSION,gP2Client_BOOT,gP2StarClientFor10Check,0,0);
  
  ECUinitHandle(0);
  
  TestStep("Verify programmingDiagnosticSession.",TestStepIntervalTime);
  CheckCurrentSession(PROGRAMMINGSESSION,PHYSICAL,0,0);
  
  testWaitForTimeout(gTimeWaitForSecuAccess);
  
  for(i=5000; i<10000; i++)
  {
    SID27_SecurityAccess_RequestSeed(Level1,PHYSICAL);
    CheckPosResponse_SID27_ReqSeed(Level1,gSeedArray,16,0,0);
    for(j=0; j<i; j++)
    {
      if((AllSeeds_PBL[j][0] == gSeedArray[0]) && (AllSeeds_PBL[j][1] == gSeedArray[1]) && (AllSeeds_PBL[j][2] == gSeedArray[2])&& (AllSeeds_PBL[j][3] == gSeedArray[3])&& (AllSeeds_PBL[j][4] == gSeedArray[4])&& (AllSeeds_PBL[j][5] == gSeedArray[5])&& (AllSeeds_PBL[j][6] == gSeedArray[6])&& (AllSeeds_PBL[j][7] == gSeedArray[7])&& (AllSeeds_PBL[j][8] == gSeedArray[8])&& (AllSeeds_PBL[j][9] == gSeedArray[9])&& (AllSeeds_PBL[j][10] == gSeedArray[10])&& (AllSeeds_PBL[j][11] == gSeedArray[11])&& (AllSeeds_PBL[j][12] == gSeedArray[12])&& (AllSeeds_PBL[j][13] == gSeedArray[13])&& (AllSeeds_PBL[j][14] == gSeedArray[14])&& (AllSeeds_PBL[j][15] == gSeedArray[15]))
      {
        repeatFlag = 1;
        TestStepFail("Fail","Generated seed is repeated.");
        checkflag = 0;
          for(k = 0;k < seednum;k++)
          {
            if((seedrecord[k].seedinfo[0] == gSeedArray[0])&& (seedrecord[k].seedinfo[1] == gSeedArray[1]) && (seedrecord[k].seedinfo[2] == gSeedArray[2])&& (seedrecord[k].seedinfo[3] == gSeedArray[3])&& (seedrecord[k].seedinfo[4] == gSeedArray[4])&& (seedrecord[k].seedinfo[5] == gSeedArray[5])&& (seedrecord[k].seedinfo[6] == gSeedArray[6])&& (seedrecord[k].seedinfo[7] == gSeedArray[7])&& (seedrecord[k].seedinfo[8] == gSeedArray[8])&& (seedrecord[k].seedinfo[9] == gSeedArray[9])&& (seedrecord[k].seedinfo[10] == gSeedArray[10])&& (seedrecord[k].seedinfo[11] == gSeedArray[11])&& (seedrecord[k].seedinfo[12] == gSeedArray[12])&& (seedrecord[k].seedinfo[13] == gSeedArray[13])&& (seedrecord[k].seedinfo[14] == gSeedArray[14])&& (seedrecord[k].seedinfo[15] == gSeedArray[15]))
            {
              seedrecord[k].seedtime++;
              checkflag = 1;
            }
          }
          if(checkflag == 1)
          {
            
          }
          else
          {
            seedrecord[seednum].seedinfo[0] = gSeedArray[0];
            seedrecord[seednum].seedinfo[1] = gSeedArray[1];
            seedrecord[seednum].seedinfo[2] = gSeedArray[2];
            seedrecord[seednum].seedinfo[3] = gSeedArray[3];
            seedrecord[seednum].seedinfo[4] = gSeedArray[4];
            seedrecord[seednum].seedinfo[5] = gSeedArray[5];
            seedrecord[seednum].seedinfo[6] = gSeedArray[6];
            seedrecord[seednum].seedinfo[7] = gSeedArray[7];
            seedrecord[seednum].seedinfo[8] = gSeedArray[8];
            seedrecord[seednum].seedinfo[9] = gSeedArray[9];
            seedrecord[seednum].seedinfo[10] = gSeedArray[10];
            seedrecord[seednum].seedinfo[11] = gSeedArray[11];
            seedrecord[seednum].seedinfo[12] = gSeedArray[12];
            seedrecord[seednum].seedinfo[13] = gSeedArray[13];
            seedrecord[seednum].seedinfo[14] = gSeedArray[14];
            seedrecord[seednum].seedinfo[15] = gSeedArray[15];
            seedrecord[seednum].seedtime = 1;
            seednum++;
          }
      }
    }
    if(repeatFlag == 0)
    {
      AllSeeds_PBL[i][0] = gSeedArray[0];
      AllSeeds_PBL[i][1] = gSeedArray[1];
      AllSeeds_PBL[i][2] = gSeedArray[2];
      AllSeeds_PBL[i][3] = gSeedArray[3];
      AllSeeds_PBL[i][4] = gSeedArray[4];
      AllSeeds_PBL[i][5] = gSeedArray[5];
      AllSeeds_PBL[i][6] = gSeedArray[6];
      AllSeeds_PBL[i][7] = gSeedArray[7];
      AllSeeds_PBL[i][8] = gSeedArray[8];
      AllSeeds_PBL[i][9] = gSeedArray[9];
      AllSeeds_PBL[i][10] = gSeedArray[10];
      AllSeeds_PBL[i][11] = gSeedArray[11];
      AllSeeds_PBL[i][12] = gSeedArray[12];
      AllSeeds_PBL[i][13] = gSeedArray[13];
      AllSeeds_PBL[i][14] = gSeedArray[14];
      AllSeeds_PBL[i][15] = gSeedArray[15];
    }
  }
  
  TestStep("Info","本次测试共计出现%d个重复种子",seednum);
  for(k=0;k<seednum;k++)
  {
    TestStep("Info","%d.种子%02X %02X %02X %02X %02X %02X %02X %02X %02X %02X %02X %02X %02X %02X %02X %02X出现%d次",k,seedrecord[k].seedinfo[0],seedrecord[k].seedinfo[1],seedrecord[k].seedinfo[2],seedrecord[k].seedinfo[3],seedrecord[k].seedinfo[4],seedrecord[k].seedinfo[5],seedrecord[k].seedinfo[6],seedrecord[k].seedinfo[7],seedrecord[k].seedinfo[8],seedrecord[k].seedinfo[9],seedrecord[k].seedinfo[10],seedrecord[k].seedinfo[11],seedrecord[k].seedinfo[12],seedrecord[k].seedinfo[13],seedrecord[k].seedinfo[14],seedrecord[k].seedinfo[15],seedrecord[k].seedtime);
  }
  /******************************以上为测试步骤*********************************/
  Postcondition();
   
}
/// <PBL_SecurityAccessAlgorithm>
testcase DelayTimer_activated_at_every_start_PBL()
{
  int i,j;
  float T3,T4,Delta;
  char logName[400] = "";
  char info[1024];
  message 0x1 TpRes;
  int counter=0;
  
  strncat(logName,"1088591_DelayTimer_activated_at_every_start_PBL",400);
  testCaseTitle("1088591","DelayTimer_activated_at_every_start_PBL");
  
  SetLog(logName);
  Precondition();
  /******************************以下为测试步骤*********************************/
  TPMsgInit(0);
  
  SessionFlag=APP;
  
  TestStep("Transition to defaultSesion(0x01)",TestStepIntervalTime);
  SID10_DiagnosticSessionControl(DEFAULTSESSION,PHYSICAL,SPRMIB_FALSE);
  CheckPosResponse_SID10(DEFAULTSESSION,gP2Client_APP,gP2StarClientFor10Check,0,0);
  SessionFlag=BOOT;
  TestStep("Transition to programmingSession(0x02)",TestStepIntervalTime);
  SID10_DiagnosticSessionControl(PROGRAMMINGSESSION,FUNCTIONAL,SPRMIB_TRUE);
//  CheckPosResponse_SID10(PROGRAMMINGSESSION,gP2Client_BOOT,gP2StarClientFor10Check,0,0);

  SessionFlag=BOOT;
  TestStep("ECU reset");
  if((gBusFlag==1)||(gBusFlag==2))
  {
    msgF186.id=gCAN_RequestID;
    TestStep("10ms cycle send 22 F1 86");
    T4 = timeNowFloat()/10000;
    setTimerCyclic(SendF186,10);

    
    //write("Response ID is %03x",ResponseID);
    while(counter<1000)
    {
      counter++;
      testJoinMessageEvent(gCAN_ResponseID);
      if(TestWaitForAnyJoinedEvent(10)>0)
      {
        testGetWaitEventMsgData(TpRes);
        if((TpRes.byte(1)==0x62)&&(TpRes.byte(4)==0x02))
        {
          T3 = timeNowFloat()/10000;
          break;
        }
      }
    }
    cancelTimer(SendF186);
    if(counter==1000)
    {
      TestStepFail("","ECU Reset timeout");
    }
    else
    {
      Delta = (T3-T4)*100;
      TestStep("","**********\nThe ECU reset time is %f ms\n**********",Delta);
    }
    counter=0;
  }
  else
  {
    ECUinitHandle(0);
  }
  
  Level1=0x01;
  
  testWaitForTimeout(gTimeWaitForSecuAccess);
  
  TestStep("ECU response with seed. Verify that S1...S16 not equal to 0x000000.",TestStepIntervalTime);
  SID27_SecurityAccess_RequestSeed(Level1,PHYSICAL);
  CheckPosResponse_SID27_ReqSeed(Level1,gSeedArray,16,0,0);

  PID27_Parameters_Seeds_Chk(NotAllZero,gSeedArray);
  SID27_SecurityAccess_SendKey(Level1,gKeyArray,PHYSICAL);
  CheckPosResponse_SID27_SenKey(Level1,0,0);
    
  TestStep("ECU Reset (hard reset)",TestStepIntervalTime);
  SID11_ECUReset(HARDRESET,PHYSICAL,SPRMIB_FALSE);
  CheckPosResponse_SID11(HARDRESET,0,0);
  testWaitForTimeout(ECUIniTime);
  SID10_DiagnosticSessionControl(PROGRAMMINGSESSION,PHYSICAL,SPRMIB_FALSE);
  CheckPosResponse_SID10(PROGRAMMINGSESSION,gP2Client_BOOT,gP2StarClientFor10Check,0,0);
  
  SessionFlag=BOOT;
  TestStep("ECU reset");
  if((gBusFlag==1)||(gBusFlag==2))
  {
    msgF186.id=gCAN_RequestID;
    TestStep("10ms cycle send 22 F1 86");
    T4 = timeNowFloat()/10000;
    setTimerCyclic(SendF186,10);

    
    //write("Response ID is %03x",ResponseID);
    while(counter<1000)
    {
      counter++;
      testJoinMessageEvent(gCAN_ResponseID);
      if(TestWaitForAnyJoinedEvent(10)>0)
      {
        testGetWaitEventMsgData(TpRes);
        if((TpRes.byte(1)==0x62)&&(TpRes.byte(4)==0x02))
        {
          T3 = timeNowFloat()/10000;
          break;
        }
      }
    }
    cancelTimer(SendF186);
    if(counter==1000)
    {
      TestStepFail("","ECU Reset timeout");
    }
    else
    {
      Delta = (T3-T4)*100;
      TestStep("","**********\nThe ECU reset time is %f ms\n**********",Delta);
    }
    counter=0;
  }
  else
  {
    ECUinitHandle(0);
  }
  Level1=0x01;
  
  testWaitForTimeout(gTimeWaitForSecuAccess);
  
  TestStep("ECU response with seed. Verify that S1...S16 not equal to 0x000000.",TestStepIntervalTime);
  SID27_SecurityAccess_RequestSeed(Level1,PHYSICAL);
  CheckPosResponse_SID27_ReqSeed(Level1,gSeedArray,16,0,0);
  PID27_Parameters_Seeds_Chk(NotAllZero,gSeedArray);
  SID27_SecurityAccess_SendKey(Level1,gKeyArray,PHYSICAL);
  CheckPosResponse_SID27_SenKey(Level1,0,0);
  /******************************以上为测试步骤*********************************/
  Postcondition();
   
}
/// <PBL_GeneralTest>
testcase S3_Timeout_Test_Physical_ProgrammingSession()
{
  char logName[400] = "";
  char info[1024];
  
  strncat(logName,"1351023_S3_Timeout_Test_Physical_ProgrammingSession",400);
  testCaseDescription("The intent of the test to verify:1.S3Server parameter timeout value. 2.The ECU returns to defaultSession from any non defaultSession when S3 timer times out.");
  testCaseTitle("1351023","S3_Timeout_Test_Physical_ProgrammingSession");
  if(gBusFlag==5 && SWRS_VERSION>=8 && EthNodeTypeNow==EdgeNode)
  {
     testStepWarning("","按照SWRS 版本>=V8,需求ID 987287定义 ,边缘节点应向车内发送3E 80 ，并维持自身的会话模式，所以不会跳转到默认会话,这个用例就不适用了");
     return;
  }
  
  SetLog(logName);
  Precondition();
  
  
   
  /******************************以下为测试步骤*********************************/
  
  SessionFlag=BOOT;
  
  TestStep("Transition from defaultSession(0x01) to ProgrammingSession(0x02).",TestStepIntervalTime);
  SID10_DiagnosticSessionControl(PROGRAMMINGSESSION,PHYSICAL,SPRMIB_FALSE);
  CheckPosResponse_SID10(PROGRAMMINGSESSION,gP2Client_BOOT,gP2StarClientFor10Check,0,0);
  ECUinitHandle(0);
  
  TP_TesterPresentSet(TP_OFF);
  TestStep("Verify ProgrammingSession.",TestStepIntervalTime);
  CheckCurrentSession(PROGRAMMINGSESSION,PHYSICAL,0,0);
  TestStep("Wait 4800 ms, from last final response.");
  delay(4800);
  TestStep("Send 3E 80",TestStepIntervalTime);
  SID3E_TesterPresent(PHYSICAL,SPRMIB_TRUE);
  //CheckNonResponse(0,0);
  TestStep("Verify ProgrammingSession.",TestStepIntervalTime);
  CheckCurrentSession(PROGRAMMINGSESSION,PHYSICAL,0,0);
  TestStep("Wait 5500 ms, from last final response.");
  delay(5500);
  
  TestStep("Wait ECU startup time' from last request.");
  ECUinitHandle(0);
  
  SessionFlag=APP;
  
  TestStep("Verify defaultSession.",TestStepIntervalTime);
  CheckCurrentSession(DEFAULTSESSION,PHYSICAL,0,0);
  /******************************以上为测试步骤*********************************/
  Postcondition();
   
}
/// <PBL_GeneralTest>
testcase S3_Timeout_Test_Functional_ProgrammingSession()
{
  char logName[400] = "";
  char info[1024];
  
  strncat(logName,"1351024_S3_Timeout_Test_Functional_ProgrammingSession",400);
  testCaseDescription("The intent of the test to verify:1.S3Server parameter timeout value. 2.The ECU returns to defaultSession from any non defaultSession when S3 timer times out.");
  testCaseTitle("1351024","S3_Timeout_Test_Functional_ProgrammingSession");
  
  if(gBusFlag==5 && SWRS_VERSION>=8 && EthNodeTypeNow==EdgeNode)
  {
     testStepWarning("","按照SWRS 版本>=V8,需求ID 987287定义 ,边缘节点应向车内发送3E 80 ，并维持自身的会话模式，所以不会跳转到默认会话,这个用例就不适用了");
     return;
  }
  
  if(gBusFlag==3)
	{
		testStepWarning("Test","This test case does not apply to the LIN bus");
		return;
	}
  SetLog(logName);
  Precondition();
   
  /******************************以下为测试步骤*********************************/
  
  SessionFlag=APP;
  
  TestStep("Transition from defaultSession(0x01) to ProgrammingSession(0x02).",TestStepIntervalTime);
  SID10_DiagnosticSessionControl(PROGRAMMINGSESSION,FUNCTIONAL,SPRMIB_FALSE);
  CheckPosResponse_SID10(PROGRAMMINGSESSION,gP2Client_BOOT,gP2StarClientFor10Check,0,0);
  ECUinitHandle(0);
  
  TP_TesterPresentSet(TP_OFF);
  TestStep("Verify ProgrammingSession.",TestStepIntervalTime);
  CheckCurrentSession(PROGRAMMINGSESSION,PHYSICAL,0,0);
  TestStep("Wait 4800 ms, from last final response.");
  delay(4800);
  TestStep("Send 3E 80",TestStepIntervalTime);
  SID3E_TesterPresent(FUNCTIONAL,SPRMIB_TRUE);
  //CheckNonResponse(0,0);
  TestStep("Verify ProgrammingSession.",TestStepIntervalTime);
  CheckCurrentSession(PROGRAMMINGSESSION,PHYSICAL,0,0);
  TestStep("Wait 5500 ms, from last final response.");
  delay(5500);
  
  TestStep("Wait ECU startup time' from last request.");
  ECUinitHandle(0);
  
  SessionFlag=APP;
  
  TestStep("Verify defaultSession.",TestStepIntervalTime);
  CheckCurrentSession(DEFAULTSESSION,PHYSICAL,0,0);
  /******************************以上为测试步骤*********************************/
  Postcondition();
   
}
/// <PBL_GeneralTest>
testcase Immediate_Diagnostic_Request_Test_Physical_ProgrammingSession()
{
  byte DID[2];
  long i,j;
  message CAN1.0x00 request_message = { dlc=8,fdf=0 };
  char logName[400] = "";
  char info[1024];
  
  strncat(logName,"1351025_Immediate_Diagnostic_Request_Test_Physical_ProgrammingSession",400);
  testCaseDescription("To verify that an ECU can handle a request immediate (as close as possible) after it has responded to a previous diagnostic response.");
  testCaseTitle("1351025","Immediate_Diagnostic_Request_Test_Physical_ProgrammingSession");
  if(gBusFlag==3)
	{
		testStepWarning("Test","This test case does not apply to the LIN bus");
		return;
	}
  SetLog(logName);
  Precondition();
   
  /******************************以下为测试步骤*********************************/
  /*  1  */
  TestStep("Transition to ProgrammingSession(0x02).",TestStepIntervalTime);
  SID10_DiagnosticSessionControl(PROGRAMMINGSESSION,PHYSICAL,SPRMIB_FALSE);
  CheckPosResponse_SID10(PROGRAMMINGSESSION,gP2Client_BOOT,gP2StarClientFor10Check,0,0);
  ECUinitHandle(0);
  SessionFlag=BOOT;
  /*  2  */
  TestStep("Verify ProgrammingSession.",TestStepIntervalTime);
  CheckCurrentSession(PROGRAMMINGSESSION,PHYSICAL,0,0);
  
  do
  {
    j++;
    /*  3  */
    TestStep("Send two requests as close as possible.",TestStepIntervalTime);
    DID[0]=gdid_queued_used[0] >> 8;
    DID[1]=gdid_queued_used[0] & 0xFF;
    if(1 == gflag_did_used || gBusFlag == 4 || gBusFlag == 5) { SID22_ReadDataByIdentifier(DID,PHYSICAL); }
    else                     
    {
      if(gBusFlag == 1 && glength_queued_used_1 <= 7)     // CAN Single Frame
      { request_message.id = gCAN_RequestID; request_message.byte(0) = glength_queued_used_1; for(i=0;i<glength_queued_used_1;i++) { request_message.byte(i+1) = gdata_queued_used_1[i]; } output(request_message); } 
      else if(gBusFlag == 1 && glength_queued_used_1 > 7) // CAN Multi Frame
      { TPSendRawMessage(gdata_queued_used_1,glength_queued_used_1,PHYSICAL); }
      else if(gBusFlag == 2 && glength_queued_used_1 <= 62) // CANFD Single Frame
      { 
        request_message.id = gCAN_RequestID; request_message.FDF = 1; request_message.BRS = 1; 
        if(glength_queued_used_1 <= 6) { request_message.dlc = 8; }
        else if(glength_queued_used_1 <= 10) { request_message.dlc = 9; }
        else if(glength_queued_used_1 <= 14) { request_message.dlc = 10; }
        else if(glength_queued_used_1 <= 18) { request_message.dlc = 11; }
        else if(glength_queued_used_1 <= 22) { request_message.dlc = 12; }
        else if(glength_queued_used_1 <= 30) { request_message.dlc = 13; }
        else if(glength_queued_used_1 <= 46) { request_message.dlc = 14; }
        else if(glength_queued_used_1 <= 62) { request_message.dlc = 15; }
        request_message.byte(0) = (glength_queued_used_1 | 0x1000) >> 8;
        request_message.byte(1) = glength_queued_used_1 | 0x1000; for(i=0;i<glength_queued_used_1;i++) { request_message.byte(i+2) = gdata_queued_used_1[i]; } 
        output(request_message);
      }
      else if(gBusFlag == 2 && glength_queued_used_1 > 62) // CANFD Multi Frame
      { TPSendRawMessage(gdata_queued_used_1,glength_queued_used_1,PHYSICAL); }
    }
    DID[0]=gdid_queued_used[1] >> 8;
    DID[1]=gdid_queued_used[1] & 0xFF;
    if(1 == gflag_did_used || gBusFlag == 4 || gBusFlag == 5) { SID22_ReadDataByIdentifier(DID,PHYSICAL); }
    else                     
    {
      if(gBusFlag == 1 && glength_queued_used_2 <= 7)     // CAN Single Frame
      { request_message.id = gCAN_RequestID; request_message.byte(0) = glength_queued_used_2; for(i=0;i<glength_queued_used_2;i++) { request_message.byte(i+1) = gdata_queued_used_2[i]; } output(request_message); } 
      else if(gBusFlag == 1 && glength_queued_used_2 > 7) // CAN Multi Frame
      { TPSendRawMessage(gdata_queued_used_2,glength_queued_used_2,PHYSICAL); }
      else if(gBusFlag == 2 && glength_queued_used_2 <= 62) // CANFD Single Frame
      { 
        request_message.id = gCAN_RequestID; request_message.FDF = 1; request_message.BRS = 1; 
        if(glength_queued_used_2 <= 6) { request_message.dlc = 8; }
        else if(glength_queued_used_2 <= 10) { request_message.dlc = 9; }
        else if(glength_queued_used_2 <= 14) { request_message.dlc = 10; }
        else if(glength_queued_used_2 <= 18) { request_message.dlc = 11; }
        else if(glength_queued_used_2 <= 22) { request_message.dlc = 12; }
        else if(glength_queued_used_2 <= 30) { request_message.dlc = 13; }
        else if(glength_queued_used_2 <= 46) { request_message.dlc = 14; }
        else if(glength_queued_used_2 <= 62) { request_message.dlc = 15; }
        request_message.byte(0) = (glength_queued_used_2 | 0x1000) >> 8;
        request_message.byte(1) = glength_queued_used_2 | 0x1000; for(i=0;i<glength_queued_used_2;i++) { request_message.byte(i+2) = gdata_queued_used_2[i]; } 
        output(request_message);
      }
      else if(gBusFlag == 2 && glength_queued_used_2 > 62) // CANFD Multi Frame
      { TPSendRawMessage(gdata_queued_used_2,glength_queued_used_2,PHYSICAL); }
    }
    if(1 == @Diagnostic::Receive_ConAll) { testStepWarning("Warning","第 %d 次测试, 未实现队列场景, 重新测试",j); testWaitForTimeout(100); continue; }
    Rss1=GetECUResponse();
    if(Rss1 == POS)
    {
      PrintPID("UDS","Pos.Response:",gTpRxData,gTpRxLength);
      if(1 == gflag_did_used || gBusFlag == 4 || gBusFlag == 5)
      {
        if(gTpRxData[0]==0x62&&gTpRxData[1]==(gdid_queued_used[0] >> 8)&&gTpRxData[2]==(gdid_queued_used[0] & 0xFF))
        {
          testStepPass("Pass","The First response received");
          DID[0]=gdid_queued_used[2] >> 8;
          DID[1]=gdid_queued_used[2] & 0xFF;
          SID22_ReadDataByIdentifier(DID,PHYSICAL);
          Rss1=GetECUResponse();
          if(Rss1 == POS)
          {
            PrintPID("UDS","Pos.Response:",gTpRxData,gTpRxLength);
            if(gTpRxData[0]==0x62&&gTpRxData[1]==(gdid_queued_used[1] >> 8)&&gTpRxData[2]==(gdid_queued_used[1] & 0xFF))
            {
              testStepPass("Pass","The Second response received");
              Rss1=GetECUResponse();
              if(Rss1 == POS)
              {
                PrintPID("UDS","Pos.Response:",gTpRxData,gTpRxLength);
                if(gTpRxData[0]==0x62&&gTpRxData[1]==(gdid_queued_used[2] >> 8)&&gTpRxData[2]==(gdid_queued_used[2] & 0xFF))
                {
                  testStepPass("Pass","The Third response received"); j = 0; break;
                }
                else { testStepFail("Fail","The Third response is wrong, test end"); break; }
              }
              else if(Rss1 == NEG) { testStepFail("Fail","Neg.Response for Third response,test end"); break; }
              else { testStepFail("Fail","Time out no Third response received,test end"); break; }
            }
            else { testStepFail("Fail","The Second response is wrong, test end"); break; }
          }
          else if(Rss1 == NEG) { testStepFail("Fail","Neg.Response for Second response,test end"); break; }
          else { testStepFail("Fail","Time out no Second response received, test end"); break; }
        }
        else { testStepFail("Fail","The First response is wrong, test end"); break; }
      }
      else 
      {
        if(gTpRxData[0] != 0x40 + gdata_queued_used_1[0]) { testStepFail("Fail","The First response is wrong, test end"); break; }
        else
        {
          testStepPass("Pass","The First response received");
          if(gBusFlag == 1 && glength_queued_used_3 <= 7)     // CAN Single Frame
          { request_message.id = gCAN_RequestID; request_message.byte(0) = glength_queued_used_3; for(i=0;i<glength_queued_used_3;i++) { request_message.byte(i+1) = gdata_queued_used_3[i]; } output(request_message); } 
          else if(gBusFlag == 1 && glength_queued_used_3 > 7) // CAN Multi Frame
          { TPSendRawMessage(gdata_queued_used_3,glength_queued_used_3,PHYSICAL); }
          else if(gBusFlag == 2 && glength_queued_used_3 <= 62) // CANFD Single Frame
          { 
            request_message.id = gCAN_RequestID; request_message.FDF = 1; request_message.BRS = 1; 
            if(glength_queued_used_3 <= 6) { request_message.dlc = 8; }
            else if(glength_queued_used_3 <= 10) { request_message.dlc = 9; }
            else if(glength_queued_used_3 <= 14) { request_message.dlc = 10; }
            else if(glength_queued_used_3 <= 18) { request_message.dlc = 11; }
            else if(glength_queued_used_3 <= 22) { request_message.dlc = 12; }
            else if(glength_queued_used_3 <= 30) { request_message.dlc = 13; }
            else if(glength_queued_used_3 <= 46) { request_message.dlc = 14; }
            else if(glength_queued_used_3 <= 62) { request_message.dlc = 15; }
            request_message.byte(0) = (glength_queued_used_3 | 0x1000) >> 8;
            request_message.byte(1) = glength_queued_used_3 | 0x1000; for(i=0;i<glength_queued_used_3;i++) { request_message.byte(i+2) = gdata_queued_used_3[i]; } 
            output(request_message);
          }
          else if(gBusFlag == 2 && glength_queued_used_3 > 62) // CANFD Multi Frame
          { TPSendRawMessage(gdata_queued_used_3,glength_queued_used_3,PHYSICAL); }
          Rss1=GetECUResponse();
          if(Rss1 == POS)
          {
            PrintPID("UDS","Pos.Response:",gTpRxData,gTpRxLength);
            if(gTpRxData[0] != 0x40 + gdata_queued_used_2[0]) { testStepFail("Fail","The Second response is wrong, test end"); break; }
            else
            {
              testStepPass("Pass","The Second response received");
              Rss1=GetECUResponse();
              if(Rss1 == POS)
              {
                PrintPID("UDS","Pos.Response:",gTpRxData,gTpRxLength);
                if(gTpRxData[0] != 0x40 + gdata_queued_used_3[0]) { testStepFail("Fail","The Third response is wrong, test end"); break; }
                else { testStepPass("Pass","The Third response received"); j = 0; break; }
              }
              else if(Rss1 == NEG)
              {
                PrintPID("UDS","Neg.Response for Third response:",gTpRxData,gTpRxLength);
                if(gTpRxData[1] != gdata_queued_used_3[0]) { testStepFail("Fail","The Third response is wrong, test end"); break; }
                else { testStepPass("Pass","The Third response received"); j = 0; break; }
              }
              else { testStepFail("Fail","Time out no Third response received, test end"); break; }
            }
          }
          else if(Rss1 == NEG)
          {
            PrintPID("UDS","Neg.Response for Second response,test end:",gTpRxData,gTpRxLength);
            if(gTpRxData[1] != gdata_queued_used_2[0]) { testStepFail("Fail","The Second response is wrong, test end"); break; }
            else 
            { 
              testStepPass("Pass","The Second response received"); 
              Rss1=GetECUResponse();
              if(Rss1 == POS)
              {
                PrintPID("UDS","Pos.Response:",gTpRxData,gTpRxLength);
                if(gTpRxData[0] != 0x40 + gdata_queued_used_3[0]) { testStepFail("Fail","The Third response is wrong, test end"); break; }
                else { testStepPass("Pass","The Third response received"); j = 0; break; }
              }
              else if(Rss1 == NEG)
              {
                PrintPID("UDS","Neg.Response for Third response:",gTpRxData,gTpRxLength);
                if(gTpRxData[1] != gdata_queued_used_3[0]) { testStepFail("Fail","The Third response is wrong, test end"); break; }
                else { testStepPass("Pass","The Third response received"); j = 0; break; }
              }
              else { testStepFail("Fail","Time out no Third response received, test end"); break; }
            }
          }
          else { testStepFail("Fail","Time out no Second response received, test end"); break; }
        }
      }
    }
    else if(Rss1 == NEG)
    {
      if(1 == gflag_did_used || gBusFlag == 4 || gBusFlag == 5) { testStepFail("Fail","Neg.Response for First response, test end"); break; }
      else
      {
        if(gTpRxData[1] != gdata_queued_used_1[0]) { testStepFail("Fail","The First response is wrong, test end"); break; }
        else 
        { 
          testStepPass("Pass","The First response received");
          if(gBusFlag == 1 && glength_queued_used_3 <= 7)     // CAN Single Frame
          { request_message.id = gCAN_RequestID; request_message.byte(0) = glength_queued_used_3; for(i=0;i<glength_queued_used_3;i++) { request_message.byte(i+1) = gdata_queued_used_3[i]; } output(request_message); } 
          else if(gBusFlag == 1 && glength_queued_used_3 > 7) // CAN Multi Frame
          { TPSendRawMessage(gdata_queued_used_3,glength_queued_used_3,PHYSICAL); }
          else if(gBusFlag == 2 && glength_queued_used_3 <= 62) // CANFD Single Frame
          { 
            request_message.id = gCAN_RequestID; request_message.FDF = 1; request_message.BRS = 1; 
            if(glength_queued_used_3 <= 6) { request_message.dlc = 8; }
            else if(glength_queued_used_3 <= 10) { request_message.dlc = 9; }
            else if(glength_queued_used_3 <= 14) { request_message.dlc = 10; }
            else if(glength_queued_used_3 <= 18) { request_message.dlc = 11; }
            else if(glength_queued_used_3 <= 22) { request_message.dlc = 12; }
            else if(glength_queued_used_3 <= 30) { request_message.dlc = 13; }
            else if(glength_queued_used_3 <= 46) { request_message.dlc = 14; }
            else if(glength_queued_used_3 <= 62) { request_message.dlc = 15; }
            request_message.byte(0) = (glength_queued_used_3 | 0x1000) >> 8;
            request_message.byte(1) = glength_queued_used_3 | 0x1000; for(i=0;i<glength_queued_used_3;i++) { request_message.byte(i+2) = gdata_queued_used_3[i]; } 
            output(request_message);
          }
          else if(gBusFlag == 2 && glength_queued_used_3 > 62) // CANFD Multi Frame
          { TPSendRawMessage(gdata_queued_used_3,glength_queued_used_3,PHYSICAL); }
          Rss1=GetECUResponse();
          if(Rss1 == POS)
          {
            PrintPID("UDS","Pos.Response:",gTpRxData,gTpRxLength);
            if(gTpRxData[0] != 0x40 + gdata_queued_used_2[0]) { testStepFail("Fail","The Second response is wrong, test end"); break; }
            else
            {
              testStepPass("Pass","The Second response received");
              Rss1=GetECUResponse();
              if(Rss1 == POS)
              {
                PrintPID("UDS","Pos.Response:",gTpRxData,gTpRxLength);
                if(gTpRxData[0] != 0x40 + gdata_queued_used_3[0]) { testStepFail("Fail","The Third response is wrong, test end"); break; }
                else { testStepPass("Pass","The Third response received"); j = 0; break; }
              }
              else if(Rss1 == NEG)
              {
                PrintPID("UDS","Neg.Response for Third response:",gTpRxData,gTpRxLength);
                if(gTpRxData[1] != gdata_queued_used_3[0]) { testStepFail("Fail","The Third response is wrong, test end"); break; }
                else { testStepPass("Pass","The Third response received"); j = 0; break; }
              }
              else { testStepFail("Fail","Time out no Third response received, test end"); break; }
            }
          }
          else if(Rss1 == NEG)
          {
            PrintPID("UDS","Neg.Response for Second response,test end:",gTpRxData,gTpRxLength);
            if(gTpRxData[1] != gdata_queued_used_2[0]) { testStepFail("Fail","The Second response is wrong, test end"); break; }
            else 
            { 
              testStepPass("Pass","The Second response received"); 
              Rss1=GetECUResponse();
              if(Rss1 == POS)
              {
                PrintPID("UDS","Pos.Response:",gTpRxData,gTpRxLength);
                if(gTpRxData[0] != 0x40 + gdata_queued_used_3[0]) { testStepFail("Fail","The Third response is wrong, test end"); break; }
                else { testStepPass("Pass","The Third response received"); j = 0; break; }
              }
              else if(Rss1 == NEG)
              {
                PrintPID("UDS","Neg.Response for Third response:",gTpRxData,gTpRxLength);
                if(gTpRxData[1] != gdata_queued_used_3[0]) { testStepFail("Fail","The Third response is wrong, test end"); break; }
                else { testStepPass("Pass","The Third response received"); j = 0; break; }
              }
              else { testStepFail("Fail","Time out no Third response received, test end"); break; }
            }
          }
          else { testStepFail("Fail","Time out no Second response received, test end"); break; }
        }
      }
    }
    else { testStepFail("Fail","Time out no First response received, test end");  break; }
  }while(j < gtimes_queued_test);
  
  if(j != 0) { testStepFail("Fail","队列场景测试异常，请确认！！！"); }
  
  /*  4  */
  TestStep("Verify ProgrammingSession.",TestStepIntervalTime);
  CheckCurrentSession(PROGRAMMINGSESSION,PHYSICAL,0,0);
  /******************************以上为测试步骤*********************************/
  Postcondition();
   
}

/// <PBL_GeneralTest>
testcase Seed_and_Key_Validity_Details_Test_Physical_ProgrammingSession()
{
  int  level1;
  int  level2;
  byte ExpectNRC[2]={0x12,0x7E};
  char logName[400] = "";
  char info[1024];
  
  strncat(logName,"1022504_Seed_and_Key_Validity_Details_Test_Physical_ProgrammingSession",400);
  testCaseDescription("The intent of this test is to verify that the security access requirements are implemented correctly.");
  testCaseTitle("1022504","Seed_and_Key_Validity_Details_Test_Physical_ProgrammingSession");
  
  
  SetLog(logName);
  Precondition();
   
  /******************************以下为测试步骤*********************************/
  
  SessionFlag=BOOT;
  
  TestStep("Transition from defaultSession(0x01) to ProgrammingSession(0x02).",TestStepIntervalTime);
  SID10_DiagnosticSessionControl(PROGRAMMINGSESSION,PHYSICAL,SPRMIB_FALSE);
  CheckPosResponse_SID10(PROGRAMMINGSESSION,gP2Client_BOOT,gP2StarClientFor10Check,0,0);
  ECUinitHandle(0);

  TestStep("Verify ProgrammingSession.",TestStepIntervalTime);
  CheckCurrentSession(PROGRAMMINGSESSION,PHYSICAL,0,0);

  testWaitForTimeout(gTimeWaitForSecuAccess);
  
  TestStep("Request seed.",TestStepIntervalTime);
  SID27_SecurityAccess_RequestSeed(0x01,PHYSICAL);
  CheckPosResponse_SID27_ReqSeed(0x01,gSeedArray,16,0,0);
  PID27_Parameters_Seeds_Chk(NotAllZero,gSeedArray);
  TestStep("Send key",TestStepIntervalTime);
  SID27_SecurityAccess_SendKey(0x01,gKeyArray,PHYSICAL);
  CheckPosResponse_SID27_SenKey(0x01,0,0);
  TestStep("Request seed.Subfunction 0x03 is not supported. ",TestStepIntervalTime);
  SID27_SecurityAccess_RequestSeed(0x03,PHYSICAL);
  CheckNegResponse(ExpectNRC,0,0,0,0);
  
  TestStep("Request seed.",TestStepIntervalTime);
  SID27_SecurityAccess_RequestSeed(0x01,PHYSICAL);
  CheckPosResponse_SID27_ReqSeed(0x01,gSeedArray,16,0,0);
  PID27_Parameters_Seeds_Chk(AllZero,gSeedArray);
  //GenerateKeyExOpt(gKeyArray,MaxKeyArraySize,DLLName);
  
  TP_TesterPresentSet(TP_OFF);
  TestStep("Wait for ECU times out to defaultSession, S3 timer plus 'ECU startup time' and an additional 500 ms.");
  delay(5500);
  
  ECUinitHandle(0);
  
  SessionFlag=APP;
  
  TestStep("Verify DefaultSession.",TestStepIntervalTime);
  CheckCurrentSession(DEFAULTSESSION,PHYSICAL,0,0);
  
  SessionFlag=BOOT;
  
  TP_TesterPresentSet(TP_ON);
  
  TestStep("Transition from defaultSession(0x01) to ProgrammingSession(0x02).",TestStepIntervalTime);
  SID10_DiagnosticSessionControl(PROGRAMMINGSESSION,PHYSICAL,SPRMIB_TRUE);
  CheckNonResponse(0,0);
  
  ECUinitHandle(0);
  
  TestStep("Verify ProgrammingSession.",TestStepIntervalTime);
  CheckCurrentSession(PROGRAMMINGSESSION,PHYSICAL,0,0);
  
  testWaitForTimeout(gTimeWaitForSecuAccess);
  
  TestStep("Request seed.",TestStepIntervalTime);
  SID27_SecurityAccess_RequestSeed(0x01,PHYSICAL);
  CheckPosResponse_SID27_ReqSeed(0x01,gSeedArray,16,0,0);
  PID27_Parameters_Seeds_Chk(NotAllZero,gSeedArray);
  
  TP_TesterPresentSet(TP_OFF);
  
  TestStep("Wait for ECU times out to defaultSession, S3 timer plus 'ECU startup time' and an additional 500 ms.");
  delay(5500);
  
  ECUinitHandle(0);
  
  SessionFlag=APP;
  
  TestStep("Verify DefaultSession.",TestStepIntervalTime);
  CheckCurrentSession(DEFAULTSESSION,PHYSICAL,0,0);
  
  SessionFlag=BOOT;
  
  TP_TesterPresentSet(TP_ON);
  
  TestStep("Transition from defaultSession(0x01) to ProgrammingSession(0x02).",TestStepIntervalTime);
  SID10_DiagnosticSessionControl(PROGRAMMINGSESSION,PHYSICAL,SPRMIB_TRUE);
  CheckNonResponse(0,0);
  
  ECUinitHandle(0);
  TestStep("Verify ProgrammingSession.",TestStepIntervalTime);
  CheckCurrentSession(PROGRAMMINGSESSION,PHYSICAL,0,0);
  
  delay(5000);
  TestStep("Send key",TestStepIntervalTime);
  SID27_SecurityAccess_SendKey(0x01,gKeyArray,PHYSICAL);
  //TPSendRawMessage(gKeyArray,PHYSICAL);
  CheckNegResponse(0x24,0,0);
  TestStep("Request seed.",TestStepIntervalTime);
  SID27_SecurityAccess_RequestSeed(0x01,PHYSICAL);
  CheckPosResponse_SID27_ReqSeed(0x01,gSeedArray,16,0,0);
  PID27_Parameters_Seeds_Chk(NotAllZero,gSeedArray);
  TestStep("Send key",TestStepIntervalTime);
  SID27_SecurityAccess_SendKey(0x01,gKeyArray,PHYSICAL);
  CheckPosResponse_SID27_SenKey(0x01,0,0);
  TestStep("Transition from ProgrammingSession(0x02) to ProgrammingSession(0x02).",TestStepIntervalTime);
  SID10_DiagnosticSessionControl(PROGRAMMINGSESSION,PHYSICAL,SPRMIB_TRUE);
  CheckNonResponse(0,0);
  
  ECUinitHandle(0);
  
  testWaitForTimeout(gTimeWaitForSecuAccess);
  
  TestStep("Request seed.",TestStepIntervalTime);
  SID27_SecurityAccess_RequestSeed(0x01,PHYSICAL);
  CheckPosResponse_SID27_ReqSeed(0x01,gSeedArray,16,0,0);
  TestStep("The following test steps verify Invalid Key & false access attempts.",TestStepIntervalTime);
  
  gSeedArray[2]=gSeedArray[2]+1;
  TestStep("Generate wrong key from response.",TestStepIntervalTime);
  SID27_SecurityAccess_SendKey(0x01,gKeyArray,PHYSICAL);
  CheckNegResponse(0x35,0,0);
  
  TestStep("Request seed.",TestStepIntervalTime);
  SID27_SecurityAccess_RequestSeed(0x01,PHYSICAL);
  CheckPosResponse_SID27_ReqSeed(0x01,gSeedArray,16,0,0);
  PID27_Parameters_Seeds_Chk(NotAllZero,gSeedArray);
  
  TestStep("Send key",TestStepIntervalTime);
  SID27_SecurityAccess_SendKey(0x01,gKeyArray,PHYSICAL);
  CheckPosResponse_SID27_SenKey(0x01,0,0);
  
  TestStep("Verify ProgrammingSession.",TestStepIntervalTime);
  CheckCurrentSession(PROGRAMMINGSESSION,PHYSICAL,0,0);
  
  /******************************以上为测试步骤*********************************/
  Postcondition();
   
}
/// <PBL_GeneralTest>
testcase Short_message_Test_Physical_ProgrammingSession()
{
  byte data[1]={0x3E};
  char logName[400] = "";
  char info[1024];
  
  strncat(logName,"1351031_Short_message_Test_Physical_ProgrammingSession",400);
  testCaseDescription("To see if correct NRC is implemented.");
  testCaseTitle("1351031","Short_message_Test_Physical_ProgrammingSession");
  
  
  SetLog(logName);
  Precondition();

  /******************************以下为测试步骤*********************************/
  
  SessionFlag=BOOT;
  
  TestStep("Transition from defaultSession(0x01) to ProgrammingSession(0x02).",TestStepIntervalTime);
  SID10_DiagnosticSessionControl(PROGRAMMINGSESSION,PHYSICAL,SPRMIB_FALSE);
  CheckPosResponse_SID10(PROGRAMMINGSESSION,gP2Client_BOOT,gP2StarClientFor10Check,0,0);
  ECUinitHandle(0);
  TestStep("Verify ProgrammingSession.",TestStepIntervalTime);
  CheckCurrentSession(PROGRAMMINGSESSION,PHYSICAL,0,0);
  
  TestStep("Let DL value be to short for the actual message.",TestStepIntervalTime);
  
  TestStep("Send short message",TestStepIntervalTime);
  TPSendRawMessage(data,PHYSICAL);
  CheckNegResponse(0x13,0,0);
  TestStep("Verify ProgrammmingSession",TestStepIntervalTime);
  CheckCurrentSession(PROGRAMMINGSESSION,PHYSICAL,0,0);
  /******************************以上为测试步骤*********************************/
   Postcondition();
   
}
/// <PBL_GeneralTest>
testcase Short_message_Test_Functional_ProgrammingSession()
{
  byte data[1]={0x3e};
  char logName[400] = "";
  char info[1024];
  
  strncat(logName,"1351032_Short_message_Test_Functional_ProgrammingSession",400);
  testCaseDescription("To see if correct NRC is implemented.");
  testCaseTitle("1351032","Short_message_Test_Functional_ProgrammingSession");
  
  if(gBusFlag==3)
	{
		testStepWarning("Test","This test case does not apply to the LIN bus");
		return;
	}
  SetLog(logName);
  Precondition();

  /******************************以下为测试步骤*********************************/
  
  SessionFlag=BOOT;
  
  TestStep("Transition from defaultSession(0x01) to ProgrammingSession(0x02).",TestStepIntervalTime);
  SID10_DiagnosticSessionControl(PROGRAMMINGSESSION,PHYSICAL,SPRMIB_FALSE);
  CheckPosResponse_SID10(PROGRAMMINGSESSION,gP2Client_BOOT,gP2StarClientFor10Check,0,0);
  ECUinitHandle(0);
  TestStep("Verify ProgrammingSession.",TestStepIntervalTime);
  CheckCurrentSession(PROGRAMMINGSESSION,PHYSICAL,0,0);
  
  TestStep("Let DL value be to short for the actual message.",TestStepIntervalTime);
  
  TestStep("Send short message",TestStepIntervalTime);
  TPSendRawMessage(data,FUNCTIONAL);
  CheckNegResponse(0x13,0,0);
  TestStep("Verify ProgrammmingSession",TestStepIntervalTime);
  CheckCurrentSession(PROGRAMMINGSESSION,PHYSICAL,0,0);
  /******************************以上为测试步骤*********************************/
  Postcondition();
   
}
/// <PBL_GeneralTest>
testcase Unsupported_Diagnostic_Service_Test_Physical_ProgrammingSession()
{
  int i,j;
  byte TestSD_service[1]= {0x00};
  byte ExpectNRC[2]={0x11,0x7F};
  int Flag;
  int StartService;
  char logName[400] = "";
  char info[1024];
  
  strncat(logName,"1351027_Unsupported_Diagnostic_Service_Test_Physical_ProgrammingSession",400);
  testCaseDescription("To ensure that no other services is implemented than those in configured list.");
  testCaseTitle("1351027","Unsupported_Diagnostic_Service_Test_Physical_ProgrammingSession");
  
  SetLog(logName);
  Precondition();

  /******************************以下为测试步骤*********************************/
  
  SessionFlag=BOOT;
  
  TestStep("Transition from defaultSession(0x01) to ProgrammingSession(0x02).",TestStepIntervalTime);
  SID10_DiagnosticSessionControl(PROGRAMMINGSESSION,PHYSICAL,SPRMIB_FALSE);
  CheckPosResponse_SID10(PROGRAMMINGSESSION,gP2Client_BOOT,gP2StarClientFor10Check,0,0);
  ECUinitHandle(0);
  TestStep("Verify ProgrammingSession.",TestStepIntervalTime);
  CheckCurrentSession(PROGRAMMINGSESSION,PHYSICAL,0,0);
  
  if(Flag_OBDNode == 1)
    StartService = 0x10;
  else
    StartService = 0x00;
  
  for(i=StartService; i<=0xFF; i++)
  {
    Flag = 0;
    
    if(i==0x10)
    {
      TestStep("Let SV=%02x",StartService);
    }
    else
    {
      TestStep("If SV<0xFF add 1 to SV and jump to Step 2",TestStepIntervalTime,2);
    }
    TestStep("If SV equals a service from configured list jump to Step 4",TestStepIntervalTime,4);
    for(j=0;j<service_PBL_Num;j++)
    {
      if(service_PBL[j] == i)
        Flag = 1;
    }
    if(Flag == 1)
      continue;
    TestStep("Request unsupported service",TestStepIntervalTime);
    TestSD_service[0]=i;
    TPSendRawMessage(TestSD_service,PHYSICAL);
    CheckNegResponse(ExpectNRC,0,0,0,0);
    testWaitForTimeout(100);
  }
  TestStep("Verify ProgrammmingSession",TestStepIntervalTime);
  CheckCurrentSession(PROGRAMMINGSESSION,PHYSICAL,0,0);
  /******************************以上为测试步骤*********************************/
  Postcondition();
   
}
/// <PBL_GeneralTest>
testcase Unsupported_Diagnostic_Service_Test_Functional_ProgrammingSession()
{
  int i,j;
  byte TestSD_service[1]= {0x00};
  int Flag;
  int StartService;
  char logName[400] = "";
  char info[1024];
  
  strncat(logName,"1351028_Unsupported_Diagnostic_Service_Test_Functional_ProgrammingSession",400);
  testCaseDescription("Send services that is not supported to the ECU.");
  testCaseTitle("1351028","Unsupported_Diagnostic_Service_Test_Functional_ProgrammingSession");
  if(gBusFlag==3)
	{
		testStepWarning("Test","This test case does not apply to the LIN bus");
		return;
	}
  SetLog(logName);
  Precondition();

  /******************************以下为测试步骤*********************************/
  
  SessionFlag=BOOT;
  
  TestStep("Transition from defaultSession(0x01) to ProgrammingSession(0x02).",TestStepIntervalTime);
  SID10_DiagnosticSessionControl(PROGRAMMINGSESSION,PHYSICAL,SPRMIB_FALSE);
  CheckPosResponse_SID10(PROGRAMMINGSESSION,gP2Client_BOOT,gP2StarClientFor10Check,0,0);
  ECUinitHandle(0);
  TestStep("Verify ProgrammingSession.",TestStepIntervalTime);
  CheckCurrentSession(PROGRAMMINGSESSION,PHYSICAL,0,0);
  
  if(Flag_OBDNode == 1)
    StartService = 0x10;
  else
    StartService = 0x00;
  
  for(i=StartService; i<=0xFF; i++)
  {
    Flag = 0;
    
    if(i==0x10)
    {
      TestStep("Let SV=%02x",StartService);
    }
    else
    {
      TestStep("If SV<0xFF add 1 to SV and jump to Step 2",TestStepIntervalTime,2);
    }
    TestStep("If SV equals a service from configured list jump to Step 4",TestStepIntervalTime,4);
    for(j=0;j<service_PBL_Num;j++)
    {
      if(service_PBL[j] == i)
        Flag = 1;
    }
    if(Flag == 1)
      continue;
    TestStep("Request unsupported service",TestStepIntervalTime);
    TestSD_service[0]=i;
    TPSendRawMessage(TestSD_service,FUNCTIONAL);
    CheckNonResponse(0,0);
    testWaitForTimeout(100);
  }
  TestStep("Verify ProgrammmingSession",TestStepIntervalTime);
  CheckCurrentSession(PROGRAMMINGSESSION,PHYSICAL,0,0);
  /******************************以上为测试步骤*********************************/
  Postcondition();
   
}
/// <PBL_GeneralTest>
testcase Unsupported_Diagnostic_Subfunction_Test_Physical_ProgrammingSession()
{
  char logPath[400] = "";
  int  i;
  byte data[2]={0x3e,0x01};
  byte ExpectNRC[2]={0x12,0x7E};
  char logName[400] = "";
  char info[1024];
  
  strncat(logName,"1351029_Unsupported_Diagnostic_Subfunction_Test_Physical_ProgrammingSession",400);
  testCaseDescription("To see if correct NRC is implemented.");
  testCaseTitle("1351029","Unsupported_Diagnostic_Subfunction_Test_Physical_ProgrammingSession");
  
  SetLog(logName);
  Precondition();

  /******************************以下为测试步骤*********************************/
  
  SessionFlag=BOOT;
  
  TestStep("Transition from defaultSession(0x01) to ProgrammingSession(0x02).",TestStepIntervalTime);
  SID10_DiagnosticSessionControl(PROGRAMMINGSESSION,PHYSICAL,SPRMIB_FALSE);
  CheckPosResponse_SID10(PROGRAMMINGSESSION,gP2Client_BOOT,gP2StarClientFor10Check,0,0);
  ECUinitHandle(0);
  TestStep("Verify ProgrammingSession.",TestStepIntervalTime);
  CheckCurrentSession(PROGRAMMINGSESSION,PHYSICAL,0,0);
  for(i=1; i<=0xFF; i++)
  {
    if(i==0)
    {
      TestStep("Let SF=00",TestStepIntervalTime);
    }
    else
    {
      TestStep("If SF<0xFF add 1 to SF and jump to Step 4",TestStepIntervalTime,4);
    }
    TestStep("If SF equals a subfunctioin supported to service 0x3E from configured list jump to Step 6.",TestStepIntervalTime,6);
    if(i!=0x80)
    {
      data[1]=i;
    }
    TestStep("Send short message",TestStepIntervalTime);
    TPSendRawMessage(data,PHYSICAL);
    CheckNegResponse(ExpectNRC,0,0,0,0);
  }
  TestStep("Verify ProgrammingSession.",TestStepIntervalTime);
  CheckCurrentSession(PROGRAMMINGSESSION,PHYSICAL,0,0);
  /******************************以上为测试步骤*********************************/
  Postcondition();
   
}
/// <PBL_GeneralTest>
testcase Unsupported_Diagnostic_Subfunction_Test_Functional_ProgrammingSession()
{
  int  i;
  byte data[2]={0x3e,0x01};
  char logName[400] = "";
  char info[1024];
  
  strncat(logName,"1351030_Unsupported_Diagnostic_Subfunction_Test_Functional_ProgrammingSession",400);
  testCaseDescription("Send a subfunction that is not supported to the ECU.");
  testCaseTitle("1351030","Unsupported_Diagnostic_Subfunction_Test_Functional_ProgrammingSession");
  if(gBusFlag==3)
	{
		testStepWarning("Test","This test case does not apply to the LIN bus");
		return;
	}
  SetLog(logName);
  Precondition();

  /******************************以下为测试步骤*********************************/
  
  SessionFlag=BOOT;
  
  TestStep("Transition from defaultSession(0x01) to ProgrammingSession(0x02).",TestStepIntervalTime);
  SID10_DiagnosticSessionControl(PROGRAMMINGSESSION,PHYSICAL,SPRMIB_FALSE);
  CheckPosResponse_SID10(PROGRAMMINGSESSION,gP2Client_BOOT,gP2StarClientFor10Check,0,0);
  ECUinitHandle(0);
  TestStep("Verify ProgrammingSession.",TestStepIntervalTime);
  CheckCurrentSession(PROGRAMMINGSESSION,PHYSICAL,0,0);
  for(i=1; i<=0xFF; i++)
  {
    if(i==0)
    {
      TestStep("Let SF=00",TestStepIntervalTime);
    }
    else
    {
      TestStep("If SF<0xFF add 1 to SF and jump to Step 4",TestStepIntervalTime,4);
    }
    TestStep("If SF equals a subfunctioin supported to service 0x3E from configured list jump to Step 6.",TestStepIntervalTime,6);
    if(i!=0x80)
    {
      data[1]=i;
    }
    TestStep("Send short message",TestStepIntervalTime);
    TPSendRawMessage(data,FUNCTIONAL);
    CheckNonResponse(0,0);
  }
  TestStep("Verify ProgrammingSession.",TestStepIntervalTime);
  CheckCurrentSession(PROGRAMMINGSESSION,PHYSICAL,0,0);
  /******************************以上为测试步骤*********************************/
  Postcondition();
   
}
/// <PBL_GeneralTest>
testcase ECU_Identification_Verification_Test_Physical_ProgrammingSession()
{
  dword MulDID[6]= {0xF18C,0xF121,0xF125,0xF12A,0xF12B,0xEDA0};
  int  i;
  byte PID[2];
  char logName[400] = "";
  char info[1024];
  
  strncat(logName,"1022511_ECU_Identification_Verification_Test_Physical_ProgrammingSession",400);
  testCaseDescription("The intent is to verify that the ECU support mandatory Identification dataIdentifiers.");
  testCaseTitle("1022511","ECU_Identification_Verification_Test_Physical_ProgrammingSession");
  
  
  SetLog(logName);
  Precondition();

  /******************************以下为测试步骤*********************************/
  
  SessionFlag=BOOT;
  
  TestStep("Transition from defaultSession(0x01) to ProgrammingSession(0x02).",TestStepIntervalTime);
  SID10_DiagnosticSessionControl(PROGRAMMINGSESSION,PHYSICAL,SPRMIB_FALSE);
  CheckPosResponse_SID10(PROGRAMMINGSESSION,gP2Client_BOOT,gP2StarClientFor10Check,0,0);
  ECUinitHandle(0);
  TestStep("Verify ProgrammingSession.",TestStepIntervalTime);
  CheckCurrentSession(PROGRAMMINGSESSION,PHYSICAL,0,0);
  
  for(i=0;i<6;i++)
  {
    if(i==0)
    {
      TestStep("Let Z1 Z2 = First dataIdentifier from table Mandatory DIDs in PBL, NN = data size of the identifier stated in table.",TestStepIntervalTime);
    }
    else
    {
      TestStep("Jump to Step 4 until all the dataIdentifiers in table Mandatory DIDs in PBL are tested. Let Z1 Z2 = next dataIdentifier, NN = data size of the identifier stated in table.",TestStepIntervalTime,4);
    }
    PID[0]=MulDID[i]>>8;
    PID[1]=MulDID[i]&0xFF;
    
    TestStep("Request multiple DIDs",TestStepIntervalTime);
    SID22_ReadDataByIdentifier(PID,PHYSICAL);
    CheckPosResponse(0x22,0,0);
  }
  TestStep("Verify ProgrammingSession.",TestStepIntervalTime);
  CheckCurrentSession(PROGRAMMINGSESSION,PHYSICAL,0,0);
  /******************************以上为测试步骤*********************************/
  Postcondition();
   
}
/// <PBL_GeneralTest>
testcase ECU_Identification_Verification_Test_Functional_ProgrammingSession()
{
  dword MulDID[6]= {0xF18C,0xF121,0xF125,0xF12A,0xF12B,0xEDA0};
  int  i;
  byte PID[2];
  char logName[400] = "";
  char info[1024];
  
  strncat(logName,"1022512_ECU_Identification_Verification_Test_Functional_ProgrammingSession",400);
  testCaseDescription("ECU supports ECU mandatory identification dataidentifiers (DIDs).ECU responds with negative response code (NRC) to dataidentifiers not supported.");
  testCaseTitle("1022512","ECU_Identification_Verification_Test_Functional_ProgrammingSession");
  if(gBusFlag==3)
	{
		testStepWarning("Test","This test case does not apply to the LIN bus");
		return;
	}
  SetLog(logName);
  Precondition();

  /******************************以下为测试步骤*********************************/
  
  SessionFlag=BOOT;
  
  TestStep("Transition from defaultSession(0x01) to ProgrammingSession(0x02).",TestStepIntervalTime);
  SID10_DiagnosticSessionControl(PROGRAMMINGSESSION,PHYSICAL,SPRMIB_FALSE);
  CheckPosResponse_SID10(PROGRAMMINGSESSION,gP2Client_BOOT,gP2StarClientFor10Check,0,0);
  ECUinitHandle(0);
  TestStep("Verify ProgrammingSession.",TestStepIntervalTime);
  CheckCurrentSession(PROGRAMMINGSESSION,PHYSICAL,0,0);
  
  for(i=0;i<6;i++)
  {
    if(i==0)
    {
      TestStep("Let Z1 Z2 = First dataIdentifier from table Mandatory DIDs in PBL, NN = data size of the identifier stated in table.",TestStepIntervalTime);
    }
    else
    {
      TestStep("Jump to Step 4 until all the dataIdentifiers in table Mandatory DIDs in PBL are tested. Let Z1 Z2 = next dataIdentifier, NN = data size of the identifier stated in table.",TestStepIntervalTime,4);
    }
    PID[0]=MulDID[i]>>8;
    PID[1]=MulDID[i]&0xFF;
    
    TestStep("Request multiple DIDs",TestStepIntervalTime);
    SID22_ReadDataByIdentifier(PID,FUNCTIONAL);
    CheckPosResponse(0x22,0,0);
  }
  TestStep("Verify ProgrammingSession.",TestStepIntervalTime);
  CheckCurrentSession(PROGRAMMINGSESSION,PHYSICAL,0,0);
  /******************************以上为测试步骤*********************************/
  Postcondition();
   
}
/// <PBL_GeneralTest>
testcase Power_Up_Default_Session_Test_Physical_All_Session()
{
  char logName[400] = "";
  char info[1024];
  
  strncat(logName,"1351019_Power_Up_Default_Session_Test_Physical_All_Session",400);
  testCaseDescription("The power to the ECU will be cycled.After power cycled wait to operation cycle start.Read out of diagnostic session");
  testCaseTitle("1351019","Power_Up_Default_Session_Test_Physical_All_Session");
  
  SetLog(logName);
  Precondition();
   
  /******************************以下为测试步骤*********************************/
  
  SessionFlag=BOOT;
  
  TestStep("Transition from defaultSession(0x01) to ProgrammingSession(0x02).",TestStepIntervalTime);
  SID10_DiagnosticSessionControl(PROGRAMMINGSESSION,PHYSICAL,SPRMIB_FALSE);
  CheckPosResponse_SID10(PROGRAMMINGSESSION,gP2Client_BOOT,gP2StarClientFor10Check,0,0);
  ECUinitHandle(0);
  TestStep("Verify ProgrammingSession.",TestStepIntervalTime);
  CheckCurrentSession(PROGRAMMINGSESSION,PHYSICAL,0,0);
  
  TestStep("Cycle the power to the ECU.",TestStepIntervalTime);
//  testWaitForTesterConfirmation("Please recycle the power of the ECU");
  kl30(T_off);
  kl15(T_off);
  testWaitForTimeout(1000);
  kl30(T_on);
  kl15(T_on);
  
  TestStep("Wait to operation cycle start.");
  ECUinitHandle(0);
  
  SessionFlag=APP;
  TestStep("Verify defaultSession.",TestStepIntervalTime);
  CheckCurrentSession(DEFAULTSESSION,PHYSICAL,0,0);
  SessionFlag=BOOT;
  
  TestStep("Transition from defaultSession(0x01) to ProgrammingSession(0x02).",TestStepIntervalTime);
  SID10_DiagnosticSessionControl(PROGRAMMINGSESSION,PHYSICAL,SPRMIB_FALSE);
  CheckPosResponse_SID10(PROGRAMMINGSESSION,gP2Client_BOOT,gP2StarClientFor10Check,0,0);
  
  ECUinitHandle(0);
  TestStep("Verify ProgrammingSession.",TestStepIntervalTime);
  CheckCurrentSession(PROGRAMMINGSESSION,PHYSICAL,0,0);
  
  TestStep("ECU Reset (hard reset)",TestStepIntervalTime);
  //SID11_ECUReset(HardReset,SPRMIB_False,PHYSICAL);
  SID11_ECUReset(HARDRESET,PHYSICAL,SPRMIB_FALSE);
  CheckPosResponse_SID11(HARDRESET,0,0);
  
  SessionFlag=APP;
  
  TestStep("Wait to operation cycle start.");
  ECUinitHandle(0);
  TestStep("Verify defaultSession.",TestStepIntervalTime);
  CheckCurrentSession(DEFAULTSESSION,PHYSICAL,0,0);
  /******************************以上为测试步骤*********************************/
  Postcondition();
   
}
/// <PBL_GeneralTest>
testcase S3_Server_SuspensionDuringSegmentedResponseTest_Valid_Physical_ProgrammingSession()
{
  long res,msgdlc,CFNum;
  message 0x1 TpRes;
  int i=0;
  char logName[400] = "";
  char info[1024];
  byte testPreFillFlag=0;
  
  strncat(logName,"1351020_S3_Server_SuspensionDuringSegmentedResponseTest_Valid_Physical_ProgrammingSession",400);
  testCaseDescription("The intent is to verify that S3Server timer is suspended during segmented response and the ECU do not time out.");
  testCaseTitle("1351020","S3_Server_SuspensionDuringSegmentedResponseTest_Valid_Physical_ProgrammingSession");
  if((gBusFlag!=1)&&(gBusFlag!=2))
	{
		testStepWarning("Test","This test case only apply to the CAN or CANFD bus");
		return;
	}
  SetLog(logName);
  Precondition();

  //*****************************以下为测试步骤********************************
  TestStep("Disable functional addressed TesterPresent(0x3E) during the test",TestStepIntervalTime);
  TPMsgInit(0);
  SessionFlag=BOOT;
  
  TestStep("Transition from defaultSession(0x01) to ProgrammingDiagnosticSession(0x02).",TestStepIntervalTime);
  SID10_DiagnosticSessionControl(PROGRAMMINGSESSION,PHYSICAL,SPRMIB_FALSE);
  CheckPosResponse_SID10(PROGRAMMINGSESSION,gP2Client_BOOT,gP2StarClientFor10Check,0,0);
  ECUinitHandle(0);
  TestStep("Verify ProgrammingDiagnosticSession",TestStepIntervalTime);
  CheckCurrentSession(PROGRAMMINGSESSION,PHYSICAL,0,0);
  TestStep("Read data by data identifer",TestStepIntervalTime);
  
  CloseCANConnection();
  testJoinMessageEvent(gCAN_ResponseID);
  testStep("Chk","Send a SF to request MultiFrame");
  output(TP_RequestMultiFrame);
  
  res= testWaitForAnyJoinedEvent(1000);
  if(res>0)
  {
    testGetWaitEventMsgData(TpRes);
    CheckNRC78(TpRes);//判断收到的报文是否为NRC78
  }
  else
    testStepFail("Chk","DUT doesn't response FF during test");

  if(res>0)
  {
    testGetWaitEventMsgData(TpRes);
    if((TpRes.byte(0)&0xF0) == 0x10 )
    {
      testStepPass("Chk","DUT Response a FF");
      msgdlc=((TpRes.byte(0) & 0x0F)<<8) + TpRes.byte(1);
      if(gBusFlag==2)
      {
        if((msgdlc-62)%63 > 0)//CFNum = 有多少CF帧
        { 
          CFNum = (msgdlc-62) / 63 + 1;  
        }
        else
          CFNum = (msgdlc-62) / 63;   
      }
      else if(gBusFlag==1)
      {
        if((msgdlc-6)%8 > 0)//CFNum = 有多少CF帧
        { 
          CFNum = (msgdlc-6) / 8 + 1;  
        }
        else
          CFNum = (msgdlc-6) / 8;   
      }
      TestStep("Wait (N_Bs timeout * 0.95) after receiving first frame and before sending flow control frame continue to send");
      testWaitForTimeout(950);
      
      output(TP_FC_CTS);
      testStep("Chk","Send FC(CTS)");
      for(i=1;i<=CFNum;i++)
      {
        testJoinMessageEvent(gCAN_ResponseID);
        res= testWaitForAnyJoinedEvent(1000);
        if(res>0)
        {
          testGetWaitEventMsgData(TpRes);
          if((TpRes.byte(0)) == (0x20|(i)) )
          {
            testStepPass("Chk","DUT Response CF%d",i);
          }
          if(i==CFNum)
          {
            testPreFillFlag=1;
            testStepPass("Chk","ALL CF received");
            TestStep("After last frame response in step 5 wait 4900 ms ");
            testWaitForTimeout(4900);
          }
        }
        else if(i==1)
        {
          testPreFillFlag=0;
          testStepFail("Chk","DUT not response CF");
          break;
        }
        else
        {
          testPreFillFlag=0;
          testStepFail("Chk","Not receive all CF");
          break;
        } 
      }
      OpenCANConnection();
      if(testPreFillFlag==1)
      {
        TestStep("Verify ProgrammingDiagnosticSession",TestStepIntervalTime);
        CheckCurrentSession(PROGRAMMINGSESSION,PHYSICAL,0,0);
      }
      else 
      {
        testStepFail("Fail","DUT Response Wrong,Test precondition not fullfilled,test end");
      }
    }
    else
    {
      testPreFillFlag=0;
      OpenCANConnection();
      testStepFail("Chk","DUT doesn't response FF during test");
    }
  }
  else
  {
    testPreFillFlag=0;
    OpenCANConnection();
    testStepFail("Chk","DUT doesn't response FF during test");
  }
  CheckCurrentSession(PROGRAMMINGSESSION,PHYSICAL,0,0);
  //*****************************以上为测试步骤********************************
  Postcondition();
   
}
/// <PBL_GeneralTest>
testcase S3_Server_SuspensionDuringSegmentedResponseTest_Valid_Functional_ProgrammingSession()
{
  long res,msgdlc,CFNum,Stmin;
  message 0x1 TpRes;
  int i=0;
  char logName[400] = "";
  char info[1024];
  byte testPreFillFlag=0;
  
  strncat(logName,"1351021_S3_Server_SuspensionDuringSegmentedResponseTest_Valid_Functional_ProgrammingSession",400);
  testCaseDescription("The intent is to verify that S3Server timer is suspended during segmented response and the ECU do not time out.");
  testCaseTitle("1351021","S3_Server_SuspensionDuringSegmentedResponseTest_Valid_Functional_ProgrammingSession");
  if((gBusFlag!=1)&&(gBusFlag!=2))
	{
		testStepWarning("Test","This test case only apply to the CAN or CANFD bus");
		return;
	}
  SetLog(logName);
  Precondition();

  /******************************以下为测试步骤*********************************/
  TPMsgInit(1);
  SessionFlag=BOOT;
  
  TestStep("Disable functional addressed TesterPresent(0x3E) during the test",TestStepIntervalTime);
  
  TestStep("Transition from defaultSession(0x01) to ProgrammingDiagnosticSession(0x02).",TestStepIntervalTime);
  SID10_DiagnosticSessionControl(PROGRAMMINGSESSION,PHYSICAL,SPRMIB_FALSE);
  CheckPosResponse_SID10(PROGRAMMINGSESSION,gP2Client_BOOT,gP2StarClientFor10Check,0,0);
  ECUinitHandle(0);
  TestStep("Verify ProgrammingDiagnosticSession",TestStepIntervalTime);
  CheckCurrentSession(PROGRAMMINGSESSION,PHYSICAL,0,0);
  TestStep("Verify extendedDiagnosticSession",TestStepIntervalTime);
  
  CloseCANConnection();
  testJoinMessageEvent(gCAN_ResponseID);
  testStep("Chk","Send a SF to request MultiFrame");
  output(TP_RequestMultiFrame);
  
  res= testWaitForAnyJoinedEvent(1000);
  if(res>0)
  {
    testGetWaitEventMsgData(TpRes);
    CheckNRC78(TpRes);//判断收到的报文是否为NRC78
  }
  else
  testStepFail("Chk","DUT doesn't response FF during test");

  if(res>0)
  {
    testGetWaitEventMsgData(TpRes);
    if((TpRes.byte(0)&0xF0) == 0x10 )
    {
      testStepPass("Chk","DUT Response a FF");
      msgdlc=((TpRes.byte(0) & 0x0F)<<8) + TpRes.byte(1);
      if(gBusFlag==2)
      {
        if((msgdlc-62)%63 > 0)//CFNum = 有多少CF帧
        { 
          CFNum = (msgdlc-62) / 63 + 1;  
        }
        else
          CFNum = (msgdlc-62) / 63;   
      }
      else if(gBusFlag==1)
      {
        if((msgdlc-6)%8 > 0)//CFNum = 有多少CF帧
        { 
          CFNum = (msgdlc-6) / 8 + 1;  
        }
        else
          CFNum = (msgdlc-6) / 8;   
      }
      TestStep("Wait (N_Bs timeout * 0.95) after receiving first frame and before sending flow control frame continue to send");
      testWaitForTimeout(950);
      
      output(TP_FC_CTS);
      testStep("Chk","Send FC(CTS)");
      for(i=1;i<=CFNum;i++)
      {
        testJoinMessageEvent(gCAN_ResponseID);
        res= testWaitForAnyJoinedEvent(1000);
        if(res>0)
        {
          testGetWaitEventMsgData(TpRes);
          if((TpRes.byte(0)) == (0x20|(i)) )
          {
            testStepPass("Chk","DUT Response CF%d",i);
          }
          if(i==CFNum)
          {
            testPreFillFlag=1;
            testStepPass("Chk","ALL CF received");
            TestStep("After last frame response in step 5 wait 4900 ms ");
            testWaitForTimeout(4900);
          }
        }
        else if(i==1)
        {
          testPreFillFlag=0;
          testStepFail("Chk","DUT not response CF");
          break;
        }
        else
        {
          testPreFillFlag=0;
          testStepFail("Chk","Not receive all CF");
          break;
        } 
      }
      OpenCANConnection();
      if(testPreFillFlag==1)
      {
        TestStep("Verify ProgrammingDiagnosticSession",TestStepIntervalTime);
        CheckCurrentSession(PROGRAMMINGSESSION,PHYSICAL,0,0);
      }
      else 
      {
        testStepFail("Fail","DUT Response Wrong,Test precondition not fullfilled,test end");
      }
    }
    else
    {
      testPreFillFlag=0;
      OpenCANConnection();
      testStepFail("Chk","DUT doesn't response FF during test");
    }
  }
  else
  {
    testPreFillFlag=0;
    OpenCANConnection();
    testStepFail("Chk","DUT doesn't response FF during test");
  }
  TestStep("Verify ProgrammingDiagnosticSession",TestStepIntervalTime);
  CheckCurrentSession(PROGRAMMINGSESSION,PHYSICAL,0,0);
  /******************************以上为测试步骤*********************************/
  Postcondition();  
}
/// <PBL_GeneralTest>
testcase S3_Server_SuspensionDuringSegmentedRequestTest_Valid_Physical_ProgrammingSession()
{
  long res,msgdlc,CFNum,Stmin;
  message 0x1 TpRes;
  int i=0;
  char logName[400] = "";
  char info[1024];
  byte testPreFillFlag=0;
  
  strncat(logName,"1351022_S3_Server_SuspensionDuringSegmentedRequestTest_Valid_Physical_ProgrammingSession",400);
  testCaseDescription("The intent of this test is to verify that the S3Server timer in the ECU is suspended during segmented request.");
  testCaseTitle("1351022","S3_Server_SuspensionDuringSegmentedRequestTest_Valid_Physical_ProgrammingSession");
  if((gBusFlag!=1)&&(gBusFlag!=2))
	{
		testStepWarning("Test","This test case only apply to the CAN or CANFD bus");
		return;
	}
  SetLog(logName);
  Precondition();

  /******************************以下为测试步骤*********************************/  
  TPMsgInit(0);
  SessionFlag=BOOT;
  
  TestStep("Transition from defaultSession(0x01) to ProgrammingDiagnosticSession(0x02).",TestStepIntervalTime);
  SID10_DiagnosticSessionControl(PROGRAMMINGSESSION,PHYSICAL,SPRMIB_FALSE);
  CheckPosResponse_SID10(PROGRAMMINGSESSION,gP2Client_BOOT,gP2StarClientFor10Check,0,0);
  ECUinitHandle(0);
  TestStep("Verify ProgrammingDiagnosticSession",TestStepIntervalTime);
  CheckCurrentSession(PROGRAMMINGSESSION,PHYSICAL,0,0);
  
  TestStep("Send MultiFrame with an unsupported diagnostic service.");
  
  CloseCANConnection();
  testStep("Chk","Send FF");
  output(TP_FirstFrame);
  
  testJoinMessageEvent(gCAN_ResponseID);
  res= testWaitForAnyJoinedEvent(1000);
  if(res>0)
  {
    testGetWaitEventMsgData(TpRes);
    CheckNRC78(TpRes);//判断收到的报文是否为NRC78
  }
  else
    testStepFail("Fail","DUT doesn't response FF during test");

  if(res>0)
  {
    testGetWaitEventMsgData(TpRes);
    if((TpRes.byte(0)&0xF0) == 0x30 )
    {
      testStepPass("Pass","Receiced FC");
      Stmin=TpRes.byte(2);
      if(Stmin<=0x7F||Stmin>=0)
      {
      }
      else
      {
        Stmin=0;
      }
    }
    else 
    {
      testStepFail("Fail","Dut don't Send a FC");
    }
  }
  testWaitForTimeout(Stmin+1);
  testStep("Chk","Wait for N_Cr Timeout*0.95, then Send CF");
  output(TP_CF1);
  OpenCANConnection();
  CheckNegResponse(0x11,0,0);
  
  
  
  TestStep("Wait for 4800 ms");
  testWaitForTimeout(4800);
  CheckCurrentSession(PROGRAMMINGSESSION,PHYSICAL,0,0);
  /******************************以上为测试步骤*********************************/
  Postcondition();
   
}

/// <PBL_CommonServiceTest>
testcase Sercice_0x11_Valid_Physical_ProgrammingSession_Supported()
{
  char logName[400] = "";
  char info[1024];
  
  strncat(logName,"1351001_Sercice_0x11_Valid_Physical_ProgrammingSession_Supported",400);
  testCaseDescription("The intent is to verify if the Service ECUReset (0x11) can be performed");
  testCaseTitle("1351001","Sercice_0x11_Valid_Physical_ProgrammingSession_Supported");
  
  SetLog(logName);
  Precondition();
  TestStep("Start to execute Sercice_0x11_Valid_Physical_ProgrammingSession_Supported",TestStepIntervalTime);
  TestStep("Start to execute the test procedure : Valid physical ProgrammingDiagnosticSession supported service",TestStepIntervalTime);
  /******************************以下为测试步骤*********************************/
  SessionFlag=APP;
  gflag_check_ecu_init_time = 1;
  
  TestStep("Transition from defaultSession(0x01) to ProgrammingDiagnosticSession(0x02).",TestStepIntervalTime);
  SID10_DiagnosticSessionControl(PROGRAMMINGSESSION,PHYSICAL,SPRMIB_FALSE);
  CheckPosResponse_SID10(PROGRAMMINGSESSION,gP2Client_BOOT,gP2StarClientFor10Check,0,0);
  ECUinitHandle(0);
  SessionFlag=BOOT;
  TestStep("Verify ProgrammingDiagnosticSession.",TestStepIntervalTime);
  CheckCurrentSession(PROGRAMMINGSESSION,PHYSICAL,0,0);
  TestStep("ECU Reset (hard reset)",TestStepIntervalTime);
  //SID11_ECUReset(HardReset,SPRMIB_False,PHYSICAL);
  SID11_ECUReset(HARDRESET,PHYSICAL,SPRMIB_FALSE);
  CheckPosResponse_SID11(HARDRESET,0,0);
  ECUinitHandle(0);
  
  SessionFlag=APP;
  TestStep("Verify defaultSession.",TestStepIntervalTime);
  CheckCurrentSession(DEFAULTSESSION,PHYSICAL,0,0);
  
  TestStep("Transition from defaultSession(0x01) to ProgrammingDiagnosticSession(0x03).",TestStepIntervalTime);
  SID10_DiagnosticSessionControl(PROGRAMMINGSESSION,PHYSICAL,SPRMIB_FALSE);
  CheckPosResponse_SID10(PROGRAMMINGSESSION,gP2Client_BOOT,gP2StarClientFor10Check,0,0);
  ECUinitHandle(0);
  SessionFlag=BOOT;
  
  TestStep("Verify ProgrammingDiagnosticSession.",TestStepIntervalTime);
  CheckCurrentSession(PROGRAMMINGSESSION,PHYSICAL,0,0);
  TestStep("ECU Reset (hard reset)",TestStepIntervalTime);
  //SID11_ECUReset(HardReset,SPRMIB_True,PHYSICAL);
  SID11_ECUReset(HARDRESET,PHYSICAL,SPRMIB_TRUE);
  CheckNonResponse(0,0);
  ECUinitHandle(0);
  SessionFlag=APP;
  
  TestStep("Verify defaultSession.",TestStepIntervalTime);
  CheckCurrentSession(DEFAULTSESSION,PHYSICAL,0,0);
  
  TestStep("Transition from defaultSession(0x01) to ProgrammingDiagnosticSession(0x02).",TestStepIntervalTime);
  SID10_DiagnosticSessionControl(PROGRAMMINGSESSION,PHYSICAL,SPRMIB_FALSE);
  CheckPosResponse_SID10(PROGRAMMINGSESSION,gP2Client_BOOT,gP2StarClientFor10Check,0,0);
  ECUinitHandle(0);
  SessionFlag=BOOT;
  
  TestStep("Verify ProgrammingDiagnosticSession.",TestStepIntervalTime);
  CheckCurrentSession(PROGRAMMINGSESSION,PHYSICAL,0,0);
  
  gflag_check_ecu_init_time = 0;
  /******************************以上为测试步骤*********************************/
  Postcondition();
}
/// <PBL_CommonServiceTest>
testcase Sercice_0x11_Valid_Functional_ProgrammingSession_Supported()
{
  char logName[400] = "";
  char info[1024];
  
  strncat(logName,"1022514_Sercice_0x11_Valid_Functional_ProgrammingSession_Supported",400);
  testCaseDescription("The intent is to verify if the Service ECUReset (0x11) can be performed");
  testCaseTitle("1022514","Sercice_0x11_Valid_Functional_ProgrammingSession_Supported");
  if(gBusFlag==3)
	{
		testStepWarning("Test","This test case does not apply to the LIN bus");
		return;
	}
  SetLog(logName);
  Precondition();
  /******************************以下为测试步骤*********************************/
  SessionFlag=APP;
  gflag_check_ecu_init_time = 1;
  
  TestStep("Transition from defaultSession(0x01) to ProgrammingDiagnosticSession(0x02).",TestStepIntervalTime);
  SID10_DiagnosticSessionControl(PROGRAMMINGSESSION,PHYSICAL,SPRMIB_FALSE);
  CheckPosResponse_SID10(PROGRAMMINGSESSION,gP2Client_BOOT,gP2StarClientFor10Check,0,0);
  ECUinitHandle(0);
  SessionFlag=BOOT;
  TestStep("Verify ProgrammingDiagnosticSession.",TestStepIntervalTime);
  CheckCurrentSession(PROGRAMMINGSESSION,PHYSICAL,0,0);
  TestStep("ECU Reset (hard reset)",TestStepIntervalTime);
  //SID11_ECUReset(HardReset,SPRMIB_False,FUNCTIONAL);
  SID11_ECUReset(HARDRESET,FUNCTIONAL,SPRMIB_FALSE);
  CheckPosResponse_SID11(HARDRESET,0,0);
  ECUinitHandle(0);
  SessionFlag=APP;
  
  TestStep("Verify defaultSession.",TestStepIntervalTime);
  CheckCurrentSession(DEFAULTSESSION,PHYSICAL,0,0);
  
  TestStep("Transition from defaultSession(0x01) to ProgrammingDiagnosticSession(0x02).",TestStepIntervalTime);
  SID10_DiagnosticSessionControl(PROGRAMMINGSESSION,PHYSICAL,SPRMIB_FALSE);
  CheckPosResponse_SID10(PROGRAMMINGSESSION,gP2Client_BOOT,gP2StarClientFor10Check,0,0);
  ECUinitHandle(0);
  SessionFlag=BOOT;
  
  TestStep("Verify ProgrammingDiagnosticSession.",TestStepIntervalTime);
  CheckCurrentSession(PROGRAMMINGSESSION,PHYSICAL,0,0);
  TestStep("ECU Reset (hard reset)",TestStepIntervalTime);
  //SID11_ECUReset(HardReset,SPRMIB_True,FUNCTIONAL);
  SID11_ECUReset(HARDRESET,FUNCTIONAL,SPRMIB_TRUE);
  CheckNonResponse(0,0);
  ECUinitHandle(0);
  
  SessionFlag=APP;
  TestStep("Verify defaultSession.",TestStepIntervalTime);
  CheckCurrentSession(DEFAULTSESSION,PHYSICAL,0,0);
  
  TestStep("Transition from defaultSession(0x01) to ProgrammingDiagnosticSession(0x02).",TestStepIntervalTime);
  SID10_DiagnosticSessionControl(PROGRAMMINGSESSION,PHYSICAL,SPRMIB_FALSE);
  CheckPosResponse_SID10(PROGRAMMINGSESSION,gP2Client_BOOT,gP2StarClientFor10Check,0,0);
  ECUinitHandle(0);
  SessionFlag=BOOT;
  
  TestStep("Verify ProgrammingDiagnosticSession.",TestStepIntervalTime);
  CheckCurrentSession(PROGRAMMINGSESSION,PHYSICAL,0,0);
  
  gflag_check_ecu_init_time = 0;
  /******************************以上为测试步骤*********************************/
  Postcondition();
}
/// <PBL_CommonServiceTest>
testcase Sercice_0x27_Valid_Physical_ProgrammingDiagnosticSession_Supported_Service()
{
  int i;
  char logPath[400] = "";
  byte ExpectNRC[2] ={0x12,0x7E};
  char logName[400] = "";
  char info[1024];
  
  strncat(logName,"1351002_Sercice_0x27_Valid_Physical_ProgrammingDiagnosticSession_Supported_Service",400);
  testCaseDescription("That the ECU supports the service Security Access (0x27).That the ECU supports subfunction SecurityAccessType, sendKey and requestSeed.");
  testCaseTitle("1351002","Sercice_0x27_Valid_Physical_ProgrammingDiagnosticSession_Supported_Service");
  
  SetLog(logName);
  Precondition();
  /******************************以下为测试步骤*********************************/
  
  TestStep("Transition from defaultSession(0x01) to ProgrammingDiagnosticSession(0x02).",TestStepIntervalTime);
  SID10_DiagnosticSessionControl(PROGRAMMINGSESSION,PHYSICAL,SPRMIB_FALSE);
  CheckPosResponse_SID10(PROGRAMMINGSESSION,gP2Client_BOOT,gP2StarClientFor10Check,0,0);
  ECUinitHandle(0);
  SessionFlag=BOOT;
  
  TestStep("Verify ProgrammingDiagnosticSession.",TestStepIntervalTime);
  CheckCurrentSession(PROGRAMMINGSESSION,PHYSICAL,0,0);
    TP_TesterPresentSet(TP_ON);
//  for(i=1; i<=LevelInProgramming; i++)
//  {
    Level1=0x01;
    testWaitForTimeout(gTimeWaitForSecuAccess);
  
    //执行解锁以确保控制器的错误计数器为0
    SID27_SecurityAccess_RequestSeed(Level1,PHYSICAL);
    CheckPosResponse_SID27_ReqSeed(Level1,gSeedArray,16,0,0);
    PID27_Parameters_Seeds_Chk(NotAllZero,gSeedArray);
    SID27_SecurityAccess_SendKey(Level1,gKeyArray,PHYSICAL);
    CheckPosResponse_SID27_SenKey(Level1,0,0);
  
    SID10_DiagnosticSessionControl(PROGRAMMINGSESSION,PHYSICAL,SPRMIB_FALSE);
    CheckPosResponse_SID10(PROGRAMMINGSESSION,gP2Client_BOOT,gP2StarClientFor10Check,0,0);
    ECUinitHandle(0);
    //执行解锁以确保控制器的错误计数器为0
    testWaitForTimeout(gTimeWaitForSecuAccess);
    TestStep("ECU response with seed. Verify that S1 S2 S3 not equal to 0x000000.",TestStepIntervalTime);
    SID27_SecurityAccess_RequestSeed(Level1,PHYSICAL);
    CheckPosResponse_SID27_ReqSeed(Level1,gSeedArray,16,0,0);
    PID27_Parameters_Seeds_Chk(NotAllZero,gSeedArray);
  
    TestStep("Generate K1 K2 K3 from response in step 3.",TestStepIntervalTime);
    gSeedArray[2]=gSeedArray[2]+1;
  
    TestStep("Generate wrong key from response.",TestStepIntervalTime);
    SID27_SecurityAccess_SendKey(Level1,gKeyArray,PHYSICAL);
    CheckNegResponse(0x35,0,0);
    TestStep("ECU response with seed. Verify that S1 S2 S3 not equal to 0x000000.",TestStepIntervalTime);
    SID27_SecurityAccess_RequestSeed(Level1,PHYSICAL);
    CheckPosResponse_SID27_ReqSeed(Level1,gSeedArray,16,0,0);
    PID27_Parameters_Seeds_Chk(NotAllZero,gSeedArray);
  
    TestStep("Generate K1 K2 K3 from response in step 6.",TestStepIntervalTime);
    gSeedArray[2]=gSeedArray[2]+1;
    TestStep("Generate wrong key from response.",TestStepIntervalTime);
    SID27_SecurityAccess_SendKey(Level1,gKeyArray,PHYSICAL);
    CheckNegResponse(0x36,0,0);
    TestStep("Wait for Delaytimer-1s.");
    delaywithreq(DelayTimer-1000);
    TestStep("requiredTimeDelayNotExpired",TestStepIntervalTime);
    SID27_SecurityAccess_RequestSeed(Level1,PHYSICAL);
    CheckNegResponse(0x37,0,0);
    TestStep("Wait for 2s.");
    testWaitForTimeout(2000);
    TestStep("ECU response with seed. Verify that S1 S2 S3 not equal to 0x000000.",TestStepIntervalTime);
    SID27_SecurityAccess_RequestSeed(Level1,PHYSICAL);
    CheckPosResponse_SID27_ReqSeed(Level1,gSeedArray,16,0,0);
    PID27_Parameters_Seeds_Chk(NotAllZero,gSeedArray);
  
    TestStep("Generate K1 K2 K3 from response in step 12.",TestStepIntervalTime);
    //gSeedArray[2]=gSeedArray[2]+1;
    TestStep("ECU unlocks.",TestStepIntervalTime);
    SID27_SecurityAccess_SendKey(Level1,gKeyArray,PHYSICAL);
    CheckPosResponse_SID27_SenKey(Level1,0,0);
    TestStep("Transition from ProgrammingDiagnosticSession(0x02) to ProgrammingDiagnosticSession(0x02).",TestStepIntervalTime);
    SID10_DiagnosticSessionControl(PROGRAMMINGSESSION,PHYSICAL,SPRMIB_FALSE);
    CheckPosResponse_SID10(PROGRAMMINGSESSION,gP2Client_BOOT,gP2StarClientFor10Check,0,0);
    ECUinitHandle(0);
    TestStep("Verify ProgrammingDiagnosticSession.",TestStepIntervalTime);
    CheckCurrentSession(PROGRAMMINGSESSION,PHYSICAL,0,0);
    
    testWaitForTimeout(gTimeWaitForSecuAccess);
    TestStep("ECU response with seed. Verify that S1 S2 S3 not equal to 0x000000.",TestStepIntervalTime);
    SID27_SecurityAccess_RequestSeed(Level1,PHYSICAL);
    CheckPosResponse_SID27_ReqSeed(Level1,gSeedArray,16,0,0);
    PID27_Parameters_Seeds_Chk(NotAllZero,gSeedArray);
    TestStep("ECU unlocks.",TestStepIntervalTime);
    SID27_SecurityAccess_SendKey(Level1,gKeyArray,PHYSICAL);
    CheckPosResponse_SID27_SenKey(Level1,0,0);
    SessionFlag=APP;
  
    TestStep("Transition to defaultSesion(0x01)",TestStepIntervalTime);
    SID10_DiagnosticSessionControl(DEFAULTSESSION,PHYSICAL,SPRMIB_FALSE);
    CheckPosResponse_SID10(DEFAULTSESSION,gP2Client_APP,gP2StarClientFor10Check,0,0);
    ECUinitHandle(0);
    TestStep("Verify defaultSession",TestStepIntervalTime);
    CheckCurrentSession(DEFAULTSESSION,PHYSICAL,0,0);
    SessionFlag=BOOT;
  
    TestStep("Transition from DefaultSession(0x01) to ProgrammingDiagnosticSession(0x02).",TestStepIntervalTime);
    SID10_DiagnosticSessionControl(PROGRAMMINGSESSION,PHYSICAL,SPRMIB_FALSE);
    CheckPosResponse_SID10(PROGRAMMINGSESSION,gP2Client_BOOT,gP2StarClientFor10Check,0,0);
    ECUinitHandle(0);
    TestStep("Verify ProgrammingDiagnosticSession.",TestStepIntervalTime);
    CheckCurrentSession(PROGRAMMINGSESSION,PHYSICAL,0,0);
  
    testWaitForTimeout(gTimeWaitForSecuAccess);
    TestStep("ECU response with seed. Verify that S1 S2 S3 not equal to 0x000000.",TestStepIntervalTime);
    SID27_SecurityAccess_RequestSeed(Level1,PHYSICAL);
    CheckPosResponse_SID27_ReqSeed(Level1,gSeedArray,16,0,0);
    PID27_Parameters_Seeds_Chk(NotAllZero,gSeedArray);
    TestStep("ECU unlock.",TestStepIntervalTime);
    SID27_SecurityAccess_SendKey(Level1,gKeyArray,PHYSICAL);
    CheckPosResponse_SID27_SenKey(Level1,0,0);
    TestStep("Disable functionally addressed periodic testerPresent.Wait for 4.8 seconds.");
    TP_TesterPresentSet(TP_OFF);
    delay(4800);
    TestStep("ECU response with seed. Verify that S1 S2 S3 equal to 0x000000.",TestStepIntervalTime);
    SID27_SecurityAccess_RequestSeed(Level1,PHYSICAL);
    CheckPosResponse_SID27_ReqSeed(Level1,gSeedArray,16,0,0);
    PID27_Parameters_Seeds_Chk(AllZero,gSeedArray);
  
    TestStep("Wait for 4s.");
    delay(4000);
  
    TestStep("ECU response with seed. Verify that S1 S2 S3 equal to 0x000000.",TestStepIntervalTime);
    SID27_SecurityAccess_RequestSeed(Level1,PHYSICAL);
    CheckPosResponse_SID27_ReqSeed(Level1,gSeedArray,16,0,0);
    PID27_Parameters_Seeds_Chk(AllZero,gSeedArray);
    for(i=0;i<elcount(gSeedArray);i++)
    {
      write("seedarray %d is %02x",i,gSeedArray[i]);
    }
    TestStep("Verify ProgrammingDiagnosticSession.",TestStepIntervalTime);
    CheckCurrentSession(PROGRAMMINGSESSION,PHYSICAL,0,0);
    TestStep("Wait for ECU times out to defaultSession, S3 timer plus 'ECU startup time' and an additional 500 ms.");
    delay(5500);
  
    ECUinitHandle(0);
  
    SessionFlag=APP;
    TestStep("Verify defaultSession",TestStepIntervalTime);
    CheckCurrentSession(DEFAULTSESSION,PHYSICAL,0,0);
  
    SessionFlag=BOOT;
    TP_TesterPresentSet(TP_ON);
    TestStep("Transition from defaultSession(0x01) to ProgrammingDiagnosticSession(0x02)",TestStepIntervalTime);
    SID10_DiagnosticSessionControl(PROGRAMMINGSESSION,PHYSICAL,SPRMIB_TRUE);
    CheckNonResponse(0,0);
  
    ECUinitHandle(0);
    TestStep("Verify ProgrammingDiagnosticSession.",TestStepIntervalTime);
    CheckCurrentSession(PROGRAMMINGSESSION,PHYSICAL,0,0);
    testWaitForTimeout(gTimeWaitForSecuAccess);
    TestStep("ECU response with seed. Verify that S1 S2 S3 not equal to 0x000000.",TestStepIntervalTime);
    SID27_SecurityAccess_RequestSeed(Level1,PHYSICAL);
    CheckPosResponse_SID27_ReqSeed(Level1,gSeedArray,16,0,0);
    PID27_Parameters_Seeds_Chk(NotAllZero,gSeedArray);
//  }
    TestStep("ECU response with seed.S1 S2 S3 not equal to 0x000000 and S1 S2 S3 not equal to S1 S2 S3 from step 34",TestStepIntervalTime);
    SID27_SecurityAccess_RequestSeed(Level1,PHYSICAL);
    CheckPosResponse_SID27_ReqSeed(Level1,gSeedArray,16,0,0);
    PID27_Parameters_Seeds_Chk(NotAllZero,gSeedArray);

  TestStep("Test of non supported subfunctions.",TestStepIntervalTime);
  for(i=0x03; i<0xFE; i=i+2)
  {
    if(i==3)
    TestStep("Let L1 be 03)",TestStepIntervalTime);
    else
    {
      TestStep("Add L1 + 2 If L1 =0x81 add +2 If L1 != 0x01 jump to step 38. ",TestStepIntervalTime);
    }
    if(i!=0x81)
    {
      Level1=i;
    }
    TestStep("ECU response with seed. Verify that S1 S2 S3 not equal to 0x000000.",TestStepIntervalTime);
    SID27_SecurityAccess_RequestSeed(Level1,PHYSICAL);
    CheckNegResponse(ExpectNRC,0,0,0,0);
  }
  TestStep("Verify ProgrammingDiagnosticSession.",TestStepIntervalTime);
  CheckCurrentSession(PROGRAMMINGSESSION,PHYSICAL,0,0);

  /******************************以上为测试步骤*********************************/
  Postcondition();
   
}
/// <PBL_CommonServiceTest>
testcase Sercice_0x27_Valid_Functional_ProgrammingDiagnosticSession_Supported_Service()
{
  int i;
  char logPath[400] = "";
  byte ExpectNRC[2]={0x12,0x7E};
  char logName[400] = "";
  char info[1024];
  
  strncat(logName,"1022496_Sercice_0x27_Valid_Functional_ProgrammingDiagnosticSession_Supported_Service",400);
  testCaseDescription("That the ECU supports the service Security Access (0x27).That the ECU supports subfunction SecurityAccessType, sendKey and requestSeed.");
  testCaseTitle("1022496","Sercice_0x27_Valid_Functional_ProgrammingDiagnosticSession_Supported_Service");
  if(gBusFlag==3)
	{
		testStepWarning("Test","This test case does not apply to the LIN bus");
		return;
	}
  else if(gBusFlag==1) { testStepWarning("Test","This test case does not apply to the Classical CAN bus"); return; }
  SetLog(logName);
  Precondition();
  /******************************以下为测试步骤*********************************/
  
  SessionFlag=BOOT;
  
  TestStep("Transition from defaultSession(0x01) to ProgrammingDiagnosticSession(0x02).",TestStepIntervalTime);
  SID10_DiagnosticSessionControl(PROGRAMMINGSESSION,PHYSICAL,SPRMIB_FALSE);
  CheckPosResponse_SID10(PROGRAMMINGSESSION,gP2Client_BOOT,gP2StarClientFor10Check,0,0);
  ECUinitHandle(0);
  TestStep("Verify ProgrammingDiagnosticSession.",TestStepIntervalTime);
  CheckCurrentSession(PROGRAMMINGSESSION,PHYSICAL,0,0);

//  for(i=1; i<=LevelInProgramming; i++)
//  {
    Level1=0x01;
    testWaitForTimeout(gTimeWaitForSecuAccess);
  
    //执行解锁以确保控制器的错误计数器为0
    SID27_SecurityAccess_RequestSeed(Level1,PHYSICAL);
    CheckPosResponse_SID27_ReqSeed(Level1,gSeedArray,16,0,0);
    PID27_Parameters_Seeds_Chk(NotAllZero,gSeedArray);
    SID27_SecurityAccess_SendKey(Level1,gKeyArray,PHYSICAL);
    CheckPosResponse_SID27_SenKey(Level1,0,0);
  
    SID10_DiagnosticSessionControl(PROGRAMMINGSESSION,PHYSICAL,SPRMIB_FALSE);
    CheckPosResponse_SID10(PROGRAMMINGSESSION,gP2Client_BOOT,gP2StarClientFor10Check,0,0);
    ECUinitHandle(0);
    //执行解锁以确保控制器的错误计数器为0
    testWaitForTimeout(gTimeWaitForSecuAccess);
  
    TestStep("ECU response with seed. Verify that S1 S2 S3 not equal to 0x000000.",TestStepIntervalTime);
    SID27_SecurityAccess_RequestSeed(Level1,FUNCTIONAL);
    CheckPosResponse_SID27_ReqSeed(Level1,gSeedArray,16,0,0);
    PID27_Parameters_Seeds_Chk(NotAllZero,gSeedArray);
  
    TestStep("Generate K1 K2 K3 from response in step 3.",TestStepIntervalTime);
    gSeedArray[2]=gSeedArray[2]+1;
  
    TestStep("Generate wrong key from response.",TestStepIntervalTime);
    SID27_SecurityAccess_SendKey(Level1,gKeyArray,FUNCTIONAL);
    CheckNegResponse(0x35,0,0);
    TestStep("ECU response with seed. Verify that S1 S2 S3 not equal to 0x000000.",TestStepIntervalTime);
    SID27_SecurityAccess_RequestSeed(Level1,FUNCTIONAL);
    CheckPosResponse_SID27_ReqSeed(Level1,gSeedArray,16,0,0);
    PID27_Parameters_Seeds_Chk(NotAllZero,gSeedArray);
  
    TestStep("Generate K1 K2 K3 from response in step 6.",TestStepIntervalTime);
    gSeedArray[2]=gSeedArray[2]+1;
    TestStep("Generate wrong key from response.",TestStepIntervalTime);
    SID27_SecurityAccess_SendKey(Level1,gKeyArray,FUNCTIONAL);
    CheckNegResponse(0x36,0,0);
    TestStep("Wait for Delaytimer-1s.");
    delaywithreq(DelayTimer-1000);
    TestStep("requiredTimeDelayNotExpired",TestStepIntervalTime);
    SID27_SecurityAccess_RequestSeed(Level1,FUNCTIONAL);
    CheckNegResponse(0x37,0,0);
    TestStep("Wait for 2s.");
    testWaitForTimeout(2000);
    TestStep("ECU response with seed. Verify that S1 S2 S3 not equal to 0x000000.",TestStepIntervalTime);
    SID27_SecurityAccess_RequestSeed(Level1,FUNCTIONAL);
    CheckPosResponse_SID27_ReqSeed(Level1,gSeedArray,16,0,0);
    PID27_Parameters_Seeds_Chk(NotAllZero,gSeedArray);
  
    TestStep("Generate K1 K2 K3 from response in step 12.",TestStepIntervalTime);
    //gSeedArray[2]=gSeedArray[2]+1;
    TestStep("ECU unlocks.",TestStepIntervalTime);
    SID27_SecurityAccess_SendKey(Level1,gKeyArray,FUNCTIONAL);
    CheckPosResponse_SID27_SenKey(Level1,0,0);
    TestStep("Transition from ProgrammingDiagnosticSession(0x02) to ProgrammingDiagnosticSession(0x02).",TestStepIntervalTime);
    SID10_DiagnosticSessionControl(PROGRAMMINGSESSION,PHYSICAL,SPRMIB_FALSE);
    CheckPosResponse_SID10(PROGRAMMINGSESSION,gP2Client_BOOT,gP2StarClientFor10Check,0,0);
    TestStep("Verify ProgrammingDiagnosticSession.",TestStepIntervalTime);
    CheckCurrentSession(PROGRAMMINGSESSION,PHYSICAL,0,0);
    
    testWaitForTimeout(gTimeWaitForSecuAccess);
    TestStep("ECU response with seed. Verify that S1 S2 S3 not equal to 0x000000.",TestStepIntervalTime);
    SID27_SecurityAccess_RequestSeed(Level1,FUNCTIONAL);
    CheckPosResponse_SID27_ReqSeed(Level1,gSeedArray,16,0,0);
    PID27_Parameters_Seeds_Chk(NotAllZero,gSeedArray);
    TestStep("ECU unlocks.",TestStepIntervalTime);
    SID27_SecurityAccess_SendKey(Level1,gKeyArray,FUNCTIONAL);
    CheckPosResponse_SID27_SenKey(Level1,0,0);
  
    SessionFlag=APP;
    TestStep("Transition to defaultSesion(0x01)",TestStepIntervalTime);
    SID10_DiagnosticSessionControl(DEFAULTSESSION,PHYSICAL,SPRMIB_FALSE);
    CheckPosResponse_SID10(DEFAULTSESSION,gP2Client_APP,gP2StarClientFor10Check,0,0);
    ECUinitHandle(0);
    TestStep("Verify defaultSession",TestStepIntervalTime);
    CheckCurrentSession(DEFAULTSESSION,PHYSICAL,0,0);
  
    SessionFlag=BOOT;
    TestStep("Transition from DefaultSession(0x01) to ProgrammingDiagnosticSession(0x02).",TestStepIntervalTime);
    SID10_DiagnosticSessionControl(PROGRAMMINGSESSION,PHYSICAL,SPRMIB_FALSE);
    CheckPosResponse_SID10(PROGRAMMINGSESSION,gP2Client_BOOT,gP2StarClientFor10Check,0,0);
    ECUinitHandle(0);
    TestStep("Verify ProgrammingDiagnosticSession.",TestStepIntervalTime);
    CheckCurrentSession(PROGRAMMINGSESSION,PHYSICAL,0,0);
    testWaitForTimeout(gTimeWaitForSecuAccess);
    TestStep("ECU response with seed. Verify that S1 S2 S3 not equal to 0x000000.",TestStepIntervalTime);
    SID27_SecurityAccess_RequestSeed(Level1,FUNCTIONAL);
    CheckPosResponse_SID27_ReqSeed(Level1,gSeedArray,16,0,0);
    PID27_Parameters_Seeds_Chk(NotAllZero,gSeedArray);
    TestStep("ECU unlock.",TestStepIntervalTime);
    SID27_SecurityAccess_SendKey(Level1,gKeyArray,FUNCTIONAL);
    CheckPosResponse_SID27_SenKey(Level1,0,0);
    TestStep("Disable functionally addressed periodic testerPresent.Wait for 4.8 seconds.");
    TP_TesterPresentSet(TP_OFF);
    delay(4800);
    TestStep("ECU response with seed. Verify that S1 S2 S3 equal to 0x000000.",TestStepIntervalTime);
    SID27_SecurityAccess_RequestSeed(Level1,FUNCTIONAL);
    CheckPosResponse_SID27_ReqSeed(Level1,16,gSeedArray,0,0);
  
    TestStep("Wait for 4s.");
    delay(4000);
  
    TestStep("ECU response with seed. Verify that S1 S2 S3 equal to 0x000000.",TestStepIntervalTime);
    SID27_SecurityAccess_RequestSeed(Level1,FUNCTIONAL);
    CheckPosResponse_SID27_ReqSeed(Level1,gSeedArray,16,0,0);
    PID27_Parameters_Seeds_Chk(AllZero,gSeedArray);
    for(i=0;i<elcount(gSeedArray);i++)
    {
      write("seedarray %d is %02x",i,gSeedArray[i]);
    }
    TestStep("Verify ProgrammingDiagnosticSession.",TestStepIntervalTime);
    CheckCurrentSession(PROGRAMMINGSESSION,PHYSICAL,0,0);
    TestStep("Wait for ECU times out to defaultSession, S3 timer plus 'ECU startup time' and an additional 500 ms.");
    delay(5500);
  
    ECUinitHandle(0);
    SessionFlag=APP;
  
    TestStep("Verify defaultSession",TestStepIntervalTime);
    CheckCurrentSession(DEFAULTSESSION,PHYSICAL,0,0);
  
    SessionFlag=BOOT;
  
     TP_TesterPresentSet(TP_ON);
    TestStep("Transition from defaultSession(0x01) to ProgrammingDiagnosticSession(0x02)",TestStepIntervalTime);
    SID10_DiagnosticSessionControl(PROGRAMMINGSESSION,PHYSICAL,SPRMIB_TRUE);
    CheckNonResponse(0,0);
  
    ECUinitHandle(0);
    TestStep("Verify ProgrammingDiagnosticSession.",TestStepIntervalTime);
    CheckCurrentSession(PROGRAMMINGSESSION,PHYSICAL,0,0);

    testWaitForTimeout(gTimeWaitForSecuAccess);
    TestStep("ECU response with seed. Verify that S1 S2 S3 not equal to 0x000000.",TestStepIntervalTime);
    SID27_SecurityAccess_RequestSeed(Level1,FUNCTIONAL);
    CheckPosResponse_SID27_ReqSeed(Level1,gSeedArray,16,0,0);
    PID27_Parameters_Seeds_Chk(NotAllZero,gSeedArray);
//  }
    TestStep("ECU response with seed.S1 S2 S3 not equal to 0x000000 and S1 S2 S3 not equal to S1 S2 S3 from step 34",TestStepIntervalTime);
    SID27_SecurityAccess_RequestSeed(Level1,FUNCTIONAL);
    CheckPosResponse_SID27_ReqSeed(Level1,gSeedArray,16,0,0);
    PID27_Parameters_Seeds_Chk(NotAllZero,gSeedArray);

  TestStep("Test of non supported subfunctions.",TestStepIntervalTime);
  for(i=0x03; i<0xFE; i=i+2)
  {
    if(i==3)
    TestStep("Let L1 be 03)",TestStepIntervalTime);
    else
    {
      TestStep("Add L1 + 2 If L1 =0x81 add +2 If L1 != 0x01 jump to step 38. ",TestStepIntervalTime);
    }
    if(i!=0x81)
    {
      Level1=i;
    }
    TestStep("ECU response with seed. Verify that S1 S2 S3 not equal to 0x000000.",TestStepIntervalTime);
    SID27_SecurityAccess_RequestSeed(Level1,FUNCTIONAL);
    CheckNonResponse(0,0);
  }
  TestStep("Verify ProgrammingDiagnosticSession.",TestStepIntervalTime);
  CheckCurrentSession(PROGRAMMINGSESSION,PHYSICAL,0,0);
  /******************************以上为测试步骤*********************************/
  Postcondition();
   
}
/// <PBL_CommonServiceTest>
testcase Service_0x3E_Physical_ProgrammingSession_Supported_Service()
{
  char logName[400] = "";
  char info[1024];
  
  strncat(logName,"1351006_Service_0x3E_Physical_ProgrammingSession_Supported_Service",400);
  testCaseDescription("The intent is to verify TesterPresent (0x3E) and its subfunctions is supported.");
  testCaseTitle("1351006","Service_0x3E_Physical_ProgrammingSession_Supported_Service");
  
  
  SetLog(logName);
  Precondition();
  /******************************以下为测试步骤*********************************/
  
  SessionFlag=BOOT;
  
  TestStep("Transition from defaultSession(0x01) to ProgrammingDiagnosticSession(0x02).",TestStepIntervalTime);
  SID10_DiagnosticSessionControl(PROGRAMMINGSESSION,PHYSICAL,SPRMIB_FALSE);
  CheckPosResponse_SID10(PROGRAMMINGSESSION,gP2Client_BOOT,gP2StarClientFor10Check,0,0);
  ECUinitHandle(0);
  TestStep("Verify ProgrammingDiagnosticSession.",TestStepIntervalTime);
  CheckCurrentSession(PROGRAMMINGSESSION,PHYSICAL,0,0);
  TestStep("Send 3E 00",TestStepIntervalTime);
  SID3E_TesterPresent(PHYSICAL,SPRMIB_FALSE);
  CheckPosResponse_SID3E(0x00,2);
  TestStep("Send 3E 80",TestStepIntervalTime);
  SID3E_TesterPresent(PHYSICAL,SPRMIB_TRUE);
  CheckNonResponse(0,0);
  TestStep("Verify ProgrammingDiagnosticSession.",TestStepIntervalTime);
  CheckCurrentSession(PROGRAMMINGSESSION,PHYSICAL,0,0);
  /******************************以上为测试步骤*********************************/
  Postcondition();
   
}
/// <PBL_CommonServiceTest>
testcase Service_0x3E_Functional_ProgrammingSession_Supported_Service()
{
  char logName[400] = "";
  char info[1024];
  
  strncat(logName,"1351007_Service_0x3E_Functional_ProgrammingSession_Supported_Service",400);
  testCaseDescription("The intent is to verify TesterPresent (0x3E) and its subfunctions is supported.");
  testCaseTitle("1351007","Service_0x3E_Functional_ProgrammingSession_Supported_Service");
  
  if(gBusFlag==3)
	{
		testStepWarning("Test","This test case does not apply to the LIN bus");
		return;
	}
  SetLog(logName);
  Precondition();
  /******************************以下为测试步骤*********************************/
  
  SessionFlag=BOOT;
  
  TestStep("Transition from defaultSession(0x01) to ProgrammingDiagnosticSession(0x02).",TestStepIntervalTime);
  SID10_DiagnosticSessionControl(PROGRAMMINGSESSION,FUNCTIONAL,SPRMIB_FALSE);
  CheckPosResponse_SID10(PROGRAMMINGSESSION,gP2Client_BOOT,gP2StarClientFor10Check,0,0);
  ECUinitHandle(0);
  TestStep("Verify ProgrammingDiagnosticSession.",TestStepIntervalTime);
  CheckCurrentSession(PROGRAMMINGSESSION,PHYSICAL,0,0);
  TestStep("Send 3E 00",TestStepIntervalTime);
  SID3E_TesterPresent(FUNCTIONAL,SPRMIB_FALSE);
  CheckPosResponse_SID3E(0x00,2);
  TestStep("Send 3E 80",TestStepIntervalTime);
  SID3E_TesterPresent(FUNCTIONAL,SPRMIB_TRUE);
  CheckNonResponse(0,0);
  TestStep("Verify ProgrammingDiagnosticSession.",TestStepIntervalTime);
  CheckCurrentSession(PROGRAMMINGSESSION,PHYSICAL,0,0);
  /******************************以上为测试步骤*********************************/
  Postcondition();
   
}
/// <PBL_CommonServiceTest>
testcase Service_0x22_Physical_ProgrammingSession_Supported_Service()
{
  int  i;
  byte PID[2];
  int  code;
  int Result;
  char logName[400] = "";
  char info[1024];
  
  strncat(logName,"1351003_Service_0x22_Physical_ProgrammingSession_Supported_Service",400);
  testCaseDescription("That the ECU supports the service ReadDataByIdentifier (0x22) by reading out supported DataIdentifiers (DID).That the ECU supports the service WriteDataByIdentifier (0x2E) by writing data to supported DataIdentifiers (DID).");
  testCaseTitle("1351003","Service_0x22_Physical_ProgrammingSession_Supported_Service");
  
  if(gBusFlag==3)
	{
		testStepWarning("Test","This test case does not apply to the LIN bus");
		return;
	}
  SetLog(logName);
  Precondition();
  /******************************以下为测试步骤*********************************/
  
  SessionFlag=BOOT;
  
  TestStep("Let Z1 Z2= First DataIdentifier from configured list.",TestStepIntervalTime);
  
  TestStep("Transition from defaultSession(0x01) to ProgrammingDiagnosticSession(0x02).",TestStepIntervalTime);
  SID10_DiagnosticSessionControl(PROGRAMMINGSESSION,PHYSICAL,SPRMIB_FALSE);
  CheckPosResponse_SID10(PROGRAMMINGSESSION,gP2Client_BOOT,gP2StarClientFor10Check,0,0);
  ECUinitHandle(0);
  TestStep("Verify ProgrammingDiagnosticSession.",TestStepIntervalTime);
  CheckCurrentSession(PROGRAMMINGSESSION,PHYSICAL,0,0);
  for(i=0; i<NumOfReadDIDPBL; i++)
  {
    PID[0]=DIDOfReadPBL[i].DID>>8;
    PID[1]=DIDOfReadPBL[i].DID&0xFF;
    
    if(DIDOfReadPBL[i].Flag_Programming==0) { continue; }
    if((PID[0] == 0xD0)&&(PID[1] == 0x1C)) { continue; }
    if((PID[0] == 0xD0)&&(PID[1] == 0x3A)) { continue; }
    if((PID[0] == 0xF1)&&(PID[1] == 0x09)) { continue; }
    if((PID[0] == 0xF1)&&(PID[1] == 0x0B)) { continue; }
    if((PID[0] == 0xF1)&&(PID[1] == 0x0A)) { continue; }
    
    if(i!=0)
    {
      TestStep("Jump to Step 4 until all the dataIdentifiers in configured list are tested. Let Z1 Z2 = next dataIdentifier.",TestStepIntervalTime);
    }
    
    TestStep("Read data",TestStepIntervalTime);
    SID22_ReadDataByIdentifier(PID,PHYSICAL);
    Result=CheckPosResponse_SID22(PID,DIDOfReadPBL[i].Lenth,0,0); 
    
    if(Result>0)
    {
    CheckParametersCoding(DIDOfReadPBL[i]);
    if(DIDOfReadPBL[i].Lenth!=(gTpRxLength-3))
      TestStepFail("Fail","Expect lenth is %d and get lenth is %d",DIDOfReadPBL[i].Lenth,gTpRxLength-3);
    else
      TestStepPass("Pass","Expect lenth is %d and get lenth is %d",DIDOfReadPBL[i].Lenth,gTpRxLength-3);
    }
    
    TestStep("","Expect lenth is %d and get lenth is %d",DIDOfReadPBL[i].Lenth,gTpRxLength-3);
  }
  
  for(i=0;i<NumOfWriteDIDPBL;i++)
  {
    if(DIDOfWritePBL[i].Flag_Programming==0)
    {
      continue;
    }
    if(DIDOfWritePBL[i].SecuLevel!=0xFF)
    {
      SID10_DiagnosticSessionControl(PROGRAMMINGSESSION,PHYSICAL,SPRMIB_FALSE);
      CheckPosResponse_SID10(PROGRAMMINGSESSION,gP2Client_BOOT,gP2StarClientFor10Check,0,0);
      
      testWaitForTimeout(gTimeWaitForSecuAccess);
      
      SID27_SecurityAccess_RequestSeed(DIDOfWritePBL[i].SecuLevel,PHYSICAL);
      CheckPosResponse_SID27_ReqSeed(DIDOfWritePBL[i].SecuLevel,gSeedArray,16,0,0);
      SID27_SecurityAccess_SendKey(DIDOfWritePBL[i].SecuLevel,gKeyArray,PHYSICAL);
      CheckPosResponse_SID27_SenKey(DIDOfWritePBL[i].SecuLevel,0,0);
    }
      
    PID[0]=DIDOfWritePBL[i].DID>>8;
    PID[1]=DIDOfWritePBL[i].DID&0xFF;
      
    SID22_ReadDataByIdentifier(PID,PHYSICAL);
    CheckPosResponse_SID22(PID,DIDOfWritePBL[i].Lenth,0,0);
    RecordData();
    TestStep("Write data",TestStepIntervalTime);
    WriteTestData(DIDOfWritePBL[i],PHYSICAL);
    CheckPosResponse_SID2E(PID,0,0);
      
      
    TestStep("Read data",TestStepIntervalTime);
    SID22_ReadDataByIdentifier(PID,PHYSICAL);
    CheckPosResponse_SID22(PID,DIDOfWritePBL[i].Lenth,0,0);
    ComTestData();
      
    testWaitForTimeout(500);
    WritePreviousData(PHYSICAL);
    CheckPosResponse_SID2E(PID,0,0);

    TestStep("Data recover",TestStepIntervalTime);
    SID22_ReadDataByIdentifier(PID,PHYSICAL);
    CheckPosResponse_SID22(PID,DIDOfWritePBL[i].Lenth,0,0);
  }
  TestStep("Verify ProgrammingDiagnosticSession.",TestStepIntervalTime);
  CheckCurrentSession(PROGRAMMINGSESSION,PHYSICAL,0,0);
  /******************************以上为测试步骤*********************************/
  Postcondition();
   
}
/// <PBL_CommonServiceTest>
testcase Service_0x22_Functional_ProgrammingSession_Supported_Service()
{
  int  i;
  byte PID[2];
  int  code;
  int Result;
  char logName[400] = "";
  char info[1024];
  
  strncat(logName,"1351004_Service_0x22_Functional_ProgrammingSession_Supported_Service",400);
  testCaseDescription("That the ECU supports the service ReadDataByIdentifier (0x22) by reading out supported DataIdentifiers (DID).That the ECU supports the service WriteDataByIdentifier (0x2E) by writing data to supported DataIdentifiers (DID).");
  testCaseTitle("1351004","Service_0x22_Functional_ProgrammingSession_Supported_Service");
  if(gBusFlag==3)
	{
		testStepWarning("Test","This test case does not apply to the LIN bus");
		return;
	}
  SetLog(logName);
  Precondition();
  /******************************以下为测试步骤*********************************/
  
  SessionFlag=APP;
  
 TestStep("Let Z1 Z2= First DataIdentifier from configured list.",TestStepIntervalTime);
  
  TestStep("Transition from defaultSession(0x01) to ProgrammingDiagnosticSession(0x02).",TestStepIntervalTime);
  SID10_DiagnosticSessionControl(PROGRAMMINGSESSION,PHYSICAL,SPRMIB_FALSE);
  CheckPosResponse_SID10(PROGRAMMINGSESSION,gP2Client_BOOT,gP2StarClientFor10Check,0,0);
  ECUinitHandle(0);
  TestStep("Verify ProgrammingDiagnosticSession.",TestStepIntervalTime);
  CheckCurrentSession(PROGRAMMINGSESSION,PHYSICAL,0,0);
  for(i=0; i<NumOfReadDIDPBL; i++)
  {
    PID[0]=DIDOfReadPBL[i].DID>>8;
    PID[1]=DIDOfReadPBL[i].DID&0xFF;
    
    if(DIDOfReadPBL[i].Flag_Programming==0) { continue; }
    if((PID[0] == 0xD0)&&(PID[1] == 0x1C)) { continue; }
    if((PID[0] == 0xD0)&&(PID[1] == 0x3A)) { continue; }
    if((PID[0] == 0xF1)&&(PID[1] == 0x09)) { continue; }
    if((PID[0] == 0xF1)&&(PID[1] == 0x0B)) { continue; }
    if((PID[0] == 0xF1)&&(PID[1] == 0x0A)) { continue; }
    
    if(i!=0)
    {
      TestStep("Jump to Step 4 until all the dataIdentifiers in configured list are tested. Let Z1 Z2 = next dataIdentifier.",TestStepIntervalTime,4);
    }
    
    TestStep("Read data",TestStepIntervalTime);
    SID22_ReadDataByIdentifier(PID,FUNCTIONAL);
    Result=CheckPosResponse_SID22(PID,DIDOfReadPBL[i].Lenth,0,0); 
    if(Result>0)
    {
    CheckParametersCoding(DIDOfReadPBL[i]);
    if(DIDOfReadPBL[i].Lenth!=(gTpRxLength-3))
      TestStepFail("Fail","Expect lenth is %d and get lenth is %d",DIDOfReadPBL[i].Lenth,gTpRxLength-3);
    else
      TestStepPass("Pass","Expect lenth is %d and get lenth is %d",DIDOfReadPBL[i].Lenth,gTpRxLength-3);
    }
    
    TestStep("","Expect lenth is %d and get lenth is %d",DIDOfReadPBL[i].Lenth,gTpRxLength-3);
  }
  
  for(i=0;i<NumOfWriteDIDPBL;i++)
  {
      if(DIDOfWritePBL[i].Flag_Programming==0)
      {
        continue;
      }
    PID[0]=DIDOfWritePBL[i].DID>>8;
    PID[1]=DIDOfWritePBL[i].DID&0xFF;
      
    SID22_ReadDataByIdentifier(PID,PHYSICAL);
    CheckPosResponse_SID22(PID,DIDOfWritePBL[i].Lenth,0,0);
    RecordData();
    TestStep("Write data",TestStepIntervalTime);
    WriteTestData(DIDOfWritePBL[i],PHYSICAL);
    CheckPosResponse_SID2E(PID,0,0);
      
    TestStep("Read data",TestStepIntervalTime);
    SID22_ReadDataByIdentifier(PID,PHYSICAL);
    CheckPosResponse_SID22(PID,DIDOfWritePBL[i].Lenth,0,0);
    ComTestData();
      
    testWaitForTimeout(500);
    WritePreviousData(PHYSICAL);
    CheckPosResponse_SID2E(PID,0,0);

    TestStep("Data recover",TestStepIntervalTime);
    SID22_ReadDataByIdentifier(PID,PHYSICAL);
    CheckPosResponse_SID22(PID,DIDOfWritePBL[i].Lenth,0,0);
  }
  TestStep("Verify ProgrammingDiagnosticSession.",TestStepIntervalTime);
  CheckCurrentSession(PROGRAMMINGSESSION,PHYSICAL,0,0);
  /******************************以上为测试步骤*********************************/
  Postcondition();
   
}
/// <PBL_CommonServiceTest>
testcase Service_0x31_valid_physical_programmingSession_supported_service_locked()
{
  
  char logPath[1000] = "";
  byte RID[2];
  byte Record[1];
  byte PID[2];
  int  i,j;
  byte StuffByte[400];
  char logName[400] = "";
  char info[1024];
  
  strncat(logName,"1351008_Service_0x31_valid_physical_programmingSession_supported_service_locked_R3",400);
  testCaseDescription("The power to the ECU will be cycled.After power cycled wait to operation cycle start.Read out of diagnostic session");
  testCaseTitle("1351008","Service_0x31_valid_physical_programmingSession_supported_service_locked_R3");
  
  
  SetLog(logName);
  Precondition();

  
  /******************************以下为测试步骤*********************************/
  SessionFlag=APP;
  TestStep("Transition from defaultSession(0x01) to programmingDiagnosticSession(0x02).",TestStepIntervalTime);
  SID10_DiagnosticSessionControl(PROGRAMMINGSESSION,FUNCTIONAL,SPRMIB_FALSE);
  CheckPosResponse_SID10(PROGRAMMINGSESSION,gP2Client_BOOT,gP2StarClientFor10Check,0,0);
  ECUinitHandle(0);
  SessionFlag=BOOT;
  TestStep("Verify programmingDiagnosticSession.",TestStepIntervalTime);
  //ECUinitHandle(0);
  CheckCurrentSession(PROGRAMMINGSESSION,PHYSICAL,0,0);
  
  for(i=0; i<NumOfRoutine_Sub0x01; i++)
  {
    PID[0]=Routine_Sub0x01[i].DID>>8;
    PID[1]=Routine_Sub0x01[i].DID&0xFF;
  //
    if((Routine_Sub0x01[i].Flag_Ser02==1)&&(Routine_Sub0x01[i].SecuLevel!=0xFF))
    {
      TestStep("StartRoutine when ECU is locked",TestStepIntervalTime);
      SID31_RoutineControl(StartRoutine,PID,Routine_Sub0x01[i].requestData,Routine_Sub0x01[i].RequestLenth,PHYSICAL,SPRMIB_FALSE);//正常请求   
      CheckNegResponse(0x33,0,0);
    }
  }
  
  TestStep("Verify ProgrammingSession.",TestStepIntervalTime);
  CheckCurrentSession(PROGRAMMINGSESSION,PHYSICAL,0,0); 
  /******************************以上为测试步骤*********************************/
  
   Postcondition();
}


/// <PBL_CommonServiceTest>
testcase Service_0x31_valid_physical_programmingSession_supported_service()
{
  byte RID[2];
  byte Record[1];
  byte sunFunction;
  byte PID[2];
  int  i,j,k;
  byte StuffByte[400];
  byte ExpectNRC[4]={0x33,0x22,0x70,0x10};
  byte ExpectNRC2[2]={0x33,0x24};
  int  NumOfLenth;
  char Description[3000];
  char answer[100];
  byte Para[50];
  int tem1,tem2;
  char logName[400] = "";
  char info[1024];
  
  strncat(logName,"1351009_Service_0x31_valid_physical_programmingSession_supported_service_R3",400);
  testCaseDescription("The power to the ECU will be cycled.After power cycled wait to operation cycle start.Read out of diagnostic session");
  testCaseTitle("1351009","Service_0x31_valid_physical_programmingSession_supported_service_R3");
  
  SetLog(logName);
  Precondition();

  /******************************以下为测试步骤*********************************/
  SessionFlag=APP;
  TestStep("Transition from defaultSession(0x01) to programmingDiagnosticSession(0x02).",TestStepIntervalTime);
  SID10_DiagnosticSessionControl(PROGRAMMINGSESSION,FUNCTIONAL,SPRMIB_FALSE);
  CheckPosResponse_SID10(PROGRAMMINGSESSION,gP2Client_BOOT,gP2StarClientFor10Check,0,0);
  
  ECUinitHandle(0);
  SessionFlag=BOOT;
  TestStep("Verify programmingDiagnosticSession.",TestStepIntervalTime);
  //ECUinitHandle(0);
  CheckCurrentSession(PROGRAMMINGSESSION,PHYSICAL,0,0);
  
  
  ////判断0x31服务是否支持
  for(i=0;i<service_APP_Num;i++)
  {
    if(service_APP[i] == 0x31)
      break;
  }
  if(i==service_APP_Num)
  {
    TestStepWarning("ECU doesn't support this service , test case exit!");
    Postcondition();
     
    return;
  }
  
  for(i=0;i<NumOfRoutine_Sub0x01_PBL;i++)//遍历所有例程
  {
    if(Routine_Sub0x01_PBL[i].Flag_Ser03 != 1)
    {
      continue;
    }
    if(Routine_Sub0x01_PBL[i].routinetype == 1)//筛选所有例程类型为1的例程
    {
      tem1 = 0;
      PID[0]=Routine_Sub0x01_PBL[i].DID>>8;
      PID[1]=Routine_Sub0x01_PBL[i].DID&0xFF;
      for(j=0;j<NumOfRoutine_Sub0x03_PBL;j++)//找到该例程是否支持03子功能
      {
        if(Routine_Sub0x01_PBL[i].DID == Routine_Sub0x03_PBL[j].DID)
        {
          tem1 = 1;
          break;
        }  
      }
      if(Routine_Sub0x01_PBL[i].SecuLevel!=0xFF)
      {
  		  SID10_DiagnosticSessionControl(PROGRAMMINGSESSION,FUNCTIONAL,SPRMIB_FALSE);
  		  CheckPosResponse_SID10(PROGRAMMINGSESSION,gP2Client_BOOT,gP2StarClientFor10Check,0,0);
  		  
  		  ECUinitHandle(0);
        
        testWaitForTimeout(gTimeWaitForSecuAccess);
        
        SID27_SecurityAccess_RequestSeed(Routine_Sub0x01_PBL[i].SecuLevel,PHYSICAL);
        CheckPosResponse_SID27_ReqSeed(Routine_Sub0x01_PBL[i].SecuLevel,gSeedArray,16,0,0);
        SID27_SecurityAccess_SendKey(Routine_Sub0x01_PBL[i].SecuLevel,gKeyArray,PHYSICAL);
        CheckPosResponse_SID27_SenKey(Routine_Sub0x01_PBL[i].SecuLevel,2,0,0);
      }
      
      if(tem1 == 1)//直接发送31 03
      {
        
        SID31_RoutineControl(RequestRoutineResult,PID,Routine_Sub0x03_PBL[j].requestData,Routine_Sub0x03_PBL[j].RequestLenth,PHYSICAL,SPRMIB_FALSE);//发送31 03
        CheckNegResponse(0x24,0,0);
      }
      
      SID31_RoutineControl(StartRoutine,PID,Routine_Sub0x01_PBL[i].requestData,Routine_Sub0x01_PBL[i].RequestLenth,PHYSICAL,SPRMIB_FALSE);//正常请求
      CheckPosResponse_SID31(StartRoutine,PID,0,0);
      if( (gRss==NEG) && (gTpRxData[2]==0x22))
      {
        TestStepWarning("warning","Received NRC0x22 for Service 0x31,test next RID");
        continue;
      }
      testWaitForTimeout(2000);
      
      if(Routine_Sub0x01_PBL[i].SecuLevel!=0xFF)
      {
        
  		  SID10_DiagnosticSessionControl(PROGRAMMINGSESSION,FUNCTIONAL,SPRMIB_FALSE);
  		  CheckPosResponse_SID10(PROGRAMMINGSESSION,gP2Client_BOOT,gP2StarClientFor10Check,0,0);
  		  
  		  ECUinitHandle(0);
        
        testWaitForTimeout(gTimeWaitForSecuAccess);
        
        SID27_SecurityAccess_RequestSeed(Routine_Sub0x01_PBL[i].SecuLevel,PHYSICAL);
        CheckPosResponse_SID27_ReqSeed(Routine_Sub0x01_PBL[i].SecuLevel,gSeedArray,16,0,0);
        SID27_SecurityAccess_SendKey(Routine_Sub0x01_PBL[i].SecuLevel,gKeyArray,PHYSICAL);
        CheckPosResponse_SID27_SenKey(Routine_Sub0x01_PBL[i].SecuLevel,2,0,0);
      
      }
      
      if(tem1 == 1)
      {
        SID31_RoutineControl(RequestRoutineResult,PID,Routine_Sub0x03_PBL[j].requestData,Routine_Sub0x03_PBL[j].RequestLenth,PHYSICAL,SPRMIB_FALSE);
        CheckPosResponse_SID31(RequestRoutineResult,PID,0,0);
      }
      
    }
    else if(Routine_Sub0x01_PBL[i].routinetype == 2)//筛选所有例程类型为2的例程
    {
      tem1 = 0;tem2 = 0;
      PID[0]=Routine_Sub0x01_PBL[i].DID>>8;
      PID[1]=Routine_Sub0x01_PBL[i].DID&0xFF;
      for(j=0;j<NumOfRoutine_Sub0x03_PBL;j++)//找到该例程是否支持03子功能
      {
        if(Routine_Sub0x01_PBL[i].DID == Routine_Sub0x03_PBL[j].DID)
        {
          tem1 = 1;
          break;
        }

      }
      for(k=0;k<NumOfRoutine_Sub0x02_PBL;k++)//找到该例程是否支持02子功能
      {
        if(Routine_Sub0x01_PBL[i].DID == Routine_Sub0x02_PBL[k].DID)
        {
          tem2 = 1;
          break;
        }

      }
      
      if(Routine_Sub0x01_PBL[i].SecuLevel!=0xFF)
      {
        
  		  SID10_DiagnosticSessionControl(PROGRAMMINGSESSION,FUNCTIONAL,SPRMIB_FALSE);
  		  CheckPosResponse_SID10(PROGRAMMINGSESSION,gP2Client_BOOT,gP2StarClientFor10Check,0,0);
  		  
  		  ECUinitHandle(0);
        
        testWaitForTimeout(gTimeWaitForSecuAccess);
        SID27_SecurityAccess_RequestSeed(Routine_Sub0x01_PBL[i].SecuLevel,PHYSICAL);
        CheckPosResponse_SID27_ReqSeed(Routine_Sub0x01_PBL[i].SecuLevel,gSeedArray,16,0,0);
        SID27_SecurityAccess_SendKey(Routine_Sub0x01_PBL[i].SecuLevel,gKeyArray,PHYSICAL);
        CheckPosResponse_SID27_SenKey(Routine_Sub0x01_PBL[i].SecuLevel,2,0,0);
      
      }
      
      if(tem2 == 1)//直接发送31 02
      {
        
        SID31_RoutineControl(StopRoutine,PID,Routine_Sub0x02_PBL[k].requestData,Routine_Sub0x02_PBL[k].RequestLenth,PHYSICAL,SPRMIB_FALSE);//发送31 02
        CheckNegResponse(0x24,0,0);

      }
      
      if(tem1 == 1)//直接发送31 03
      {
        
        SID31_RoutineControl(RequestRoutineResult,PID,Routine_Sub0x03_PBL[j].requestData,Routine_Sub0x03_PBL[j].RequestLenth,PHYSICAL,SPRMIB_FALSE);//发送31 02
        CheckNegResponse(0x24,0,0);
  
      }
      
      SID31_RoutineControl(StartRoutine,PID,Routine_Sub0x01_PBL[i].requestData,Routine_Sub0x01_PBL[i].RequestLenth,PHYSICAL,SPRMIB_FALSE);//正常请求
      CheckPosResponse_SID31(StartRoutine,PID,0,0);
      
      SID31_RoutineControl(RequestRoutineResult,PID,Routine_Sub0x03_PBL[j].requestData,Routine_Sub0x03_PBL[j].RequestLenth,PHYSICAL,SPRMIB_FALSE);//正常请求
      CheckPosResponse_SID31(RequestRoutineResult,PID,0,0);
      if(gTpRxData[4]!= 0x22)
      {
        TestStepWarning("Chk","No 0x22 maybe routine has finished executing");
      }
      testWaitForTimeout(Routine_Sub0x01_PBL[i].runtime+10);
      
      SID31_RoutineControl(RequestRoutineResult,PID,Routine_Sub0x03_PBL[j].requestData,Routine_Sub0x03_PBL[j].RequestLenth,PHYSICAL,SPRMIB_FALSE);//正常请求
      CheckPosResponse_SID31(RequestRoutineResult,PID,0,0);
      if(gTpRxData[4]!= 0x20)
      {
        TestStepFail("Fail","Routine still not finished after running time timeout");
      }
      
      if(Routine_Sub0x01_PBL[i].SecuLevel!=0xFF)
      {
        
  		  SID10_DiagnosticSessionControl(PROGRAMMINGSESSION,FUNCTIONAL,SPRMIB_FALSE);
  		  CheckPosResponse_SID10(PROGRAMMINGSESSION,gP2Client_BOOT,gP2StarClientFor10Check,0,0);
  		  
  		  ECUinitHandle(0);
        
        testWaitForTimeout(gTimeWaitForSecuAccess);
        
        SID27_SecurityAccess_RequestSeed(Routine_Sub0x01_PBL[i].SecuLevel,PHYSICAL);
        CheckPosResponse_SID27_ReqSeed(Routine_Sub0x01_PBL[i].SecuLevel,gSeedArray,16,0,0);
        SID27_SecurityAccess_SendKey(Routine_Sub0x01_PBL[i].SecuLevel,gKeyArray,PHYSICAL);
        CheckPosResponse_SID27_SenKey(Routine_Sub0x01_PBL[i].SecuLevel,2,0,0);
      
      }
      
      if(tem2 == 1)//直接发送31 02
      {
        
        SID31_RoutineControl(StopRoutine,PID,Routine_Sub0x02_PBL[k].requestData,Routine_Sub0x02_PBL[k].RequestLenth,PHYSICAL,SPRMIB_FALSE);//发送31 03
        CheckNegResponse(0x24,0,0);

      }

      
      if(Routine_Sub0x01_PBL[i].SecuLevel!=0xFF)
      {
  		  SID10_DiagnosticSessionControl(PROGRAMMINGSESSION,FUNCTIONAL,SPRMIB_FALSE);
  		  CheckPosResponse_SID10(PROGRAMMINGSESSION,gP2Client_BOOT,gP2StarClientFor10Check,0,0);
  		  
  		  ECUinitHandle(0);
        
        testWaitForTimeout(gTimeWaitForSecuAccess);
        
        SID27_SecurityAccess_RequestSeed(Routine_Sub0x01_PBL[i].SecuLevel,PHYSICAL);
        CheckPosResponse_SID27_ReqSeed(Routine_Sub0x01_PBL[i].SecuLevel,gSeedArray,16,0,0);
        SID27_SecurityAccess_SendKey(Routine_Sub0x01_PBL[i].SecuLevel,gKeyArray,PHYSICAL);
        CheckPosResponse_SID27_SenKey(Routine_Sub0x01_PBL[i].SecuLevel,2,0,0);
      
      }
      
      SID31_RoutineControl(StartRoutine,PID,Routine_Sub0x01_PBL[i].requestData,Routine_Sub0x01_PBL[i].RequestLenth,PHYSICAL,SPRMIB_FALSE);//正常请求
      CheckPosResponse_SID31(StartRoutine,PID,0,0);
      
      if(tem2 == 1)//直接发送31 02
      {
        SID31_RoutineControl(StopRoutine,PID,Routine_Sub0x02_PBL[k].requestData,Routine_Sub0x02_PBL[k].RequestLenth,PHYSICAL,SPRMIB_FALSE);//正常请求
        CheckPosResponse_SID31(StopRoutine,PID,0,0);
      }
      
      SID31_RoutineControl(RequestRoutineResult,PID,Routine_Sub0x03_PBL[j].requestData,Routine_Sub0x03_PBL[j].RequestLenth,PHYSICAL,SPRMIB_FALSE);//正常请求
      CheckPosResponse_SID31(RequestRoutineResult,PID,0,0);
      if(gTpRxData[4]!= 0x20)
      {
        TestStepFail("Fail","Routine still not finished after running time timeout");
      }
    }
    else if(Routine_Sub0x01_PBL[i].routinetype == 3)//筛选所有例程类型为3的例程
    {
      tem1 = 0;tem2 = 0;
      PID[0]=Routine_Sub0x01_PBL[i].DID>>8;
      PID[1]=Routine_Sub0x01_PBL[i].DID&0xFF;
      for(j=0;j<NumOfRoutine_Sub0x03_PBL;j++)//找到该例程是否支持03子功能
      {
        if(Routine_Sub0x01_PBL[i].DID == Routine_Sub0x03_PBL[j].DID)
        {
          tem1 = 1;
          break;
        }

      }
      for(k=0;k<NumOfRoutine_Sub0x02_PBL;k++)//找到该例程是否支持02子功能
      {
        if(Routine_Sub0x01_PBL[i].DID == Routine_Sub0x02_PBL[k].DID)
        {
          tem2 = 1;
          break;
        }
      } 
      if(Routine_Sub0x01_PBL[i].SecuLevel!=0xFF)
      {
  		  SID10_DiagnosticSessionControl(PROGRAMMINGSESSION,FUNCTIONAL,SPRMIB_FALSE);
  		  CheckPosResponse_SID10(PROGRAMMINGSESSION,gP2Client_BOOT,gP2StarClientFor10Check,0,0);
  		  
  		  ECUinitHandle(0);
        
        testWaitForTimeout(gTimeWaitForSecuAccess);
        
        SID27_SecurityAccess_RequestSeed(Routine_Sub0x01_PBL[i].SecuLevel,PHYSICAL);
        CheckPosResponse_SID27_ReqSeed(Routine_Sub0x01_PBL[i].SecuLevel,gSeedArray,16,0,0);
        SID27_SecurityAccess_SendKey(Routine_Sub0x01_PBL[i].SecuLevel,gKeyArray,PHYSICAL);
        CheckPosResponse_SID27_SenKey(Routine_Sub0x01_PBL[i].SecuLevel,2,0,0);
      }
      
      if(tem2 == 1)//直接发送31 02
      {
        SID31_RoutineControl(StopRoutine,PID,Routine_Sub0x02_PBL[k].requestData,Routine_Sub0x02_PBL[k].RequestLenth,PHYSICAL,SPRMIB_FALSE);//发送31 03
        CheckNegResponse(0x24,0,0);
      }
      
      if(tem1 == 1)//直接发送31 03
      {
        
        SID31_RoutineControl(RequestRoutineResult,PID,Routine_Sub0x03_PBL[j].requestData,Routine_Sub0x03_PBL[j].RequestLenth,PHYSICAL,SPRMIB_FALSE);//发送31 03
        CheckNegResponse(0x24,0,0);

      }
      
      SID31_RoutineControl(StartRoutine,PID,Routine_Sub0x01_PBL[i].requestData,Routine_Sub0x01_PBL[i].RequestLenth,PHYSICAL,SPRMIB_FALSE);//正常请求
      CheckPosResponse_SID31(StartRoutine,PID,0,0);
      
      if(tem2 == 1)//发送31 03
      {
        SID31_RoutineControl(RequestRoutineResult,PID,Routine_Sub0x03_PBL[j].requestData,Routine_Sub0x03_PBL[j].RequestLenth,PHYSICAL,SPRMIB_FALSE);//正常请求
        CheckPosResponse_SID31(RequestRoutineResult,PID,0,0);
        if(gTpRxData[4]!= 0x32)
        {
          TestStepFail("Chk","Routine can't run");
        }
      }
      
      if(tem1 == 1)//直接发送31 02
      {
        SID31_RoutineControl(StopRoutine,PID,Routine_Sub0x02_PBL[k].requestData,Routine_Sub0x02_PBL[k].RequestLenth,PHYSICAL,SPRMIB_FALSE);//正常请求
        CheckPosResponse_SID31(StopRoutine,PID,0,0);
        if(gTpRxData[4]!= 0x30)
        {
          TestStepFail("Chk","Routine can't run");
        }
      }
      
      if(tem2 == 1)//发送31 03
      {
        SID31_RoutineControl(RequestRoutineResult,PID,Routine_Sub0x03_PBL[j].requestData,Routine_Sub0x03_PBL[j].RequestLenth,PHYSICAL,SPRMIB_FALSE);//正常请求
        CheckPosResponse_SID31(RequestRoutineResult,PID,0,0);
        if(gTpRxData[4]!= 0x30)
        {
          TestStepFail("Chk","Routine can't run");
        }
      }     
    }
  }
  
  TestStep("programmingSession.",TestStepIntervalTime);
  CheckCurrentSession(PROGRAMMINGSESSION,PHYSICAL,0,0); 
  /******************************以上为测试步骤*********************************/
  Postcondition();
}
/// <PBL_CommonServiceTest>
testcase Service_0x31_valid_functional_programmingSession_supported_service()
{
  char logPath[1000] = "";
  byte RID[2];
  byte Record[1];
  byte sunFunction;
  byte PID[2];
  int  i,j;
  byte StuffByte[400];
  byte ExpectNRC[4]={0x33,0x22,0x70,0x10};
  byte ExpectNRC2[2]={0x33,0x24};
  int  NumOfLenth;
  char Description[3000];
  char answer[100];
  byte Para[50];
  int tem1,tem2;
  char logName[400] = "";
  char info[1024];
  
  strncat(logName,"1351010_Service_0x31_valid_functional_programmingSession_supported_service_R3",400);
  testCaseDescription("The power to the ECU will be cycled.After power cycled wait to operation cycle start.Read out of diagnostic session");
  testCaseTitle("1351010","Service_0x31_valid_functional_programmingSession_supported_service_R3");
  if(gBusFlag==3)
	{
		testStepWarning("Test","This test case does not apply to the LIN bus");
		return;
	}
  SetLog(logName);
  Precondition();

  /******************************以下为测试步骤*********************************/
  SessionFlag=APP;
  TestStep("Transition from defaultSession(0x01) to programmingDiagnosticSession(0x02).",TestStepIntervalTime);
  SID10_DiagnosticSessionControl(PROGRAMMINGSESSION,FUNCTIONAL,SPRMIB_FALSE);
  CheckPosResponse_SID10(PROGRAMMINGSESSION,gP2Client_BOOT,gP2StarClientFor10Check,0,0);
  
  ECUinitHandle(0);
  SessionFlag=BOOT;
  TestStep("Verify programmingDiagnosticSession.",TestStepIntervalTime);
  //ECUinitHandle(0);
  CheckCurrentSession(PROGRAMMINGSESSION,PHYSICAL,0,0);
  
  for(i=0; i<NumOfRoutine_Sub0x01; i++)
  {
    PID[0]=Routine_Sub0x01[i].DID>>8;
    PID[1]=Routine_Sub0x01[i].DID&0xFF;
    
    if((Routine_Sub0x01[i].SelectFlag != 1)||(Routine_Sub0x01[i].Flag_Ser02!=1))
    {
      continue;
    }
    else
    {
      NumOfLenth = Routine_Sub0x01[i].RequestLenth;
    }
    if(Routine_Sub0x01[i].Flag_Ser02==1)
    {
      for(j=0;j<NumOfRoutine_Sub0x03;j++)
      {
       if(Routine_Sub0x01[i].DID==Routine_Sub0x03[j].DID)
        {
          SID31_RoutineControl(RequestRoutineResult,PID,Routine_Sub0x03[i].requestData,Routine_Sub0x03[j].RequestLenth,FUNCTIONAL,SPRMIB_FALSE);//发送31 03
          CheckNegResponse(ExpectNRC2,1,1,0,0);
        }
      }
      if(Routine_Sub0x01[i].SecuLevel!=0xFF)
      {
        SID10_DiagnosticSessionControl(PROGRAMMINGSESSION,PHYSICAL,SPRMIB_FALSE);
        CheckPosResponse_SID10(PROGRAMMINGSESSION,gP2Client_BOOT,gP2StarClientFor10Check,0,0);
        
        testWaitForTimeout(gTimeWaitForSecuAccess);
        
        SID27_SecurityAccess_RequestSeed(Routine_Sub0x01[i].SecuLevel,PHYSICAL);
        CheckPosResponse_SID27_ReqSeed(Routine_Sub0x01[i].SecuLevel,gSeedArray,16,0,0);
        SID27_SecurityAccess_SendKey(Routine_Sub0x01[i].SecuLevel,gKeyArray,PHYSICAL);
        CheckPosResponse_SID27_SenKey(Routine_Sub0x01[i].SecuLevel,2,0,0);
      }

      TestStep("Request routine control",TestStepIntervalTime);
      SID31_RoutineControl(StartRoutine,PID,Routine_Sub0x01[i].requestData,Routine_Sub0x01[i].RequestLenth,FUNCTIONAL,SPRMIB_FALSE);//正常请求 
      CheckNegResponse(ExpectNRC,1,1,0,0);
      
      for(j=0;j<NumOfRoutine_Sub0x03;j++)
      {
       if(Routine_Sub0x01[i].DID==Routine_Sub0x03[j].DID)
        {
          SID31_RoutineControl(RequestRoutineResult,PID,Routine_Sub0x03[i].requestData,Routine_Sub0x03[j].RequestLenth,FUNCTIONAL,SPRMIB_FALSE);//发送31 03
          CheckPosResponse_SID31(RequestRoutineResult,PID,0,0);
        } 
      }
      for(j=0;j<NumOfRoutine_Sub0x02;j++)
      {
        if(Routine_Sub0x01[i].DID==Routine_Sub0x02[j].DID)
        {
          SID31_RoutineControl(StartRoutine,PID,Routine_Sub0x01[i].requestData,Routine_Sub0x01[i].RequestLenth,FUNCTIONAL,SPRMIB_FALSE);//正常请求    
          CheckNegResponse(ExpectNRC,1,1,0,0);

          SID31_RoutineControl(StopRoutine,PID,Routine_Sub0x03[i].requestData,Routine_Sub0x03[j].RequestLenth,FUNCTIONAL,SPRMIB_FALSE);//发送31 02
          CheckNegResponse(ExpectNRC,1,1,0,0);
        }
      }
      
      for(j=0;j<NumOfRoutine_Sub0x03;j++)
      {
       if(Routine_Sub0x01[i].DID==Routine_Sub0x03[j].DID)
        {
          SID31_RoutineControl(RequestRoutineResult,PID,Routine_Sub0x03[i].requestData,Routine_Sub0x03[j].RequestLenth,FUNCTIONAL,SPRMIB_FALSE);//发送31 03
          CheckNegResponse(ExpectNRC,1,1,0,0);
        } 
      }
    }
  }
  TestStep("Check ProgrammingSession.",TestStepIntervalTime);
  CheckCurrentSession(PROGRAMMINGSESSION,PHYSICAL,0,0); 
  /******************************以上为测试步骤*********************************/
  Postcondition(); 
}
/// <PBL_CommonServiceTest>
testcase Service_0x34_valid_physical_programmingSession_supported_service()
{
  char logPath[1000] = "";
  byte StartAddress[4];
  byte Lenth[4];
  int i = 0;
  char logName[400] = "";
  char info[1024];
  byte expecrtNRC[2]={0x33,0x31};
  
  StartAddress[0]=0x11;
  StartAddress[1]=0x11;
  StartAddress[2]=0x11;
  StartAddress[3]=0x11;
  Lenth[0]=0x22;
  Lenth[1]=0x22;
  Lenth[2]=0x22;
  Lenth[3]=0x22;
  
  strncat(logName,"1351011_Service_0x34_valid_physical_programmingSession_supported_service_R3",400);
  testCaseTitle("1351011","Service_0x34_valid_physical_programmingSession_supported_service_R3");
  
  
  SetLog(logName);
  Precondition();
  /******************************以下为测试步骤*********************************/
  SessionFlag=APP;
  TestStep("Transition from defaultSession(0x01) to programmingDiagnosticSession(0x02).",TestStepIntervalTime);
  SID10_DiagnosticSessionControl(PROGRAMMINGSESSION,FUNCTIONAL,SPRMIB_FALSE);
  CheckPosResponse_SID10(PROGRAMMINGSESSION,gP2Client_BOOT,gP2StarClientFor10Check,0,0);
  
  ECUinitHandle(0);
  SessionFlag=BOOT;
  TestStep("Verify programmingDiagnosticSession.",TestStepIntervalTime);
  //ECUinitHandle(0);
  CheckCurrentSession(PROGRAMMINGSESSION,PHYSICAL,0,0);
  
  TestStep("Request download",TestStepIntervalTime);
  SID34_RequestDownload(0x00,0x44,StartAddress,Lenth,PHYSICAL);
  CheckNegResponse(expecrtNRC,0,0,0,0);
//      CheckPosResponse(0x34);
  
  TestStep("Verify programmingDiagnosticSession.",TestStepIntervalTime);
  CheckCurrentSession(PROGRAMMINGSESSION,PHYSICAL,0,0);
  
  TestStep("Transition to defaultSession(0x01).",TestStepIntervalTime);
  SID10_DiagnosticSessionControl(DEFAULTSESSION,PHYSICAL,SPRMIB_TRUE);
  CheckNonResponse(0,0);
  
  ECUinitHandle(0);
  TestStep("Verify defaultSession",TestStepIntervalTime);
  //ECUinitHandle(0);
  CheckCurrentSession(DEFAULTSESSION,PHYSICAL,0,0);
  
  TestStep("Transition from defaultSession(0x01) to programmingDiagnosticSession(0x02).",TestStepIntervalTime);
  SID10_DiagnosticSessionControl(PROGRAMMINGSESSION,PHYSICAL,SPRMIB_TRUE);
  CheckNonResponse(0,0);
  
  ECUinitHandle(0);
  TestStep("Verify programmingDiagnosticSession.",TestStepIntervalTime);
  //ECUinitHandle(0);
  CheckCurrentSession(PROGRAMMINGSESSION,PHYSICAL,0,0);
  /******************************以上为测试步骤*********************************/
  
  Postcondition();
}
/// <PBL_CommonServiceTest>
testcase Service_0x35_valid_physical_programmingSession_supported_service()
{
  char logPath[1000] = "";
  byte StartAddress[4];
  byte Lenth[4];
  int i = 0;
  char logName[400] = "";
  char info[1024];
  byte expcetNRC[2]={0x33};
  
  StartAddress[0]=0x11;
  StartAddress[1]=0x11;
  StartAddress[2]=0x11;
  StartAddress[3]=0x11;
  Lenth[0]=0x22;
  Lenth[1]=0x22;
  Lenth[2]=0x22;
  Lenth[3]=0x22;
  
  strncat(logName,"1351012_Service_0x35_valid_physical_programmingSession_supported_service_R3",400);
  testCaseTitle("1351012","Service_0x35_valid_physical_programmingSession_supported_service_R3");
  
  SetLog(logName);
  Precondition();
  
  for(i=0;i<service_APP_Num;i++)
  {
    if(service_APP[i] == 0x35)
      break;
  }
  if(i==service_APP_Num)
  {
    TestStepWarning("ECU doesn't support 0x35 service , test case exit!");
    Postcondition();
    return;
  }
  
  /******************************以下为测试步骤*********************************/
  SessionFlag=APP;
  TestStep("Transition from defaultSession(0x01) to ProgrammingDiagnosticSession(0x02).",TestStepIntervalTime);
  SID10_DiagnosticSessionControl(PROGRAMMINGSESSION,FUNCTIONAL,SPRMIB_FALSE);
  CheckPosResponse_SID10(PROGRAMMINGSESSION,gP2Client_BOOT,gP2StarClientFor10Check,0,0);
  
  ECUinitHandle(0);
  SessionFlag=BOOT;
  TestStep("Verify ProgrammingDiagnosticSession.",TestStepIntervalTime);
  //ECUinitHandle(0);
  CheckCurrentSession(PROGRAMMINGSESSION,PHYSICAL,0,0);
  
  TestStep("Request download",TestStepIntervalTime);
  SID35_RequestUpload(0x00,0x44,StartAddress,Lenth,PHYSICAL);
  CheckNegResponse(expcetNRC,0,0,0,0);
  
  TestStep("Verify programmingDiagnosticSession.",TestStepIntervalTime);
  CheckCurrentSession(PROGRAMMINGSESSION,PHYSICAL,0,0);
  
  TestStep("Transition to defaultSession(0x01).",TestStepIntervalTime);
  SID10_DiagnosticSessionControl(DEFAULTSESSION,PHYSICAL,SPRMIB_FALSE);
  CheckPosResponse_SID10(DEFAULTSESSION,gP2Client_APP,gP2StarClientFor10Check,0,0);
  
  ECUinitHandle(0);
  TestStep("Verify defaultSession",TestStepIntervalTime);
  //ECUinitHandle(0);
  CheckCurrentSession(DEFAULTSESSION,PHYSICAL,0,0);
  
  TestStep("Transition from defaultSession(0x01) to programmingDiagnosticSession(0x03).",TestStepIntervalTime);
  SID10_DiagnosticSessionControl(PROGRAMMINGSESSION,PHYSICAL,SPRMIB_FALSE);
  CheckPosResponse_SID10(PROGRAMMINGSESSION,gP2Client_BOOT,gP2StarClientFor10Check,0,0);
  
  ECUinitHandle(0);
  TestStep("Verify programmingDiagnosticSession.",TestStepIntervalTime);
  //ECUinitHandle(0);
  CheckCurrentSession(PROGRAMMINGSESSION,PHYSICAL,0,0);
  /******************************以上为测试步骤*********************************/
  Postcondition();
}
/// <PBL_CommonServiceTest>
testcase Service_0x36_valid_physical_programmingSession_supported_service()
{
  char logPath[1000] = "";
  byte Data[3];
  char logName[400] = "";
  char info[1024];
  
  Data[0]=0x36;
  Data[1]=0x01;  
  Data[2]=0x01;
  
  strncat(logName,"1351013_Service_0x36_valid_physical_programmingSession_supported_service_R3",400);
  testCaseTitle("1351013","Service_0x36_valid_physical_programmingSession_supported_service_R3");
  
  
  SetLog(logName);
  Precondition();
  
  /******************************以下为测试步骤*********************************/
  SessionFlag=APP;
  TestStep("Transition from defaultSession(0x01) to ProgrammingDiagnosticSession(0x02).",TestStepIntervalTime);
  SID10_DiagnosticSessionControl(PROGRAMMINGSESSION,FUNCTIONAL,SPRMIB_FALSE);
  CheckPosResponse_SID10(PROGRAMMINGSESSION,gP2Client_BOOT,gP2StarClientFor10Check,0,0);
  
  ECUinitHandle(0);
  SessionFlag=BOOT;
  TestStep("Verify ProgrammingDiagnosticSession.",TestStepIntervalTime);
  //ECUinitHandle(0);
  CheckCurrentSession(PROGRAMMINGSESSION,PHYSICAL,0,0);
  
  TestStep("Transfer data",TestStepIntervalTime);
  TPSendRawMessage(Data,PHYSICAL);
  CheckNegResponse(0x24,0,0);
  
  TestStep("Verify defaultSession",TestStepIntervalTime);
  CheckCurrentSession(PROGRAMMINGSESSION,PHYSICAL,0,0);
      
  /******************************以上为测试步骤*********************************/
  Postcondition();
}
/// <PBL_CommonServiceTest>
testcase Service_0x36_valid_functional_programmingSession_supported_service()
{
  char logPath[1000] = "";
  byte Data[3];
  char logName[400] = "";
  char info[1024];
  
  Data[0]=0x36;
  Data[1]=0x01;  
  Data[2]=0x01;
  
  strncat(logName,"1351014_Service_0x36_valid_functional_programmingSession_supported_service_R3",400);
  testCaseTitle("1351014","Service_0x36_valid_functional_programmingSession_supported_service_R3");
  if(gBusFlag==3)
	{
		testStepWarning("Test","This test case does not apply to the LIN bus");
		return;
	}
  SetLog(logName);
  Precondition();
  /******************************以下为测试步骤*********************************/
  SessionFlag=APP;
  TestStep("Transition from defaultSession(0x01) to ProgrammingDiagnosticSession(0x02).",TestStepIntervalTime);
  SID10_DiagnosticSessionControl(PROGRAMMINGSESSION,FUNCTIONAL,SPRMIB_FALSE);
  CheckPosResponse_SID10(PROGRAMMINGSESSION,gP2Client_BOOT,gP2StarClientFor10Check,0,0);
  
  ECUinitHandle(0);
  SessionFlag=BOOT;
  TestStep("Verify ProgrammingDiagnosticSession.",TestStepIntervalTime);
  //ECUinitHandle(0);
  CheckCurrentSession(PROGRAMMINGSESSION,PHYSICAL,0,0);
  
  TestStep("Transfer data",TestStepIntervalTime);
  TPSendRawMessage(Data,FUNCTIONAL);
  CheckNegResponse(0x24,0,0);
  
  TestStep("Verify defaultSession",TestStepIntervalTime);
  CheckCurrentSession(PROGRAMMINGSESSION,PHYSICAL,0,0);
  /******************************以上为测试步骤*********************************/
  
  Postcondition();
}

/// <PBL_CommonServiceTest>
testcase Service_0x37_valid_physical_programmingSession_supported_service()
{
  char logPath[1000] = "";
  byte Data[2];
  char logName[400] = "";
  char info[1024];
  
  strncat(logName,"1351015_Service_0x37_valid_physical_programmingSession_supported_service_R3",400);
  SetLog(logName);
  
  Data[0]=0x36;
  Data[1]=0x01;  

  testCaseTitle("1351015","Service_0x37_valid_physical_programmingSession_supported_service_R3");
  TestStep("Start to execute the test procedure : Valid physical extendedDiagnosticSession supported service",TestStepIntervalTime);
  
  
  SetLog(logName);
  Precondition();
  /******************************以下为测试步骤*********************************/
  SessionFlag=APP;
  TestStep("Transition from defaultSession(0x01) to ProgrammingDiagnosticSession(0x02).",TestStepIntervalTime);
  SID10_DiagnosticSessionControl(PROGRAMMINGSESSION,FUNCTIONAL,SPRMIB_FALSE);
  CheckPosResponse_SID10(PROGRAMMINGSESSION,gP2Client_BOOT,gP2StarClientFor10Check,0,0);
  
  ECUinitHandle(0);
  SessionFlag=BOOT;
  TestStep("Verify ProgrammingDiagnosticSession.",TestStepIntervalTime);
  //ECUinitHandle(0);
  CheckCurrentSession(PROGRAMMINGSESSION,PHYSICAL,0,0);
  
  TestStep("Transfer data",TestStepIntervalTime);
  SID37_RequestTransferExit(PHYSICAL);
  CheckNegResponse(0x24,0,0);
  
  TestStep("Verify defaultSession",TestStepIntervalTime);
  CheckCurrentSession(PROGRAMMINGSESSION,PHYSICAL,0,0);
      
  /******************************以上为测试步骤*********************************/ 
  Postcondition();
}

/// <PBL_CommonServiceTest>
testcase Service_0x37_valid_functional_programmingSession_supported_service()
{
  char logPath[1000] = "";
  byte Data[2];
  char logName[400] = "";
  char info[1024];
  
  Data[0]=0x36;
  Data[1]=0x01;  
  
  strncat(logName,"1351016_Service_0x37_valid_functional_programmingSession_supported_service_R3",400);
  testCaseTitle("1351016","Service_0x37_valid_functional_programmingSession_supported_service_R3");
 
  if(gBusFlag==3)
	{
		testStepWarning("Test","This test case does not apply to the LIN bus");
		return;
	}
  SetLog(logName);
  Precondition();
  /******************************以下为测试步骤*********************************/
  SessionFlag=APP;
  TestStep("Transition from defaultSession(0x01) to ProgrammingDiagnosticSession(0x02).",TestStepIntervalTime);
  SID10_DiagnosticSessionControl(PROGRAMMINGSESSION,FUNCTIONAL,SPRMIB_FALSE);
  CheckPosResponse_SID10(PROGRAMMINGSESSION,gP2Client_BOOT,gP2StarClientFor10Check,0,0);

  ECUinitHandle(0);
  SessionFlag=BOOT;    
  TestStep("Verify ProgrammingDiagnosticSession.",TestStepIntervalTime);
  //ECUinitHandle(0);
  CheckCurrentSession(PROGRAMMINGSESSION,PHYSICAL,0,0);
  
  TestStep("Transfer data",TestStepIntervalTime);
  SID37_RequestTransferExit(FUNCTIONAL);
  CheckNegResponse(0x24,0,0);
  
  TestStep("Verify defaultSession",TestStepIntervalTime);
  CheckCurrentSession(PROGRAMMINGSESSION,PHYSICAL,0,0);
      
  /******************************以上为测试步骤*********************************/
  
  Postcondition();
}
/// <PBL_CommonServiceTest>
testcase Service_0x38_valid_physical_programmingSession_supported_service()
{
  char logPath[1000] = "";
  byte data1[11]={0x38,0x01,0x00,0x01,0x41,0x00,0x02,0x00,0x02,0x00,0x01};
  byte data2[11]={0x38,0x02,0x00,0x01,0x41,0x00,0x02,0x00,0x02,0x00,0x01};
  byte data3[11]={0x38,0x03,0x00,0x01,0x41,0x00,0x02,0x00,0x02,0x00,0x01};
  byte data4[11]={0x38,0x04,0x00,0x01,0x41,0x00,0x02,0x00,0x02,0x00,0x01};
  byte data5[11]={0x38,0x05,0x00,0x01,0x41,0x00,0x02,0x00,0x02,0x00,0x01};
  int i = 0;
  char logName[400] = "";
  char info[1024];
  
  strncat(logName,"1351017_Service_0x38_valid_physical_programmingSession_supported_service_R3",400);
  testCaseTitle("1351017","Service_0x38_valid_physical_programmingSession_supported_service_R3");
  
  SetLog(logName);
  Precondition();
  
  for(i=0;i<service_APP_Num;i++)
  {
    if(service_APP[i] == 0x38)
      break;
  }
  if(i==service_APP_Num)
  {
    TestStepWarning("ECU doesn't support 0x38 service , test case exit!");
    Postcondition();
    return;
  }
  
  TestStep("Start to execute the test procedure : Valid physical ProgrammingDiagnosticSession supported service",TestStepIntervalTime);
  
  /******************************以下为测试步骤*********************************/     
  SessionFlag=APP;
  TestStep("Transition from defaultSession(0x01) to ProgrammingDiagnosticSession(0x02).",TestStepIntervalTime);
  SID10_DiagnosticSessionControl(PROGRAMMINGSESSION,FUNCTIONAL,SPRMIB_FALSE);
  CheckPosResponse_SID10(PROGRAMMINGSESSION,gP2Client_BOOT,gP2StarClientFor10Check,0,0);

  ECUinitHandle(0);
  SessionFlag=BOOT;
  TestStep("Verify ProgrammingDiagnosticSession.",TestStepIntervalTime);
  //ECUinitHandle(0);
  CheckCurrentSession(PROGRAMMINGSESSION,PHYSICAL,0,0);
  
  TestStep("Transfer data",TestStepIntervalTime);
  TPSendRawMessage(data1,PHYSICAL);//38 01 00 01 41 10 00 02 00 02 00 01
  CheckNegResponse(0x33,0,0);
  
  TestStep("Transition  to ProgrammingDiagnosticSession(0x02).",TestStepIntervalTime);
  SID10_DiagnosticSessionControl(PROGRAMMINGSESSION,FUNCTIONAL,SPRMIB_FALSE);
  CheckPosResponse_SID10(PROGRAMMINGSESSION,gP2Client_BOOT,gP2StarClientFor10Check,0,0);
  
  TestStep("Transfer data",TestStepIntervalTime);
  TPSendRawMessage(data2,PHYSICAL);//38 02 00 01 41 
  CheckNegResponse(0x33,0,0);
  
  TestStep("Transition  to ProgrammingDiagnosticSession(0x02).",TestStepIntervalTime);
  SID10_DiagnosticSessionControl(PROGRAMMINGSESSION,FUNCTIONAL,SPRMIB_FALSE);
  CheckPosResponse_SID10(PROGRAMMINGSESSION,gP2Client_BOOT,gP2StarClientFor10Check,0,0);
  
  TestStep("Transfer data",TestStepIntervalTime);
  TPSendRawMessage(data3,PHYSICAL);//38 03 00 01 41 10 00 02 00 02 00 01
  CheckNegResponse(0x33,0,0);
  
  TestStep("Transition  to ProgrammingDiagnosticSession(0x02).",TestStepIntervalTime);
  SID10_DiagnosticSessionControl(PROGRAMMINGSESSION,FUNCTIONAL,SPRMIB_FALSE);
  CheckPosResponse_SID10(PROGRAMMINGSESSION,gP2Client_BOOT,gP2StarClientFor10Check,0,0);
  
  TestStep("Transfer data",TestStepIntervalTime);
  TPSendRawMessage(data4,PHYSICAL);//38 04 00 01 41 
  CheckNegResponse(0x33,0,0);
  
  TestStep("Transition  to ProgrammingDiagnosticSession(0x02).",TestStepIntervalTime);
  SID10_DiagnosticSessionControl(PROGRAMMINGSESSION,FUNCTIONAL,SPRMIB_FALSE);
  CheckPosResponse_SID10(PROGRAMMINGSESSION,gP2Client_BOOT,gP2StarClientFor10Check,0,0);
  
  TestStep("Transfer data",TestStepIntervalTime);
  TPSendRawMessage(data5,PHYSICAL);//38 05 00 01 41 
  CheckNegResponse(0x33,0,0);
  
  TestStep("Verify programmingSession",TestStepIntervalTime);
  CheckCurrentSession(PROGRAMMINGSESSION,PHYSICAL,0,0);
  /******************************以上为测试步骤*********************************/
 
  Postcondition();
}
/// <PBL_CommonServiceTest>
testcase Service_0x38_valid_functional_programmingSession_supported_service()
{
  char logPath[1000] = "";
  byte data1[11]={0x38,0x01,0x00,0x01,0x41,0x00,0x02,0x00,0x02,0x00,0x01};
  byte data2[11]={0x38,0x02,0x00,0x01,0x41,0x00,0x02,0x00,0x02,0x00,0x01};
  byte data3[11]={0x38,0x03,0x00,0x01,0x41,0x00,0x02,0x00,0x02,0x00,0x01};
  byte data4[11]={0x38,0x04,0x00,0x01,0x41,0x00,0x02,0x00,0x02,0x00,0x01};
  byte data5[11]={0x38,0x05,0x00,0x01,0x41,0x00,0x02,0x00,0x02,0x00,0x01};
  int i = 0;
  char logName[400] = "";
  char info[1024];
  
  strncat(logName,"1351018_Service_0x38_valid_functional_programmingSession_supported_service_R3",400);
  testCaseTitle("1351018","Service_0x38_valid_functional_programmingSession_supported_service_R3");
  
  if(gBusFlag==3)
	{
		testStepWarning("Test","This test case does not apply to the LIN bus");
		return;
	}
  SetLog(logName);
  Precondition();
  
  for(i=0;i<service_APP_Num;i++)
  {
    if(service_APP[i] == 0x38)
      break;
  }
  if(i==service_APP_Num)
  {
    TestStepWarning("ECU doesn't support 0x38 service , test case exit!");
    Postcondition();
    stopLogging("Diag_Logging");
    return;
  }
  
  TestStep("Start to execute the test procedure : Valid functional ProgrammingDiagnosticSession supported service",TestStepIntervalTime);
      
  /******************************以下为测试步骤*********************************/  
  SessionFlag=APP;
  TestStep("Transition from defaultSession(0x01) to ProgrammingDiagnosticSession(0x02).",TestStepIntervalTime);
  SID10_DiagnosticSessionControl(PROGRAMMINGSESSION,FUNCTIONAL,SPRMIB_FALSE);
  CheckPosResponse_SID10(PROGRAMMINGSESSION,gP2Client_BOOT,gP2StarClientFor10Check,0,0);

  ECUinitHandle(0);
  SessionFlag=BOOT;
  TestStep("Verify ProgrammingDiagnosticSession.",TestStepIntervalTime);
  //ECUinitHandle(0);
  CheckCurrentSession(PROGRAMMINGSESSION,PHYSICAL,0,0);
  
  TestStep("Transfer data",TestStepIntervalTime);
  TPSendRawMessage(data2,FUNCTIONAL);
  CheckNegResponse(0x33,0,0);
  
  TestStep("Transition  to ProgrammingDiagnosticSession(0x02).",TestStepIntervalTime);
  SID10_DiagnosticSessionControl(PROGRAMMINGSESSION,FUNCTIONAL,SPRMIB_FALSE);
  CheckPosResponse_SID10(PROGRAMMINGSESSION,gP2Client_BOOT,gP2StarClientFor10Check,0,0);

  TestStep("Transfer data",TestStepIntervalTime);
  TPSendRawMessage(data2,FUNCTIONAL); 
  CheckNegResponse(0x33,0,0);
 
  
  TestStep("Verify programmingSession",TestStepIntervalTime);
  CheckCurrentSession(PROGRAMMINGSESSION,PHYSICAL,0,0);
  /******************************以上为测试步骤*********************************/
 
  Postcondition();
}

/// <Authentication_Test>
testcase Unidirectional_Authentication_Test()
{

  char logName[400] = "";
  char info[1024];
  
  byte OCSP_RID[2]={0x70,0x27};
  byte tempdata[5000];
  char errorMsg[500];
  byte challenge[32]={0xAD,0x95,0x37,0xF6,0xC8,0x04,0x56,0x99,0xCE,0x04,0x19,0x88,0x68,0x83,0xB3,0xA1};
  char hashFunction[10]="SHA-256";  
//  char testerCertName[300] = "Geely3.0";
  byte testerCertByte[2000];
  dword testerCertByteLength;
  char testerCertString[4000];
  byte ownerShip[1000];
  dword ownerShipLength;
  char ownerShipString[2000];
  dword i=0,tempI;
  
  strncat(logName,"1318670_Unidirectional_Authentication_Test",400);
  testCaseTitle("1318670","Unidirectional_Authentication_Test");
  
  if(gBusFlag==5&&EthNodeTypeNow==EdgeNode)
  {
    
  }
  else
  {
    testStepWarning("Warning","This test case is only applicable for ETH_Edgenode");
    return;
  }
  
  SetLog(logName);
  Precondition();
   
  /******************************以下为测试步骤*********************************/
  SessionFlag=APP;
  
  checkAuthenticateState(Deauthenticated);
  
  SID29_Authentication_authenticationConfiguration(PHYSICAL);
  CheckPosResponse_SID29_authenticationConfiguration(0x2,0,0);
  
  if(GetCertificateAsBinaryByName(testerCertName, testerCertByte, testerCertByteLength, errorMsg)!=1)
  {
    testStepFail("Fail","%s",errorMsg);
    return;
  }
  
  ocspCheckSequence();
  
  SID29_Authentication_verifyCertificateUnidirectional(0,testerCertByteLength,testerCertByte,0,PHYSICAL);
  CheckPosResponse_SID29_verifyCertificateUnidirectional(0x11,0x20,challenge,0,0,0);
  
  
  if(CreateOwnership(testerCertName, hashFunction, challenge, elcount(challenge), ownerShip, ownerShipLength, errorMsg)!=1)
  {
    testStepFail("Fail","%s",errorMsg);
    return;
  }
  
  SID29_Authentication_proofOfOwnership(ownerShipLength,ownerShip,0,PHYSICAL);
  CheckPosResponse_SID29_proofOfOwnership(0x12,0,0);
  
  checkAuthenticateState(Authenticated);
  
  TestStep("Transition from defaultSession(0x01) to extendedDiagnosticSession(0x03)",TestStepIntervalTime);
  SID10_DiagnosticSessionControl(EXTENDEDSESSION,PHYSICAL,SPRMIB_FALSE);
  CheckPosResponse_SID10(EXTENDEDSESSION,gP2Client_APP,gP2StarClientFor10Check,0,0);
  TestStep("Verify extendedDiagnosticSession",TestStepIntervalTime);
  CheckCurrentSession(EXTENDEDSESSION,PHYSICAL,0,0);
  
  checkAuthenticateState(Authenticated);
  
  TestStep("Transition from extendedDiagnosticSession(0x03) to ProgrammingSession(0x02)",TestStepIntervalTime);
  SID10_DiagnosticSessionControl(PROGRAMMINGSESSION,PHYSICAL,SPRMIB_FALSE);
  CheckPosResponse_SID10(PROGRAMMINGSESSION,gP2Client_BOOT,gP2StarClientFor10Check,0,0);
  ECUinitHandle(0);
  TestStep("Verify ProgrammingSession",TestStepIntervalTime);
  CheckCurrentSession(PROGRAMMINGSESSION,PHYSICAL,0,0);
  
  checkAuthenticateState(Authenticated);
  
  SID29_Authentication_deAuthenticate(PHYSICAL);
  CheckPosResponse_SID29_deAuthenticate(0x10,0,0);
  
  checkAuthenticateState(Deauthenticated);

  /******************************以上为测试步骤*********************************/
  Postcondition();
  
}

/// <Authentication_Test>
testcase AuthenticationConfigureTest_Enable()
{
  char logName[400] = "";
  char info[1024];
  
  strncat(logName,"1366386_AuthenticationConfigureTest_Enable",400);
  testCaseTitle("1366386","AuthenticationConfigureTest_Enable");
  
  if(gBusFlag==5&&EthNodeTypeNow==EdgeNode)
  {
    
  }
  else
  {
    testStepWarning("Warning","This test case is only applicable for ETH_Edgenode");
    return;
  }
  
  SetLog(logName);
  Precondition();
   
  /******************************以下为测试步骤*********************************/

  SessionFlag=APP;
  
  checkSecureDiagFunConfig(Disable);
  
  checkAuthenticateState(Authenticated);
  
  TestStep("Transition from defaultSession(0x01) to extendedDiagnosticSession(0x03)",TestStepIntervalTime);
  SID10_DiagnosticSessionControl(EXTENDEDSESSION,PHYSICAL,SPRMIB_FALSE);
  CheckPosResponse_SID10(EXTENDEDSESSION,gP2Client_APP,gP2StarClientFor10Check,0,0);
  TestStep("Verify extendedDiagnosticSession",TestStepIntervalTime);
  CheckCurrentSession(EXTENDEDSESSION,PHYSICAL,0,0);
  
  SID27_SecurityAccess_RequestSeed(0x05,PHYSICAL);
  CheckPosResponse_SID27_ReqSeed(0x05,gSeedArray,16,0,0);
  PID27_Parameters_Seeds_Chk(NotAllZero,gSeedArray);
  SID27_SecurityAccess_SendKey(0x05,gKeyArray,PHYSICAL);
  CheckPosResponse_SID27_SenKey(0x05,0,0);
  
  writeSecureDiagFunConfig(UnidirectionalAuthen);
  
  checkSecureDiagFunConfig(UnidirectionalAuthen);
  
  checkAuthenticateState(Deauthenticated);

  /******************************以上为测试步骤*********************************/
  Postcondition();
}
/// <Authentication_Test>
testcase AuthenticationConfigureTest_Disable()
{
  char logName[400] = "";
  char info[1024];
  byte OCSP_RID[2]={0x70,0x27};
  byte tempdata[3075];
  char errorMsg[500];
  byte challenge[32]={0xAD,0x95,0x37,0xF6,0xC8,0x04,0x56,0x99,0xCE,0x04,0x19,0x88,0x68,0x83,0xB3,0xA1};
  char hashFunction[10]="SHA-256";  
//  char testerCertName[300] = "Geely3.0";
  byte testerCertByte[2000];
  dword testerCertByteLength;
  char testerCertString[4000];
  byte ownerShip[1000];
  dword ownerShipLength;
  char ownerShipString[2000];
  
  strncat(logName,"1366387_AuthenticationConfigureTest_Disable",400);
  testCaseTitle("1366387","AuthenticationConfigureTest_Disable");
  
  if(gBusFlag==5&&EthNodeTypeNow==EdgeNode)
  {
    
  }
  else
  {
    testStepWarning("Warning","This test case is only applicable for ETH_Edgenode");
    return;
  }
  
  SetLog(logName);
  Precondition();
   
  /******************************以下为测试步骤*********************************/

  SessionFlag=APP;
  
  checkSecureDiagFunConfig(UnidirectionalAuthen);
  
  checkAuthenticateState(Deauthenticated);
  
  SID29_Authentication_authenticationConfiguration(PHYSICAL);
  CheckPosResponse_SID29_authenticationConfiguration(0x2,0,0);
  
//  tempdata[0]=0x07;
//  tempdata[1]=0xFF;
//  tempdata[2049]=0x04;
//  tempdata[2050]=0x00;
//  SID31_RoutineControl(StartRoutine,OCSP_RID,tempdata,3075,PHYSICAL,SPRMIB_FALSE);
//  CheckPosResponse_SID31(StartRoutine,OCSP_RID,0,0);
  if(GetCertificateAsBinaryByName(testerCertName, testerCertByte, testerCertByteLength, errorMsg)!=1)
  {
    testStepFail("Fail","%s",errorMsg);
    return;
  }
  
  ocspCheckSequence();
  
  SID29_Authentication_verifyCertificateUnidirectional(0,testerCertByteLength,testerCertByte,0,PHYSICAL);
  CheckPosResponse_SID29_verifyCertificateUnidirectional(0x11,0x20,challenge,0,0,0);
  
  if(CreateOwnership(testerCertName, hashFunction, challenge, elcount(challenge), ownerShip, ownerShipLength, errorMsg)!=1)
  {
    testStepFail("Fail","%s",errorMsg);
    return;
  }
  
  SID29_Authentication_proofOfOwnership(ownerShipLength,ownerShip,0,PHYSICAL);
  CheckPosResponse_SID29_proofOfOwnership(0x12,0,0);
  
  checkAuthenticateState(Authenticated);
  

  
  TestStep("Transition from defaultSession(0x01) to extendedDiagnosticSession(0x03)",TestStepIntervalTime);
  SID10_DiagnosticSessionControl(EXTENDEDSESSION,PHYSICAL,SPRMIB_FALSE);
  CheckPosResponse_SID10(EXTENDEDSESSION,gP2Client_APP,gP2StarClientFor10Check,0,0);
  TestStep("Verify extendedDiagnosticSession",TestStepIntervalTime);
  CheckCurrentSession(EXTENDEDSESSION,PHYSICAL,0,0);
  
  SID27_SecurityAccess_RequestSeed(0x05,PHYSICAL);
  CheckPosResponse_SID27_ReqSeed(0x05,gSeedArray,16,0,0);
  PID27_Parameters_Seeds_Chk(NotAllZero,gSeedArray);
  SID27_SecurityAccess_SendKey(0x05,gKeyArray,PHYSICAL);
  CheckPosResponse_SID27_SenKey(0x05,0,0);
  
  writeSecureDiagFunConfig(Disable);
  
  checkSecureDiagFunConfig(Disable);

  SID29_Authentication_deAuthenticate(PHYSICAL);
  CheckPosResponse_SID29_deAuthenticate(0x10,0,0);
  
  checkAuthenticateState(Deauthenticated);
  
  /******************************以上为测试步骤*********************************/
  Postcondition();
}
/// <Authentication_Test>
testcase BidirectionalAuthenticationTest_WithoutSecureDiagnosticCommunication()
{
  char logName[400] = "";
  char info[1024];
  byte OCSP_RID[2]={0x70,0x27};
  byte tempdata[3075];
  char errorMsg[500];
  byte challenge[32]={0xAD,0x95,0x37,0xF6,0xC8,0x04,0x56,0x99,0xCE,0x04,0x19,0x88,0x68,0x83,0xB3,0xA1};
  char hashFunction[10]="SHA-256";  
//  char testerCertName[300] = "Geely3.0";
  byte testerCertByte[2000];
  dword testerCertByteLength;
  char testerCertString[4000];
  byte ownerShip[1000];
  dword ownerShipLength;
  char ownerShipString[2000];
  
  strncat(logName,"1318671_BidirectionalAuthenticationTest_WithoutSecureDiagnosticCommunication",400);
  testCaseTitle("1318671","BidirectionalAuthenticationTest_WithoutSecureDiagnosticCommunication");
  
  if(gBusFlag==5&&EthNodeTypeNow==EdgeNode)
  {
    
  }
  else
  {
    testStepWarning("Warning","This test case is only applicable for ETH_Edgenode");
    return;
  }
  
  SetLog(logName);
  Precondition();
   
  /******************************以下为测试步骤*********************************/

  
  /******************************以上为测试步骤*********************************/
  Postcondition();
}
/// <Authentication_Test>
testcase BidirectionalAuthenticationTest_WithSecureDiagnosticCommunication()
{
  char logName[400] = "";
  char info[1024];
  byte OCSP_RID[2]={0x70,0x27};
  byte tempdata[3075];
  char errorMsg[500];
  byte challenge[32]={0xAD,0x95,0x37,0xF6,0xC8,0x04,0x56,0x99,0xCE,0x04,0x19,0x88,0x68,0x83,0xB3,0xA1};
  char hashFunction[10]="SHA-256";  
//  char testerCertName[300] = "Geely3.0";
  byte testerCertByte[2000];
  dword testerCertByteLength;
  char testerCertString[4000];
  byte ownerShip[1000];
  dword ownerShipLength;
  char ownerShipString[2000];
  
  strncat(logName,"1318672_BidirectionalAuthenticationTest_WithSecureDiagnosticCommunication",400);
  testCaseTitle("1318672","BidirectionalAuthenticationTest_WithSecureDiagnosticCommunication");
  
  if(gBusFlag==5&&EthNodeTypeNow==EdgeNode)
  {
    
  }
  else
  {
    testStepWarning("Warning","This test case is only applicable for ETH_Edgenode");
    return;
  }
  
  SetLog(logName);
  Precondition();
   
  /******************************以下为测试步骤*********************************/

  
  /******************************以上为测试步骤*********************************/
  Postcondition();
}
/// <Authentication_Test>
testcase Service_0x29_UnsupporrtedSubfunctionTest()
{
  char logName[400] = "";
  char info[1024];
  byte OCSP_RID[2]={0x70,0x27};
  byte tempdata[3075];
  char errorMsg[500];
  byte challenge[32]={0xAD,0x95,0x37,0xF6,0xC8,0x04,0x56,0x99,0xCE,0x04,0x19,0x88,0x68,0x83,0xB3,0xA1};
  char hashFunction[10]="SHA-256";  
//  char testerCertName[300] = "Geely3.0";
  byte testerCertByte[2000];
  dword testerCertByteLength;
  char testerCertString[4000];
  byte ownerShip[1000];
  dword ownerShipLength;
  char ownerShipString[2000];
  byte supportSubFunction[4]={0,1,3,8};
  int i=0,j=0;
  byte data[2]={0x29,00};
  byte ExpectNRC[2]={0x12,0x7E};
  byte supportFlag=0;
  
  strncat(logName,"1318673_Service_0x29_UnsupporrtedSubfunctionTest",400);
  testCaseTitle("1318673","Service_0x29_UnsupporrtedSubfunctionTest");
  
  if(gBusFlag==5&&EthNodeTypeNow==EdgeNode)
  {
    
  }
  else
  {
    testStepWarning("Warning","This test case is only applicable for ETH_Edgenode");
    return;
  }
  
  SetLog(logName);
  Precondition();
   
  /******************************以下为测试步骤*********************************/

  for(i=0; i<=0xFF; i++)
  {
    for(j=0;j<elcount(supportSubFunction); j++)
    {
      if(i==supportSubFunction[j])
      {
        supportFlag=1;
        break;
      }
      else if(i==(supportSubFunction[j]+0x80))
      {
        supportFlag=1;
        break;
      }
    }
    if(supportFlag==1)
    {
      supportFlag=0;
      continue;
    }
    else
    {
      data[1]=i;
      TPSendRawMessage(data,PHYSICAL);
      CheckNegResponse(ExpectNRC,0,0,0,0);
    }
  }
  
  
  /******************************以上为测试步骤*********************************/
  Postcondition();
}
/// <Authentication_Test>
testcase Service_0x29_IncorrectMessageLengthTest()
{
  char logName[400] = "";
  char info[1024];
  byte OCSP_RID[2]={0x70,0x27};
  byte tempdata[3075];
  char errorMsg[500];
  byte challenge[32]={0xAD,0x95,0x37,0xF6,0xC8,0x04,0x56,0x99,0xCE,0x04,0x19,0x88,0x68,0x83,0xB3,0xA1};
  char hashFunction[10]="SHA-256";  
//  char testerCertName[300] = "Geely3.0";
  byte testerCertByte[2000];
  dword testerCertByteLength;
  char testerCertString[4000];
  byte ownerShip[1000];
  dword ownerShipLength;
  char ownerShipString[2000];
  byte supportSubFunction[4]={0,1,3,8};
  int i=0,j=0;
  byte data[3]={0x29,08,00};
  byte ExpectNRC[1]={0x13};
  byte supportFlag=0;
  
  strncat(logName,"1318674_Service_0x29_IncorrectMessageLengthTest",400);
  testCaseTitle("1318674","Service_0x29_IncorrectMessageLengthTest");
  
  if(gBusFlag==5&&EthNodeTypeNow==EdgeNode)
  {
    
  }
  else
  {
    testStepWarning("Warning","This test case is only applicable for ETH_Edgenode");
    return;
  }
  
  SetLog(logName);
  Precondition();
   
  /******************************以下为测试步骤*********************************/


  TPSendRawMessage(data,1,PHYSICAL);
  CheckNegResponse(ExpectNRC,0,0,0,0);

  TPSendRawMessage(data,3,PHYSICAL);
  CheckNegResponse(ExpectNRC,0,0,0,0);
  
  /******************************以上为测试步骤*********************************/
  Postcondition();
}

/// <Authentication_Test>
testcase AuthenticationTest_With_SequeneError()
{
  char logName[400] = "";
  char info[1024];
  
  byte OCSP_RID[2]={0x70,0x27};
  byte tempdata[3075];
  char errorMsg[500];
  byte challenge[32]={0xAD,0x95,0x37,0xF6,0xC8,0x04,0x56,0x99,0xCE,0x04,0x19,0x88,0x68,0x83,0xB3,0xA1};
  char hashFunction[10]="SHA-256";  
//  char testerCertName[300] = "Geely3.0";
  byte testerCertByte[2000];
  dword testerCertByteLength;
  char testerCertString[4000];
  byte ownerShip[1000];
  dword ownerShipLength;
  char ownerShipString[2000];
  byte ExpectNRC[1]={0x24};
  int i=0;
  strncat(logName,"1318675_AuthenticationTest_With_SequeneError",400);
  testCaseTitle("1318675","AuthenticationTest_With_SequeneError");
  
  if(gBusFlag==5&&EthNodeTypeNow==EdgeNode)
  {
    
  }
  else
  {
    testStepWarning("Warning","This test case is only applicable for ETH_Edgenode");
    return;
  }
  
  SetLog(logName);
  Precondition();
   
  /******************************以下为测试步骤*********************************/

  SessionFlag=APP;
  
  checkAuthenticateState(Deauthenticated);
  
  SID29_Authentication_authenticationConfiguration(PHYSICAL);
  CheckPosResponse_SID29_authenticationConfiguration(0x2,0,0);
  
  
  
  if(GetCertificateAsBinaryByName(testerCertName, testerCertByte, testerCertByteLength, errorMsg)!=1)
  {
    testStepFail("Fail","%s",errorMsg);
    return;
  }
  ocspCheckSequence();
  
//  SID29_Authentication_verifyCertificateUnidirectional(0,testerCertByteLength,testerCertByte,0,PHYSICAL);
//  CheckPosResponse_SID29_verifyCertificateUnidirectional(0x11,0x20,challenge,0,0,0);
  
  if(CreateOwnership(testerCertName, hashFunction, challenge, elcount(challenge), ownerShip, ownerShipLength, errorMsg)!=1)
  {
    testStepFail("Fail","%s",errorMsg);
    return;
  }

  SID29_Authentication_proofOfOwnership(ownerShipLength,ownerShip,0,PHYSICAL);
  CheckNegResponse(ExpectNRC,0,0,0,0);

  /******************************以上为测试步骤*********************************/
  Postcondition();
}

/// <Authentication_Test>
testcase Service_0x29_Authentication_Failed_InvalidOwnership()
{

  char logName[400] = "";
  char info[1024];
  
  byte OCSP_RID[2]={0x70,0x27};
  byte tempdata[3075];
  char errorMsg[500];
  byte challenge[32]={0xAD,0x95,0x37,0xF6,0xC8,0x04,0x56,0x99,0xCE,0x04,0x19,0x88,0x68,0x83,0xB3,0xA1};
  char hashFunction[10]="SHA-256";  
//  char testerCertName[300] = "Geely3.0";
  byte testerCertByte[2000];
  dword testerCertByteLength;
  char testerCertString[4000];
  byte ownerShip[1000];
  dword ownerShipLength;
  char ownerShipString[2000];
  byte ExpectNRC[1]={0x58};
  int i=0;
  strncat(logName,"1318681_Service_0x29_Authentication_Failed_InvalidOwnership",400);
  testCaseTitle("1318681","Service_0x29_Authentication_Failed_InvalidOwnership");
  
  if(gBusFlag==5&&EthNodeTypeNow==EdgeNode)
  {
    
  }
  else
  {
    testStepWarning("Warning","This test case is only applicable for ETH_Edgenode");
    return;
  }
  
  SetLog(logName);
  Precondition();
   
  /******************************以下为测试步骤*********************************/

  SessionFlag=APP;
 
  SID29_Authentication_authenticationConfiguration(PHYSICAL);
  CheckPosResponse_SID29_authenticationConfiguration(0x2,0,0);
  
  if(GetCertificateAsBinaryByName(testerCertName, testerCertByte, testerCertByteLength, errorMsg)!=1)
  {
    testStepFail("Fail","%s",errorMsg);
    return;
  }
  
  ocspCheckSequence();
  
  SID29_Authentication_verifyCertificateUnidirectional(0,testerCertByteLength,testerCertByte,0,PHYSICAL);
  CheckPosResponse_SID29_verifyCertificateUnidirectional(0x11,0x20,challenge,0,0,0);
  

  
  if(CreateOwnership(testerCertName, hashFunction, challenge, elcount(challenge), ownerShip, ownerShipLength, errorMsg)!=1)
  {
    testStepFail("Fail","%s",errorMsg);
    return;
  }
  ownerShip[0]+=1;
  
  SID29_Authentication_proofOfOwnership(ownerShipLength,ownerShip,0,PHYSICAL);
  CheckNegResponse(ExpectNRC,0,0,0,0);
  
  SID29_Authentication_authenticationConfiguration(PHYSICAL);
  CheckPosResponse_SID29_authenticationConfiguration(0x2,0,0);
  
//  tempdata[0]=0x07;
//  tempdata[1]=0xFF;
//  tempdata[2049]=0x04;
//  tempdata[2050]=0x00;
//  SID31_RoutineControl(StartRoutine,OCSP_RID,tempdata,3075,PHYSICAL,SPRMIB_FALSE);
//  CheckPosResponse_SID31(StartRoutine,OCSP_RID,0,0);
  if(GetCertificateAsBinaryByName(testerCertName, testerCertByte, testerCertByteLength, errorMsg)!=1)
  {
    testStepFail("Fail","%s",errorMsg);
    return;
  }
  SID29_Authentication_verifyCertificateUnidirectional(0,testerCertByteLength,testerCertByte,0,PHYSICAL);
  CheckPosResponse_SID29_verifyCertificateUnidirectional(0x11,0x20,challenge,0,0,0);
  
  
  if(CreateOwnership(testerCertName, hashFunction, challenge, elcount(challenge), ownerShip, ownerShipLength, errorMsg)!=1)
  {
    testStepFail("Fail","%s",errorMsg);
    return;
  }
  
  SID29_Authentication_proofOfOwnership(ownerShipLength,ownerShip,0,PHYSICAL);
  CheckPosResponse_SID29_proofOfOwnership(0x12,0,0);
  
  checkAuthenticateState(Authenticated);
  
  SID29_Authentication_deAuthenticate(PHYSICAL);
  CheckPosResponse_SID29_deAuthenticate(0x10,0,0);
  
  checkAuthenticateState(Deauthenticated);

  /******************************以上为测试步骤*********************************/
  Postcondition();
  
}
/// <Authentication_Test>
testcase DelayTimerAfterFalseAttemptsDuringAuthentication()
{

  char logName[400] = "";
  char info[1024];
  
  byte OCSP_RID[2]={0x70,0x27};
  byte tempdata[3075];
  char errorMsg[500];
  byte challenge[32]={0xAD,0x95,0x37,0xF6,0xC8,0x04,0x56,0x99,0xCE,0x04,0x19,0x88,0x68,0x83,0xB3,0xA1};
  char hashFunction[10]="SHA-256";  
//  char testerCertName[300] = "Geely3.0";
  byte testerCertByte[2000];
  dword testerCertByteLength;
  char testerCertString[4000];
  byte ownerShip[1000];
  dword ownerShipLength;
  char ownerShipString[2000];
  byte ExpectNRC[1]={0x58};
  int i=0;
  strncat(logName,"1318682_DelayTimerAfterFalseAttemptsDuringAuthentication",400);
  testCaseTitle("1318682","DelayTimerAfterFalseAttemptsDuringAuthentication");
  
  if(gBusFlag==5&&EthNodeTypeNow==EdgeNode)
  {
    
  }
  else
  {
    testStepWarning("Warning","This test case is only applicable for ETH_Edgenode");
    return;
  }
  
  SetLog(logName);
  Precondition();
   
  /******************************以下为测试步骤*********************************/
  SessionFlag=APP;
 ///////////////////////////////////////////////////////正确
  SID29_Authentication_authenticationConfiguration(PHYSICAL);
  CheckPosResponse_SID29_authenticationConfiguration(0x2,0,0);
  
//  tempdata[0]=0x07;
//  tempdata[1]=0xFF;
//  tempdata[2049]=0x04;
//  tempdata[2050]=0x00;
//  SID31_RoutineControl(StartRoutine,OCSP_RID,tempdata,3075,PHYSICAL,SPRMIB_FALSE);
//  CheckPosResponse_SID31(StartRoutine,OCSP_RID,0,0);
  if(GetCertificateAsBinaryByName(testerCertName, testerCertByte, testerCertByteLength, errorMsg)!=1)
  {
    testStepFail("Fail","%s",errorMsg);
    return;
  }
  ocspCheckSequence();
  
  SID29_Authentication_verifyCertificateUnidirectional(0,testerCertByteLength,testerCertByte,0,PHYSICAL);
  CheckPosResponse_SID29_verifyCertificateUnidirectional(0x11,0x20,challenge,0,0,0);
  
  
  if(CreateOwnership(testerCertName, hashFunction, challenge, elcount(challenge), ownerShip, ownerShipLength, errorMsg)!=1)
  {
    testStepFail("Fail","%s",errorMsg);
    return;
  }
  
  SID29_Authentication_proofOfOwnership(ownerShipLength,ownerShip,0,PHYSICAL);
  CheckPosResponse_SID29_proofOfOwnership(0x12,0,0);
  
  checkAuthenticateState(Authenticated);
  
  SID29_Authentication_deAuthenticate(PHYSICAL);
  CheckPosResponse_SID29_deAuthenticate(0x10,0,0);
  
  checkAuthenticateState(Deauthenticated);
  ////////////////////////////////////NRC58
  
  SID29_Authentication_authenticationConfiguration(PHYSICAL);
  CheckPosResponse_SID29_authenticationConfiguration(0x2,0,0);
  
//  tempdata[0]=0x07;
//  tempdata[1]=0xFF;
//  tempdata[2049]=0x04;
//  tempdata[2050]=0x00;
//  SID31_RoutineControl(StartRoutine,OCSP_RID,tempdata,3075,PHYSICAL,SPRMIB_FALSE);
//  CheckPosResponse_SID31(StartRoutine,OCSP_RID,0,0);
  if(GetCertificateAsBinaryByName(testerCertName, testerCertByte, testerCertByteLength, errorMsg)!=1)
  {
    testStepFail("Fail","%s",errorMsg);
    return;
  }
  SID29_Authentication_verifyCertificateUnidirectional(0,testerCertByteLength,testerCertByte,0,PHYSICAL);
  CheckPosResponse_SID29_verifyCertificateUnidirectional(0x11,0x20,challenge,0,0,0);
  

  
  if(CreateOwnership(testerCertName, hashFunction, challenge, elcount(challenge), ownerShip, ownerShipLength, errorMsg)!=1)
  {
    testStepFail("Fail","%s",errorMsg);
    return;
  }
  ownerShip[0]+=1;
  
  SID29_Authentication_proofOfOwnership(ownerShipLength,ownerShip,0,PHYSICAL);
  CheckNegResponse(0x58,0,0);
  
  ////////////////////////////////////NRC58
  SID29_Authentication_authenticationConfiguration(PHYSICAL);
  CheckPosResponse_SID29_authenticationConfiguration(0x2,0,0);
  
//  tempdata[0]=0x07;
//  tempdata[1]=0xFF;
//  tempdata[2049]=0x04;
//  tempdata[2050]=0x00;
//  SID31_RoutineControl(StartRoutine,OCSP_RID,tempdata,3075,PHYSICAL,SPRMIB_FALSE);
//  CheckPosResponse_SID31(StartRoutine,OCSP_RID,0,0);
  if(GetCertificateAsBinaryByName(testerCertName, testerCertByte, testerCertByteLength, errorMsg)!=1)
  {
    testStepFail("Fail","%s",errorMsg);
    return;
  }
  SID29_Authentication_verifyCertificateUnidirectional(0,testerCertByteLength,testerCertByte,0,PHYSICAL);
  CheckPosResponse_SID29_verifyCertificateUnidirectional(0x11,0x20,challenge,0,0,0);
  

  
  if(CreateOwnership(testerCertName, hashFunction, challenge, elcount(challenge), ownerShip, ownerShipLength, errorMsg)!=1)
  {
    testStepFail("Fail","%s",errorMsg);
    return;
  }
  ownerShip[0]+=1;
  
  SID29_Authentication_proofOfOwnership(ownerShipLength,ownerShip,0,PHYSICAL);
  CheckNegResponse(0x58,0,0);
  
  //////////////////////////NRC22
//  tempdata[0]=0x07;
//  tempdata[1]=0xFF;
//  tempdata[2049]=0x04;
//  tempdata[2050]=0x00;
//  SID31_RoutineControl(StartRoutine,OCSP_RID,tempdata,3075,PHYSICAL,SPRMIB_FALSE);
//  CheckPosResponse_SID31(StartRoutine,OCSP_RID,0,0);
  testWaitForTimeout(9000);
  
  if(GetCertificateAsBinaryByName(testerCertName, testerCertByte, testerCertByteLength, errorMsg)!=1)
  {
    testStepFail("Fail","%s",errorMsg);
    return;
  }
  SID29_Authentication_verifyCertificateUnidirectional(0,testerCertByteLength,testerCertByte,0,PHYSICAL);
  CheckNegResponse(0x22,0,0);
  testWaitForTimeout(1500);
  //////////////////////////正确
  if(GetCertificateAsBinaryByName(testerCertName, testerCertByte, testerCertByteLength, errorMsg)!=1)
  {
    testStepFail("Fail","%s",errorMsg);
    return;
  }
  SID29_Authentication_verifyCertificateUnidirectional(0,testerCertByteLength,testerCertByte,0,PHYSICAL);
  CheckPosResponse_SID29_verifyCertificateUnidirectional(0x11,0x20,challenge,0,0,0);
  
  for(i=0;i<32;i++)
  write("challengebyte=%x",challenge[i]);
  
  if(CreateOwnership(testerCertName, hashFunction, challenge, elcount(challenge), ownerShip, ownerShipLength, errorMsg)!=1)
  {
    testStepFail("Fail","%s",errorMsg);
    return;
  }
  
  SID29_Authentication_proofOfOwnership(ownerShipLength,ownerShip,0,PHYSICAL);
  CheckPosResponse_SID29_proofOfOwnership(0x12,0,0);
  
  checkAuthenticateState(Authenticated);

  SID29_Authentication_deAuthenticate(PHYSICAL);
  CheckPosResponse_SID29_deAuthenticate(0x10,0,0);
  
  checkAuthenticateState(Deauthenticated);

  /******************************以上为测试步骤*********************************/
  Postcondition();
  
} 
/// <Authentication_Test>
testcase TimeoutTestForAuthentication()
{

  char logName[400] = "";
  char info[1024];
  
  byte OCSP_RID[2]={0x70,0x27};
  byte tempdata[3075];
  char errorMsg[500];
  byte challenge[32]={0xAD,0x95,0x37,0xF6,0xC8,0x04,0x56,0x99,0xCE,0x04,0x19,0x88,0x68,0x83,0xB3,0xA1};
  char hashFunction[10]="SHA-256";  
//  char testerCertName[300] = "Geely3.0";
  byte testerCertByte[2000];
  dword testerCertByteLength;
  char testerCertString[4000];
  byte ownerShip[1000];
  dword ownerShipLength;
  char ownerShipString[2000];
  int i=0;
  strncat(logName,"1366388_TimeoutTestForAuthentication",400);
  testCaseTitle("1366388","TimeoutTestForAuthentication");
  
  if(gBusFlag==5&&EthNodeTypeNow==EdgeNode)
  {
    
  }
  else
  {
    testStepWarning("Warning","This test case is only applicable for ETH_Edgenode");
    return;
  }
  
  SetLog(logName);
  Precondition();
   
  /******************************以下为测试步骤*********************************/

  SessionFlag=APP;
  
  checkAuthenticateState(Deauthenticated);
  
  SID29_Authentication_authenticationConfiguration(PHYSICAL);
  CheckPosResponse_SID29_authenticationConfiguration(0x2,0,0);
  
//  tempdata[0]=0x07;
//  tempdata[1]=0xFF;
//  tempdata[2049]=0x04;
//  tempdata[2050]=0x00;
//  SID31_RoutineControl(StartRoutine,OCSP_RID,tempdata,3075,PHYSICAL,SPRMIB_FALSE);
//  CheckPosResponse_SID31(StartRoutine,OCSP_RID,0,0);
  if(GetCertificateAsBinaryByName(testerCertName, testerCertByte, testerCertByteLength, errorMsg)!=1)
  {
    testStepFail("Fail","%s",errorMsg);
    return;
  }
  
  ocspCheckSequence();
  
  SID29_Authentication_verifyCertificateUnidirectional(0,testerCertByteLength,testerCertByte,0,PHYSICAL);
  CheckPosResponse_SID29_verifyCertificateUnidirectional(0x11,0x20,challenge,0,0,0);

  
  if(CreateOwnership(testerCertName, hashFunction, challenge, elcount(challenge), ownerShip, ownerShipLength, errorMsg)!=1)
  {
    testStepFail("Fail","%s",errorMsg);
    return;
  }
  
  SID29_Authentication_proofOfOwnership(ownerShipLength,ownerShip,0,PHYSICAL);
  CheckPosResponse_SID29_proofOfOwnership(0x12,0,0);
  
  TP_TesterPresentSet(TP_OFF);
  
  CheckCurrentSession(DEFAULTSESSION,PHYSICAL,0,0);
  
  checkAuthenticateState(Authenticated);
  
  
  testWaitForTimeout(179000);
  
  checkAuthenticateState(Authenticated);
  
  testWaitForTimeout(181000);
  
  checkAuthenticateState(Deauthenticated);
  
  TP_TesterPresentSet(TP_ON);
  
  SID29_Authentication_verifyCertificateUnidirectional(0,testerCertByteLength,testerCertByte,0,PHYSICAL);
  CheckPosResponse_SID29_verifyCertificateUnidirectional(0x11,0x20,challenge,0,0,0);

  
  if(CreateOwnership(testerCertName, hashFunction, challenge, elcount(challenge), ownerShip, ownerShipLength, errorMsg)!=1)
  {
    testStepFail("Fail","%s",errorMsg);
    return;
  }
  ocspCheckSequence();
  
  SID29_Authentication_proofOfOwnership(ownerShipLength,ownerShip,0,PHYSICAL);
  CheckPosResponse_SID29_proofOfOwnership(0x12,0,0);
  
  checkAuthenticateState(Authenticated);
  
  TestStep("Transition from defaultSession(0x01) to extendedDiagnosticSession(0x03)",TestStepIntervalTime);
  SID10_DiagnosticSessionControl(EXTENDEDSESSION,PHYSICAL,SPRMIB_FALSE);
  CheckPosResponse_SID10(EXTENDEDSESSION,gP2Client_APP,gP2StarClientFor10Check,0,0);
  TestStep("Verify extendedDiagnosticSession",TestStepIntervalTime);
  CheckCurrentSession(EXTENDEDSESSION,PHYSICAL,0,0);
  
  TP_TesterPresentSet(TP_OFF);
  
  testWaitForTimeout(5500);
  
  checkAuthenticateState(Deauthenticated);
  
  TP_TesterPresentSet(TP_ON);
  SID29_Authentication_deAuthenticate(PHYSICAL);
  CheckPosResponse_SID29_deAuthenticate(0x10,0,0);
  
  checkAuthenticateState(Deauthenticated);

  
  SID29_Authentication_verifyCertificateUnidirectional(0,testerCertByteLength,testerCertByte,0,PHYSICAL);
  CheckPosResponse_SID29_verifyCertificateUnidirectional(0x11,0x20,challenge,0,0,0);

  
  if(CreateOwnership(testerCertName, hashFunction, challenge, elcount(challenge), ownerShip, ownerShipLength, errorMsg)!=1)
  {
    testStepFail("Fail","%s",errorMsg);
    return;
  }
  
  ocspCheckSequence();
  
  SID29_Authentication_proofOfOwnership(ownerShipLength,ownerShip,0,PHYSICAL);
  CheckPosResponse_SID29_proofOfOwnership(0x12,0,0);
  
  checkAuthenticateState(Authenticated);
  
  
  SID11_ECUReset(HARDRESET,PHYSICAL,SPRMIB_FALSE);
  CheckPosResponse_SID11(HARDRESET,0,0);
  ECUinitHandle(0);
  
  checkAuthenticateState(Deauthenticated);
  
  SID29_Authentication_verifyCertificateUnidirectional(0,testerCertByteLength,testerCertByte,0,PHYSICAL);
  CheckPosResponse_SID29_verifyCertificateUnidirectional(0x11,0x20,challenge,0,0,0);

  
  if(CreateOwnership(testerCertName, hashFunction, challenge, elcount(challenge), ownerShip, ownerShipLength, errorMsg)!=1)
  {
    testStepFail("Fail","%s",errorMsg);
    return;
  }
  
  ocspCheckSequence();
  
  SID29_Authentication_proofOfOwnership(ownerShipLength,ownerShip,0,PHYSICAL);
  CheckPosResponse_SID29_proofOfOwnership(0x12,0,0);
  
  checkAuthenticateState(Authenticated);
  
  
  kl30(T_off);
  kl15(T_off);
  testWaitForTimeout(1000);
  kl30(T_on);
  kl15(T_on);
  
  ECUinitHandle(0);
  
  checkAuthenticateState(Deauthenticated);
  
  /******************************以上为测试步骤*********************************/
  Postcondition();
  
}
/// <Authentication_Test>
testcase Authentication_NRC50_Test()
{
  char logName[400] = "";
  char info[1024];
  
  byte OCSP_RID[2]={0x70,0x27};
  byte tempdata[3075];
  char errorMsg[500];
  byte challenge[32]={0xAD,0x95,0x37,0xF6,0xC8,0x04,0x56,0x99,0xCE,0x04,0x19,0x88,0x68,0x83,0xB3,0xA1};
  char hashFunction[10]="SHA-256";  
  
  byte testerCertByte[2000];
  dword testerCertByteLength;
  char testerCertString[4000];
  byte ownerShip[1000];
  dword ownerShipLength;
  char ownerShipString[2000];
  int i=0;
  strncat(logName,"Authentication_NRC50_Test",400);
  testCaseTitle("","Authentication_NRC50_Test");
  
  if(gBusFlag==5&&EthNodeTypeNow==EdgeNode)
  {
    
  }
  else
  {
    testStepWarning("Warning","This test case is only applicable for ETH_Edgenode");
    return;
  }
  
  SetLog(logName);
  Precondition();
   
  /******************************以下为测试步骤*********************************/

  SessionFlag=APP;
  
  checkAuthenticateState(Deauthenticated);
  
  SID29_Authentication_authenticationConfiguration(PHYSICAL);
  CheckPosResponse_SID29_authenticationConfiguration(0x2,0,0);
  
//  tempdata[0]=0x07;
//  tempdata[1]=0xFF;
//  tempdata[2049]=0x04;
//  tempdata[2050]=0x00;
//  SID31_RoutineControl(StartRoutine,OCSP_RID,tempdata,3075,PHYSICAL,SPRMIB_FALSE);
//  CheckPosResponse_SID31(StartRoutine,OCSP_RID,0,0);
  
  if(GetCertificateAsBinaryByName(testerCertName_NRC50, testerCertByte, testerCertByteLength, errorMsg)!=1)
  {
    testStepFail("Fail","%s",errorMsg);
    return;
  }
  ocspCheckSequence();
  
//  PrintPID("UDS","Certificate:",testerCertByte,testerCertByteLength);
//  write("testerCertByteLength=%d",testerCertByteLength);
  SID29_Authentication_verifyCertificateUnidirectional(0,testerCertByteLength,testerCertByte,0,PHYSICAL);
  CheckNegResponse(0x50,0,0);
  
  if(GetCertificateAsBinaryByName(testerCertName, testerCertByte, testerCertByteLength, errorMsg)!=1)
  {
    testStepFail("Fail","%s",errorMsg);
    return;
  }
  
//  PrintPID("UDS","Certificate:",testerCertByte,testerCertByteLength);
//  write("testerCertByteLength=%d",testerCertByteLength);
  SID29_Authentication_verifyCertificateUnidirectional(0,testerCertByteLength,testerCertByte,0,PHYSICAL);
  CheckPosResponse_SID29_verifyCertificateUnidirectional(0x11,0x20,challenge,0,0,0);
  
  if(CreateOwnership(testerCertName, hashFunction, challenge, elcount(challenge), ownerShip, ownerShipLength, errorMsg)!=1)
  {
    testStepFail("Fail","%s",errorMsg);
    return;
  }
  
  SID29_Authentication_proofOfOwnership(ownerShipLength,ownerShip,0,PHYSICAL);
  CheckPosResponse_SID29_proofOfOwnership(0x12,0,0);
  
  checkAuthenticateState(Authenticated);
  
  SID29_Authentication_deAuthenticate(PHYSICAL);
  CheckPosResponse_SID29_deAuthenticate(0x10,0,0);
  
  checkAuthenticateState(Deauthenticated);
  /******************************以上为测试步骤*********************************/
  Postcondition();
}
/// <Authentication_Test>
testcase Authentication()
{
  char logName[400] = "";
  char info[1024];
  
  byte OCSP_RID[2]={0x70,0x27};
  byte tempdata[5000];
  char errorMsg[500];
  byte challenge[32]={0xAD,0x95,0x37,0xF6,0xC8,0x04,0x56,0x99,0xCE,0x04,0x19,0x88,0x68,0x83,0xB3,0xA1};
  char hashFunction[10]="SHA-256";  
//  char testerCertName[300] = "Geely3.0";
  byte testerCertByte[2000];
  dword testerCertByteLength;
  char testerCertString[4000];
  byte ownerShip[1000];
  dword ownerShipLength;
  char ownerShipString[2000];
  dword i=0;
  dword tempI;
  strncat(logName,"Authentication",400);
  testCaseTitle("","Authentication");
  
  if(gBusFlag==5&&EthNodeTypeNow==EdgeNode)
  {
    
  }
  else
  {
    testStepWarning("Warning","This test case is only applicable for ETH_Edgenode");
    return;
  }
  
  SetLog(logName);
  Precondition();
   
  /******************************以下为测试步骤*********************************/
  SessionFlag=APP;
  
  checkAuthenticateState(Deauthenticated);
  
  SID29_Authentication_authenticationConfiguration(PHYSICAL);
  CheckPosResponse_SID29_authenticationConfiguration(0x2,0,0);
  
  if(GetCertificateAsBinaryByName(testerCertName, testerCertByte, testerCertByteLength, errorMsg)!=1)
  {
    testStepFail("Fail","%s",errorMsg);
    return;
  }
  
  ocspCheckSequence();
  
  SID29_Authentication_verifyCertificateUnidirectional(0,testerCertByteLength,testerCertByte,0,PHYSICAL);
  CheckPosResponse_SID29_verifyCertificateUnidirectional(0x11,0x20,challenge,0,0,0);
  
  if(CreateOwnership(testerCertName, hashFunction, challenge, elcount(challenge), ownerShip, ownerShipLength, errorMsg)!=1)
  {
    testStepFail("Fail","%s",errorMsg);
    return;
  }
  
  SID29_Authentication_proofOfOwnership(ownerShipLength,ownerShip,0,PHYSICAL);
  CheckPosResponse_SID29_proofOfOwnership(0x12,0,0);
  
  checkAuthenticateState(Authenticated);


  /******************************以上为测试步骤*********************************/
  Postcondition();
}
/// <Authentication_Test>
testcase JumpOCSP_WrongOCSP()
{
  char logName[400] = "";
  char info[1024];
  
  byte OCSP_RID[2]={0x70,0x27};
  byte tempdata[3075];
  char errorMsg[500];
  byte challenge[32]={0xAD,0x95,0x37,0xF6,0xC8,0x04,0x56,0x99,0xCE,0x04,0x19,0x88,0x68,0x83,0xB3,0xA1};
  char hashFunction[10]="SHA-256";  
//  char testerCertName[300] = "Geely3.0";
  byte testerCertByte[2000];
  dword testerCertByteLength;
  char testerCertString[4000];
  byte ownerShip[1000];
  dword ownerShipLength;
  char ownerShipString[2000];
  dword i=0;
  dword tempI;
  
  
  strncat(logName,"JumpOCSP_WrongOCSP",400);
  testCaseTitle("","JumpOCSP_WrongOCSP");
  
  if(gBusFlag==5&&EthNodeTypeNow==EdgeNode)
  {
    
  }
  else
  {
    testStepWarning("Warning","This test case is only applicable for ETH_Edgenode");
    return;
  }
  
  SetLog(logName);
  Precondition();
   
  /******************************以下为测试步骤*********************************/
  SessionFlag=APP;
  
  checkAuthenticateState(Deauthenticated);
  
  SID29_Authentication_authenticationConfiguration(PHYSICAL);
  CheckPosResponse_SID29_authenticationConfiguration(0x2,0,0);
  
  if(GetCertificateAsBinaryByName(testerCertName, testerCertByte, testerCertByteLength, errorMsg)!=1)
  {
    testStepFail("Fail","%s",errorMsg);
    return;
  }

  SID29_Authentication_verifyCertificateUnidirectional(0,testerCertByteLength,testerCertByte,0,PHYSICAL);
  CheckNegResponse(0x57,0,0);
  
  /////another new sequence
  SID29_Authentication_authenticationConfiguration(PHYSICAL);
  CheckPosResponse_SID29_authenticationConfiguration(0x2,0,0);
  
  if(GetCertificateAsBinaryByName(testerCertName, testerCertByte, testerCertByteLength, errorMsg)!=1)
  {
    testStepFail("Fail","%s",errorMsg);
    return;
  }
  
  string2array(ocspResponseString,ocspBytearray,ocspLen);
  memcpy(tempdata,ocspBytearray,ocspLen);
  tempdata[0]=ocspLen>>8;
  tempdata[1]=ocspLen;
  for(i=0;i<ocspLen;i++)
  {
    tempdata[2+i]=0xFF;
  }
  
  tempdata[2050]=testerCertByteLength>>8;
  tempdata[2051]=testerCertByteLength;
  
  for(i=0;i<testerCertByteLength;i++)
  {
    tempdata[2052+i]=testerCertByte[i];
  }

  SID31_RoutineControl(StartRoutine,OCSP_RID,tempdata,3076,PHYSICAL,SPRMIB_FALSE);
  CheckPosResponse_SID31(StartRoutine,OCSP_RID,0,0);
  if(gTpRxData[4]==0x10&&gTpRxData[5]==0x01)
  {
    
  }
  else
  {
    testStepFail("Fail","get wrong routine parameter0x%x%x instead of 0x10 01",gTpRxData[4],gTpRxData[5]);
  }
  
  SID29_Authentication_verifyCertificateUnidirectional(0,testerCertByteLength,testerCertByte,0,PHYSICAL);
  CheckNegResponse(0x57,0,0);
  
  checkAuthenticateState(Deauthenticated);


  /******************************以上为测试步骤*********************************/
  Postcondition();
}
/// <Authentication_Test>
testcase Authentication_NRC51_Test()
{
  char logName[400] = "";
  char info[1024];
  
  byte OCSP_RID[2]={0x70,0x27};
  byte tempdata[3075];
  char errorMsg[500];
  byte challenge[32]={0xAD,0x95,0x37,0xF6,0xC8,0x04,0x56,0x99,0xCE,0x04,0x19,0x88,0x68,0x83,0xB3,0xA1};
  char hashFunction[10]="SHA-256";  
  
  byte testerCertByte[2000];
  dword testerCertByteLength;
  char testerCertString[4000];
  byte ownerShip[1000];
  dword ownerShipLength;
  char ownerShipString[2000];
  int i=0;
  strncat(logName,"Authentication_NRC51_Test",400);
  testCaseTitle("","Authentication_NRC51_Test");
  
  if(gBusFlag==5&&EthNodeTypeNow==EdgeNode)
  {
    
  }
  else
  {
    testStepWarning("Warning","This test case is only applicable for ETH_Edgenode");
    return;
  }
  
  SetLog(logName);
  Precondition();
   
  /******************************以下为测试步骤*********************************/

  SessionFlag=APP;
  
  checkAuthenticateState(Deauthenticated);
  
  SID29_Authentication_authenticationConfiguration(PHYSICAL);
  CheckPosResponse_SID29_authenticationConfiguration(0x2,0,0);
  
//  tempdata[0]=0x07;
//  tempdata[1]=0xFF;
//  tempdata[2049]=0x04;
//  tempdata[2050]=0x00;
//  SID31_RoutineControl(StartRoutine,OCSP_RID,tempdata,3075,PHYSICAL,SPRMIB_FALSE);
//  CheckPosResponse_SID31(StartRoutine,OCSP_RID,0,0);
  ocspCheckSequence();
  
  if(GetCertificateAsBinaryByName(testerCertName_NRC51, testerCertByte, testerCertByteLength, errorMsg)!=1)
  {
    testStepFail("Fail","%s",errorMsg);
    return;
  }
  
  SID29_Authentication_verifyCertificateUnidirectional(0,testerCertByteLength,testerCertByte,0,PHYSICAL);
  CheckNegResponse(0x51,0,0);

  
  if(GetCertificateAsBinaryByName(testerCertName, testerCertByte, testerCertByteLength, errorMsg)!=1)
  {
    testStepFail("Fail","%s",errorMsg);
    return;
  }
  testWaitForTimeout(2);
  SID29_Authentication_verifyCertificateUnidirectional(0,testerCertByteLength,testerCertByte,0,PHYSICAL);
  CheckPosResponse_SID29_verifyCertificateUnidirectional(0x11,0x20,challenge,0,0,0);
  
//  for(i=0;i<32;i++)
//  write("challengebyte=%x",challenge[i]);
  
  if(CreateOwnership(testerCertName, hashFunction, challenge, elcount(challenge), ownerShip, ownerShipLength, errorMsg)!=1)
  {
    testStepFail("Fail","%s",errorMsg);
    return;
  }
  
  SID29_Authentication_proofOfOwnership(ownerShipLength,ownerShip,0,PHYSICAL);
  CheckPosResponse_SID29_proofOfOwnership(0x12,0,0);
  
  checkAuthenticateState(Authenticated);
  
  SID29_Authentication_deAuthenticate(PHYSICAL);
  CheckPosResponse_SID29_deAuthenticate(0x10,0,0);
  
  checkAuthenticateState(Deauthenticated);
  /******************************以上为测试步骤*********************************/
  Postcondition();
}
/// <Authentication_Test>
testcase Authentication_NRC52_Test()
{
  char logName[400] = "";
  char info[1024];
  
  byte OCSP_RID[2]={0x70,0x27};
  byte tempdata[3075];
  char errorMsg[500];
  byte challenge[32]={0xAD,0x95,0x37,0xF6,0xC8,0x04,0x56,0x99,0xCE,0x04,0x19,0x88,0x68,0x83,0xB3,0xA1};
  char hashFunction[10]="SHA-256";  
  
  byte testerCertByte[2000];
  dword testerCertByteLength;
  char testerCertString[4000];
  byte ownerShip[1000];
  dword ownerShipLength;
  char ownerShipString[2000];
  int i=0;
  strncat(logName,"Authentication_NRC52Test",400);
  testCaseTitle("","Authentication_NRC52_Test");
  
  if(gBusFlag==5&&EthNodeTypeNow==EdgeNode)
  {
    
  }
  else
  {
    testStepWarning("Warning","This test case is only applicable for ETH_Edgenode");
    return;
  }
  
  SetLog(logName);
  Precondition();
   
  /******************************以下为测试步骤*********************************/

  SessionFlag=APP;
  
  checkAuthenticateState(Deauthenticated);
  
  SID29_Authentication_authenticationConfiguration(PHYSICAL);
  CheckPosResponse_SID29_authenticationConfiguration(0x2,0,0);
  
//  tempdata[0]=0x07;
//  tempdata[1]=0xFF;
//  tempdata[2049]=0x04;
//  tempdata[2050]=0x00;
//  SID31_RoutineControl(StartRoutine,OCSP_RID,tempdata,3075,PHYSICAL,SPRMIB_FALSE);
//  CheckPosResponse_SID31(StartRoutine,OCSP_RID,0,0);
  ocspCheckSequence();
  
  if(GetCertificateAsBinaryByName(testerCertName_NRC52, testerCertByte, testerCertByteLength, errorMsg)!=1)
  {
    testStepFail("Fail","%s",errorMsg);
    return;
  }
  SID29_Authentication_verifyCertificateUnidirectional(0,testerCertByteLength,testerCertByte,0,PHYSICAL);
  CheckNegResponse(0x52,0,0);

  
  if(GetCertificateAsBinaryByName(testerCertName, testerCertByte, testerCertByteLength, errorMsg)!=1)
  {
    testStepFail("Fail","%s",errorMsg);
    return;
  }
  SID29_Authentication_verifyCertificateUnidirectional(0,testerCertByteLength,testerCertByte,0,PHYSICAL);
  CheckPosResponse_SID29_verifyCertificateUnidirectional(0x11,0x20,challenge,0,0,0);
  
//  for(i=0;i<32;i++)
//  write("challengebyte=%x",challenge[i]);
  
  if(CreateOwnership(testerCertName, hashFunction, challenge, elcount(challenge), ownerShip, ownerShipLength, errorMsg)!=1)
  {
    testStepFail("Fail","%s",errorMsg);
    return;
  }
  
  SID29_Authentication_proofOfOwnership(ownerShipLength,ownerShip,0,PHYSICAL);
  CheckPosResponse_SID29_proofOfOwnership(0x12,0,0);
  
  checkAuthenticateState(Authenticated);
  
  SID29_Authentication_deAuthenticate(PHYSICAL);
  CheckPosResponse_SID29_deAuthenticate(0x10,0,0);
  
  checkAuthenticateState(Deauthenticated);
  /******************************以上为测试步骤*********************************/
  Postcondition();
}
/// <Authentication_Test>
testcase Authentication_NRC53_Test()
{
  char logName[400] = "";
  char info[1024];
  
  byte OCSP_RID[2]={0x70,0x27};
  byte tempdata[3075];
  char errorMsg[500];
  byte challenge[32]={0xAD,0x95,0x37,0xF6,0xC8,0x04,0x56,0x99,0xCE,0x04,0x19,0x88,0x68,0x83,0xB3,0xA1};
  char hashFunction[10]="SHA-256";  
  
  byte testerCertByte[2000];
  dword testerCertByteLength;
  char testerCertString[4000];
  byte ownerShip[1000];
  dword ownerShipLength;
  char ownerShipString[2000];
  int i=0;
  strncat(logName,"Authentication_NRC53_Test",400);
  testCaseTitle("","Authentication_NRC53_Test");
  
  if(gBusFlag==5&&EthNodeTypeNow==EdgeNode)
  {
    
  }
  else
  {
    testStepWarning("Warning","This test case is only applicable for ETH_Edgenode");
    return;
  }
  
  SetLog(logName);
  Precondition();
   
  /******************************以下为测试步骤*********************************/

  SessionFlag=APP;
  
  checkAuthenticateState(Deauthenticated);
  
  SID29_Authentication_authenticationConfiguration(PHYSICAL);
  CheckPosResponse_SID29_authenticationConfiguration(0x2,0,0);
  
//  tempdata[0]=0x07;
//  tempdata[1]=0xFF;
//  tempdata[2049]=0x04;
//  tempdata[2050]=0x00;
//  SID31_RoutineControl(StartRoutine,OCSP_RID,tempdata,3075,PHYSICAL,SPRMIB_FALSE);
//  CheckPosResponse_SID31(StartRoutine,OCSP_RID,0,0);
  ocspCheckSequence();
  
  if(GetCertificateAsBinaryByName(testerCertName_NRC53, testerCertByte, testerCertByteLength, errorMsg)!=1)
  {
    testStepFail("Fail","%s",errorMsg);
    return;
  }
  SID29_Authentication_verifyCertificateUnidirectional(0,testerCertByteLength,testerCertByte,0,PHYSICAL);
  CheckNegResponse(0x53,0,0);

  
  if(GetCertificateAsBinaryByName(testerCertName, testerCertByte, testerCertByteLength, errorMsg)!=1)
  {
    testStepFail("Fail","%s",errorMsg);
    return;
  }
  SID29_Authentication_verifyCertificateUnidirectional(0,testerCertByteLength,testerCertByte,0,PHYSICAL);
  CheckPosResponse_SID29_verifyCertificateUnidirectional(0x11,0x20,challenge,0,0,0);
  
//  for(i=0;i<32;i++)
//  write("challengebyte=%x",challenge[i]);
  
  if(CreateOwnership(testerCertName, hashFunction, challenge, elcount(challenge), ownerShip, ownerShipLength, errorMsg)!=1)
  {
    testStepFail("Fail","%s",errorMsg);
    return;
  }
  
  SID29_Authentication_proofOfOwnership(ownerShipLength,ownerShip,0,PHYSICAL);
  CheckPosResponse_SID29_proofOfOwnership(0x12,0,0);
  
  checkAuthenticateState(Authenticated);
  
  SID29_Authentication_deAuthenticate(PHYSICAL);
  CheckPosResponse_SID29_deAuthenticate(0x10,0,0);
  
  checkAuthenticateState(Deauthenticated);
  /******************************以上为测试步骤*********************************/
  Postcondition();
}
/// <Authentication_Test>
testcase Authentication_NRC54_Test()
{
  char logName[400] = "";
  char info[1024];
  
  byte OCSP_RID[2]={0x70,0x27};
  byte tempdata[3075];
  char errorMsg[500];
  byte challenge[32]={0xAD,0x95,0x37,0xF6,0xC8,0x04,0x56,0x99,0xCE,0x04,0x19,0x88,0x68,0x83,0xB3,0xA1};
  char hashFunction[10]="SHA-256";  
  
  byte testerCertByte[2000];
  dword testerCertByteLength;
  char testerCertString[4000];
  byte ownerShip[1000];
  dword ownerShipLength;
  char ownerShipString[2000];
  int i=0;
  strncat(logName,"Authentication_NRC54_Test",400);
  testCaseTitle("","Authentication_NRC54_Test");
  
  if(gBusFlag==5&&EthNodeTypeNow==EdgeNode)
  {
    
  }
  else
  {
    testStepWarning("Warning","This test case is only applicable for ETH_Edgenode");
    return;
  }
  
  SetLog(logName);
  Precondition();
   
  /******************************以下为测试步骤*********************************/

  SessionFlag=APP;
  
  checkAuthenticateState(Deauthenticated);
  
  SID29_Authentication_authenticationConfiguration(PHYSICAL);
  CheckPosResponse_SID29_authenticationConfiguration(0x2,0,0);
  
//  tempdata[0]=0x07;
//  tempdata[1]=0xFF;
//  tempdata[2049]=0x04;
//  tempdata[2050]=0x00;
//  SID31_RoutineControl(StartRoutine,OCSP_RID,tempdata,3075,PHYSICAL,SPRMIB_FALSE);
//  CheckPosResponse_SID31(StartRoutine,OCSP_RID,0,0);
  ocspCheckSequence();
  
  if(GetCertificateAsBinaryByName(testerCertName_NRC54, testerCertByte, testerCertByteLength, errorMsg)!=1)
  {
    testStepFail("Fail","%s",errorMsg);
    return;
  }
  SID29_Authentication_verifyCertificateUnidirectional(0,testerCertByteLength,testerCertByte,0,PHYSICAL);
  CheckNegResponse(0x54,0,0);

  
  if(GetCertificateAsBinaryByName(testerCertName, testerCertByte, testerCertByteLength, errorMsg)!=1)
  {
    testStepFail("Fail","%s",errorMsg);
    return;
  }
  SID29_Authentication_verifyCertificateUnidirectional(0,testerCertByteLength,testerCertByte,0,PHYSICAL);
  CheckPosResponse_SID29_verifyCertificateUnidirectional(0x11,0x20,challenge,0,0,0);
  
//  for(i=0;i<32;i++)
//  write("challengebyte=%x",challenge[i]);
  
  if(CreateOwnership(testerCertName, hashFunction, challenge, elcount(challenge), ownerShip, ownerShipLength, errorMsg)!=1)
  {
    testStepFail("Fail","%s",errorMsg);
    return;
  }
  
  SID29_Authentication_proofOfOwnership(ownerShipLength,ownerShip,0,PHYSICAL);
  CheckPosResponse_SID29_proofOfOwnership(0x12,0,0);
  
  checkAuthenticateState(Authenticated);
  
  SID29_Authentication_deAuthenticate(PHYSICAL);
  CheckPosResponse_SID29_deAuthenticate(0x10,0,0);
  
  checkAuthenticateState(Deauthenticated);
  /******************************以上为测试步骤*********************************/
  Postcondition();
}
/// <Authentication_Test>
testcase AuthenticationFunctionErgodic()
{
  char logName[400] = "";
  char info[1024];
  
  byte OCSP_RID[2]={0x70,0x27};
  byte tempdata[3075];
  
  byte testerCertByte[2000];
  dword testerCertByteLength;
  char testerCertString[4000];
  byte ownerShip[1000];
  dword ownerShipLength;
  char ownerShipString[2000];
  
  byte PID[2];
  int code;
  int  Result;
  char TemDescription[500];
  char Description[5000];
  int DesFlag;
  char Description2[5000];
  int DesFlag2;
  char Description1[5000];
  int DesFlag1;
  
  int  i,j,k;
  byte StuffByte[400];
  byte ExpectNRC[4]={0x33,0x22,0x70,0x10};
  byte ExpectNRC2[2]={0x33,0x24};
  int  NumOfLenth;

  char answer[100];
  byte Para[50];
  int tem1,tem2;
  
  byte ControlOptionRecord[1000];
  byte ControlEnableMaskRecord[1000];
  byte data[1];
  
  strncat(logName,"1371477 AuthenticationFunctionErgodic",400);
  testCaseTitle("1371477","AuthenticationFunctionErgodic");
  
  if(gBusFlag==5&&EthNodeTypeNow==EdgeNode)
  {
    
  }
  else
  {
    testStepWarning("Warning","This test case is only applicable for ETH_Edgenode");
    return;
  }
  
  SetLog(logName);
  Precondition();
   
  /******************************以下为测试步骤*********************************/
  
//***************************************************************************//
  SessionFlag=APP;
  
//22&2E
  
  for(i=10;i<0xFF;i++)
  {
    for(j=0;j<service_APP_Num;j++)
    {
      if(service_APP[j]==i)
      {
        data[0]=i;
        TPSendRawMessage(data,PHYSICAL);
        CheckNegResponse(0x34,0,0);
        break;
      }

    }
    for(j=0;j<service_PBL_Num;j++)
    {
      if(service_PBL[j]==i)
      {
        data[0]=i;
        TPSendRawMessage(data,PHYSICAL);
        CheckNegResponse(0x34,0,0);
        break;
      }

    }
  }

  for(i=0; i<NumOfReadDIDAPP; i++)
  {
    if(DIDOfReadAPP[i].Flag_Extended==0)
    {
      continue;
    }
    PID[0]=DIDOfReadAPP[i].DID>>8;
    PID[1]=DIDOfReadAPP[i].DID&0xFF;
    if((PID[0] == 0xD0)&&(PID[1] == 0x1C))
    {
      continue;
    }
    if((PID[0] == 0xD0)&&(PID[1] == 0x3A))
    {
      continue;
    }
    if((PID[0] == 0xF1)&&(PID[1] == 0x09))
    {
      continue;
    }
    if((PID[0] == 0xF1)&&(PID[1] == 0x0B))
    {
      continue;
    }
    if((PID[0] == 0xF1)&&(PID[1] == 0x0A))
    {
      continue;
    }
    
    if(checkAuthenticateState(Deauthenticated)!=2)
    {
      
    }
    else
    {
      AuthenticationFullSeq(testerCertName);
    }
    
    SID10_DiagnosticSessionControl(EXTENDEDSESSION,PHYSICAL,SPRMIB_FALSE);
    CheckPosResponse_SID10(EXTENDEDSESSION,gP2Client_APP,gP2StarClientFor10Check,0,0);
    
    testWaitForTimeout(gTimeWaitForSecuAccess);
    
    if(DIDOfReadAPP[i].SecuLevel!=0xFF)
    {
      SID27_SecurityAccess_RequestSeed(DIDOfReadAPP[i].SecuLevel,PHYSICAL);
      CheckPosResponse_SID27_ReqSeed(DIDOfReadAPP[i].SecuLevel,gSeedArray,16,0,0);
      SID27_SecurityAccess_SendKey(DIDOfReadAPP[i].SecuLevel,gKeyArray,PHYSICAL);
      CheckPosResponse_SID27_SenKey(DIDOfReadAPP[i].SecuLevel,0,0);
    }
    else
    {
      
    }
    
    Deauthenticate();
    
    TestStep("Read data",TestStepIntervalTime);
    SID22_ReadDataByIdentifier(PID,PHYSICAL);
    if(DIDOfReadAPP[i].AuthenticationFlag==0)
    {
      CheckPosResponse(0x22,0,0);
    }
    else
    {
      CheckNegResponse(0x34,0,0); 
    }
    
  }
  
  for(i=0;i<NumOfWriteDIDAPP;i++)
  {
    if(DIDOfWriteAPP[i].Flag_Extended==0)
    {
      continue;
    }
    PID[0]=DIDOfWriteAPP[i].DID>>8;
    PID[1]=DIDOfWriteAPP[i].DID&0xFF;
    if((PID[0] == 0xD0)&&(PID[1] == 0x1C))
    {
      continue;
    }
    if((PID[0] == 0xD0)&&(PID[1] == 0x3A))
    {
      continue;
    }
    if((PID[0] == 0xF1)&&(PID[1] == 0x09))
    {
      continue;
    }
    if((PID[0] == 0xF1)&&(PID[1] == 0x0B))
    {
      continue;
    }
    if((PID[0] == 0xF1)&&(PID[1] == 0x0A))
    {
      continue;
    }
    
    if(checkAuthenticateState(Deauthenticated)!=2)
    {
      
    }
    else
    {
      AuthenticationFullSeq(testerCertName);
    }
    
    SID10_DiagnosticSessionControl(EXTENDEDSESSION,PHYSICAL,SPRMIB_FALSE);
    CheckPosResponse_SID10(EXTENDEDSESSION,gP2Client_APP,gP2StarClientFor10Check,0,0);
    
    if(DIDOfWriteAPP[i].SecuLevel!=0xFF)
    {
      testWaitForTimeout(gTimeWaitForSecuAccess);
      
      SID27_SecurityAccess_RequestSeed(DIDOfWriteAPP[i].SecuLevel,PHYSICAL);
      CheckPosResponse_SID27_ReqSeed(DIDOfWriteAPP[i].SecuLevel,gSeedArray,16,0,0);
      SID27_SecurityAccess_SendKey(DIDOfWriteAPP[i].SecuLevel,gKeyArray,PHYSICAL);
      CheckPosResponse_SID27_SenKey(DIDOfWriteAPP[i].SecuLevel,0,0);
    }
      
    Deauthenticate();
    
    TestStep("Write data",TestStepIntervalTime);
    WriteTestData(DIDOfWriteAPP[i],PHYSICAL);
    if(DIDOfWriteAPP[i].AuthenticationFlag==0)
    {
      CheckPosResponse(0x2E,0,0);
    }
    else
    {
      CheckNegResponse(0x34,0,0); 
    }
    testWaitForTimeout(200);
  }
  
  
  

  for(i=0; i<NumOfReadDIDPBL; i++)
  {
    if(i!=0)
    {
      TestStep("Jump to Step 4 until all the dataIdentifiers in configured list are tested. Let Z1 Z2 = next dataIdentifier.",TestStepIntervalTime);
    }
    if(DIDOfReadPBL[i].Flag_Programming==0)
    {
      continue;
    }
    if((PID[0] == 0xD0)&&(PID[1] == 0x1C))
    {
      continue;
    }
    if((PID[0] == 0xD0)&&(PID[1] == 0x3A))
    {
      continue;
    }
    if((PID[0] == 0xF1)&&(PID[1] == 0x09))
    {
      continue;
    }
    if((PID[0] == 0xF1)&&(PID[1] == 0x0B))
    {
      continue;
    }
    if((PID[0] == 0xF1)&&(PID[1] == 0x0A))
    {
      continue;
    }
    
    if(checkAuthenticateState(Deauthenticated)!=2)
    {
      
    }
    else
    {
      AuthenticationFullSeq(testerCertName);
    }
    
    SID10_DiagnosticSessionControl(PROGRAMMINGSESSION,PHYSICAL,SPRMIB_FALSE);
    CheckPosResponse_SID10(PROGRAMMINGSESSION,gP2Client_BOOT,gP2StarClientFor10Check,0,0);
    ECUinitHandle(0);
    
    SessionFlag=BOOT;
    
    TestStep("Verify ProgrammingDiagnosticSession.",TestStepIntervalTime);
    CheckCurrentSession(PROGRAMMINGSESSION,PHYSICAL,0,0);
    
    
    PID[0]=DIDOfReadPBL[i].DID>>8;
    PID[1]=DIDOfReadPBL[i].DID&0xFF;

    Deauthenticate();
    
    TestStep("Read data",TestStepIntervalTime);
    SID22_ReadDataByIdentifier(PID,PHYSICAL);
    if(DIDOfReadPBL[i].AuthenticationFlag==0)
    {
      CheckPosResponse(0x22,0,0);
    }
    else
    {
      CheckNegResponse(0x34,0,0); 
    }
  }
  
  for(i=0;i<NumOfWriteDIDPBL;i++)
  {
    if(DIDOfWritePBL[i].Flag_Programming==0)
    {
      continue;
    }
    if(DIDOfReadPBL[i].Flag_Programming==0)
    {
      continue;
    }
    if(DIDOfReadPBL[i].AuthenticationFlag==0)
    {
      continue;
    }
    if((PID[0] == 0xD0)&&(PID[1] == 0x1C))
    {
      continue;
    }
    if((PID[0] == 0xD0)&&(PID[1] == 0x3A))
    {
      continue;
    }
    if((PID[0] == 0xF1)&&(PID[1] == 0x09))
    {
      continue;
    }
    if((PID[0] == 0xF1)&&(PID[1] == 0x0B))
    {
      continue;
    }
    if((PID[0] == 0xF1)&&(PID[1] == 0x0A))
    {
      continue;
    }
    
    if(checkAuthenticateState(Deauthenticated)!=2)
    {
      
    }
    else
    {
      AuthenticationFullSeq(testerCertName);
    }
    SID10_DiagnosticSessionControl(PROGRAMMINGSESSION,PHYSICAL,SPRMIB_FALSE);
    CheckPosResponse_SID10(PROGRAMMINGSESSION,gP2Client_BOOT,gP2StarClientFor10Check,0,0);
    ECUinitHandle(0);
    
    SessionFlag=BOOT;
    
    TestStep("Verify ProgrammingDiagnosticSession.",TestStepIntervalTime);
    CheckCurrentSession(PROGRAMMINGSESSION,PHYSICAL,0,0);
     
    if(DIDOfWritePBL[i].SecuLevel!=0xFF)
    {
      testWaitForTimeout(gTimeWaitForSecuAccess);
      
      SID27_SecurityAccess_RequestSeed(DIDOfWritePBL[i].SecuLevel,PHYSICAL);
      CheckPosResponse_SID27_ReqSeed(DIDOfWritePBL[i].SecuLevel,gSeedArray,16,0,0);
      SID27_SecurityAccess_SendKey(DIDOfWritePBL[i].SecuLevel,gKeyArray,PHYSICAL);
      CheckPosResponse_SID27_SenKey(DIDOfWritePBL[i].SecuLevel,0,0);
    }
    
    Deauthenticate();
    
    PID[0]=DIDOfWritePBL[i].DID>>8;
    PID[1]=DIDOfWritePBL[i].DID&0xFF;    

    TestStep("Write data",TestStepIntervalTime);
    WriteTestData(DIDOfWritePBL[i],PHYSICAL);
    if(DIDOfWritePBL[i].AuthenticationFlag==0)
    {
      CheckPosResponse(0x2E,0,0);
    }
    else
    {
      CheckNegResponse(0x34,0,0);
    }
  }
  TestStep("Verify ProgrammingDiagnosticSession.",TestStepIntervalTime);
  CheckCurrentSession(PROGRAMMINGSESSION,PHYSICAL,0,0);
//22&2E
  
 
//2F
  SID10_DiagnosticSessionControl(DEFAULTSESSION,PHYSICAL,SPRMIB_FALSE);
  CheckPosResponse_SID10(DEFAULTSESSION,gP2Client_APP,gP2StarClientFor10Check,0,0);
  ECUinitHandle(0);

  SessionFlag=APP;
  
  for(i=0; i<NumOfIO; i++)
  {
    PID[0]=IODID[i].DID>>8;
    PID[1]=IODID[i].DID&0xFF;
    if(IODID[i].SelectFlag != 1)
    {
      continue;
    }
    else
    {
      NumOfLenth = IODID[i].RequestLenth;
    }
    
    if(checkAuthenticateState(Deauthenticated)!=2)
    {
      
    }
    else
    {
      AuthenticationFullSeq(testerCertName);
    }
    
    SID10_DiagnosticSessionControl(EXTENDEDSESSION,PHYSICAL,SPRMIB_FALSE);
    CheckPosResponse_SID10(EXTENDEDSESSION,gP2Client_APP,gP2StarClientFor10Check,0,0);
    
    if(IODID[i].SecuLevel!=0xFF)
    {
      testWaitForTimeout(gTimeWaitForSecuAccess);
      
      SID27_SecurityAccess_RequestSeed(IODID[i].SecuLevel,PHYSICAL);
      CheckPosResponse_SID27_ReqSeed(IODID[i].SecuLevel,gSeedArray,16,0,0);
      SID27_SecurityAccess_SendKey(IODID[i].SecuLevel,gKeyArray,PHYSICAL);
      CheckPosResponse_SID27_SenKey(IODID[i].SecuLevel,0,0);    
    }
//
    Deauthenticate();
    
    if(IODID[i].Flag_Ser03==1)
    {
      TestStep("return control to ECU",TestStepIntervalTime);
      SID2F_IOControl(PID,0x00,ControlOptionRecord,0,ControlEnableMaskRecord,0,PHYSICAL);
      if(IODID[i].AuthenticationFlag != 1)
      {
        CheckPosResponse(0x2F,0,0);
      }
      else
      {
        CheckNegResponse(0x34,0,0);
      }
      
      
      TestStep("Short term adjustment",TestStepIntervalTime);
      SID2F_IOControl(PID,0x03,ControlOptionRecord,NumOfLenth,ControlEnableMaskRecord,0,PHYSICAL);
      if(IODID[i].AuthenticationFlag != 1)
      {
        CheckPosResponse(0x2F,0,0);
      }
      else
      {
        CheckNegResponse(0x34,0,0);
      }
      
      TestStep("Short term adjustment",TestStepIntervalTime);
      SID2F_IOControl(PID,0x03,ControlOptionRecord,NumOfLenth,ControlEnableMaskRecord,0,PHYSICAL);
      if(IODID[i].AuthenticationFlag != 1)
      {
        CheckPosResponse(0x2F,0,0);
      }
      else
      {
        CheckNegResponse(0x34,0,0);
      }
      
      TestStep("return control to ECU",TestStepIntervalTime);
      SID2F_IOControl(PID,0x00,ControlOptionRecord,0,ControlEnableMaskRecord,0,PHYSICAL);
      if(IODID[i].AuthenticationFlag != 1)
      {
        CheckPosResponse(0x2F,0,0);
      }
      else
      {
        CheckNegResponse(0x34,0,0);
      }
    }
    
    if(IODID[i].Flag_Ser02==1)
    {
      TestStep("freeze current state",TestStepIntervalTime);
      SID2F_IOControl(PID,0x02,ControlOptionRecord,0,ControlEnableMaskRecord,0,PHYSICAL);
      if(IODID[i].AuthenticationFlag != 1)
      {
        CheckPosResponse(0x2F,0,0);
      }
      else
      {
        CheckNegResponse(0x34,0,0);
      }
      
      TestStep("return control to ECU",TestStepIntervalTime);
      SID2F_IOControl(PID,0x00,ControlOptionRecord,0,ControlEnableMaskRecord,0,PHYSICAL);
      if(IODID[i].AuthenticationFlag != 1)
      {
        CheckPosResponse(0x2F,0,0);
      }
      else
      {
        CheckNegResponse(0x34,0,0);
      }
    }
  }
//2F
  
  
//31
  for(i=0;i<NumOfRoutine_Sub0x01;i++)//遍历所有例程
  {
    if(Routine_Sub0x01[i].Flag_Ser03 != 1)
    {
      continue;
    }
    
    if(checkAuthenticateState(Deauthenticated)!=2)
    {
      
    }
    else
    {
      AuthenticationFullSeq(testerCertName);
    }
    
    SID10_DiagnosticSessionControl(EXTENDEDSESSION,PHYSICAL,SPRMIB_FALSE);
    CheckPosResponse_SID10(EXTENDEDSESSION,gP2Client_APP,gP2StarClientFor10Check,0,0);
    
    if(Routine_Sub0x01[i].SecuLevel!=0xFF)
    {

      
      testWaitForTimeout(gTimeWaitForSecuAccess);
      
      SID27_SecurityAccess_RequestSeed(Routine_Sub0x01[i].SecuLevel,PHYSICAL);
      CheckPosResponse_SID27_ReqSeed(Routine_Sub0x01[i].SecuLevel,gSeedArray,16,0,0);
      SID27_SecurityAccess_SendKey(Routine_Sub0x01[i].SecuLevel,gKeyArray,PHYSICAL);
      CheckPosResponse_SID27_SenKey(Routine_Sub0x01[i].SecuLevel,2,0,0);
    }
    
    Deauthenticate();
    
    if(Routine_Sub0x01[i].routinetype == 1)//筛选所有例程类型为1的例程
    {
      tem1 = 0;
      PID[0]=Routine_Sub0x01[i].DID>>8;
      PID[1]=Routine_Sub0x01[i].DID&0xFF;
      for(j=0;j<NumOfRoutine_Sub0x03;j++)//找到该例程是否支持03子功能
      {
        if(Routine_Sub0x01[i].DID == Routine_Sub0x03[j].DID)
        {
          tem1 = 1;
          break;
        }  
      }
      
      SID31_RoutineControl(StartRoutine,PID,Routine_Sub0x01[i].requestData,Routine_Sub0x01[i].RequestLenth,PHYSICAL,SPRMIB_FALSE);//正常请求
      if(Routine_Sub0x01[i].AuthenticationFlag != 1)
      {
        CheckPosResponse(0x31,0,0);
      }  
      else
      {
       CheckNegResponse(0x34,0,0); 
      }
      

      testWaitForTimeout(2000);
      
      if(tem1 == 1)
      {
        SID31_RoutineControl(RequestRoutineResult,PID,Routine_Sub0x03[j].requestData,Routine_Sub0x03[j].RequestLenth,PHYSICAL,SPRMIB_FALSE);
        if(Routine_Sub0x01[i].AuthenticationFlag != 1)
        {
          CheckPosResponse(0x31,0,0);
        }  
        else
        {
         CheckNegResponse(0x34,0,0); 
        }
      }
      
    }
    else if(Routine_Sub0x01[i].routinetype == 2)//筛选所有例程类型为2的例程
    {
      tem1 = 0;tem2 = 0;
      PID[0]=Routine_Sub0x01[i].DID>>8;
      PID[1]=Routine_Sub0x01[i].DID&0xFF;
      for(j=0;j<NumOfRoutine_Sub0x03;j++)//找到该例程是否支持03子功能
      {
        if(Routine_Sub0x01[i].DID == Routine_Sub0x03[j].DID)
        {
          tem1 = 1;
          break;
        }

      }
      for(k=0;k<NumOfRoutine_Sub0x02;k++)//找到该例程是否支持02子功能
      {
        if(Routine_Sub0x01[i].DID == Routine_Sub0x02[k].DID)
        {
          tem2 = 1;
          break;
        }

      }
      
      SID31_RoutineControl(StartRoutine,PID,Routine_Sub0x01[i].requestData,Routine_Sub0x01[i].RequestLenth,PHYSICAL,SPRMIB_FALSE);//正常请求
      if(Routine_Sub0x01[i].AuthenticationFlag != 1)
      {
        CheckPosResponse(0x31,0,0);
      }  
      else
      {
       CheckNegResponse(0x34,0,0); 
      }
      
      SID31_RoutineControl(RequestRoutineResult,PID,Routine_Sub0x03[j].requestData,Routine_Sub0x03[j].RequestLenth,PHYSICAL,SPRMIB_FALSE);//正常请求
      if(Routine_Sub0x01[i].AuthenticationFlag != 1)
      {
        CheckPosResponse(0x31,0,0);
      }  
      else
      {
       CheckNegResponse(0x34,0,0); 
      }
   
      if(tem2 == 1)//直接发送31 02
      {
        SID31_RoutineControl(StopRoutine,PID,Routine_Sub0x02[k].requestData,Routine_Sub0x02[k].RequestLenth,PHYSICAL,SPRMIB_FALSE);//正常请求
        if(Routine_Sub0x01[i].AuthenticationFlag != 1)
        {
          CheckPosResponse(0x31,0,0);
        }  
        else
        {
         CheckNegResponse(0x34,0,0); 
        }
      }
    }
    else if(Routine_Sub0x01[i].routinetype == 3)//筛选所有例程类型为3的例程
    {
      tem1 = 0;tem2 = 0;
      PID[0]=Routine_Sub0x01[i].DID>>8;
      PID[1]=Routine_Sub0x01[i].DID&0xFF;
      for(j=0;j<NumOfRoutine_Sub0x03;j++)//找到该例程是否支持03子功能
      {
        if(Routine_Sub0x01[i].DID == Routine_Sub0x03[j].DID)
        {
          tem1 = 1;
          break;
        }

      }
      for(k=0;k<NumOfRoutine_Sub0x02;k++)//找到该例程是否支持02子功能
      {
        if(Routine_Sub0x01[i].DID == Routine_Sub0x02[k].DID)
        {
          tem2 = 1;
          break;
        }
      }
      
      SID31_RoutineControl(StartRoutine,PID,Routine_Sub0x01[i].requestData,Routine_Sub0x01[i].RequestLenth,PHYSICAL,SPRMIB_FALSE);//正常请求
      CheckNegResponse(0x34,0,0);
      
      if(tem2 == 1)//发送31 03
      {
        SID31_RoutineControl(RequestRoutineResult,PID,Routine_Sub0x03[j].requestData,Routine_Sub0x03[j].RequestLenth,PHYSICAL,SPRMIB_FALSE);//正常请求
        if(Routine_Sub0x01[i].AuthenticationFlag != 1)
        {
          CheckPosResponse(0x31,0,0);
        }  
        else
        {
         CheckNegResponse(0x34,0,0); 
        }
      }
      
      if(tem1 == 1)//直接发送31 02
      {
        SID31_RoutineControl(StopRoutine,PID,Routine_Sub0x02[k].requestData,Routine_Sub0x02[k].RequestLenth,PHYSICAL,SPRMIB_FALSE);//正常请求
        if(Routine_Sub0x01[i].AuthenticationFlag != 1)
        {
          CheckPosResponse(0x31,0,0);
        }  
        else
        {
         CheckNegResponse(0x34,0,0); 
        }
      }
      
      if(tem2 == 1)//发送31 03
      {
        SID31_RoutineControl(RequestRoutineResult,PID,Routine_Sub0x03[j].requestData,Routine_Sub0x03[j].RequestLenth,PHYSICAL,SPRMIB_FALSE);//正常请求
      }     
    }
  }
  
  for(i=0;i<NumOfRoutine_Sub0x01;i++)//遍历所有例程
  {
    if(Routine_Sub0x01[i].Flag_Ser02 != 1)
    {
      continue;
    }
    
    if(checkAuthenticateState(Deauthenticated)!=2)
    {
      
    }
    else
    {
      AuthenticationFullSeq(testerCertName);
    }
    
    SID10_DiagnosticSessionControl(PROGRAMMINGSESSION,PHYSICAL,SPRMIB_FALSE);
    CheckPosResponse_SID10(PROGRAMMINGSESSION,gP2Client_BOOT,gP2StarClientFor10Check,0,0);
    
    SessionFlag=BOOT;
    
    if(Routine_Sub0x01[i].SecuLevel!=0xFF)
    {
      testWaitForTimeout(gTimeWaitForSecuAccess);
      
      SID27_SecurityAccess_RequestSeed(Routine_Sub0x01[i].SecuLevel,PHYSICAL);
      CheckPosResponse_SID27_ReqSeed(Routine_Sub0x01[i].SecuLevel,gSeedArray,16,0,0);
      SID27_SecurityAccess_SendKey(Routine_Sub0x01[i].SecuLevel,gKeyArray,PHYSICAL);
      CheckPosResponse_SID27_SenKey(Routine_Sub0x01[i].SecuLevel,2,0,0);
    }
     
    Deauthenticate();
    
    if(Routine_Sub0x01[i].routinetype == 1)//筛选所有例程类型为1的例程
    {
      tem1 = 0;
      PID[0]=Routine_Sub0x01[i].DID>>8;
      PID[1]=Routine_Sub0x01[i].DID&0xFF;
      for(j=0;j<NumOfRoutine_Sub0x03;j++)//找到该例程是否支持03子功能
      {
        if(Routine_Sub0x01[i].DID == Routine_Sub0x03[j].DID)
        {
          tem1 = 1;
          break;
        }  
      }
      
      SID31_RoutineControl(StartRoutine,PID,Routine_Sub0x01[i].requestData,Routine_Sub0x01[i].RequestLenth,PHYSICAL,SPRMIB_FALSE);//正常请求
      if(Routine_Sub0x01[i].AuthenticationFlag != 1)
      {
        CheckPosResponse(0x31,0,0);
      }  
      else
      {
       CheckNegResponse(0x34,0,0); 
      }

      testWaitForTimeout(2000);
      
      if(tem1 == 1)
      {
        SID31_RoutineControl(RequestRoutineResult,PID,Routine_Sub0x03[j].requestData,Routine_Sub0x03[j].RequestLenth,PHYSICAL,SPRMIB_FALSE);
        if(Routine_Sub0x01[i].AuthenticationFlag != 1)
        {
          CheckPosResponse(0x31,0,0);
        }  
        else
        {
         CheckNegResponse(0x34,0,0); 
        }
      }
      
    }
    else if(Routine_Sub0x01[i].routinetype == 2)//筛选所有例程类型为2的例程
    {
      tem1 = 0;tem2 = 0;
      PID[0]=Routine_Sub0x01[i].DID>>8;
      PID[1]=Routine_Sub0x01[i].DID&0xFF;
      for(j=0;j<NumOfRoutine_Sub0x03;j++)//找到该例程是否支持03子功能
      {
        if(Routine_Sub0x01[i].DID == Routine_Sub0x03[j].DID)
        {
          tem1 = 1;
          break;
        }

      }
      for(k=0;k<NumOfRoutine_Sub0x02;k++)//找到该例程是否支持02子功能
      {
        if(Routine_Sub0x01[i].DID == Routine_Sub0x02[k].DID)
        {
          tem2 = 1;
          break;
        }

      }
      
      SID31_RoutineControl(StartRoutine,PID,Routine_Sub0x01[i].requestData,Routine_Sub0x01[i].RequestLenth,PHYSICAL,SPRMIB_FALSE);//正常请求
      if(Routine_Sub0x01[i].AuthenticationFlag != 1)
      {
        CheckPosResponse(0x31,0,0);
      }  
      else
      {
       CheckNegResponse(0x34,0,0); 
      }
      
      SID31_RoutineControl(RequestRoutineResult,PID,Routine_Sub0x03[j].requestData,Routine_Sub0x03[j].RequestLenth,PHYSICAL,SPRMIB_FALSE);//正常请求
      if(Routine_Sub0x01[i].AuthenticationFlag != 1)
      {
        CheckPosResponse(0x31,0,0);
      }  
      else
      {
       CheckNegResponse(0x34,0,0); 
      }
   
      if(tem2 == 1)//直接发送31 02
      {
        SID31_RoutineControl(StopRoutine,PID,Routine_Sub0x02[k].requestData,Routine_Sub0x02[k].RequestLenth,PHYSICAL,SPRMIB_FALSE);//正常请求
        if(Routine_Sub0x01[i].AuthenticationFlag != 1)
        {
          CheckPosResponse(0x31,0,0);
        }  
        else
        {
         CheckNegResponse(0x34,0,0); 
        }
      }
    }
    else if(Routine_Sub0x01[i].routinetype == 3)//筛选所有例程类型为3的例程
    {
      tem1 = 0;tem2 = 0;
      PID[0]=Routine_Sub0x01[i].DID>>8;
      PID[1]=Routine_Sub0x01[i].DID&0xFF;
      for(j=0;j<NumOfRoutine_Sub0x03;j++)//找到该例程是否支持03子功能
      {
        if(Routine_Sub0x01[i].DID == Routine_Sub0x03[j].DID)
        {
          tem1 = 1;
          break;
        }

      }
      for(k=0;k<NumOfRoutine_Sub0x02;k++)//找到该例程是否支持02子功能
      {
        if(Routine_Sub0x01[i].DID == Routine_Sub0x02[k].DID)
        {
          tem2 = 1;
          break;
        }
      }  
      SID31_RoutineControl(StartRoutine,PID,Routine_Sub0x01[i].requestData,Routine_Sub0x01[i].RequestLenth,PHYSICAL,SPRMIB_FALSE);//正常请求
      if(Routine_Sub0x01[i].AuthenticationFlag != 1)
      {
        CheckPosResponse(0x31,0,0);
      }  
      else
      {
       CheckNegResponse(0x34,0,0); 
      }
      
      if(tem2 == 1)//发送31 03
      {
        SID31_RoutineControl(RequestRoutineResult,PID,Routine_Sub0x03[j].requestData,Routine_Sub0x03[j].RequestLenth,PHYSICAL,SPRMIB_FALSE);//正常请求
        if(Routine_Sub0x01[i].AuthenticationFlag != 1)
        {
          CheckPosResponse(0x31,0,0);
        }  
        else
        {
         CheckNegResponse(0x34,0,0); 
        }
      }
      
      if(tem1 == 1)//直接发送31 02
      {
        SID31_RoutineControl(StopRoutine,PID,Routine_Sub0x02[k].requestData,Routine_Sub0x02[k].RequestLenth,PHYSICAL,SPRMIB_FALSE);//正常请求
        if(Routine_Sub0x01[i].AuthenticationFlag != 1)
        {
          CheckPosResponse(0x31,0,0);
        }  
        else
        {
         CheckNegResponse(0x34,0,0); 
        }
      }
      
      if(tem2 == 1)//发送31 03
      {
        SID31_RoutineControl(RequestRoutineResult,PID,Routine_Sub0x03[j].requestData,Routine_Sub0x03[j].RequestLenth,PHYSICAL,SPRMIB_FALSE);//正常请求
        if(Routine_Sub0x01[i].AuthenticationFlag != 1)
        {
          CheckPosResponse(0x31,0,0);
        }  
        else
        {
         CheckNegResponse(0x34,0,0); 
        }
      }     
    }
  }
//31
  
//***************************************************************************//
  if(checkAuthenticateState(Authenticated)==2)
  {
    
  }
  else
  {
    AuthenticationFullSeq(testerCertName);
  }
  
  SID10_DiagnosticSessionControl(DEFAULTSESSION,PHYSICAL,SPRMIB_FALSE);
  CheckPosResponse_SID10(DEFAULTSESSION,gP2Client_APP,gP2StarClientFor10Check,0,0);
  ECUinitHandle(0);

  SessionFlag=APP;
//22&2E
  SID10_DiagnosticSessionControl(DEFAULTSESSION,PHYSICAL,SPRMIB_FALSE);
  CheckPosResponse_SID10(DEFAULTSESSION,gP2Client_APP,gP2StarClientFor10Check,0,0);
  TestStep("Transition from defaultSession(0x01) to extendedDiagnosticSession(0x03).",TestStepIntervalTime);
  SID10_DiagnosticSessionControl(EXTENDEDSESSION,PHYSICAL,SPRMIB_FALSE);
  CheckPosResponse_SID10(EXTENDEDSESSION,gP2Client_APP,gP2StarClientFor10Check,0,0);
  TestStep("Verify extendedDiagnosticSession.",TestStepIntervalTime);
  CheckCurrentSession(EXTENDEDSESSION,PHYSICAL,0,0);
  for(i=0; i<NumOfReadDIDAPP; i++)
  {
    if(DIDOfReadAPP[i].Flag_Extended==0)
    {
      continue;
    }
    if(DIDOfReadAPP[i].AuthenticationFlag==0)
    {
      continue;
    }
    PID[0]=DIDOfReadAPP[i].DID>>8;
    PID[1]=DIDOfReadAPP[i].DID&0xFF;
    if((PID[0] == 0xD0)&&(PID[1] == 0x1C))
    {
      continue;
    }
    if((PID[0] == 0xD0)&&(PID[1] == 0x3A))
    {
      continue;
    }
    if((PID[0] == 0xF1)&&(PID[1] == 0x09))
    {
      continue;
    }
    if((PID[0] == 0xF1)&&(PID[1] == 0x0B))
    {
      continue;
    }
    if((PID[0] == 0xF1)&&(PID[1] == 0x0A))
    {
      continue;
    }
    
    if(i!=0)
    {
      TestStep("Jump to Step 4 until all the dataIdentifiers in the configured list are tested. Let Z1 Z2 = next dataIdentifier",TestStepIntervalTime,4);
    }
    
    if(DIDOfReadAPP[i].SecuLevel!=0xFF)
    {
      SID10_DiagnosticSessionControl(EXTENDEDSESSION,PHYSICAL,SPRMIB_FALSE);
      CheckPosResponse_SID10(EXTENDEDSESSION,gP2Client_APP,gP2StarClientFor10Check,0,0);
      
      testWaitForTimeout(gTimeWaitForSecuAccess);
      
      SID27_SecurityAccess_RequestSeed(DIDOfReadAPP[i].SecuLevel,PHYSICAL);
      CheckPosResponse_SID27_ReqSeed(DIDOfReadAPP[i].SecuLevel,gSeedArray,16,0,0);
      SID27_SecurityAccess_SendKey(DIDOfReadAPP[i].SecuLevel,gKeyArray,PHYSICAL);
      CheckPosResponse_SID27_SenKey(DIDOfReadAPP[i].SecuLevel,0,0);
    }
    TestStep("Read data",TestStepIntervalTime);
    SID22_ReadDataByIdentifier(PID,PHYSICAL);
    Result=CheckPosResponse_SID22(PID,DIDOfReadAPP[i].Lenth,0,0); 
    if(Result>0)
    {
      CheckParametersCoding(DIDOfReadAPP[i]);
      if(DIDOfReadAPP[i].Lenth != (gTpRxLength-3))
      {
        DesFlag = 1;
        snprintf(TemDescription,400,"[%02x %02x] ,",PID[0],PID[1]);
        strncat(Description,TemDescription,5000);
      TestStepFail("","Expect lenth is %d but get lenth is %d",DIDOfReadAPP[i].Lenth,gTpRxLength-3);
      }
      else
      {
        TestStepPass("","Expect lenth is %d and get lenth is %d",DIDOfReadAPP[i].Lenth,gTpRxLength-3);
      }
    }
    else
    {
      DesFlag2 = 1;
      snprintf(TemDescription,400,"[%02x %02x] ,",PID[0],PID[1]);
      strncat(Description2,TemDescription,5000);
    }
  }
  SID10_DiagnosticSessionControl(EXTENDEDSESSION,PHYSICAL,SPRMIB_FALSE);
  CheckPosResponse_SID10(EXTENDEDSESSION,gP2Client_APP,gP2StarClientFor10Check,0,0);
  DesFlag1 = 0;
  snprintf(Description1,400,"The following DIDs gives wrong response for service 0x2E:");
  
  for(i=0;i<NumOfWriteDIDAPP;i++)
  {
    if(DIDOfWriteAPP[i].Flag_Extended==0)
    {
      continue;
    }
    if(DIDOfWriteAPP[i].AuthenticationFlag==0)
    {
      continue;
    }
    PID[0]=DIDOfWriteAPP[i].DID>>8;
    PID[1]=DIDOfWriteAPP[i].DID&0xFF;
    if((PID[0] == 0xD0)&&(PID[1] == 0x1C))
    {
      continue;
    }
    if((PID[0] == 0xD0)&&(PID[1] == 0x3A))
    {
      continue;
    }
    if((PID[0] == 0xF1)&&(PID[1] == 0x09))
    {
      continue;
    }
    if((PID[0] == 0xF1)&&(PID[1] == 0x0B))
    {
      continue;
    }
    if((PID[0] == 0xF1)&&(PID[1] == 0x0A))
    {
      continue;
    }
      
    if(DIDOfWriteAPP[i].SecuLevel!=0xFF)
    {
      SID10_DiagnosticSessionControl(EXTENDEDSESSION,PHYSICAL,SPRMIB_FALSE);
      CheckPosResponse_SID10(EXTENDEDSESSION,gP2Client_APP,gP2StarClientFor10Check,0,0);
      
      testWaitForTimeout(gTimeWaitForSecuAccess);
      
      SID27_SecurityAccess_RequestSeed(DIDOfWriteAPP[i].SecuLevel,PHYSICAL);
      CheckPosResponse_SID27_ReqSeed(DIDOfWriteAPP[i].SecuLevel,gSeedArray,16,0,0);
      SID27_SecurityAccess_SendKey(DIDOfWriteAPP[i].SecuLevel,gKeyArray,PHYSICAL);
      CheckPosResponse_SID27_SenKey(DIDOfWriteAPP[i].SecuLevel,0,0);
    }
      
    SID22_ReadDataByIdentifier(PID,PHYSICAL);
    CheckPosResponse_SID22(PID,DIDOfWriteAPP[i].Lenth,0,0);
    RecordData();
    TestStep("Write data",TestStepIntervalTime);
    WriteTestData(DIDOfWriteAPP[i],PHYSICAL);
    if(CheckNegResponse(ExpectNRC,1,0,0,0)==0)
    {
      TestStep("The DID is not writable in active session.",TestStepIntervalTime);
      continue;
    }
    
    TestStep("Read data",TestStepIntervalTime);
    SID22_ReadDataByIdentifier(PID,PHYSICAL);
    CheckPosResponse_SID22(PID,DIDOfWriteAPP[i].Lenth,0,0);
    ComTestData();
    
    testWaitForTimeout(500);
    
//    SID11_ECUReset(HARDRESET,PHYSICAL,SPRMIB_FALSE);
//    CheckPosResponse_SID11(HARDRESET,0,0);
    
    ECUinitHandle(0);
    
    SID10_DiagnosticSessionControl(EXTENDEDSESSION,PHYSICAL,SPRMIB_FALSE);
    CheckPosResponse_SID10(EXTENDEDSESSION,gP2Client_APP,gP2StarClientFor10Check,0,0);
    
    if(DIDOfWriteAPP[i].SecuLevel!=0xFF)
    {
    
    testWaitForTimeout(gTimeWaitForSecuAccess);
    
    SID27_SecurityAccess_RequestSeed(DIDOfWriteAPP[i].SecuLevel,PHYSICAL);
    CheckPosResponse_SID27_ReqSeed(DIDOfWriteAPP[i].SecuLevel,gSeedArray,16,0,0);
    SID27_SecurityAccess_SendKey(DIDOfWriteAPP[i].SecuLevel,gKeyArray,PHYSICAL);
    CheckPosResponse_SID27_SenKey(DIDOfWriteAPP[i].SecuLevel,0,0);
    
    }
    
    SID22_ReadDataByIdentifier(PID,PHYSICAL);
    CheckPosResponse_SID22(PID,DIDOfWriteAPP[i].Lenth,0,0);
    
    ComTestData();
    
    WritePreviousData(PHYSICAL);
    CheckPosResponse_SID2E(PID,0,0);
    //TestStep("Data recover",TestStepIntervalTime);
    SID22_ReadDataByIdentifier(PID,PHYSICAL);
    CheckPosResponse_SID22(PID,DIDOfWriteAPP[i].Lenth,0,0);
  }
  
  if(DesFlag == 1)
  {
    TestStep(Description);
  }
  if(DesFlag1 == 1)
  {
    TestStep(Description1);
  }
  if(DesFlag2 == 1)
  {
    TestStep(Description2);
  }
  
  SessionFlag=BOOT;
  
  
  TestStep("Transition from defaultSession(0x01) to ProgrammingDiagnosticSession(0x02).",TestStepIntervalTime);
  SID10_DiagnosticSessionControl(PROGRAMMINGSESSION,PHYSICAL,SPRMIB_FALSE);
  CheckPosResponse_SID10(PROGRAMMINGSESSION,gP2Client_BOOT,gP2StarClientFor10Check,0,0);
  ECUinitHandle(0);
  TestStep("Verify ProgrammingDiagnosticSession.",TestStepIntervalTime);
  CheckCurrentSession(PROGRAMMINGSESSION,PHYSICAL,0,0);
  for(i=0; i<NumOfReadDIDPBL; i++)
  {
    
    if(i!=0)
    {
      TestStep("Jump to Step 4 until all the dataIdentifiers in configured list are tested. Let Z1 Z2 = next dataIdentifier.",TestStepIntervalTime);
    }
    if(DIDOfReadPBL[i].Flag_Programming==0)
    {
      continue;
    }
    if(DIDOfReadPBL[i].AuthenticationFlag==0)
    {
      continue;
    }
    if((PID[0] == 0xD0)&&(PID[1] == 0x1C))
    {
      continue;
    }
    if((PID[0] == 0xD0)&&(PID[1] == 0x3A))
    {
      continue;
    }
    if((PID[0] == 0xF1)&&(PID[1] == 0x09))
    {
      continue;
    }
    if((PID[0] == 0xF1)&&(PID[1] == 0x0B))
    {
      continue;
    }
    if((PID[0] == 0xF1)&&(PID[1] == 0x0A))
    {
      continue;
    }
    
    PID[0]=DIDOfReadPBL[i].DID>>8;
    PID[1]=DIDOfReadPBL[i].DID&0xFF;
    if((PID[0] == 0xD0)&&(PID[1] == 0x1C))
    {
      continue;
    }
    TestStep("Read data",TestStepIntervalTime);
    SID22_ReadDataByIdentifier(PID,PHYSICAL);
    if((PID[0] == 0xD0)&&(PID[0] == 0x1C))
    {
     testWaitForTimeout(500);
    }
    else
    {
     Result=CheckPosResponse_SID22(PID,DIDOfReadPBL[i].Lenth,0,0); 
    }
    if(Result>0)
    {
    CheckParametersCoding(DIDOfReadPBL[i]);
    if(DIDOfReadPBL[i].Lenth!=(gTpRxLength-3))
      TestStepFail("Fail","Expect lenth is %d and get lenth is %d",DIDOfReadPBL[i].Lenth,gTpRxLength-3);
    else
      TestStepPass("Pass","Expect lenth is %d and get lenth is %d",DIDOfReadPBL[i].Lenth,gTpRxLength-3);
    }
    
    TestStep("","Expect lenth is %d and get lenth is %d",DIDOfReadPBL[i].Lenth,gTpRxLength-3);
  }
  
  for(i=0;i<NumOfWriteDIDPBL;i++)
  {
    if(DIDOfWritePBL[i].Flag_Programming==0)
    {
      continue;
    }
    if(DIDOfWritePBL[i].AuthenticationFlag==0)
    {
      continue;
    }
    if(DIDOfReadPBL[i].Flag_Programming==0)
    {
      continue;
    }
    if(DIDOfReadPBL[i].AuthenticationFlag==0)
    {
      continue;
    }
    if((PID[0] == 0xD0)&&(PID[1] == 0x1C))
    {
      continue;
    }
    if((PID[0] == 0xD0)&&(PID[1] == 0x3A))
    {
      continue;
    }
    if((PID[0] == 0xF1)&&(PID[1] == 0x09))
    {
      continue;
    }
    if((PID[0] == 0xF1)&&(PID[1] == 0x0B))
    {
      continue;
    }
    if((PID[0] == 0xF1)&&(PID[1] == 0x0A))
    {
      continue;
    }
    PID[0]=DIDOfWritePBL[i].DID>>8;
    PID[1]=DIDOfWritePBL[i].DID&0xFF;
      
    if(DIDOfWritePBL[i].SecuLevel!=0xFF)
    {
      SID10_DiagnosticSessionControl(PROGRAMMINGSESSION,PHYSICAL,SPRMIB_FALSE);
      CheckPosResponse_SID10(PROGRAMMINGSESSION,gP2Client_BOOT,gP2StarClientFor10Check,0,0);
      ECUinitHandle(0);
      TestStep("Verify ProgrammingDiagnosticSession.",TestStepIntervalTime);
      CheckCurrentSession(PROGRAMMINGSESSION,PHYSICAL,0,0);
        
      testWaitForTimeout(gTimeWaitForSecuAccess);
      
      SID27_SecurityAccess_RequestSeed(DIDOfWritePBL[i].SecuLevel,PHYSICAL);
      CheckPosResponse_SID27_ReqSeed(DIDOfWritePBL[i].SecuLevel,gSeedArray,16,0,0);
      SID27_SecurityAccess_SendKey(DIDOfWritePBL[i].SecuLevel,gKeyArray,PHYSICAL);
      CheckPosResponse_SID27_SenKey(DIDOfWritePBL[i].SecuLevel,0,0);
    }
    
    SID22_ReadDataByIdentifier(PID,PHYSICAL);
    CheckPosResponse_SID22(PID,DIDOfWritePBL[i].Lenth,0,0);
    RecordData();
    TestStep("Write data",TestStepIntervalTime);
    WriteTestData(DIDOfWritePBL[i],PHYSICAL);
    TestStep("Read data",TestStepIntervalTime);
    SID22_ReadDataByIdentifier(PID,PHYSICAL);
    CheckPosResponse_SID22(PID,DIDOfWritePBL[i].Lenth,0,0);
    testWaitForTimeout(500);
    WritePreviousData(PHYSICAL);
    CheckPosResponse_SID2E(PID,0,0);

    TestStep("Data recover",TestStepIntervalTime);
    SID22_ReadDataByIdentifier(PID,PHYSICAL);
    CheckPosResponse_SID22(PID,DIDOfWritePBL[i].Lenth,0,0);
  }
  TestStep("Verify ProgrammingDiagnosticSession.",TestStepIntervalTime);
  CheckCurrentSession(PROGRAMMINGSESSION,PHYSICAL,0,0);
//22&2E
  
  
//2F
  
  SessionFlag=APP;
  SID10_DiagnosticSessionControl(DEFAULTSESSION,PHYSICAL,SPRMIB_FALSE);
  CheckPosResponse_SID10(DEFAULTSESSION,gP2Client_APP,gP2StarClientFor10Check,0,0);
  ECUinitHandle(0);
  TestStep("Transition from defaultSession(0x01) to extendedDiagnosticSession(0x03).",TestStepIntervalTime);
  SID10_DiagnosticSessionControl(EXTENDEDSESSION,PHYSICAL,SPRMIB_FALSE);
  CheckPosResponse_SID10(EXTENDEDSESSION,gP2Client_APP,gP2StarClientFor10Check,0,0);
  TestStep("Verify extendedDiagnosticSession.",TestStepIntervalTime);
  CheckCurrentSession(EXTENDEDSESSION,PHYSICAL,0,0);
  for(i=0; i<NumOfIO; i++)
  {
    PID[0]=IODID[i].DID>>8;
    PID[1]=IODID[i].DID&0xFF;
    if(IODID[i].AuthenticationFlag != 1)
    {
      continue;
    }
    if(IODID[i].SelectFlag != 1)
    {
      continue;
    }
    else
    {
      NumOfLenth = IODID[i].RequestLenth;
      
//      if(NumOfLenth>0)
//      {
//        snprintf(Description,3000,"Please input %d byte input parameter(s) for IO control DID:%02x %02x\nExample(2Byte):010A",NumOfLenth,PID[0],PID[1]);
//        testWaitForStringInput(Description);
//        TestGetStringInput(answer, 100);
//        //write("Answer is %02x",answer[0]);
//        for(g=0;g<(2*NumOfLenth);g=g+2)
//        {
//          if(answer[g]<0x40)
//          {
//            tem1 = answer[g]-0x30;
//          }
//          else if(answer[g]<0x60)
//          {
//            tem1 = answer[g]- 0x37;
//          }
//          else
//          {
//            tem1 = answer[g]- 0x57;
//          }
//          if(answer[g+1]<0x40)
//          {
//            tem2 = answer[g+1]-0x30;
//          }
//          else if(answer[g+1]<0x60)
//          {
//            tem2 = answer[g+1]- 0x37;
//          }
//          else
//          {
//            tem2 = answer[g+1]- 0x57;
//          }
//          
//          Para[g/2] = (tem1<<4)+tem2;
//        }
//      }
    }
    
    if(IODID[i].SecuLevel!=0xFF)
      {
        
      SID10_DiagnosticSessionControl(EXTENDEDSESSION,PHYSICAL,SPRMIB_FALSE);
      CheckPosResponse_SID10(EXTENDEDSESSION,gP2Client_APP,gP2StarClientFor10Check,0,0);
      
      testWaitForTimeout(gTimeWaitForSecuAccess);
      
      SID27_SecurityAccess_RequestSeed(IODID[i].SecuLevel,PHYSICAL);
      CheckPosResponse_SID27_ReqSeed(IODID[i].SecuLevel,gSeedArray,16,0,0);
      SID27_SecurityAccess_SendKey(IODID[i].SecuLevel,gKeyArray,PHYSICAL);
      CheckPosResponse_SID27_SenKey(IODID[i].SecuLevel,0,0);
      
      }
//
    if(IODID[i].Flag_Ser03==1)
    {
      TestStep("return control to ECU",TestStepIntervalTime);
      SID2F_IOControl(PID,0x00,ControlOptionRecord,0,ControlEnableMaskRecord,0,PHYSICAL);
      CheckPosResponse_SID2F(0x00,PID,0,0);
      
      TestStep("Short term adjustment",TestStepIntervalTime);
      SID2F_IOControl(PID,0x03,ControlOptionRecord,NumOfLenth,ControlEnableMaskRecord,0,PHYSICAL);
      CheckPosResponse_SID2F(0x03,PID,0,0);
      
      TestStep("Short term adjustment",TestStepIntervalTime);
      SID2F_IOControl(PID,0x03,ControlOptionRecord,NumOfLenth,ControlEnableMaskRecord,0,PHYSICAL);
      CheckPosResponse_SID2F(0x03,PID,0,0);
      
      TestStep("return control to ECU",TestStepIntervalTime);
      SID2F_IOControl(PID,0x00,ControlOptionRecord,0,ControlEnableMaskRecord,0,PHYSICAL);
      CheckPosResponse_SID2F(0x00,PID,0,0);
    }
    
    if(IODID[i].Flag_Ser02==1)
    {
      TestStep("freeze current state",TestStepIntervalTime);
      SID2F_IOControl(PID,0x02,ControlOptionRecord,0,ControlEnableMaskRecord,0,PHYSICAL);
      CheckPosResponse_SID2F(0x02,PID,0,0);
      
      TestStep("return control to ECU",TestStepIntervalTime);
      SID2F_IOControl(PID,0x00,ControlOptionRecord,0,ControlEnableMaskRecord,0,PHYSICAL);
      CheckPosResponse_SID2F(0x00,PID,0,0);
    }
  }

  TestStep("Verify extendedDiagnosticSession.",TestStepIntervalTime);
  CheckCurrentSession(EXTENDEDSESSION,PHYSICAL,0,0);
//2F
  
  
//31
  for(i=0;i<NumOfRoutine_Sub0x01;i++)//遍历所有例程
  {
    if(Routine_Sub0x01[i].AuthenticationFlag != 1)
    {
      continue;
    }
    if(Routine_Sub0x01[i].Flag_Ser03 != 1)
    {
      continue;
    }
    if(Routine_Sub0x01[i].routinetype == 1)//筛选所有例程类型为1的例程
    {
      tem1 = 0;
      PID[0]=Routine_Sub0x01[i].DID>>8;
      PID[1]=Routine_Sub0x01[i].DID&0xFF;
      for(j=0;j<NumOfRoutine_Sub0x03;j++)//找到该例程是否支持03子功能
      {
        if(Routine_Sub0x01[i].DID == Routine_Sub0x03[j].DID)
        {
          tem1 = 1;
          break;
        }  
      }
      if(Routine_Sub0x01[i].SecuLevel!=0xFF)
      {
        SID10_DiagnosticSessionControl(EXTENDEDSESSION,PHYSICAL,SPRMIB_FALSE);
        CheckPosResponse_SID10(EXTENDEDSESSION,gP2Client_APP,gP2StarClientFor10Check,0,0);
        
        testWaitForTimeout(gTimeWaitForSecuAccess);
        
        SID27_SecurityAccess_RequestSeed(Routine_Sub0x01[i].SecuLevel,PHYSICAL);
        CheckPosResponse_SID27_ReqSeed(Routine_Sub0x01[i].SecuLevel,gSeedArray,16,0,0);
        SID27_SecurityAccess_SendKey(Routine_Sub0x01[i].SecuLevel,gKeyArray,PHYSICAL);
        CheckPosResponse_SID27_SenKey(Routine_Sub0x01[i].SecuLevel,2,0,0);
      }
      
      if(tem1 == 1)//直接发送31 03
      {
        
        SID31_RoutineControl(RequestRoutineResult,PID,Routine_Sub0x03[j].requestData,Routine_Sub0x03[j].RequestLenth,PHYSICAL,SPRMIB_FALSE);//发送31 03
        CheckNegResponse(0x24,0,0);
      }
      
      SID31_RoutineControl(StartRoutine,PID,Routine_Sub0x01[i].requestData,Routine_Sub0x01[i].RequestLenth,PHYSICAL,SPRMIB_FALSE);//正常请求
      CheckPosResponse_SID31(StartRoutine,PID,0,0);
      if( (gRss==NEG) && (gTpRxData[2]==0x22))
      {
        TestStepWarning("warning","Received NRC0x22 for Service 0x31,test next RID");
        continue;
      }
      testWaitForTimeout(2000);
      
      if(Routine_Sub0x01[i].SecuLevel!=0xFF)
      {
        
        SID10_DiagnosticSessionControl(EXTENDEDSESSION,PHYSICAL,SPRMIB_FALSE);
        CheckPosResponse_SID10(EXTENDEDSESSION,gP2Client_APP,gP2StarClientFor10Check,0,0);
        
        testWaitForTimeout(gTimeWaitForSecuAccess);
        
        SID27_SecurityAccess_RequestSeed(Routine_Sub0x01[i].SecuLevel,PHYSICAL);
        CheckPosResponse_SID27_ReqSeed(Routine_Sub0x01[i].SecuLevel,gSeedArray,16,0,0);
        SID27_SecurityAccess_SendKey(Routine_Sub0x01[i].SecuLevel,gKeyArray,PHYSICAL);
        CheckPosResponse_SID27_SenKey(Routine_Sub0x01[i].SecuLevel,2,0,0);
      
      }
      
      if(tem1 == 1)
      {
        SID31_RoutineControl(RequestRoutineResult,PID,Routine_Sub0x03[j].requestData,Routine_Sub0x03[j].RequestLenth,PHYSICAL,SPRMIB_FALSE);
        CheckPosResponse_SID31(RequestRoutineResult,PID,0,0);
      }
      
    }
    else if(Routine_Sub0x01[i].routinetype == 2)//筛选所有例程类型为2的例程
    {
      tem1 = 0;tem2 = 0;
      PID[0]=Routine_Sub0x01[i].DID>>8;
      PID[1]=Routine_Sub0x01[i].DID&0xFF;
      for(j=0;j<NumOfRoutine_Sub0x03;j++)//找到该例程是否支持03子功能
      {
        if(Routine_Sub0x01[i].DID == Routine_Sub0x03[j].DID)
        {
          tem1 = 1;
          break;
        }

      }
      for(k=0;k<NumOfRoutine_Sub0x02;k++)//找到该例程是否支持02子功能
      {
        if(Routine_Sub0x01[i].DID == Routine_Sub0x02[k].DID)
        {
          tem2 = 1;
          break;
        }

      }
      
      if(Routine_Sub0x01[i].SecuLevel!=0xFF)
      {
        
        SID10_DiagnosticSessionControl(EXTENDEDSESSION,PHYSICAL,SPRMIB_FALSE);
        CheckPosResponse_SID10(EXTENDEDSESSION,gP2Client_APP,gP2StarClientFor10Check,0,0);
        
        testWaitForTimeout(gTimeWaitForSecuAccess);
        SID27_SecurityAccess_RequestSeed(Routine_Sub0x01[i].SecuLevel,PHYSICAL);
        CheckPosResponse_SID27_ReqSeed(Routine_Sub0x01[i].SecuLevel,gSeedArray,16,0,0);
        SID27_SecurityAccess_SendKey(Routine_Sub0x01[i].SecuLevel,gKeyArray,PHYSICAL);
        CheckPosResponse_SID27_SenKey(Routine_Sub0x01[i].SecuLevel,2,0,0);
      
      }
      
      if(tem2 == 1)//直接发送31 02
      {
        
        SID31_RoutineControl(StopRoutine,PID,Routine_Sub0x02[k].requestData,Routine_Sub0x02[k].RequestLenth,PHYSICAL,SPRMIB_FALSE);//发送31 02
        CheckNegResponse(0x24,0,0);

      }
      
      if(tem1 == 1)//直接发送31 03
      {
        
        SID31_RoutineControl(RequestRoutineResult,PID,Routine_Sub0x03[j].requestData,Routine_Sub0x03[j].RequestLenth,PHYSICAL,SPRMIB_FALSE);//发送31 02
        CheckNegResponse(0x24,0,0);
  
      }
      
      SID31_RoutineControl(StartRoutine,PID,Routine_Sub0x01[i].requestData,Routine_Sub0x01[i].RequestLenth,PHYSICAL,SPRMIB_FALSE);//正常请求
      CheckPosResponse_SID31(StartRoutine,PID,0,0);
      
      SID31_RoutineControl(RequestRoutineResult,PID,Routine_Sub0x03[j].requestData,Routine_Sub0x03[j].RequestLenth,PHYSICAL,SPRMIB_FALSE);//正常请求
      CheckPosResponse_SID31(RequestRoutineResult,PID,0,0);
      if(gTpRxData[4]!= 0x22)
      {
        TestStepWarning("Chk","No 0x22 maybe routine has finished executing");
      }
      testWaitForTimeout(Routine_Sub0x01[i].runtime+10);
      
      SID31_RoutineControl(RequestRoutineResult,PID,Routine_Sub0x03[j].requestData,Routine_Sub0x03[j].RequestLenth,PHYSICAL,SPRMIB_FALSE);//正常请求
      CheckPosResponse_SID31(RequestRoutineResult,PID,0,0);
      if(gTpRxData[4]!= 0x20)
      {
        TestStepFail("Fail","Routine still not finished after running time timeout");
      }
      
      if(Routine_Sub0x01[i].SecuLevel!=0xFF)
      {
        
        SID10_DiagnosticSessionControl(EXTENDEDSESSION,PHYSICAL,SPRMIB_FALSE);
        CheckPosResponse_SID10(EXTENDEDSESSION,gP2Client_APP,gP2StarClientFor10Check,0,0);
        
        testWaitForTimeout(gTimeWaitForSecuAccess);
        
        SID27_SecurityAccess_RequestSeed(Routine_Sub0x01[i].SecuLevel,PHYSICAL);
        CheckPosResponse_SID27_ReqSeed(Routine_Sub0x01[i].SecuLevel,gSeedArray,16,0,0);
        SID27_SecurityAccess_SendKey(Routine_Sub0x01[i].SecuLevel,gKeyArray,PHYSICAL);
        CheckPosResponse_SID27_SenKey(Routine_Sub0x01[i].SecuLevel,2,0,0);
      
      }
      
      if(tem2 == 1)//直接发送31 02
      {
        
        SID31_RoutineControl(StopRoutine,PID,Routine_Sub0x02[k].requestData,Routine_Sub0x02[k].RequestLenth,PHYSICAL,SPRMIB_FALSE);//发送31 03
        CheckNegResponse(0x24,0,0);

      }

      
      if(Routine_Sub0x01[i].SecuLevel!=0xFF)
      {
        SID10_DiagnosticSessionControl(EXTENDEDSESSION,PHYSICAL,SPRMIB_FALSE);
        CheckPosResponse_SID10(EXTENDEDSESSION,gP2Client_APP,gP2StarClientFor10Check,0,0);
        
        testWaitForTimeout(gTimeWaitForSecuAccess);
        
        SID27_SecurityAccess_RequestSeed(Routine_Sub0x01[i].SecuLevel,PHYSICAL);
        CheckPosResponse_SID27_ReqSeed(Routine_Sub0x01[i].SecuLevel,gSeedArray,16,0,0);
        SID27_SecurityAccess_SendKey(Routine_Sub0x01[i].SecuLevel,gKeyArray,PHYSICAL);
        CheckPosResponse_SID27_SenKey(Routine_Sub0x01[i].SecuLevel,2,0,0);
      
      }
      
      SID31_RoutineControl(StartRoutine,PID,Routine_Sub0x01[i].requestData,Routine_Sub0x01[i].RequestLenth,PHYSICAL,SPRMIB_FALSE);//正常请求
      CheckPosResponse_SID31(StartRoutine,PID,0,0);
      
      if(tem2 == 1)//直接发送31 02
      {
        SID31_RoutineControl(StopRoutine,PID,Routine_Sub0x02[k].requestData,Routine_Sub0x02[k].RequestLenth,PHYSICAL,SPRMIB_FALSE);//正常请求
        CheckPosResponse_SID31(StopRoutine,PID,0,0);
      }
      
      SID31_RoutineControl(RequestRoutineResult,PID,Routine_Sub0x03[j].requestData,Routine_Sub0x03[j].RequestLenth,PHYSICAL,SPRMIB_FALSE);//正常请求
      CheckPosResponse_SID31(RequestRoutineResult,PID,0,0);
      if(gTpRxData[4]!= 0x20)
      {
        TestStepFail("Fail","Routine still not finished after running time timeout");
      }
    }
    else if(Routine_Sub0x01[i].routinetype == 3)//筛选所有例程类型为3的例程
    {
      tem1 = 0;tem2 = 0;
      PID[0]=Routine_Sub0x01[i].DID>>8;
      PID[1]=Routine_Sub0x01[i].DID&0xFF;
      for(j=0;j<NumOfRoutine_Sub0x03;j++)//找到该例程是否支持03子功能
      {
        if(Routine_Sub0x01[i].DID == Routine_Sub0x03[j].DID)
        {
          tem1 = 1;
          break;
        }

      }
      for(k=0;k<NumOfRoutine_Sub0x02;k++)//找到该例程是否支持02子功能
      {
        if(Routine_Sub0x01[i].DID == Routine_Sub0x02[k].DID)
        {
          tem2 = 1;
          break;
        }
      } 
      if(Routine_Sub0x01[i].SecuLevel!=0xFF)
      {
        SID10_DiagnosticSessionControl(EXTENDEDSESSION,PHYSICAL,SPRMIB_FALSE);
        CheckPosResponse_SID10(EXTENDEDSESSION,gP2Client_APP,gP2StarClientFor10Check,0,0);
        
        testWaitForTimeout(gTimeWaitForSecuAccess);
        
        SID27_SecurityAccess_RequestSeed(Routine_Sub0x01[i].SecuLevel,PHYSICAL);
        CheckPosResponse_SID27_ReqSeed(Routine_Sub0x01[i].SecuLevel,gSeedArray,16,0,0);
        SID27_SecurityAccess_SendKey(Routine_Sub0x01[i].SecuLevel,gKeyArray,PHYSICAL);
        CheckPosResponse_SID27_SenKey(Routine_Sub0x01[i].SecuLevel,2,0,0);
      }
      
      if(tem2 == 1)//直接发送31 02
      {
        SID31_RoutineControl(StopRoutine,PID,Routine_Sub0x02[k].requestData,Routine_Sub0x02[k].RequestLenth,PHYSICAL,SPRMIB_FALSE);//发送31 03
        CheckNegResponse(0x24,0,0);
      }
      
      if(tem1 == 1)//直接发送31 03
      {
        
        SID31_RoutineControl(RequestRoutineResult,PID,Routine_Sub0x03[j].requestData,Routine_Sub0x03[j].RequestLenth,PHYSICAL,SPRMIB_FALSE);//发送31 03
        CheckNegResponse(0x24,0,0);

      }
      
      SID31_RoutineControl(StartRoutine,PID,Routine_Sub0x01[i].requestData,Routine_Sub0x01[i].RequestLenth,PHYSICAL,SPRMIB_FALSE);//正常请求
      CheckPosResponse_SID31(StartRoutine,PID,0,0);
      
      if(tem2 == 1)//发送31 03
      {
        SID31_RoutineControl(RequestRoutineResult,PID,Routine_Sub0x03[j].requestData,Routine_Sub0x03[j].RequestLenth,PHYSICAL,SPRMIB_FALSE);//正常请求
        CheckPosResponse_SID31(RequestRoutineResult,PID,0,0);
        if(gTpRxData[4]!= 0x32)
        {
          TestStepFail("Chk","Routine can't run");
        }
      }
      
      if(tem1 == 1)//直接发送31 02
      {
        SID31_RoutineControl(StopRoutine,PID,Routine_Sub0x02[k].requestData,Routine_Sub0x02[k].RequestLenth,PHYSICAL,SPRMIB_FALSE);//正常请求
        CheckPosResponse_SID31(StopRoutine,PID,0,0);
        if(gTpRxData[4]!= 0x30)
        {
          TestStepFail("Chk","Routine can't run");
        }
      }
      
      if(tem2 == 1)//发送31 03
      {
        SID31_RoutineControl(RequestRoutineResult,PID,Routine_Sub0x03[j].requestData,Routine_Sub0x03[j].RequestLenth,PHYSICAL,SPRMIB_FALSE);//正常请求
        CheckPosResponse_SID31(RequestRoutineResult,PID,0,0);
        if(gTpRxData[4]!= 0x30)
        {
          TestStepFail("Chk","Routine can't run");
        }
      }     
    }
  }
  
  TestStep("Transition from defaultSession(0x01) to programmingDiagnosticSession(0x02).",TestStepIntervalTime);
  SID10_DiagnosticSessionControl(PROGRAMMINGSESSION,FUNCTIONAL,SPRMIB_FALSE);
  CheckPosResponse_SID10(PROGRAMMINGSESSION,gP2Client_BOOT,gP2StarClientFor10Check,0,0);
  
  ECUinitHandle(0);
  SessionFlag=BOOT;
  TestStep("Verify programmingDiagnosticSession.",TestStepIntervalTime);
  //ECUinitHandle(0);
  CheckCurrentSession(PROGRAMMINGSESSION,PHYSICAL,0,0);
  
  for(i=0;i<NumOfRoutine_Sub0x01;i++)//遍历所有例程
  {
    if(Routine_Sub0x01[i].AuthenticationFlag != 1)
    {
      continue;
    }
    if(Routine_Sub0x01[i].Flag_Ser02 != 1)
    {
      continue;
    }
    if(Routine_Sub0x01[i].routinetype == 1)//筛选所有例程类型为1的例程
    {
      tem1 = 0;
      PID[0]=Routine_Sub0x01[i].DID>>8;
      PID[1]=Routine_Sub0x01[i].DID&0xFF;
      for(j=0;j<NumOfRoutine_Sub0x03;j++)//找到该例程是否支持03子功能
      {
        if(Routine_Sub0x01[i].DID == Routine_Sub0x03[j].DID)
        {
          tem1 = 1;
          break;
        }  
      }
      if(Routine_Sub0x01[i].SecuLevel!=0xFF)
      {
        SID10_DiagnosticSessionControl(PROGRAMMINGSESSION,PHYSICAL,SPRMIB_FALSE);
        CheckPosResponse_SID10(PROGRAMMINGSESSION,gP2Client_BOOT,gP2StarClientFor10Check,0,0);
        
        testWaitForTimeout(gTimeWaitForSecuAccess);
        
        SID27_SecurityAccess_RequestSeed(Routine_Sub0x01[i].SecuLevel,PHYSICAL);
        CheckPosResponse_SID27_ReqSeed(Routine_Sub0x01[i].SecuLevel,gSeedArray,16,0,0);
        SID27_SecurityAccess_SendKey(Routine_Sub0x01[i].SecuLevel,gKeyArray,PHYSICAL);
        CheckPosResponse_SID27_SenKey(Routine_Sub0x01[i].SecuLevel,2,0,0);
      }
      
      if(tem1 == 1)//直接发送31 03
      {
        
        SID31_RoutineControl(RequestRoutineResult,PID,Routine_Sub0x03[j].requestData,Routine_Sub0x03[j].RequestLenth,PHYSICAL,SPRMIB_FALSE);//发送31 03
        CheckNegResponse(0x24,0,0);
      }
      
      SID31_RoutineControl(StartRoutine,PID,Routine_Sub0x01[i].requestData,Routine_Sub0x01[i].RequestLenth,PHYSICAL,SPRMIB_FALSE);//正常请求
      CheckPosResponse_SID31(StartRoutine,PID,0,0);
      if( (gRss==NEG) && (gTpRxData[2]==0x22))
      {
        TestStepWarning("warning","Received NRC0x22 for Service 0x31,test next RID");
        continue;
      }
      testWaitForTimeout(2000);
      
      if(Routine_Sub0x01[i].SecuLevel!=0xFF)
      {
        
        SID10_DiagnosticSessionControl(PROGRAMMINGSESSION,PHYSICAL,SPRMIB_FALSE);
        CheckPosResponse_SID10(PROGRAMMINGSESSION,gP2Client_BOOT,gP2StarClientFor10Check,0,0);
        
        testWaitForTimeout(gTimeWaitForSecuAccess);
        
        SID27_SecurityAccess_RequestSeed(Routine_Sub0x01[i].SecuLevel,PHYSICAL);
        CheckPosResponse_SID27_ReqSeed(Routine_Sub0x01[i].SecuLevel,gSeedArray,16,0,0);
        SID27_SecurityAccess_SendKey(Routine_Sub0x01[i].SecuLevel,gKeyArray,PHYSICAL);
        CheckPosResponse_SID27_SenKey(Routine_Sub0x01[i].SecuLevel,2,0,0);
      
      }
      
      if(tem1 == 1)
      {
        SID31_RoutineControl(RequestRoutineResult,PID,Routine_Sub0x03[j].requestData,Routine_Sub0x03[j].RequestLenth,PHYSICAL,SPRMIB_FALSE);
        CheckPosResponse_SID31(RequestRoutineResult,PID,0,0);
      }
      
    }
    else if(Routine_Sub0x01[i].routinetype == 2)//筛选所有例程类型为2的例程
    {
      tem1 = 0;tem2 = 0;
      PID[0]=Routine_Sub0x01[i].DID>>8;
      PID[1]=Routine_Sub0x01[i].DID&0xFF;
      for(j=0;j<NumOfRoutine_Sub0x03;j++)//找到该例程是否支持03子功能
      {
        if(Routine_Sub0x01[i].DID == Routine_Sub0x03[j].DID)
        {
          tem1 = 1;
          break;
        }

      }
      for(k=0;k<NumOfRoutine_Sub0x02;k++)//找到该例程是否支持02子功能
      {
        if(Routine_Sub0x01[i].DID == Routine_Sub0x02[k].DID)
        {
          tem2 = 1;
          break;
        }

      }
      
      if(Routine_Sub0x01[i].SecuLevel!=0xFF)
      {
        
        SID10_DiagnosticSessionControl(PROGRAMMINGSESSION,PHYSICAL,SPRMIB_FALSE);
        CheckPosResponse_SID10(PROGRAMMINGSESSION,gP2Client_BOOT,gP2StarClientFor10Check,0,0);
        
        testWaitForTimeout(gTimeWaitForSecuAccess);
        SID27_SecurityAccess_RequestSeed(Routine_Sub0x01[i].SecuLevel,PHYSICAL);
        CheckPosResponse_SID27_ReqSeed(Routine_Sub0x01[i].SecuLevel,gSeedArray,16,0,0);
        SID27_SecurityAccess_SendKey(Routine_Sub0x01[i].SecuLevel,gKeyArray,PHYSICAL);
        CheckPosResponse_SID27_SenKey(Routine_Sub0x01[i].SecuLevel,2,0,0);
      
      }
      
      if(tem2 == 1)//直接发送31 02
      {
        
        SID31_RoutineControl(StopRoutine,PID,Routine_Sub0x02[k].requestData,Routine_Sub0x02[k].RequestLenth,PHYSICAL,SPRMIB_FALSE);//发送31 02
        CheckNegResponse(0x24,0,0);

      }
      
      if(tem1 == 1)//直接发送31 03
      {
        
        SID31_RoutineControl(RequestRoutineResult,PID,Routine_Sub0x03[j].requestData,Routine_Sub0x03[j].RequestLenth,PHYSICAL,SPRMIB_FALSE);//发送31 02
        CheckNegResponse(0x24,0,0);
  
      }
      
      SID31_RoutineControl(StartRoutine,PID,Routine_Sub0x01[i].requestData,Routine_Sub0x01[i].RequestLenth,PHYSICAL,SPRMIB_FALSE);//正常请求
      CheckPosResponse_SID31(StartRoutine,PID,0,0);
      
      SID31_RoutineControl(RequestRoutineResult,PID,Routine_Sub0x03[j].requestData,Routine_Sub0x03[j].RequestLenth,PHYSICAL,SPRMIB_FALSE);//正常请求
      CheckPosResponse_SID31(RequestRoutineResult,PID,0,0);
      if(gTpRxData[4]!= 0x22)
      {
        TestStepWarning("Chk","No 0x22 maybe routine has finished executing");
      }
      testWaitForTimeout(Routine_Sub0x01[i].runtime+10);
      
      SID31_RoutineControl(RequestRoutineResult,PID,Routine_Sub0x03[j].requestData,Routine_Sub0x03[j].RequestLenth,PHYSICAL,SPRMIB_FALSE);//正常请求
      CheckPosResponse_SID31(RequestRoutineResult,PID,0,0);
      if(gTpRxData[4]!= 0x20)
      {
        TestStepFail("Fail","Routine still not finished after running time timeout");
      }
      
      if(Routine_Sub0x01[i].SecuLevel!=0xFF)
      {
        
        SID10_DiagnosticSessionControl(PROGRAMMINGSESSION,PHYSICAL,SPRMIB_FALSE);
        CheckPosResponse_SID10(PROGRAMMINGSESSION,gP2Client_BOOT,gP2StarClientFor10Check,0,0);
        
        testWaitForTimeout(gTimeWaitForSecuAccess);
        
        SID27_SecurityAccess_RequestSeed(Routine_Sub0x01[i].SecuLevel,PHYSICAL);
        CheckPosResponse_SID27_ReqSeed(Routine_Sub0x01[i].SecuLevel,gSeedArray,16,0,0);
        SID27_SecurityAccess_SendKey(Routine_Sub0x01[i].SecuLevel,gKeyArray,PHYSICAL);
        CheckPosResponse_SID27_SenKey(Routine_Sub0x01[i].SecuLevel,2,0,0);
      
      }
      
      if(tem2 == 1)//直接发送31 02
      {
        
        SID31_RoutineControl(StopRoutine,PID,Routine_Sub0x02[k].requestData,Routine_Sub0x02[k].RequestLenth,PHYSICAL,SPRMIB_FALSE);//发送31 03
        CheckNegResponse(0x24,0,0);

      }

      
      if(Routine_Sub0x01[i].SecuLevel!=0xFF)
      {
        SID10_DiagnosticSessionControl(PROGRAMMINGSESSION,PHYSICAL,SPRMIB_FALSE);
        CheckPosResponse_SID10(PROGRAMMINGSESSION,gP2Client_BOOT,gP2StarClientFor10Check,0,0);
        
        testWaitForTimeout(gTimeWaitForSecuAccess);
        
        SID27_SecurityAccess_RequestSeed(Routine_Sub0x01[i].SecuLevel,PHYSICAL);
        CheckPosResponse_SID27_ReqSeed(Routine_Sub0x01[i].SecuLevel,gSeedArray,16,0,0);
        SID27_SecurityAccess_SendKey(Routine_Sub0x01[i].SecuLevel,gKeyArray,PHYSICAL);
        CheckPosResponse_SID27_SenKey(Routine_Sub0x01[i].SecuLevel,2,0,0);
      
      }
      
      SID31_RoutineControl(StartRoutine,PID,Routine_Sub0x01[i].requestData,Routine_Sub0x01[i].RequestLenth,PHYSICAL,SPRMIB_FALSE);//正常请求
      CheckPosResponse_SID31(StartRoutine,PID,0,0);
      
      if(tem2 == 1)//直接发送31 02
      {
        SID31_RoutineControl(StopRoutine,PID,Routine_Sub0x02[k].requestData,Routine_Sub0x02[k].RequestLenth,PHYSICAL,SPRMIB_FALSE);//正常请求
        CheckPosResponse_SID31(StopRoutine,PID,0,0);
      }
      
      SID31_RoutineControl(RequestRoutineResult,PID,Routine_Sub0x03[j].requestData,Routine_Sub0x03[j].RequestLenth,PHYSICAL,SPRMIB_FALSE);//正常请求
      CheckPosResponse_SID31(RequestRoutineResult,PID,0,0);
      if(gTpRxData[4]!= 0x20)
      {
        TestStepFail("Fail","Routine still not finished after running time timeout");
      }
    }
    else if(Routine_Sub0x01[i].routinetype == 3)//筛选所有例程类型为3的例程
    {
      tem1 = 0;tem2 = 0;
      PID[0]=Routine_Sub0x01[i].DID>>8;
      PID[1]=Routine_Sub0x01[i].DID&0xFF;
      for(j=0;j<NumOfRoutine_Sub0x03;j++)//找到该例程是否支持03子功能
      {
        if(Routine_Sub0x01[i].DID == Routine_Sub0x03[j].DID)
        {
          tem1 = 1;
          break;
        }

      }
      for(k=0;k<NumOfRoutine_Sub0x02;k++)//找到该例程是否支持02子功能
      {
        if(Routine_Sub0x01[i].DID == Routine_Sub0x02[k].DID)
        {
          tem2 = 1;
          break;
        }
      } 
      if(Routine_Sub0x01[i].SecuLevel!=0xFF)
      {
        SID10_DiagnosticSessionControl(PROGRAMMINGSESSION,PHYSICAL,SPRMIB_FALSE);
        CheckPosResponse_SID10(PROGRAMMINGSESSION,gP2Client_BOOT,gP2StarClientFor10Check,0,0);
        
        testWaitForTimeout(gTimeWaitForSecuAccess);
        
        SID27_SecurityAccess_RequestSeed(Routine_Sub0x01[i].SecuLevel,PHYSICAL);
        CheckPosResponse_SID27_ReqSeed(Routine_Sub0x01[i].SecuLevel,gSeedArray,16,0,0);
        SID27_SecurityAccess_SendKey(Routine_Sub0x01[i].SecuLevel,gKeyArray,PHYSICAL);
        CheckPosResponse_SID27_SenKey(Routine_Sub0x01[i].SecuLevel,2,0,0);
      }
      
      if(tem2 == 1)//直接发送31 02
      {
        SID31_RoutineControl(StopRoutine,PID,Routine_Sub0x02[k].requestData,Routine_Sub0x02[k].RequestLenth,PHYSICAL,SPRMIB_FALSE);//发送31 03
        CheckNegResponse(0x24,0,0);
      }
      
      if(tem1 == 1)//直接发送31 03
      {
        
        SID31_RoutineControl(RequestRoutineResult,PID,Routine_Sub0x03[j].requestData,Routine_Sub0x03[j].RequestLenth,PHYSICAL,SPRMIB_FALSE);//发送31 03
        CheckNegResponse(0x24,0,0);

      }
      
      SID31_RoutineControl(StartRoutine,PID,Routine_Sub0x01[i].requestData,Routine_Sub0x01[i].RequestLenth,PHYSICAL,SPRMIB_FALSE);//正常请求
      CheckPosResponse_SID31(StartRoutine,PID,0,0);
      
      if(tem2 == 1)//发送31 03
      {
        SID31_RoutineControl(RequestRoutineResult,PID,Routine_Sub0x03[j].requestData,Routine_Sub0x03[j].RequestLenth,PHYSICAL,SPRMIB_FALSE);//正常请求
        CheckPosResponse_SID31(RequestRoutineResult,PID,0,0);
        if(gTpRxData[4]!= 0x32)
        {
          TestStepFail("Chk","Routine can't run");
        }
      }
      
      if(tem1 == 1)//直接发送31 02
      {
        SID31_RoutineControl(StopRoutine,PID,Routine_Sub0x02[k].requestData,Routine_Sub0x02[k].RequestLenth,PHYSICAL,SPRMIB_FALSE);//正常请求
        CheckPosResponse_SID31(StopRoutine,PID,0,0);
        if(gTpRxData[4]!= 0x30)
        {
          TestStepFail("Chk","Routine can't run");
        }
      }
      
      if(tem2 == 1)//发送31 03
      {
        SID31_RoutineControl(RequestRoutineResult,PID,Routine_Sub0x03[j].requestData,Routine_Sub0x03[j].RequestLenth,PHYSICAL,SPRMIB_FALSE);//正常请求
        CheckPosResponse_SID31(RequestRoutineResult,PID,0,0);
        if(gTpRxData[4]!= 0x30)
        {
          TestStepFail("Chk","Routine can't run");
        }
      }     
    }
  }
  TestStep("programmingSession.",TestStepIntervalTime);
  CheckCurrentSession(PROGRAMMINGSESSION,PHYSICAL,0,0); 
//31
//***************************************************************************//
  
  
  /******************************以上为测试步骤*********************************/
  Postcondition();
  
}
/// <Authentication_Test>
testcase RandomChallengeByteTest()
{
  char logName[400] = "";
  char info[1024];
  
  byte OCSP_RID[2]={0x70,0x27};
  byte tempdata[3075];
  char errorMsg[500];
  byte challenge[32]={0xAD,0x95,0x37,0xF6,0xC8,0x04,0x56,0x99,0xCE,0x04,0x19,0x88,0x68,0x83,0xB3,0xA1};
  char hashFunction[10]="SHA-256";  
//  char testerCertName[300] = "Geely3.0";
  byte testerCertByte[2000];
  dword testerCertByteLength;
  char testerCertString[4000];
  byte ownerShip[1000];
  dword ownerShipLength;
  char ownerShipString[2000];
  dword i,j;
  byte Data[10000][32];
  dword compareTime=0;
  strncat(logName,"1318683 RandomChallengeByteTest",400);
  testCaseTitle("1318683","RandomChallengeByteTest");
  
  if(gBusFlag==5&&EthNodeTypeNow==EdgeNode)
  {
    
  }
  else
  {
    testStepWarning("Warning","This test case is only applicable for ETH_Edgenode");
    return;
  }
  
  SetLog(logName);
//  Precondition();
   
  /******************************以下为测试步骤*********************************/

  SessionFlag=APP;

  if(GetCertificateAsBinaryByName(testerCertName, testerCertByte, testerCertByteLength, errorMsg)!=1)
  {
    testStepFail("Fail","%s",errorMsg);
    return;
  }
  ocspCheckSequence();
  
  for(i=0;i<5000;i++)
  {
    SID29_Authentication_verifyCertificateUnidirectional(0,testerCertByteLength,testerCertByte,0,PHYSICAL);
    gRss=CheckPosResponse_SID29_verifyCertificateUnidirectional(0x11,0x20,challenge,0,0,0);
    if(gRss==2)
    {
      for(j=0;j<32;j++)
      {
        Data[i][j]=gTpRxData[5+j];
      }
      PrintPID("Byte","ChallengeByte：",Data[i],32);
      compareTime++;
      testWaitForTimeout(1);
    }
  }
  
  SID11_ECUReset(HARDRESET,PHYSICAL,SPRMIB_FALSE);
  CheckPosResponse_SID11(HARDRESET,0,0);
  ECUinitHandle(0);
  
  CheckCurrentSession(0x01,PHYSICAL,0,0);
  
  for(i=5000;i<9999;i++)
  {
    SID29_Authentication_verifyCertificateUnidirectional(0,testerCertByteLength,testerCertByte,0,PHYSICAL);
    gRss=CheckPosResponse_SID29_verifyCertificateUnidirectional(0x11,0x20,challenge,0,0,0);
    if(gRss==2)
    {
      for(j=0;j<32;j++)
      {
        Data[i][j]=gTpRxData[5+j];
      }
      PrintPID("Byte","ChallengeByte：",Data[i],32);
      compareTime++;
      testWaitForTimeout(1);
    }
  }
  
  compareData(Data,compareTime);

  /******************************以上为测试步骤*********************************/
//  Postcondition();
  
}

/// <Authentication_Test>
testcase TiAndDatelndn_AbnormalTest()
{
  char logName[400] = "";
  char info[1024];
  
  byte OCSP_RID[2]={0x70,0x27};
  byte tempdata[5000];
  char errorMsg[500];
  byte challenge[32]={0xAD,0x95,0x37,0xF6,0xC8,0x04,0x56,0x99,0xCE,0x04,0x19,0x88,0x68,0x83,0xB3,0xA1};
  char hashFunction[10]="SHA-256";  
//  char testerCertName[300] = "Geely3.0";
  byte testerCertByte[2000];
  dword testerCertByteLength;
  char testerCertString[4000];
  byte ownerShip[1000];
  dword ownerShipLength;
  char ownerShipString[2000];
  dword i=0;
  dword tempI;
  strncat(logName,"TiAndDatelndn_AbnormalTest",400);
  testCaseTitle("","TiAndDatelndn_AbnormalTest");
  
  if(gBusFlag==5&&EthNodeTypeNow==EdgeNode)
  {
    
  }
  else
  {
    testStepWarning("Warning","This test case is only applicable for ETH_Edgenode");
    return;
  }
  
  SetLog(logName);
  Precondition();
   
  /******************************以下为测试步骤*********************************/
  SessionFlag=APP;
  
  checkAuthenticateState(Deauthenticated);
  
  TestStep("仿真正确的TiAndDatelndn信号");
  testWaitForTesterConfirmation("请仿真正确的TiAndDatelndn信号");
  testWaitForTimeout(5000);
  
  SID29_Authentication_authenticationConfiguration(PHYSICAL);
  CheckPosResponse_SID29_authenticationConfiguration(0x2,0,0);
  
  if(GetCertificateAsBinaryByName(testerCertName, testerCertByte, testerCertByteLength, errorMsg)!=1)
  {
    testStepFail("Fail","%s",errorMsg);
    return;
  }
  ocspCheckSequence();
  
  SID29_Authentication_verifyCertificateUnidirectional(0,testerCertByteLength,testerCertByte,0,PHYSICAL);
  CheckPosResponse_SID29_verifyCertificateUnidirectional(0x11,0x20,challenge,0,0,0);
  
  if(CreateOwnership(testerCertName, hashFunction, challenge, elcount(challenge), ownerShip, ownerShipLength, errorMsg)!=1)
  {
    testStepFail("Fail","%s",errorMsg);
    return;
  }
  
  SID29_Authentication_proofOfOwnership(ownerShipLength,ownerShip,0,PHYSICAL);
  CheckPosResponse_SID29_proofOfOwnership(0x12,0,0);
  
  checkAuthenticateState(Authenticated);
  
  SID29_Authentication_deAuthenticate(PHYSICAL);
  CheckPosResponse_SID29_deAuthenticate(0x10,0,0);
  
  checkAuthenticateState(Deauthenticated);
  
  TestStep("仿真无效的TiAndDatelndn信号，比如月份为13");
  testWaitForTesterConfirmation("请仿真无效的TiAndDatelndn信号，比如月份为13");
  testWaitForTimeout(5000);
  
  SID29_Authentication_authenticationConfiguration(PHYSICAL);
  CheckPosResponse_SID29_authenticationConfiguration(0x2,0,0);
  
  if(GetCertificateAsBinaryByName(testerCertName, testerCertByte, testerCertByteLength, errorMsg)!=1)
  {
    testStepFail("Fail","%s",errorMsg);
    return;
  }
  ocspCheckSequence();
  
  SID29_Authentication_verifyCertificateUnidirectional(0,testerCertByteLength,testerCertByte,0,PHYSICAL);
  CheckPosResponse_SID29_verifyCertificateUnidirectional(0x11,0x20,challenge,0,0,0);
  
  if(CreateOwnership(testerCertName, hashFunction, challenge, elcount(challenge), ownerShip, ownerShipLength, errorMsg)!=1)
  {
    testStepFail("Fail","%s",errorMsg);
    return;
  }
  
  SID29_Authentication_proofOfOwnership(ownerShipLength,ownerShip,0,PHYSICAL);
  CheckPosResponse_SID29_proofOfOwnership(0x12,0,0);
  
  checkAuthenticateState(Authenticated);
  
  SID29_Authentication_deAuthenticate(PHYSICAL);
  CheckPosResponse_SID29_deAuthenticate(0x10,0,0);
  
  checkAuthenticateState(Deauthenticated);

  TestStep("仿真TiAndDatelndn信号为超出证书有效期的时间");
  testWaitForTesterConfirmation("请仿真TiAndDatelndn信号为超出证书有效期的时间");
  testWaitForTimeout(5000);
  
  SID29_Authentication_authenticationConfiguration(PHYSICAL);
  CheckPosResponse_SID29_authenticationConfiguration(0x2,0,0);
  
  if(GetCertificateAsBinaryByName(testerCertName, testerCertByte, testerCertByteLength, errorMsg)!=1)
  {
    testStepFail("Fail","%s",errorMsg);
    return;
  }

  ocspCheckSequence();
  
  SID29_Authentication_verifyCertificateUnidirectional(0,testerCertByteLength,testerCertByte,0,PHYSICAL);
  CheckNegResponse(0x50,0,0);
  
  checkAuthenticateState(Deauthenticated);
  
  TestStep("停止仿真TiAndDatelndn信号");
  testWaitForTesterConfirmation("停止仿真TiAndDatelndn信号");
  testWaitForTimeout(5000);
  
  SID29_Authentication_authenticationConfiguration(PHYSICAL);
  CheckPosResponse_SID29_authenticationConfiguration(0x2,0,0);
  
  if(GetCertificateAsBinaryByName(testerCertName, testerCertByte, testerCertByteLength, errorMsg)!=1)
  {
    testStepFail("Fail","%s",errorMsg);
    return;
  }
  string2array(ocspResponseString,ocspBytearray,ocspLen);
  memcpy(tempdata,ocspBytearray,ocspLen);
  tempdata[0]=ocspLen>>8;
  tempdata[1]=ocspLen;
  for(i=0;i<ocspLen;i++)
  {
    tempdata[2+i]=ocspBytearray[i];
  }
  
  tempdata[2050]=testerCertByteLength>>8;
  tempdata[2051]=testerCertByteLength;
  
  for(i=0;i<testerCertByteLength;i++)
  {
    tempdata[2052+i]=testerCertByte[i];
  }

  SID31_RoutineControl(StartRoutine,OCSP_RID,tempdata,3076,PHYSICAL,SPRMIB_FALSE);
  CheckPosResponse_SID31(StartRoutine,OCSP_RID,0,0);
  if(gTpRxData[4]==0x10&&gTpRxData[5]==0x01)
  {
    
  }
  else
  {
    testStepFail("Fail","get wrong routine parameter0x%x%x instead of 0x10 01",gTpRxData[4],gTpRxData[5]);
  }
  
  SID29_Authentication_verifyCertificateUnidirectional(0,testerCertByteLength,testerCertByte,0,PHYSICAL);
  CheckPosResponse_SID29_verifyCertificateUnidirectional(0x11,0x20,challenge,0,0,0);
  
  if(CreateOwnership(testerCertName, hashFunction, challenge, elcount(challenge), ownerShip, ownerShipLength, errorMsg)!=1)
  {
    testStepFail("Fail","%s",errorMsg);
    return;
  }
  
  SID29_Authentication_proofOfOwnership(ownerShipLength,ownerShip,0,PHYSICAL);
  CheckPosResponse_SID29_proofOfOwnership(0x12,0,0);
  
  checkAuthenticateState(Authenticated);
  
  SID29_Authentication_deAuthenticate(PHYSICAL);
  CheckPosResponse_SID29_deAuthenticate(0x10,0,0);
  
  checkAuthenticateState(Deauthenticated);
  /******************************以上为测试步骤*********************************/
  Postcondition();
}


testcase ReadSWandHWVersion()
{
 char logName[400] = "";
  byte ExpectNRC[2]={0x12,0x7E};
  char info[1024];
  byte PID[2];
  
  strncat(logName,"ReadSWandHWVersion",400);
  testCaseTitle("-","ReadSWandHWVersion");
  
  SetLog(logName);
  Precondition();

  /******************************以下为测试步骤*********************************/
  
  SessionFlag=APP;
  TestStep("Transition to defaultSesion(0x01)",TestStepIntervalTime);

  SID10_DiagnosticSessionControl(EXTENDEDSESSION,PHYSICAL,SPRMIB_FALSE);
  CheckPosResponse_SID10(EXTENDEDSESSION,gP2Client_APP,gP2StarClientFor10Check,0,0);
  TestStep("Verify EXTENDEDSESSION",TestStepIntervalTime);
  CheckCurrentSession(EXTENDEDSESSION,PHYSICAL,0,0);
  
  PID[0]=0xF1;
  PID[1]=0xAA;
  
  TestStep("Read data",TestStepIntervalTime);
  SID22_ReadDataByIdentifier(PID,PHYSICAL);
  CheckPosResponse_SID22(PID,0,0); 
  
  PID[0]=0xF1;
  PID[1]=0xAE;
  
  TestStep("Read data",TestStepIntervalTime);
  SID22_ReadDataByIdentifier(PID,PHYSICAL);
  CheckPosResponse_SID22(PID,0,0); 
    
  /******************************以上为测试步骤*********************************/
  PostCondition();
}

testcase debug()
{
  byte data[1]=0;
  int i=0;
  
  TP_TesterPresentSet(TP_ON);
  
  for(i=0;i<10000;i++)
  {
    TPSendRawMessage(data,PHYSICAL);
    CheckNegResponse(0x11,0,0);
    testWaitForTimeout(100);
  }

}
