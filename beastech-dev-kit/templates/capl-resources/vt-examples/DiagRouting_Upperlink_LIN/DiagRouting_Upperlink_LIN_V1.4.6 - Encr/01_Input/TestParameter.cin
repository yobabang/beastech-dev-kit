/*@!Encoding:936*/
variables
{
  char NodeName[30]="DHU";
  char IP_Address1[32]="169.254.15.118";
  enum ECUName_List
  {
//    ECUResetTime    = 1000,     //ECU重启时间
    ECUResetTime    = 8000,     //ECU重启时间
    EcuSum          =   13,      //app下路由地址个数+2
//    Req_Sum         =   13,     //Boot下路由地址个数+2
    DomianFun_Sum   =   2,     //域功能寻址个数+1
    NetworkNumber   =   6,      //子网段数目
    MaxTransTime    =   50, //诊断请求转发时间
    
    FunctionalReq   =   0,
    GW              =   1
  };
  enum TestParameters
  {        
    requestBufferAPP1      = 200,   responseBufferAPP1      = 500,
    requestBufferAPP2      = 2050,   responseBufferAPP2      = 200,
    requestBufferBoot1     = 2050,  responseBufferBoot1     = 100, 
	
    requestRAMAPP       = 200+2050*2,  responseRAMAPP       = 500+200*2,//注意buffer大小和个数
    requestRAMBoot        = 2050*4,  responseRAMBoot      = 100*3,
    
    requestBufferAPP_NUM       = 3,       responseBufferAPP_NUM       = 3, 
    requestBufferBoot_NUM    = 4,      responseBufferBoot_NUM    = 3
  };
  
  struct  EcuAddress
  {
    word   SN;
    word   domain;
    char   RoutingNet[20];
    word   SourceID;
    word   TargetID;
    char   EcuName[10];
    char   Type[10];
  };
  
  struct EcuAddress EcuAddressTable[EcuSum] = 
  {
  // SN  domain  RoutingNet  SourceID   TargetID    EcuName  Type
    { 0,  0, "Tester",        0x0E80,   0x1FFF,     "Func", "CANFD"   },//功能寻址
    { 1,  0, "Tester",        0x0E80,   0x1D01,     "ZCUD" , "CANFD"   },
    //Domain1

    { 2,  1, "Routing_NoDiag",        0x0E80,   0x1B61,     "BMS" , "LIN"    },//DHU
	{ 3,  1, "Routing_NoDiag",        0x0E80,   0x1B64,     "FDML" , "LIN"    },
	{ 4,  1, "Routing_NoDiag",        0x0E80,   0x1B62,     "FMDM" , "LIN"    },
    { 5,  2, "Routing_NoDiag",        0x0E80,   0x1B67,     "POSM" , "LIN"    },
//	{ 6,  2, "Routing_NoDiag",        0x0E80,   0x1B68,     "SBMS" , "LIN"    },
	{ 6,  2, "Routing_NoDiag",        0x0E80,   0x1B69,     "TCS" ,  "LIN"    },
	{ 7,  3, "Routing_NoDiag",        0x0E80,   0x1B2A,     "HCML2" ,  "LIN"    },
	{ 8,  3, "Routing_NoDiag",        0x0E80,   0x1B2B,     "HCMR2" ,  "LIN"    },
	{ 9,  4, "Routing_NoDiag",        0x0E80,   0x1B24,     "SRM" ,  "LIN"    },
	{ 10,  4, "Routing_NoDiag",        0x0E80,   0x1B25,     "AWM2" ,  "LIN"    },
	{ 11,  5, "Tester",        0x0E80,   0x1B71,     "FTKS" ,  "LIN"    },
    { 12,  6, "Routing_NoDiag",        0x0E80,   0x1B23,     "WMM" ,  "LIN"    }
//	{ 14,  7, "Tester",        0x0E80,   0x1B53,     "BBS" ,  "LIN"    },	
//	{ 15,  7, "Tester",        0x0E80,   0x1B52,     "IMS" ,  "LIN"    }
  
  }; 
  
//  struct EcuAddress EcuAddressTable_Boot[EcuSum] = 
//  {
//  // SN  domain  SourceID   TargetID    EcuName
//    { 0,  0, 0x0E80,   0x1FFF,     "Func", "ETH"   },//功能寻址
//    { 1,  0, 0x0E80,   0x1101,     "ZCL" , "ETH"   },//ZCL
//    //Domain1
//    {2,   1, 0x0E80,   0x110B,     "BMS" , "LIN"    }
//  };
   
  struct EcuAddress EcuAddressTable_Fun[DomianFun_Sum] = 
  {
    // SN  domain  RoutingNet  SourceID   TargetID      EcuName             Type
    {  0,    0,     "Tester",   0x0E80,    0x1FFF,      "Func",             "ETH"   },//功能寻址
    {  1,    1,     "Tester",   0x0e80,    0x12FF,      "DIM_LIN1",         "ETH"   }
  };
}
/*
**获取ECU ID在路由表中的编号
*/
long GetEcuSN(word ecuAddress)
{
  word i = 0;

  for(i=0;i<EcuSum;i++)
	{
		if(EcuAddressTable[i].TargetID == ecuAddress)
		{
			return i;
		}
	}
  
  return -1;
}

long GetEcuSNbyNAD(word NAD)
{
  word i = 0;

  for(i=0;i<EcuSum;i++)
	{
		if((EcuAddressTable[i].TargetID & 0xff) == NAD)
		{
			return i;
		}
	}
	if(0x7e == NAD)
	{
		return 0;
	}  
  return -1;
}