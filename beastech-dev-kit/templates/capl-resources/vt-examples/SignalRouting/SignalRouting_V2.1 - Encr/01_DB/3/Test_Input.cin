
variables
{   
    //由basetech测试配置生成，非code-factory生成
    
    //本次生成选中的目标网段为：['PropulsionCAN', 'CEM_LIN3', 'BodyExposedCAN', 'CEM_LIN6', 'ChassisCANFD2', 'ZCUD_CANFD4', 'ZCUD_CAN1', 'ChassisCAN1', 'ZCUD_CANFD3', 'CEM_LIN7', 'CEM_LIN4']
    //本次生成被过滤的源网段为：['CEM_LIN2', 'ZCUD_LIN3']
    
    const int Event = 1002;
    char NodeName[20] = "ZCUD5";
    LinFrame ZCUD_LIN1.0x36 des_DdsZCUD_Lin1Fr01={dlc=7};
    LinFrame ZCUD_LIN1.0x39 des_AdcZcud_Lin1Fr02={dlc=4};
    LinFrame ZCUD_LIN1.0x13 des_MdmZCUD_Lin1Fr01={dlc=2};
    LinFrame ZCUD_LIN1.0x3b des_AdcZcud_Lin1Fr01={dlc=8};
    LinFrame ZCUD_LIN1.0x1 des_MmdZCUD_Lin1Fr01={dlc=4};
    LinFrame CEM_LIN3.0x20 des_OhcCem_Lin3Fr01={dlc=7};
    LinFrame CEM_LIN3.0x23 des_Srm2Cem_Lin3Fr02={dlc=8};
    LinFrame CEM_LIN3.0x8 des_SigCem_Lin3Fr01={dlc=7};
    LinFrame CEM_LIN3.0x11 des_Srm2Cem_Lin3Fr01={dlc=7};
    LinFrame CEM_LIN3.0x1a des_AwmCem_Lin3Fr01={dlc=3};
    LinFrame CEM_LIN3.0x16 des_OhcCem_Lin3Fr05={dlc=2};
    LinFrame CEM_LIN3.0xe des_Awm2Cem_Lin3SertNrFr01={dlc=4};
    LinFrame CEM_LIN3.0x1c des_OhcCem_Lin3Fr06={dlc=7};
    LinFrame CEM_LIN3.0x14 des_OhcCem_Lin3Fr04={dlc=1};
    LinFrame CEM_LIN3.0x6 des_OhcCem_Lin3Fr10={dlc=7};
    LinFrame CEM_LIN6.0x28 des_BmsCem_Lin6Fr06={dlc=7};
    LinFrame CEM_LIN6.0x20 des_BmsCem_Lin6Fr10={dlc=7};
    LinFrame CEM_LIN6.0x2 des_BmsCem_Lin6Fr01={dlc=8};
    LinFrame CEM_LIN6.0x29 des_BmsCem_Lin6Fr12={dlc=8};
    LinFrame CEM_LIN6.0x16 des_FmdmCem_Lin6Fr01={dlc=1};
    LinFrame CEM_LIN6.0x2a des_BmsCem_Lin6Fr13={dlc=8};
    LinFrame CEM_LIN6.0x18 des_FdmlCem_Lin6Fr01={dlc=1};
    LinFrame CEM_LIN6.0x3 des_BmsCem_Lin6Fr02={dlc=8};
    LinFrame CEM_LIN6.0x26 des_BmsCem_Lin6Fr16={dlc=8};
    LinFrame CEM_LIN6.0x4 des_BmsCem_Lin6Fr03={dlc=7};
    LinFrame CEM_LIN6.0x7 des_BmsCem_Lin6Fr08={dlc=8};
    LinFrame CEM_LIN6.0x21 des_BmsCem_Lin6Fr11={dlc=4};
    LinFrame CEM_LIN6.0x9 des_BmsCem_Lin6Fr04={dlc=7};
    LinFrame CEM_LIN6.0x6 des_BmsCem_Lin6Fr05={dlc=7};
    LinFrame CEM_LIN6.0x10 des_BmsCem_Lin6Fr09={dlc=8};
    LinFrame CEM_LIN6.0x8 des_BmsCem_Lin6Fr07={dlc=8};
    LinFrame CEM_LIN6.0x24 des_BmsCem_Lin6Fr14={dlc=8};
    LinFrame CEM_LIN6.0x25 des_BmsCem_Lin6Fr15={dlc=8};
    LinFrame CEM_LIN6.0x27 des_BmsCem_Lin6Fr17={dlc=8};
    LinFrame CEM_LIN1.0x2c des_RlsmCem_Lin1Fr02={dlc=8};
    LinFrame CEM_LIN1.0x2 des_RlsmCem_Lin1Fr03={dlc=8};
    LinFrame CEM_LIN1.0x25 des_WmmCem_Lin1Fr01={dlc=4};
    LinFrame CEM_LIN1.0x15 des_RlsmCem_Lin1Fr01={dlc=8};
    LinFrame CEM_LIN1.0x3 des_RlsmCem_Lin1Fr04={dlc=7};
    LinFrame CEM_LIN1.0x10 des_IrmmCem_Lin1Fr01={dlc=4};
    LinFrame CEM_LIN1.0x13 des_IrmmCem_Lin1Fr02={dlc=8};
    LinFrame CEM_LIN4.0xc des_FtksCem_Lin4Fr01={dlc=8};
    LinFrame CEM_LIN4.0x20 des_LsmCem_Lin4Fr01={dlc=5};
    LinFrame ZCUD_LIN2.0x1 des_HcmlZcud_Lin2Fr01={dlc=7};
    LinFrame ZCUD_LIN2.0x2 des_HcmrZcud_Lin2Fr01={dlc=7};
    LinFrame CEM_LIN7.0x11 des_PosmCem_Lin7Fr01={dlc=8};
    LinFrame CEM_LIN7.0xf des_TCSCem_Lin7Fr03={dlc=8};
    LinFrame CEM_LIN7.0xa des_TCSCem_Lin7Fr02={dlc=8};
    Const int  Num_LIN=48;

    message 0x1 HighPriority_Msg1= {FDF=1,BRS=1,dlc = 15};
    message 0x7FE LowPriority_Msg1= {FDF=1,BRS=1,dlc = 15};
    message PropulsionCAN.0x000 des_PropulsionCAN_0x000;
    message ChassisCAN1.0x000 des_ChassisCAN1_0x000;
    message ZCU_CANFD1.0x000 des_ZCU_CANFD1_0x000;
    message ZCUD_CANFD3.0x000 des_ZCUD_CANFD3_0x000;
    message ChassisCANFD2.0x000 des_ChassisCANFD2_0x000;
    message ZCUD_CAN1.0x000 des_ZCUD_CAN1_0x000;
    message ZCUD_CANFD4.0x000 des_ZCUD_CANFD4_0x000;
    message ZCU_CANFD2.0x000 des_ZCU_CANFD2_0x000;
    message BodyExposedCAN.0x000 des_BodyExposedCAN_0x000;
    const int network_quantity=18;
    dword SignaleRoutingTime=5;
    int network_num;
    int Encoding=2;

    struct gFrame{
    char des_frame[100];
    int des_cyc;
    int des_id;   
    int des_slotid_fr;
    int des_basecycle_fr;
    int des_repetition_fr;
    int des_dlc;
  };
  
    //data for Signal routing message check
    struct Demo_signal_frame{ 
    char des_can[100];
    char networktype[20];
    int SumAll;
    struct gFrame GFrame[500];
  };
        
    struct Demo_signal_frame test_sig_frame[network_quantity]={

   {
       /*des_channels*/  "ZCUD_LIN1",
       /*networktype*/  "LIN",
       0,
       {
           0
       }
   },
   {
       /*des_channels*/  "CEM_LIN3",
       /*networktype*/  "LIN",
       2,
       {
           {/*des_frame*/"ZCUDCem_Lin3Fr12",   /*des_cyc*/1000,   /*des_id*/36,   /*des_slotid_fr*/0,   /*des_basecycle_fr*/0,   /*des_repetition_fr*/0,  /*des_dlc*/8    
           },
           {/*des_frame*/"ZCUDCem_Lin3Fr01",   /*des_cyc*/1000,   /*des_id*/0,   /*des_slotid_fr*/0,   /*des_basecycle_fr*/0,   /*des_repetition_fr*/0,  /*des_dlc*/7    
           }
       }
   },
   {
       /*des_channels*/  "CEM_LIN2",
       /*networktype*/  "LIN",
       0,
       {
           0
       }
   },
   {
       /*des_channels*/  "CEM_LIN6",
       /*networktype*/  "LIN",
       3,
       {
           {/*des_frame*/"CemCem_Lin6Fr11",   /*des_cyc*/1000,   /*des_id*/20,   /*des_slotid_fr*/0,   /*des_basecycle_fr*/0,   /*des_repetition_fr*/0,  /*des_dlc*/8    
           },
           {/*des_frame*/"ZCUDCem_Lin6Fr08",   /*des_cyc*/1000,   /*des_id*/51,   /*des_slotid_fr*/0,   /*des_basecycle_fr*/0,   /*des_repetition_fr*/0,  /*des_dlc*/7    
           },
           {/*des_frame*/"ZCUDCem_Lin6Fr02",   /*des_cyc*/1000,   /*des_id*/13,   /*des_slotid_fr*/0,   /*des_basecycle_fr*/0,   /*des_repetition_fr*/0,  /*des_dlc*/5    
           }
       }
   },
   {
       /*des_channels*/  "CEM_LIN1",
       /*networktype*/  "LIN",
       0,
       {
           0
       }
   },
   {
       /*des_channels*/  "CEM_LIN4",
       /*networktype*/  "LIN",
       1,
       {
           {/*des_frame*/"CemCem_Lin4Fr02",   /*des_cyc*/1000,   /*des_id*/2,   /*des_slotid_fr*/0,   /*des_basecycle_fr*/0,   /*des_repetition_fr*/0,  /*des_dlc*/7    
           }
       }
   },
   {
       /*des_channels*/  "ZCUD_LIN2",
       /*networktype*/  "LIN",
       0,
       {
           0
       }
   },
   {
       /*des_channels*/  "ZCUD_LIN3",
       /*networktype*/  "LIN",
       0,
       {
           0
       }
   },
   {
       /*des_channels*/  "CEM_LIN7",
       /*networktype*/  "LIN",
       3,
       {
           {/*des_frame*/"ZCUDCem_Lin7Fr03",   /*des_cyc*/1000,   /*des_id*/33,   /*des_slotid_fr*/0,   /*des_basecycle_fr*/0,   /*des_repetition_fr*/0,  /*des_dlc*/7    
           },
           {/*des_frame*/"ZCUDCem_Lin7Fr04",   /*des_cyc*/1000,   /*des_id*/34,   /*des_slotid_fr*/0,   /*des_basecycle_fr*/0,   /*des_repetition_fr*/0,  /*des_dlc*/8    
           },
           {/*des_frame*/"ZCUDCem_Lin7Fr01",   /*des_cyc*/1000,   /*des_id*/16,   /*des_slotid_fr*/0,   /*des_basecycle_fr*/0,   /*des_repetition_fr*/0,  /*des_dlc*/8    
           }
       }
   },
   {
       /*des_channels*/  "PropulsionCAN",
       /*networktype*/  "CAN",
       10,
       {
           {/*des_frame*/"ZcudPropFr17",   /*des_cyc*/10,   /*des_id*/0x41,   /*des_slotid_fr*/0,   /*des_basecycle_fr*/0,   /*des_repetition_fr*/0,  /*des_dlc*/8    
           },
           {/*des_frame*/"ZcudPropFr02",   /*des_cyc*/1000,   /*des_id*/0x4a3,   /*des_slotid_fr*/0,   /*des_basecycle_fr*/0,   /*des_repetition_fr*/0,  /*des_dlc*/8    
           },
           {/*des_frame*/"ZcudPropFr21",   /*des_cyc*/100,   /*des_id*/0x162,   /*des_slotid_fr*/0,   /*des_basecycle_fr*/0,   /*des_repetition_fr*/0,  /*des_dlc*/8    
           },
           {/*des_frame*/"ZcudPropFr03",   /*des_cyc*/50,   /*des_id*/0x19d,   /*des_slotid_fr*/0,   /*des_basecycle_fr*/0,   /*des_repetition_fr*/0,  /*des_dlc*/8    
           },
           {/*des_frame*/"ZcudPropFr16",   /*des_cyc*/15,   /*des_id*/0x76,   /*des_slotid_fr*/0,   /*des_basecycle_fr*/0,   /*des_repetition_fr*/0,  /*des_dlc*/8    
           },
           {/*des_frame*/"ZcudPropFr27",   /*des_cyc*/160,   /*des_id*/0x238,   /*des_slotid_fr*/0,   /*des_basecycle_fr*/0,   /*des_repetition_fr*/0,  /*des_dlc*/8    
           },
           {/*des_frame*/"ZcudPropFr26",   /*des_cyc*/50,   /*des_id*/0x198,   /*des_slotid_fr*/0,   /*des_basecycle_fr*/0,   /*des_repetition_fr*/0,  /*des_dlc*/8    
           },
           {/*des_frame*/"ZcudPropFr28",   /*des_cyc*/10,   /*des_id*/0x54,   /*des_slotid_fr*/0,   /*des_basecycle_fr*/0,   /*des_repetition_fr*/0,  /*des_dlc*/8    
           },
           {/*des_frame*/"ZcudPropFr19",   /*des_cyc*/25,   /*des_id*/0x139,   /*des_slotid_fr*/0,   /*des_basecycle_fr*/0,   /*des_repetition_fr*/0,  /*des_dlc*/8    
           },
           {/*des_frame*/"ZcudPropFr23",   /*des_cyc*/200,   /*des_id*/0x285,   /*des_slotid_fr*/0,   /*des_basecycle_fr*/0,   /*des_repetition_fr*/0,  /*des_dlc*/8    
           }
       }
   },
   {
       /*des_channels*/  "ChassisCAN1",
       /*networktype*/  "CAN",
       7,
       {
           {/*des_frame*/"ZcudChas1Fr17",   /*des_cyc*/320,   /*des_id*/0x3a0,   /*des_slotid_fr*/0,   /*des_basecycle_fr*/0,   /*des_repetition_fr*/0,  /*des_dlc*/8    
           },
           {/*des_frame*/"ZcudChas1Fr16",   /*des_cyc*/10,   /*des_id*/0xa0,   /*des_slotid_fr*/0,   /*des_basecycle_fr*/0,   /*des_repetition_fr*/0,  /*des_dlc*/8    
           },
           {/*des_frame*/"ZcudChas1Fr27",   /*des_cyc*/100,   /*des_id*/0x1a,   /*des_slotid_fr*/0,   /*des_basecycle_fr*/0,   /*des_repetition_fr*/0,  /*des_dlc*/8    
           },
           {/*des_frame*/"ZcudChas1Fr31",   /*des_cyc*/200,   /*des_id*/0x244,   /*des_slotid_fr*/0,   /*des_basecycle_fr*/0,   /*des_repetition_fr*/0,  /*des_dlc*/8    
           },
           {/*des_frame*/"ZcudChas1Fr18",   /*des_cyc*/10,   /*des_id*/0x1b0,   /*des_slotid_fr*/0,   /*des_basecycle_fr*/0,   /*des_repetition_fr*/0,  /*des_dlc*/8    
           },
           {/*des_frame*/"ZcudChas1Fr15",   /*des_cyc*/10,   /*des_id*/0x51,   /*des_slotid_fr*/0,   /*des_basecycle_fr*/0,   /*des_repetition_fr*/0,  /*des_dlc*/8    
           },
           {/*des_frame*/"ZcudChas1Fr10",   /*des_cyc*/Event,   /*des_id*/0x2f,   /*des_slotid_fr*/0,   /*des_basecycle_fr*/0,   /*des_repetition_fr*/0,  /*des_dlc*/8    
           }
       }
   },
   {
       /*des_channels*/  "ZCU_CANFD1",
       /*networktype*/  "CAN",
       0,
       {
           0
       }
   },
   {
       /*des_channels*/  "ZCUD_CANFD3",
       /*networktype*/  "CAN",
       5,
       {
           {/*des_frame*/"ZcudZCUDCANFD3Fr06",   /*des_cyc*/100,   /*des_id*/0x239,   /*des_slotid_fr*/0,   /*des_basecycle_fr*/0,   /*des_repetition_fr*/0,  /*des_dlc*/64    
           },
           {/*des_frame*/"ZcudZCUDCANFD3Fr01",   /*des_cyc*/10,   /*des_id*/0x55,   /*des_slotid_fr*/0,   /*des_basecycle_fr*/0,   /*des_repetition_fr*/0,  /*des_dlc*/64    
           },
           {/*des_frame*/"ZcudZCUDCANFD3Fr07",   /*des_cyc*/200,   /*des_id*/0x271,   /*des_slotid_fr*/0,   /*des_basecycle_fr*/0,   /*des_repetition_fr*/0,  /*des_dlc*/64    
           },
           {/*des_frame*/"ZcudZCUDCANFD3Fr02",   /*des_cyc*/50,   /*des_id*/0x153,   /*des_slotid_fr*/0,   /*des_basecycle_fr*/0,   /*des_repetition_fr*/0,  /*des_dlc*/64    
           },
           {/*des_frame*/"ZcudZCUDCANFD3Fr09",   /*des_cyc*/10,   /*des_id*/0x66,   /*des_slotid_fr*/0,   /*des_basecycle_fr*/0,   /*des_repetition_fr*/0,  /*des_dlc*/64    
           }
       }
   },
   {
       /*des_channels*/  "ChassisCANFD2",
       /*networktype*/  "CAN",
       7,
       {
           {/*des_frame*/"ZcudChassisCANFD2Fr004",   /*des_cyc*/40,   /*des_id*/0x13c,   /*des_slotid_fr*/0,   /*des_basecycle_fr*/0,   /*des_repetition_fr*/0,  /*des_dlc*/64    
           },
           {/*des_frame*/"ZcudChassisCANFD2Fr018",   /*des_cyc*/450,   /*des_id*/0x335,   /*des_slotid_fr*/0,   /*des_basecycle_fr*/0,   /*des_repetition_fr*/0,  /*des_dlc*/64    
           },
           {/*des_frame*/"ZcudChassisCANFD2Fr002",   /*des_cyc*/10,   /*des_id*/0x4f,   /*des_slotid_fr*/0,   /*des_basecycle_fr*/0,   /*des_repetition_fr*/0,  /*des_dlc*/64    
           },
           {/*des_frame*/"ZcudChassisCANFD2Fr016",   /*des_cyc*/200,   /*des_id*/0x2a4,   /*des_slotid_fr*/0,   /*des_basecycle_fr*/0,   /*des_repetition_fr*/0,  /*des_dlc*/64    
           },
           {/*des_frame*/"ZcudChassisCANFD2Fr003",   /*des_cyc*/20,   /*des_id*/0xdf,   /*des_slotid_fr*/0,   /*des_basecycle_fr*/0,   /*des_repetition_fr*/0,  /*des_dlc*/64    
           },
           {/*des_frame*/"ZcudChassisCANFD2Fr015",   /*des_cyc*/450,   /*des_id*/0x35c,   /*des_slotid_fr*/0,   /*des_basecycle_fr*/0,   /*des_repetition_fr*/0,  /*des_dlc*/64    
           },
           {/*des_frame*/"ZcudChassisCANFD2Fr014",   /*des_cyc*/10,   /*des_id*/0x59,   /*des_slotid_fr*/0,   /*des_basecycle_fr*/0,   /*des_repetition_fr*/0,  /*des_dlc*/64    
           }
       }
   },
   {
       /*des_channels*/  "ZCUD_CAN1",
       /*networktype*/  "CAN",
       26,
       {
           {/*des_frame*/"ZCUDZCUDCAN1Fr39",   /*des_cyc*/1000,   /*des_id*/0x399,   /*des_slotid_fr*/0,   /*des_basecycle_fr*/0,   /*des_repetition_fr*/0,  /*des_dlc*/8    
           },
           {/*des_frame*/"ZCUDZCUDCAN1Fr31",   /*des_cyc*/40,   /*des_id*/0x78,   /*des_slotid_fr*/0,   /*des_basecycle_fr*/0,   /*des_repetition_fr*/0,  /*des_dlc*/8    
           },
           {/*des_frame*/"ZCUDZCUDCAN1Fr45",   /*des_cyc*/420,   /*des_id*/0x351,   /*des_slotid_fr*/0,   /*des_basecycle_fr*/0,   /*des_repetition_fr*/0,  /*des_dlc*/8    
           },
           {/*des_frame*/"ZCUDZCUDCAN1Fr96",   /*des_cyc*/70,   /*des_id*/0x235,   /*des_slotid_fr*/0,   /*des_basecycle_fr*/0,   /*des_repetition_fr*/0,  /*des_dlc*/8    
           },
           {/*des_frame*/"ZCUDZCUDCAN1Fr12",   /*des_cyc*/350,   /*des_id*/0x388,   /*des_slotid_fr*/0,   /*des_basecycle_fr*/0,   /*des_repetition_fr*/0,  /*des_dlc*/8    
           },
           {/*des_frame*/"ZCUDZCUDCAN1Fr63",   /*des_cyc*/10,   /*des_id*/0x1b,   /*des_slotid_fr*/0,   /*des_basecycle_fr*/0,   /*des_repetition_fr*/0,  /*des_dlc*/8    
           },
           {/*des_frame*/"ZCUDZCUDCAN1Fr58",   /*des_cyc*/200,   /*des_id*/0x20,   /*des_slotid_fr*/0,   /*des_basecycle_fr*/0,   /*des_repetition_fr*/0,  /*des_dlc*/8    
           },
           {/*des_frame*/"ZCUDZCUDCAN1Fr10",   /*des_cyc*/800,   /*des_id*/0x390,   /*des_slotid_fr*/0,   /*des_basecycle_fr*/0,   /*des_repetition_fr*/0,  /*des_dlc*/8    
           },
           {/*des_frame*/"ZCUDZCUDCAN1Fr05",   /*des_cyc*/620,   /*des_id*/0x370,   /*des_slotid_fr*/0,   /*des_basecycle_fr*/0,   /*des_repetition_fr*/0,  /*des_dlc*/8    
           },
           {/*des_frame*/"ZCUDZCUDCAN1Fr24",   /*des_cyc*/100,   /*des_id*/0x206,   /*des_slotid_fr*/0,   /*des_basecycle_fr*/0,   /*des_repetition_fr*/0,  /*des_dlc*/8    
           },
           {/*des_frame*/"ZCUDZCUDCAN1Fr60",   /*des_cyc*/15,   /*des_id*/0x5b,   /*des_slotid_fr*/0,   /*des_basecycle_fr*/0,   /*des_repetition_fr*/0,  /*des_dlc*/8    
           },
           {/*des_frame*/"ZCUDZCUDCAN1Fr37",   /*des_cyc*/20,   /*des_id*/0x76,   /*des_slotid_fr*/0,   /*des_basecycle_fr*/0,   /*des_repetition_fr*/0,  /*des_dlc*/8    
           },
           {/*des_frame*/"ZCUDZCUDCAN1Fr48",   /*des_cyc*/100,   /*des_id*/0x209,   /*des_slotid_fr*/0,   /*des_basecycle_fr*/0,   /*des_repetition_fr*/0,  /*des_dlc*/8    
           },
           {/*des_frame*/"ZCUDZCUDCAN1Fr09",   /*des_cyc*/150,   /*des_id*/0x371,   /*des_slotid_fr*/0,   /*des_basecycle_fr*/0,   /*des_repetition_fr*/0,  /*des_dlc*/8    
           },
           {/*des_frame*/"ZCUDZCUDCAN1Fr97",   /*des_cyc*/30,   /*des_id*/0x13a,   /*des_slotid_fr*/0,   /*des_basecycle_fr*/0,   /*des_repetition_fr*/0,  /*des_dlc*/8    
           },
           {/*des_frame*/"ZCUDZCUDCAN1Fr19",   /*des_cyc*/350,   /*des_id*/0x384,   /*des_slotid_fr*/0,   /*des_basecycle_fr*/0,   /*des_repetition_fr*/0,  /*des_dlc*/8    
           },
           {/*des_frame*/"ZCUDZCUDCAN1Fr25",   /*des_cyc*/15,   /*des_id*/0x24,   /*des_slotid_fr*/0,   /*des_basecycle_fr*/0,   /*des_repetition_fr*/0,  /*des_dlc*/8    
           },
           {/*des_frame*/"ZCUDZCUDCAN1Fr65",   /*des_cyc*/60,   /*des_id*/0x215,   /*des_slotid_fr*/0,   /*des_basecycle_fr*/0,   /*des_repetition_fr*/0,  /*des_dlc*/8    
           },
           {/*des_frame*/"ZCUDZCUDCAN1Fr23",   /*des_cyc*/420,   /*des_id*/0x345,   /*des_slotid_fr*/0,   /*des_basecycle_fr*/0,   /*des_repetition_fr*/0,  /*des_dlc*/8    
           },
           {/*des_frame*/"ZCUDZCUDCAN1Fr67",   /*des_cyc*/200,   /*des_id*/0x140,   /*des_slotid_fr*/0,   /*des_basecycle_fr*/0,   /*des_repetition_fr*/0,  /*des_dlc*/8    
           },
           {/*des_frame*/"ZCUDZCUDCAN1Fr80",   /*des_cyc*/15,   /*des_id*/0x110,   /*des_slotid_fr*/0,   /*des_basecycle_fr*/0,   /*des_repetition_fr*/0,  /*des_dlc*/8    
           },
           {/*des_frame*/"ZCUDZCUDCAN1Fr21",   /*des_cyc*/800,   /*des_id*/0x398,   /*des_slotid_fr*/0,   /*des_basecycle_fr*/0,   /*des_repetition_fr*/0,  /*des_dlc*/8    
           },
           {/*des_frame*/"ZCUDZCUDCAN1Fr59",   /*des_cyc*/40,   /*des_id*/0xea,   /*des_slotid_fr*/0,   /*des_basecycle_fr*/0,   /*des_repetition_fr*/0,  /*des_dlc*/8    
           },
           {/*des_frame*/"ZCUDZCUDCAN1Fr22",   /*des_cyc*/150,   /*des_id*/0x378,   /*des_slotid_fr*/0,   /*des_basecycle_fr*/0,   /*des_repetition_fr*/0,  /*des_dlc*/8    
           },
           {/*des_frame*/"ZCUDZCUDCAN1Fr81",   /*des_cyc*/15,   /*des_id*/0x11a,   /*des_slotid_fr*/0,   /*des_basecycle_fr*/0,   /*des_repetition_fr*/0,  /*des_dlc*/8    
           },
           {/*des_frame*/"ZCUDZCUDCAN1Fr70",   /*des_cyc*/70,   /*des_id*/0x99,   /*des_slotid_fr*/0,   /*des_basecycle_fr*/0,   /*des_repetition_fr*/0,  /*des_dlc*/8    
           }
       }
   },
   {
       /*des_channels*/  "ZCUD_CANFD4",
       /*networktype*/  "CAN",
       1,
       {
           {/*des_frame*/"ZcudZCUDCANFD4Fr06",   /*des_cyc*/20,   /*des_id*/0x100,   /*des_slotid_fr*/0,   /*des_basecycle_fr*/0,   /*des_repetition_fr*/0,  /*des_dlc*/64    
           }
       }
   },
   {
       /*des_channels*/  "ZCU_CANFD2",
       /*networktype*/  "CAN",
       0,
       {
           0
       }
   },
   {
       /*des_channels*/  "BodyExposedCAN",
       /*networktype*/  "CAN",
       1,
       {
           {/*des_frame*/"ZCUDBodyExpoFr01",   /*des_cyc*/450,   /*des_id*/0x3a1,   /*des_slotid_fr*/0,   /*des_basecycle_fr*/0,   /*des_repetition_fr*/0,  /*des_dlc*/8    
           }
       }
   }
};//data for Signal routing test
  struct gSignal{
    char sig_name[100];
    char scr_can[100];
    char scr_network_type[100];
    int scr_slotid_fr;
    int scr_basecycle_fr;
    int scr_repetition_fr;
    int scr_startbit;
    int sig_length;
    int des_slotid_fr;
    int des_basecycle_fr;
    int des_repetition_fr;
    int des_startbit;
    int scr_cyc;
    int scr_id;
    int scr_dlc;
    int des_cyc;
    int des_id;  
    int updatebit; //source
    int des_updatebit;
    qword InitValue; 
  };
  
 //data for Signal routing test
  struct Demo_signal{ 
    char des_can[100]; 
    char des_networktype[100];
    int sum;
    struct gSignal GSignal[4000];
  };
    
  struct Demo_signal test_sig[network_quantity]={
   {
       /*des_can*/ "ZCUD_LIN1",
       /*networktype*/ "LIN",
       0,
       {
           0
       }
   },
   {
       /*des_can*/ "CEM_LIN3",
       /*networktype*/ "LIN",
       10,
       {
           {   /*sig_name*/"isVehSpdLgtCntr_0",   /*src_can*/"ChassisCANFD2",   /*src_network_type*/"CANFD",   /*src_slotid_fr*/0,   /*src_basecycle_fr*/0,  /*src_repetition_fr*/0,  /*src_startbit*/216,   /*sig_length*/4,  /*des_slotid_fr*/0,   /*des_basecycle_fr*/0,  /*des_repetition_fr*/0,   /*des_startbit*/40,    /*src_cyc*/101,  /*src_id*/0x9f,   /*src_dlc*/64,   /*des_cyc*/1000,   /*des_id*/36, /*src_updatebit*/471,   /*des_updatebit*/1000,      /*initvalue*/0         },
           {   /*sig_name*/"isVehSpdLgtA_0",   /*src_can*/"ChassisCANFD2",   /*src_network_type*/"CANFD",   /*src_slotid_fr*/0,   /*src_basecycle_fr*/0,  /*src_repetition_fr*/0,  /*src_startbit*/207,   /*sig_length*/15,  /*des_slotid_fr*/0,   /*des_basecycle_fr*/0,  /*des_repetition_fr*/0,   /*des_startbit*/17,    /*src_cyc*/101,  /*src_id*/0x9f,   /*src_dlc*/64,   /*des_cyc*/1000,   /*des_id*/36, /*src_updatebit*/471,   /*des_updatebit*/1000,      /*initvalue*/0         },
           {   /*sig_name*/"isVehSpdLgtQf_0",   /*src_can*/"ChassisCANFD2",   /*src_network_type*/"CANFD",   /*src_slotid_fr*/0,   /*src_basecycle_fr*/0,  /*src_repetition_fr*/0,  /*src_startbit*/228,   /*sig_length*/2,  /*des_slotid_fr*/0,   /*des_basecycle_fr*/0,  /*des_repetition_fr*/0,   /*des_startbit*/44,    /*src_cyc*/101,  /*src_id*/0x9f,   /*src_dlc*/64,   /*des_cyc*/1000,   /*des_id*/36, /*src_updatebit*/471,   /*des_updatebit*/1000,      /*initvalue*/1         },
           {   /*sig_name*/"isVehSpdLgtChks_0",   /*src_can*/"ChassisCANFD2",   /*src_network_type*/"CANFD",   /*src_slotid_fr*/0,   /*src_basecycle_fr*/0,  /*src_repetition_fr*/0,  /*src_startbit*/208,   /*sig_length*/8,  /*des_slotid_fr*/0,   /*des_basecycle_fr*/0,  /*des_repetition_fr*/0,   /*des_startbit*/32,    /*src_cyc*/101,  /*src_id*/0x9f,   /*src_dlc*/64,   /*des_cyc*/1000,   /*des_id*/36, /*src_updatebit*/471,   /*des_updatebit*/1000,      /*initvalue*/0         },
           {   /*sig_name*/"isPassAirbLampReqPassAirbLampEnaReq_0",   /*src_can*/"ZCUD_CAN1",   /*src_network_type*/"CAN",   /*src_slotid_fr*/0,   /*src_basecycle_fr*/0,  /*src_repetition_fr*/0,  /*src_startbit*/53,   /*sig_length*/2,  /*des_slotid_fr*/0,   /*des_basecycle_fr*/0,  /*des_repetition_fr*/0,   /*des_startbit*/44,    /*src_cyc*/101,  /*src_id*/0x142,   /*src_dlc*/8,   /*des_cyc*/1000,   /*des_id*/0, /*src_updatebit*/33,   /*des_updatebit*/1000,      /*initvalue*/2         },
           {   /*sig_name*/"isPassAirbLampReqChgOfPassAirbSts_0",   /*src_can*/"ZCUD_CAN1",   /*src_network_type*/"CAN",   /*src_slotid_fr*/0,   /*src_basecycle_fr*/0,  /*src_repetition_fr*/0,  /*src_startbit*/32,   /*sig_length*/1,  /*des_slotid_fr*/0,   /*des_basecycle_fr*/0,  /*des_repetition_fr*/0,   /*des_startbit*/48,    /*src_cyc*/101,  /*src_id*/0x142,   /*src_dlc*/8,   /*des_cyc*/1000,   /*des_id*/0, /*src_updatebit*/33,   /*des_updatebit*/1000,      /*initvalue*/0         },
           {   /*sig_name*/"isPassAirbLampReqChks_0",   /*src_can*/"ZCUD_CAN1",   /*src_network_type*/"CAN",   /*src_slotid_fr*/0,   /*src_basecycle_fr*/0,  /*src_repetition_fr*/0,  /*src_startbit*/47,   /*sig_length*/8,  /*des_slotid_fr*/0,   /*des_basecycle_fr*/0,  /*des_repetition_fr*/0,   /*des_startbit*/32,    /*src_cyc*/101,  /*src_id*/0x142,   /*src_dlc*/8,   /*des_cyc*/1000,   /*des_id*/0, /*src_updatebit*/33,   /*des_updatebit*/1000,      /*initvalue*/255         },
           {   /*sig_name*/"isPassAirbLampReqPassAirbLampDiReq_0",   /*src_can*/"ZCUD_CAN1",   /*src_network_type*/"CAN",   /*src_slotid_fr*/0,   /*src_basecycle_fr*/0,  /*src_repetition_fr*/0,  /*src_startbit*/55,   /*sig_length*/2,  /*des_slotid_fr*/0,   /*des_basecycle_fr*/0,  /*des_repetition_fr*/0,   /*des_startbit*/46,    /*src_cyc*/101,  /*src_id*/0x142,   /*src_dlc*/8,   /*des_cyc*/1000,   /*des_id*/0, /*src_updatebit*/33,   /*des_updatebit*/1000,      /*initvalue*/2         },
           {   /*sig_name*/"isPassAirbLampReqCntr_0",   /*src_can*/"ZCUD_CAN1",   /*src_network_type*/"CAN",   /*src_slotid_fr*/0,   /*src_basecycle_fr*/0,  /*src_repetition_fr*/0,  /*src_startbit*/51,   /*sig_length*/4,  /*des_slotid_fr*/0,   /*des_basecycle_fr*/0,  /*des_repetition_fr*/0,   /*des_startbit*/40,    /*src_cyc*/101,  /*src_id*/0x142,   /*src_dlc*/8,   /*des_cyc*/1000,   /*des_id*/0, /*src_updatebit*/33,   /*des_updatebit*/1000,      /*initvalue*/0         },
           {   /*sig_name*/"isTrlrPrsnt_0",   /*src_can*/"ZCUD_CAN1",   /*src_network_type*/"CAN",   /*src_slotid_fr*/0,   /*src_basecycle_fr*/0,  /*src_repetition_fr*/0,  /*src_startbit*/13,   /*sig_length*/1,  /*des_slotid_fr*/0,   /*des_basecycle_fr*/0,  /*des_repetition_fr*/0,   /*des_startbit*/53,    /*src_cyc*/101,  /*src_id*/0xd0,   /*src_dlc*/4,   /*des_cyc*/1000,   /*des_id*/36, /*src_updatebit*/20,   /*des_updatebit*/1000,      /*initvalue*/0         }
       }
   },
   {
       /*des_can*/ "CEM_LIN2",
       /*networktype*/ "LIN",
       0,
       {
           0
       }
   },
   {
       /*des_can*/ "CEM_LIN6",
       /*networktype*/ "LIN",
       12,
       {
           {   /*sig_name*/"isHvBattLimnIndcn_0",   /*src_can*/"PropulsionCAN",   /*src_network_type*/"CAN",   /*src_slotid_fr*/0,   /*src_basecycle_fr*/0,  /*src_repetition_fr*/0,  /*src_startbit*/15,   /*sig_length*/16,  /*des_slotid_fr*/0,   /*des_basecycle_fr*/0,  /*des_repetition_fr*/0,   /*des_startbit*/48,    /*src_cyc*/101,  /*src_id*/0x141,   /*src_dlc*/8,   /*des_cyc*/1000,   /*des_id*/20, /*src_updatebit*/31,   /*des_updatebit*/1000,      /*initvalue*/0         },
           {   /*sig_name*/"isVehSpdLgtCntr_0",   /*src_can*/"ChassisCANFD2",   /*src_network_type*/"CANFD",   /*src_slotid_fr*/0,   /*src_basecycle_fr*/0,  /*src_repetition_fr*/0,  /*src_startbit*/216,   /*sig_length*/4,  /*des_slotid_fr*/0,   /*des_basecycle_fr*/0,  /*des_repetition_fr*/0,   /*des_startbit*/26,    /*src_cyc*/101,  /*src_id*/0x9f,   /*src_dlc*/64,   /*des_cyc*/1000,   /*des_id*/51, /*src_updatebit*/471,   /*des_updatebit*/1000,      /*initvalue*/0         },
           {   /*sig_name*/"isVehSpdLgtA_0",   /*src_can*/"ChassisCANFD2",   /*src_network_type*/"CANFD",   /*src_slotid_fr*/0,   /*src_basecycle_fr*/0,  /*src_repetition_fr*/0,  /*src_startbit*/207,   /*sig_length*/15,  /*des_slotid_fr*/0,   /*des_basecycle_fr*/0,  /*des_repetition_fr*/0,   /*des_startbit*/1,    /*src_cyc*/101,  /*src_id*/0x9f,   /*src_dlc*/64,   /*des_cyc*/1000,   /*des_id*/51, /*src_updatebit*/471,   /*des_updatebit*/1000,      /*initvalue*/0         },
           {   /*sig_name*/"isVehSpdLgtQf_0",   /*src_can*/"ChassisCANFD2",   /*src_network_type*/"CANFD",   /*src_slotid_fr*/0,   /*src_basecycle_fr*/0,  /*src_repetition_fr*/0,  /*src_startbit*/228,   /*sig_length*/2,  /*des_slotid_fr*/0,   /*des_basecycle_fr*/0,  /*des_repetition_fr*/0,   /*des_startbit*/24,    /*src_cyc*/101,  /*src_id*/0x9f,   /*src_dlc*/64,   /*des_cyc*/1000,   /*des_id*/51, /*src_updatebit*/471,   /*des_updatebit*/1000,      /*initvalue*/1         },
           {   /*sig_name*/"isVehSpdLgtChks_0",   /*src_can*/"ChassisCANFD2",   /*src_network_type*/"CANFD",   /*src_slotid_fr*/0,   /*src_basecycle_fr*/0,  /*src_repetition_fr*/0,  /*src_startbit*/208,   /*sig_length*/8,  /*des_slotid_fr*/0,   /*des_basecycle_fr*/0,  /*des_repetition_fr*/0,   /*des_startbit*/16,    /*src_cyc*/101,  /*src_id*/0x9f,   /*src_dlc*/64,   /*des_cyc*/1000,   /*des_id*/51, /*src_updatebit*/471,   /*des_updatebit*/1000,      /*initvalue*/0         },
           {   /*sig_name*/"isFltTDcDc_0",   /*src_can*/"PropulsionCAN",   /*src_network_type*/"CAN",   /*src_slotid_fr*/0,   /*src_basecycle_fr*/0,  /*src_repetition_fr*/0,  /*src_startbit*/9,   /*sig_length*/1,  /*des_slotid_fr*/0,   /*des_basecycle_fr*/0,  /*des_repetition_fr*/0,   /*des_startbit*/22,    /*src_cyc*/101,  /*src_id*/0x14b,   /*src_dlc*/8,   /*des_cyc*/1000,   /*des_id*/13, /*src_updatebit*/8,   /*des_updatebit*/1000,      /*initvalue*/0         },
           {   /*sig_name*/"isHvBattPreChrgReq_0",   /*src_can*/"PropulsionCAN",   /*src_network_type*/"CAN",   /*src_slotid_fr*/0,   /*src_basecycle_fr*/0,  /*src_repetition_fr*/0,  /*src_startbit*/48,   /*sig_length*/1,  /*des_slotid_fr*/0,   /*des_basecycle_fr*/0,  /*des_repetition_fr*/0,   /*des_startbit*/0,    /*src_cyc*/101,  /*src_id*/0x14f,   /*src_dlc*/8,   /*des_cyc*/1000,   /*des_id*/51, /*src_updatebit*/49,   /*des_updatebit*/1000,      /*initvalue*/0         },
           {   /*sig_name*/"isDcDcActvd_0",   /*src_can*/"PropulsionCAN",   /*src_network_type*/"CAN",   /*src_slotid_fr*/0,   /*src_basecycle_fr*/0,  /*src_repetition_fr*/0,  /*src_startbit*/25,   /*sig_length*/1,  /*des_slotid_fr*/0,   /*des_basecycle_fr*/0,  /*des_repetition_fr*/0,   /*des_startbit*/24,    /*src_cyc*/101,  /*src_id*/0x14b,   /*src_dlc*/8,   /*des_cyc*/1000,   /*des_id*/13, /*src_updatebit*/24,   /*des_updatebit*/1000,      /*initvalue*/0         },
           {   /*sig_name*/"isFltElecDcDc_0",   /*src_can*/"PropulsionCAN",   /*src_network_type*/"CAN",   /*src_slotid_fr*/0,   /*src_basecycle_fr*/0,  /*src_repetition_fr*/0,  /*src_startbit*/11,   /*sig_length*/1,  /*des_slotid_fr*/0,   /*des_basecycle_fr*/0,  /*des_repetition_fr*/0,   /*des_startbit*/21,    /*src_cyc*/101,  /*src_id*/0x14b,   /*src_dlc*/8,   /*des_cyc*/1000,   /*des_id*/13, /*src_updatebit*/10,   /*des_updatebit*/1000,      /*initvalue*/0         },
           {   /*sig_name*/"isCrashStsSafeChks_0",   /*src_can*/"ZCUD_CAN1",   /*src_network_type*/"CAN",   /*src_slotid_fr*/0,   /*src_basecycle_fr*/0,  /*src_repetition_fr*/0,  /*src_startbit*/15,   /*sig_length*/8,  /*des_slotid_fr*/0,   /*des_basecycle_fr*/0,  /*des_repetition_fr*/0,   /*des_startbit*/30,    /*src_cyc*/101,  /*src_id*/0x10,   /*src_dlc*/4,   /*des_cyc*/1000,   /*des_id*/51, /*src_updatebit*/5,   /*des_updatebit*/1000,      /*initvalue*/255         },
           {   /*sig_name*/"isCrashStsSafeSts_0",   /*src_can*/"ZCUD_CAN1",   /*src_network_type*/"CAN",   /*src_slotid_fr*/0,   /*src_basecycle_fr*/0,  /*src_repetition_fr*/0,  /*src_startbit*/4,   /*sig_length*/1,  /*des_slotid_fr*/0,   /*des_basecycle_fr*/0,  /*des_repetition_fr*/0,   /*des_startbit*/42,    /*src_cyc*/101,  /*src_id*/0x10,   /*src_dlc*/4,   /*des_cyc*/1000,   /*des_id*/51, /*src_updatebit*/5,   /*des_updatebit*/1000,      /*initvalue*/0         },
           {   /*sig_name*/"isCrashStsSafeCntr_0",   /*src_can*/"ZCUD_CAN1",   /*src_network_type*/"CAN",   /*src_slotid_fr*/0,   /*src_basecycle_fr*/0,  /*src_repetition_fr*/0,  /*src_startbit*/3,   /*sig_length*/4,  /*des_slotid_fr*/0,   /*des_basecycle_fr*/0,  /*des_repetition_fr*/0,   /*des_startbit*/38,    /*src_cyc*/101,  /*src_id*/0x10,   /*src_dlc*/4,   /*des_cyc*/1000,   /*des_id*/51, /*src_updatebit*/5,   /*des_updatebit*/1000,      /*initvalue*/0         }
       }
   },
   {
       /*des_can*/ "CEM_LIN1",
       /*networktype*/ "LIN",
       0,
       {
           0
       }
   },
   {
       /*des_can*/ "CEM_LIN4",
       /*networktype*/ "LIN",
       1,
       {
           {   /*sig_name*/"isRainfallAmnt_0",   /*src_can*/"CEM_LIN1",   /*src_network_type*/"LIN",   /*src_slotid_fr*/0,   /*src_basecycle_fr*/0,  /*src_repetition_fr*/0,  /*src_startbit*/8,   /*sig_length*/4,  /*des_slotid_fr*/0,   /*des_basecycle_fr*/0,  /*des_repetition_fr*/0,   /*des_startbit*/11,    /*src_cyc*/101,  /*src_id*/2,   /*src_dlc*/8,   /*des_cyc*/1000,   /*des_id*/2, /*src_updatebit*/1000,   /*des_updatebit*/1000,      /*initvalue*/14         }
       }
   },
   {
       /*des_can*/ "ZCUD_LIN2",
       /*networktype*/ "LIN",
       0,
       {
           0
       }
   },
   {
       /*des_can*/ "ZCUD_LIN3",
       /*networktype*/ "LIN",
       0,
       {
           0
       }
   },
   {
       /*des_can*/ "CEM_LIN7",
       /*networktype*/ "LIN",
       25,
       {
           {   /*sig_name*/"isCmptmtCoolgSts_0",   /*src_can*/"PropulsionCAN",   /*src_network_type*/"CAN",   /*src_slotid_fr*/0,   /*src_basecycle_fr*/0,  /*src_repetition_fr*/0,  /*src_startbit*/3,   /*sig_length*/4,  /*des_slotid_fr*/0,   /*des_basecycle_fr*/0,  /*des_repetition_fr*/0,   /*des_startbit*/16,    /*src_cyc*/101,  /*src_id*/0x31d,   /*src_dlc*/8,   /*des_cyc*/1000,   /*des_id*/33, /*src_updatebit*/4,   /*des_updatebit*/1000,      /*initvalue*/0         },
           {   /*sig_name*/"isTCSCooltFlow_0",   /*src_can*/"ChassisCANFD2",   /*src_network_type*/"CANFD",   /*src_slotid_fr*/0,   /*src_basecycle_fr*/0,  /*src_repetition_fr*/0,  /*src_startbit*/407,   /*sig_length*/7,  /*des_slotid_fr*/0,   /*des_basecycle_fr*/0,  /*des_repetition_fr*/0,   /*des_startbit*/48,    /*src_cyc*/101,  /*src_id*/0x28f,   /*src_dlc*/64,   /*des_cyc*/1000,   /*des_id*/33, /*src_updatebit*/400,   /*des_updatebit*/1000,      /*initvalue*/0         },
           {   /*sig_name*/"isFctvStsVlvPosn_0",   /*src_can*/"ChassisCANFD2",   /*src_network_type*/"CANFD",   /*src_slotid_fr*/0,   /*src_basecycle_fr*/0,  /*src_repetition_fr*/0,  /*src_startbit*/167,   /*sig_length*/10,  /*des_slotid_fr*/0,   /*des_basecycle_fr*/0,  /*des_repetition_fr*/0,   /*des_startbit*/0,    /*src_cyc*/101,  /*src_id*/0x3cf,   /*src_dlc*/64,   /*des_cyc*/1000,   /*des_id*/34, /*src_updatebit*/185,   /*des_updatebit*/1000,      /*initvalue*/0         },
           {   /*sig_name*/"isFctvStsVlvOverTErr_0",   /*src_can*/"ChassisCANFD2",   /*src_network_type*/"CANFD",   /*src_slotid_fr*/0,   /*src_basecycle_fr*/0,  /*src_repetition_fr*/0,  /*src_startbit*/179,   /*sig_length*/1,  /*des_slotid_fr*/0,   /*des_basecycle_fr*/0,  /*des_repetition_fr*/0,   /*des_startbit*/20,    /*src_cyc*/101,  /*src_id*/0x3cf,   /*src_dlc*/64,   /*des_cyc*/1000,   /*des_id*/34, /*src_updatebit*/185,   /*des_updatebit*/1000,      /*initvalue*/0         },
           {   /*sig_name*/"isFctvStsVlvCalibSts_0",   /*src_can*/"ChassisCANFD2",   /*src_network_type*/"CANFD",   /*src_slotid_fr*/0,   /*src_basecycle_fr*/0,  /*src_repetition_fr*/0,  /*src_startbit*/173,   /*sig_length*/2,  /*des_slotid_fr*/0,   /*des_basecycle_fr*/0,  /*des_repetition_fr*/0,   /*des_startbit*/10,    /*src_cyc*/101,  /*src_id*/0x3cf,   /*src_dlc*/64,   /*des_cyc*/1000,   /*des_id*/34, /*src_updatebit*/185,   /*des_updatebit*/1000,      /*initvalue*/0         },
           {   /*sig_name*/"isFctvStsVlvBlkFlt_0",   /*src_can*/"ChassisCANFD2",   /*src_network_type*/"CANFD",   /*src_slotid_fr*/0,   /*src_basecycle_fr*/0,  /*src_repetition_fr*/0,  /*src_startbit*/169,   /*sig_length*/1,  /*des_slotid_fr*/0,   /*des_basecycle_fr*/0,  /*des_repetition_fr*/0,   /*des_startbit*/14,    /*src_cyc*/101,  /*src_id*/0x3cf,   /*src_dlc*/64,   /*des_cyc*/1000,   /*des_id*/34, /*src_updatebit*/185,   /*des_updatebit*/1000,      /*initvalue*/0         },
           {   /*sig_name*/"isFctvStsVlvMoveSts_0",   /*src_can*/"ChassisCANFD2",   /*src_network_type*/"CANFD",   /*src_slotid_fr*/0,   /*src_basecycle_fr*/0,  /*src_repetition_fr*/0,  /*src_startbit*/182,   /*sig_length*/1,  /*des_slotid_fr*/0,   /*des_basecycle_fr*/0,  /*des_repetition_fr*/0,   /*des_startbit*/17,    /*src_cyc*/101,  /*src_id*/0x3cf,   /*src_dlc*/64,   /*des_cyc*/1000,   /*des_id*/34, /*src_updatebit*/185,   /*des_updatebit*/1000,      /*initvalue*/0         },
           {   /*sig_name*/"isFctvStsVlvUnderUErr_0",   /*src_can*/"ChassisCANFD2",   /*src_network_type*/"CANFD",   /*src_slotid_fr*/0,   /*src_basecycle_fr*/0,  /*src_repetition_fr*/0,  /*src_startbit*/186,   /*sig_length*/1,  /*des_slotid_fr*/0,   /*des_basecycle_fr*/0,  /*des_repetition_fr*/0,   /*des_startbit*/29,    /*src_cyc*/101,  /*src_id*/0x3cf,   /*src_dlc*/64,   /*des_cyc*/1000,   /*des_id*/34, /*src_updatebit*/185,   /*des_updatebit*/1000,      /*initvalue*/0         },
           {   /*sig_name*/"isFctvStsVlvPosnUkwnFlt_0",   /*src_can*/"ChassisCANFD2",   /*src_network_type*/"CANFD",   /*src_slotid_fr*/0,   /*src_basecycle_fr*/0,  /*src_repetition_fr*/0,  /*src_startbit*/190,   /*sig_length*/1,  /*des_slotid_fr*/0,   /*des_basecycle_fr*/0,  /*des_repetition_fr*/0,   /*des_startbit*/25,    /*src_cyc*/101,  /*src_id*/0x3cf,   /*src_dlc*/64,   /*des_cyc*/1000,   /*des_id*/34, /*src_updatebit*/185,   /*des_updatebit*/1000,      /*initvalue*/0         },
           {   /*sig_name*/"isFctvStsVlvNVMFlt_0",   /*src_can*/"ChassisCANFD2",   /*src_network_type*/"CANFD",   /*src_slotid_fr*/0,   /*src_basecycle_fr*/0,  /*src_repetition_fr*/0,  /*src_startbit*/181,   /*sig_length*/1,  /*des_slotid_fr*/0,   /*des_basecycle_fr*/0,  /*des_repetition_fr*/0,   /*des_startbit*/18,    /*src_cyc*/101,  /*src_id*/0x3cf,   /*src_dlc*/64,   /*des_cyc*/1000,   /*des_id*/34, /*src_updatebit*/185,   /*des_updatebit*/1000,      /*initvalue*/0         },
           {   /*sig_name*/"isFctvStsVlvOverUErr_0",   /*src_can*/"ChassisCANFD2",   /*src_network_type*/"CANFD",   /*src_slotid_fr*/0,   /*src_basecycle_fr*/0,  /*src_repetition_fr*/0,  /*src_startbit*/176,   /*sig_length*/1,  /*des_slotid_fr*/0,   /*des_basecycle_fr*/0,  /*des_repetition_fr*/0,   /*des_startbit*/23,    /*src_cyc*/101,  /*src_id*/0x3cf,   /*src_dlc*/64,   /*des_cyc*/1000,   /*des_id*/34, /*src_updatebit*/185,   /*des_updatebit*/1000,      /*initvalue*/0         },
           {   /*sig_name*/"isFctvStsVlvSpdLvlSts_0",   /*src_can*/"ChassisCANFD2",   /*src_network_type*/"CANFD",   /*src_slotid_fr*/0,   /*src_basecycle_fr*/0,  /*src_repetition_fr*/0,  /*src_startbit*/171,   /*sig_length*/2,  /*des_slotid_fr*/0,   /*des_basecycle_fr*/0,  /*des_repetition_fr*/0,   /*des_startbit*/12,    /*src_cyc*/101,  /*src_id*/0x3cf,   /*src_dlc*/64,   /*des_cyc*/1000,   /*des_id*/34, /*src_updatebit*/185,   /*des_updatebit*/1000,      /*initvalue*/0         },
           {   /*sig_name*/"isFctvStsVlvPosnCtrlTimeOutFlt_0",   /*src_can*/"ChassisCANFD2",   /*src_network_type*/"CANFD",   /*src_slotid_fr*/0,   /*src_basecycle_fr*/0,  /*src_repetition_fr*/0,  /*src_startbit*/191,   /*sig_length*/1,  /*des_slotid_fr*/0,   /*des_basecycle_fr*/0,  /*des_repetition_fr*/0,   /*des_startbit*/24,    /*src_cyc*/101,  /*src_id*/0x3cf,   /*src_dlc*/64,   /*des_cyc*/1000,   /*des_id*/34, /*src_updatebit*/185,   /*des_updatebit*/1000,      /*initvalue*/0         },
           {   /*sig_name*/"isFctvStsVlvOpenCircFlt_0",   /*src_can*/"ChassisCANFD2",   /*src_network_type*/"CANFD",   /*src_slotid_fr*/0,   /*src_basecycle_fr*/0,  /*src_repetition_fr*/0,  /*src_startbit*/180,   /*sig_length*/1,  /*des_slotid_fr*/0,   /*des_basecycle_fr*/0,  /*des_repetition_fr*/0,   /*des_startbit*/19,    /*src_cyc*/101,  /*src_id*/0x3cf,   /*src_dlc*/64,   /*des_cyc*/1000,   /*des_id*/34, /*src_updatebit*/185,   /*des_updatebit*/1000,      /*initvalue*/0         },
           {   /*sig_name*/"isFctvStsVlvOverTWarn_0",   /*src_can*/"ChassisCANFD2",   /*src_network_type*/"CANFD",   /*src_slotid_fr*/0,   /*src_basecycle_fr*/0,  /*src_repetition_fr*/0,  /*src_startbit*/177,   /*sig_length*/1,  /*des_slotid_fr*/0,   /*des_basecycle_fr*/0,  /*des_repetition_fr*/0,   /*des_startbit*/22,    /*src_cyc*/101,  /*src_id*/0x3cf,   /*src_dlc*/64,   /*des_cyc*/1000,   /*des_id*/34, /*src_updatebit*/185,   /*des_updatebit*/1000,      /*initvalue*/0         },
           {   /*sig_name*/"isFctvStsVlvSelfLearnFlt_0",   /*src_can*/"ChassisCANFD2",   /*src_network_type*/"CANFD",   /*src_slotid_fr*/0,   /*src_basecycle_fr*/0,  /*src_repetition_fr*/0,  /*src_startbit*/188,   /*sig_length*/1,  /*des_slotid_fr*/0,   /*des_basecycle_fr*/0,  /*des_repetition_fr*/0,   /*des_startbit*/27,    /*src_cyc*/101,  /*src_id*/0x3cf,   /*src_dlc*/64,   /*des_cyc*/1000,   /*des_id*/34, /*src_updatebit*/185,   /*des_updatebit*/1000,      /*initvalue*/0         },
           {   /*sig_name*/"isFctvStsVlvCmdPosnErr_0",   /*src_can*/"ChassisCANFD2",   /*src_network_type*/"CANFD",   /*src_slotid_fr*/0,   /*src_basecycle_fr*/0,  /*src_repetition_fr*/0,  /*src_startbit*/168,   /*sig_length*/1,  /*des_slotid_fr*/0,   /*des_basecycle_fr*/0,  /*des_repetition_fr*/0,   /*des_startbit*/15,    /*src_cyc*/101,  /*src_id*/0x3cf,   /*src_dlc*/64,   /*des_cyc*/1000,   /*des_id*/34, /*src_updatebit*/185,   /*des_updatebit*/1000,      /*initvalue*/0         },
           {   /*sig_name*/"isFctvStsVlvShoCircFlt_0",   /*src_can*/"ChassisCANFD2",   /*src_network_type*/"CANFD",   /*src_slotid_fr*/0,   /*src_basecycle_fr*/0,  /*src_repetition_fr*/0,  /*src_startbit*/187,   /*sig_length*/1,  /*des_slotid_fr*/0,   /*des_basecycle_fr*/0,  /*des_repetition_fr*/0,   /*des_startbit*/28,    /*src_cyc*/101,  /*src_id*/0x3cf,   /*src_dlc*/64,   /*des_cyc*/1000,   /*des_id*/34, /*src_updatebit*/185,   /*des_updatebit*/1000,      /*initvalue*/0         },
           {   /*sig_name*/"isFctvStsVlvLoTErr_0",   /*src_can*/"ChassisCANFD2",   /*src_network_type*/"CANFD",   /*src_slotid_fr*/0,   /*src_basecycle_fr*/0,  /*src_repetition_fr*/0,  /*src_startbit*/183,   /*sig_length*/1,  /*des_slotid_fr*/0,   /*des_basecycle_fr*/0,  /*des_repetition_fr*/0,   /*des_startbit*/16,    /*src_cyc*/101,  /*src_id*/0x3cf,   /*src_dlc*/64,   /*des_cyc*/1000,   /*des_id*/34, /*src_updatebit*/185,   /*des_updatebit*/1000,      /*initvalue*/0         },
           {   /*sig_name*/"isFctvStsVlvPreHeatgSts_0",   /*src_can*/"ChassisCANFD2",   /*src_network_type*/"CANFD",   /*src_slotid_fr*/0,   /*src_basecycle_fr*/0,  /*src_repetition_fr*/0,  /*src_startbit*/189,   /*sig_length*/1,  /*des_slotid_fr*/0,   /*des_basecycle_fr*/0,  /*des_repetition_fr*/0,   /*des_startbit*/26,    /*src_cyc*/101,  /*src_id*/0x3cf,   /*src_dlc*/64,   /*des_cyc*/1000,   /*des_id*/34, /*src_updatebit*/185,   /*des_updatebit*/1000,      /*initvalue*/0         },
           {   /*sig_name*/"isFctvStsVlvOverTrvlFlt_0",   /*src_can*/"ChassisCANFD2",   /*src_network_type*/"CANFD",   /*src_slotid_fr*/0,   /*src_basecycle_fr*/0,  /*src_repetition_fr*/0,  /*src_startbit*/178,   /*sig_length*/1,  /*des_slotid_fr*/0,   /*des_basecycle_fr*/0,  /*des_repetition_fr*/0,   /*des_startbit*/21,    /*src_cyc*/101,  /*src_id*/0x3cf,   /*src_dlc*/64,   /*des_cyc*/1000,   /*des_id*/34, /*src_updatebit*/185,   /*des_updatebit*/1000,      /*initvalue*/0         },
           {   /*sig_name*/"isRefrtorVlvEna_0",   /*src_can*/"ChassisCANFD2",   /*src_network_type*/"CANFD",   /*src_slotid_fr*/0,   /*src_basecycle_fr*/0,  /*src_repetition_fr*/0,  /*src_startbit*/330,   /*sig_length*/1,  /*des_slotid_fr*/0,   /*des_basecycle_fr*/0,  /*des_repetition_fr*/0,   /*des_startbit*/15,    /*src_cyc*/101,  /*src_id*/0x28f,   /*src_dlc*/64,   /*des_cyc*/1000,   /*des_id*/33, /*src_updatebit*/329,   /*des_updatebit*/1000,      /*initvalue*/0         },
           {   /*sig_name*/"isDcDcActvd_0",   /*src_can*/"PropulsionCAN",   /*src_network_type*/"CAN",   /*src_slotid_fr*/0,   /*src_basecycle_fr*/0,  /*src_repetition_fr*/0,  /*src_startbit*/25,   /*sig_length*/1,  /*des_slotid_fr*/0,   /*des_basecycle_fr*/0,  /*des_repetition_fr*/0,   /*des_startbit*/47,    /*src_cyc*/101,  /*src_id*/0x14b,   /*src_dlc*/8,   /*des_cyc*/1000,   /*des_id*/16, /*src_updatebit*/24,   /*des_updatebit*/1000,      /*initvalue*/0         },
           {   /*sig_name*/"isTCSCooltT_0",   /*src_can*/"ChassisCANFD2",   /*src_network_type*/"CANFD",   /*src_slotid_fr*/0,   /*src_basecycle_fr*/0,  /*src_repetition_fr*/0,  /*src_startbit*/415,   /*sig_length*/8,  /*des_slotid_fr*/0,   /*des_basecycle_fr*/0,  /*des_repetition_fr*/0,   /*des_startbit*/32,    /*src_cyc*/101,  /*src_id*/0x28f,   /*src_dlc*/64,   /*des_cyc*/1000,   /*des_id*/33, /*src_updatebit*/248,   /*des_updatebit*/1000,      /*initvalue*/50         },
           {   /*sig_name*/"isRefrLpSwSts_0",   /*src_can*/"ChassisCANFD2",   /*src_network_type*/"CANFD",   /*src_slotid_fr*/0,   /*src_basecycle_fr*/0,  /*src_repetition_fr*/0,  /*src_startbit*/332,   /*sig_length*/1,  /*des_slotid_fr*/0,   /*des_basecycle_fr*/0,  /*des_repetition_fr*/0,   /*des_startbit*/14,    /*src_cyc*/101,  /*src_id*/0x28f,   /*src_dlc*/64,   /*des_cyc*/1000,   /*des_id*/33, /*src_updatebit*/331,   /*des_updatebit*/1000,      /*initvalue*/0         }
       }
   },
   {
       /*des_can*/ "PropulsionCAN",
       /*networktype*/ "CAN",
       30,
       {
           {   /*sig_name*/"isPtTqAtAxleMaxReqCntr_0",   /*src_can*/"ChassisCANFD2",   /*src_network_type*/"CANFD",   /*src_slotid_fr*/0,   /*src_basecycle_fr*/0,  /*src_repetition_fr*/0,  /*src_startbit*/235,   /*sig_length*/4,  /*des_slotid_fr*/0,   /*des_basecycle_fr*/0,  /*des_repetition_fr*/0,   /*des_startbit*/19,    /*src_cyc*/101,  /*src_id*/0x67,   /*src_dlc*/64,   /*des_cyc*/10,   /*des_id*/0x41, /*src_updatebit*/465,   /*des_updatebit*/20,      /*initvalue*/0         },
           {   /*sig_name*/"isPtTqAtAxleMaxReqChks_0",   /*src_can*/"ChassisCANFD2",   /*src_network_type*/"CANFD",   /*src_slotid_fr*/0,   /*src_basecycle_fr*/0,  /*src_repetition_fr*/0,  /*src_startbit*/227,   /*sig_length*/8,  /*des_slotid_fr*/0,   /*des_basecycle_fr*/0,  /*des_repetition_fr*/0,   /*des_startbit*/31,    /*src_cyc*/101,  /*src_id*/0x67,   /*src_dlc*/64,   /*des_cyc*/10,   /*des_id*/0x41, /*src_updatebit*/465,   /*des_updatebit*/20,      /*initvalue*/0         },
           {   /*sig_name*/"isPtTqAtAxleMaxReqPtTqAtAxleReReq_0",   /*src_can*/"ChassisCANFD2",   /*src_network_type*/"CANFD",   /*src_slotid_fr*/0,   /*src_basecycle_fr*/0,  /*src_repetition_fr*/0,  /*src_startbit*/211,   /*sig_length*/16,  /*des_slotid_fr*/0,   /*des_basecycle_fr*/0,  /*des_repetition_fr*/0,   /*des_startbit*/55,    /*src_cyc*/101,  /*src_id*/0x67,   /*src_dlc*/64,   /*des_cyc*/10,   /*des_id*/0x41, /*src_updatebit*/465,   /*des_updatebit*/20,      /*initvalue*/20000         },
           {   /*sig_name*/"isPtTqAtAxleMaxReqPtTqAtAxleFrntReq_0",   /*src_can*/"ChassisCANFD2",   /*src_network_type*/"CANFD",   /*src_slotid_fr*/0,   /*src_basecycle_fr*/0,  /*src_repetition_fr*/0,  /*src_startbit*/195,   /*sig_length*/16,  /*des_slotid_fr*/0,   /*des_basecycle_fr*/0,  /*des_repetition_fr*/0,   /*des_startbit*/39,    /*src_cyc*/101,  /*src_id*/0x67,   /*src_dlc*/64,   /*des_cyc*/10,   /*des_id*/0x41, /*src_updatebit*/465,   /*des_updatebit*/20,      /*initvalue*/20000         },
           {   /*sig_name*/"isRainDetected_0",   /*src_can*/"CEM_LIN1",   /*src_network_type*/"LIN",   /*src_slotid_fr*/0,   /*src_basecycle_fr*/0,  /*src_repetition_fr*/0,  /*src_startbit*/7,   /*sig_length*/1,  /*des_slotid_fr*/0,   /*des_basecycle_fr*/0,  /*des_repetition_fr*/0,   /*des_startbit*/7,    /*src_cyc*/101,  /*src_id*/2,   /*src_dlc*/8,   /*des_cyc*/1000,   /*des_id*/0x4a3, /*src_updatebit*/1000,   /*des_updatebit*/13,      /*initvalue*/0         },
           {   /*sig_name*/"isBattSohRaw_0",   /*src_can*/"CEM_LIN6",   /*src_network_type*/"LIN",   /*src_slotid_fr*/0,   /*src_basecycle_fr*/0,  /*src_repetition_fr*/0,  /*src_startbit*/40,   /*sig_length*/10,  /*des_slotid_fr*/0,   /*des_basecycle_fr*/0,  /*des_repetition_fr*/0,   /*des_startbit*/33,    /*src_cyc*/101,  /*src_id*/16,   /*src_dlc*/8,   /*des_cyc*/100,   /*des_id*/0x162, /*src_updatebit*/1000,   /*des_updatebit*/34,      /*initvalue*/1000         },
           {   /*sig_name*/"isEngTracCtrlActvReMax_0",   /*src_can*/"ChassisCANFD2",   /*src_network_type*/"CANFD",   /*src_slotid_fr*/0,   /*src_basecycle_fr*/0,  /*src_repetition_fr*/0,  /*src_startbit*/191,   /*sig_length*/1,  /*des_slotid_fr*/0,   /*des_basecycle_fr*/0,  /*des_repetition_fr*/0,   /*des_startbit*/37,    /*src_cyc*/101,  /*src_id*/0xe3,   /*src_dlc*/64,   /*des_cyc*/50,   /*des_id*/0x19d, /*src_updatebit*/190,   /*des_updatebit*/36,      /*initvalue*/0         },
           {   /*sig_name*/"isAutWinWipgCmd_0",   /*src_can*/"CEM_LIN1",   /*src_network_type*/"LIN",   /*src_slotid_fr*/0,   /*src_basecycle_fr*/0,  /*src_repetition_fr*/0,  /*src_startbit*/0,   /*sig_length*/3,  /*des_slotid_fr*/0,   /*des_basecycle_fr*/0,  /*des_repetition_fr*/0,   /*des_startbit*/6,    /*src_cyc*/101,  /*src_id*/21,   /*src_dlc*/8,   /*des_cyc*/1000,   /*des_id*/0x4a3, /*src_updatebit*/1000,   /*des_updatebit*/3,      /*initvalue*/0         },
           {   /*sig_name*/"isVehSpdLgtCntr_0",   /*src_can*/"ChassisCANFD2",   /*src_network_type*/"CANFD",   /*src_slotid_fr*/0,   /*src_basecycle_fr*/0,  /*src_repetition_fr*/0,  /*src_startbit*/216,   /*sig_length*/4,  /*des_slotid_fr*/0,   /*des_basecycle_fr*/0,  /*des_repetition_fr*/0,   /*des_startbit*/63,    /*src_cyc*/101,  /*src_id*/0x9f,   /*src_dlc*/64,   /*des_cyc*/15,   /*des_id*/0x76, /*src_updatebit*/471,   /*des_updatebit*/39,      /*initvalue*/0         },
           {   /*sig_name*/"isVehSpdLgtA_0",   /*src_can*/"ChassisCANFD2",   /*src_network_type*/"CANFD",   /*src_slotid_fr*/0,   /*src_basecycle_fr*/0,  /*src_repetition_fr*/0,  /*src_startbit*/207,   /*sig_length*/15,  /*des_slotid_fr*/0,   /*des_basecycle_fr*/0,  /*des_repetition_fr*/0,   /*des_startbit*/38,    /*src_cyc*/101,  /*src_id*/0x9f,   /*src_dlc*/64,   /*des_cyc*/15,   /*des_id*/0x76, /*src_updatebit*/471,   /*des_updatebit*/39,      /*initvalue*/0         },
           {   /*sig_name*/"isVehSpdLgtQf_0",   /*src_can*/"ChassisCANFD2",   /*src_network_type*/"CANFD",   /*src_slotid_fr*/0,   /*src_basecycle_fr*/0,  /*src_repetition_fr*/0,  /*src_startbit*/228,   /*sig_length*/2,  /*des_slotid_fr*/0,   /*des_basecycle_fr*/0,  /*des_repetition_fr*/0,   /*des_startbit*/59,    /*src_cyc*/101,  /*src_id*/0x9f,   /*src_dlc*/64,   /*des_cyc*/15,   /*des_id*/0x76, /*src_updatebit*/471,   /*des_updatebit*/39,      /*initvalue*/1         },
           {   /*sig_name*/"isVehSpdLgtChks_0",   /*src_can*/"ChassisCANFD2",   /*src_network_type*/"CANFD",   /*src_slotid_fr*/0,   /*src_basecycle_fr*/0,  /*src_repetition_fr*/0,  /*src_startbit*/208,   /*sig_length*/8,  /*des_slotid_fr*/0,   /*des_basecycle_fr*/0,  /*des_repetition_fr*/0,   /*des_startbit*/55,    /*src_cyc*/101,  /*src_id*/0x9f,   /*src_dlc*/64,   /*des_cyc*/15,   /*des_id*/0x76, /*src_updatebit*/471,   /*des_updatebit*/39,      /*initvalue*/0         },
           {   /*sig_name*/"isRainLi_0",   /*src_can*/"CEM_LIN1",   /*src_network_type*/"LIN",   /*src_slotid_fr*/0,   /*src_basecycle_fr*/0,  /*src_repetition_fr*/0,  /*src_startbit*/7,   /*sig_length*/1,  /*des_slotid_fr*/0,   /*des_basecycle_fr*/0,  /*des_repetition_fr*/0,   /*des_startbit*/15,    /*src_cyc*/101,  /*src_id*/21,   /*src_dlc*/8,   /*des_cyc*/1000,   /*des_id*/0x4a3, /*src_updatebit*/1000,   /*des_updatebit*/14,      /*initvalue*/0         },
           {   /*sig_name*/"isBattURaw_0",   /*src_can*/"CEM_LIN6",   /*src_network_type*/"LIN",   /*src_slotid_fr*/0,   /*src_basecycle_fr*/0,  /*src_repetition_fr*/0,  /*src_startbit*/15,   /*sig_length*/9,  /*des_slotid_fr*/0,   /*des_basecycle_fr*/0,  /*des_repetition_fr*/0,   /*des_startbit*/16,    /*src_cyc*/101,  /*src_id*/6,   /*src_dlc*/7,   /*des_cyc*/160,   /*des_id*/0x238, /*src_updatebit*/1000,   /*des_updatebit*/17,      /*initvalue*/0         },
           {   /*sig_name*/"isBattSocRawChks_0",   /*src_can*/"CEM_LIN6",   /*src_network_type*/"LIN",   /*src_slotid_fr*/0,   /*src_basecycle_fr*/0,  /*src_repetition_fr*/0,  /*src_startbit*/42,   /*sig_length*/8,  /*des_slotid_fr*/0,   /*des_basecycle_fr*/0,  /*des_repetition_fr*/0,   /*des_startbit*/53,    /*src_cyc*/101,  /*src_id*/32,   /*src_dlc*/7,   /*des_cyc*/50,   /*des_id*/0x198, /*src_updatebit*/1000,   /*des_updatebit*/32,      /*initvalue*/0         },
           {   /*sig_name*/"isBattSocRawSoc_0",   /*src_can*/"CEM_LIN6",   /*src_network_type*/"LIN",   /*src_slotid_fr*/0,   /*src_basecycle_fr*/0,  /*src_repetition_fr*/0,  /*src_startbit*/32,   /*sig_length*/10,  /*des_slotid_fr*/0,   /*des_basecycle_fr*/0,  /*des_repetition_fr*/0,   /*des_startbit*/47,    /*src_cyc*/101,  /*src_id*/32,   /*src_dlc*/7,   /*des_cyc*/50,   /*des_id*/0x198, /*src_updatebit*/1000,   /*des_updatebit*/32,      /*initvalue*/0         },
           {   /*sig_name*/"isBattSocRawCntr_0",   /*src_can*/"CEM_LIN6",   /*src_network_type*/"LIN",   /*src_slotid_fr*/0,   /*src_basecycle_fr*/0,  /*src_repetition_fr*/0,  /*src_startbit*/50,   /*sig_length*/4,  /*des_slotid_fr*/0,   /*des_basecycle_fr*/0,  /*des_repetition_fr*/0,   /*des_startbit*/61,    /*src_cyc*/101,  /*src_id*/32,   /*src_dlc*/7,   /*des_cyc*/50,   /*des_id*/0x198, /*src_updatebit*/1000,   /*des_updatebit*/32,      /*initvalue*/0         },
           {   /*sig_name*/"isBattIRaw_0",   /*src_can*/"CEM_LIN6",   /*src_network_type*/"LIN",   /*src_slotid_fr*/0,   /*src_basecycle_fr*/0,  /*src_repetition_fr*/0,  /*src_startbit*/0,   /*sig_length*/16,  /*des_slotid_fr*/0,   /*des_basecycle_fr*/0,  /*des_repetition_fr*/0,   /*des_startbit*/7,    /*src_cyc*/101,  /*src_id*/2,   /*src_dlc*/8,   /*des_cyc*/50,   /*des_id*/0x198, /*src_updatebit*/1000,   /*des_updatebit*/34,      /*initvalue*/32768         },
           {   /*sig_name*/"isStcStsMinToDmcStcStsToDmcFrnt_0",   /*src_can*/"ChassisCANFD2",   /*src_network_type*/"CANFD",   /*src_slotid_fr*/0,   /*src_basecycle_fr*/0,  /*src_repetition_fr*/0,  /*src_startbit*/399,   /*sig_length*/8,  /*des_slotid_fr*/0,   /*des_basecycle_fr*/0,  /*des_repetition_fr*/0,   /*des_startbit*/47,    /*src_cyc*/101,  /*src_id*/0x55,   /*src_dlc*/64,   /*des_cyc*/10,   /*des_id*/0x54, /*src_updatebit*/411,   /*des_updatebit*/59,      /*initvalue*/0         },
           {   /*sig_name*/"isStcStsMinToDmcCntr_0",   /*src_can*/"ChassisCANFD2",   /*src_network_type*/"CANFD",   /*src_slotid_fr*/0,   /*src_basecycle_fr*/0,  /*src_repetition_fr*/0,  /*src_startbit*/415,   /*sig_length*/4,  /*des_slotid_fr*/0,   /*des_basecycle_fr*/0,  /*des_repetition_fr*/0,   /*des_startbit*/63,    /*src_cyc*/101,  /*src_id*/0x55,   /*src_dlc*/64,   /*des_cyc*/10,   /*des_id*/0x54, /*src_updatebit*/411,   /*des_updatebit*/59,      /*initvalue*/0         },
           {   /*sig_name*/"isStcStsMinToDmcChks_0",   /*src_can*/"ChassisCANFD2",   /*src_network_type*/"CANFD",   /*src_slotid_fr*/0,   /*src_basecycle_fr*/0,  /*src_repetition_fr*/0,  /*src_startbit*/391,   /*sig_length*/8,  /*des_slotid_fr*/0,   /*des_basecycle_fr*/0,  /*des_repetition_fr*/0,   /*des_startbit*/39,    /*src_cyc*/101,  /*src_id*/0x55,   /*src_dlc*/64,   /*des_cyc*/10,   /*des_id*/0x54, /*src_updatebit*/411,   /*des_updatebit*/59,      /*initvalue*/0         },
           {   /*sig_name*/"isStcStsMinToDmcStcStsToDmcRear_0",   /*src_can*/"ChassisCANFD2",   /*src_network_type*/"CANFD",   /*src_slotid_fr*/0,   /*src_basecycle_fr*/0,  /*src_repetition_fr*/0,  /*src_startbit*/407,   /*sig_length*/8,  /*des_slotid_fr*/0,   /*des_basecycle_fr*/0,  /*des_repetition_fr*/0,   /*des_startbit*/55,    /*src_cyc*/101,  /*src_id*/0x55,   /*src_dlc*/64,   /*des_cyc*/10,   /*des_id*/0x54, /*src_updatebit*/411,   /*des_updatebit*/59,      /*initvalue*/0         },
           {   /*sig_name*/"isStcStsMinToDmcEngRotTarSpdDMCFrnt_0",   /*src_can*/"ChassisCANFD2",   /*src_network_type*/"CANFD",   /*src_slotid_fr*/0,   /*src_basecycle_fr*/0,  /*src_repetition_fr*/0,  /*src_startbit*/359,   /*sig_length*/16,  /*des_slotid_fr*/0,   /*des_basecycle_fr*/0,  /*des_repetition_fr*/0,   /*des_startbit*/7,    /*src_cyc*/101,  /*src_id*/0x55,   /*src_dlc*/64,   /*des_cyc*/10,   /*des_id*/0x54, /*src_updatebit*/411,   /*des_updatebit*/59,      /*initvalue*/0         },
           {   /*sig_name*/"isStcStsMinToDmcEngRotTarSpdDMCRear_0",   /*src_can*/"ChassisCANFD2",   /*src_network_type*/"CANFD",   /*src_slotid_fr*/0,   /*src_basecycle_fr*/0,  /*src_repetition_fr*/0,  /*src_startbit*/375,   /*sig_length*/16,  /*des_slotid_fr*/0,   /*des_basecycle_fr*/0,  /*des_repetition_fr*/0,   /*des_startbit*/23,    /*src_cyc*/101,  /*src_id*/0x55,   /*src_dlc*/64,   /*des_cyc*/10,   /*des_id*/0x54, /*src_updatebit*/411,   /*des_updatebit*/59,      /*initvalue*/0         },
           {   /*sig_name*/"isHVfault_0",   /*src_can*/"ZCUD_CAN1",   /*src_network_type*/"CAN",   /*src_slotid_fr*/0,   /*src_basecycle_fr*/0,  /*src_repetition_fr*/0,  /*src_startbit*/42,   /*sig_length*/1,  /*des_slotid_fr*/0,   /*des_basecycle_fr*/0,  /*des_repetition_fr*/0,   /*des_startbit*/60,    /*src_cyc*/101,  /*src_id*/0x274,   /*src_dlc*/8,   /*des_cyc*/50,   /*des_id*/0x19d, /*src_updatebit*/41,   /*des_updatebit*/59,      /*initvalue*/0         },
           {   /*sig_name*/"isSpdRotlForWhlsAtAxleRe_0",   /*src_can*/"ChassisCANFD2",   /*src_network_type*/"CANFD",   /*src_slotid_fr*/0,   /*src_basecycle_fr*/0,  /*src_repetition_fr*/0,  /*src_startbit*/135,   /*sig_length*/15,  /*des_slotid_fr*/0,   /*des_basecycle_fr*/0,  /*des_repetition_fr*/0,   /*des_startbit*/38,    /*src_cyc*/101,  /*src_id*/0xe3,   /*src_dlc*/64,   /*des_cyc*/25,   /*des_id*/0x139, /*src_updatebit*/136,   /*des_updatebit*/39,      /*initvalue*/0         },
           {   /*sig_name*/"isTrlrPrsnt_0",   /*src_can*/"ZCUD_CAN1",   /*src_network_type*/"CAN",   /*src_slotid_fr*/0,   /*src_basecycle_fr*/0,  /*src_repetition_fr*/0,  /*src_startbit*/13,   /*sig_length*/1,  /*des_slotid_fr*/0,   /*des_basecycle_fr*/0,  /*des_repetition_fr*/0,   /*des_startbit*/23,    /*src_cyc*/101,  /*src_id*/0xd0,   /*src_dlc*/4,   /*des_cyc*/200,   /*des_id*/0x285, /*src_updatebit*/20,   /*des_updatebit*/22,      /*initvalue*/0         },
           {   /*sig_name*/"isYawStabyCtrlActv_0",   /*src_can*/"ChassisCANFD2",   /*src_network_type*/"CANFD",   /*src_slotid_fr*/0,   /*src_basecycle_fr*/0,  /*src_repetition_fr*/0,  /*src_startbit*/185,   /*sig_length*/1,  /*des_slotid_fr*/0,   /*des_basecycle_fr*/0,  /*des_repetition_fr*/0,   /*des_startbit*/62,    /*src_cyc*/101,  /*src_id*/0x5a,   /*src_dlc*/64,   /*des_cyc*/50,   /*des_id*/0x19d, /*src_updatebit*/508,   /*des_updatebit*/61,      /*initvalue*/0         },
           {   /*sig_name*/"isEngTracCtrlActvFrntMax_0",   /*src_can*/"ChassisCANFD2",   /*src_network_type*/"CANFD",   /*src_slotid_fr*/0,   /*src_basecycle_fr*/0,  /*src_repetition_fr*/0,  /*src_startbit*/180,   /*sig_length*/1,  /*des_slotid_fr*/0,   /*des_basecycle_fr*/0,  /*des_repetition_fr*/0,   /*des_startbit*/60,    /*src_cyc*/101,  /*src_id*/0xe3,   /*src_dlc*/64,   /*des_cyc*/25,   /*des_id*/0x139, /*src_updatebit*/179,   /*des_updatebit*/59,      /*initvalue*/0         },
           {   /*sig_name*/"isBattTRaw_0",   /*src_can*/"CEM_LIN6",   /*src_network_type*/"LIN",   /*src_slotid_fr*/0,   /*src_basecycle_fr*/0,  /*src_repetition_fr*/0,  /*src_startbit*/15,   /*sig_length*/9,  /*des_slotid_fr*/0,   /*des_basecycle_fr*/0,  /*des_repetition_fr*/0,   /*des_startbit*/0,    /*src_cyc*/101,  /*src_id*/4,   /*src_dlc*/7,   /*des_cyc*/160,   /*des_id*/0x238, /*src_updatebit*/1000,   /*des_updatebit*/1,      /*initvalue*/256         }
       }
   },
   {
       /*des_can*/ "ChassisCAN1",
       /*networktype*/ "CAN",
       32,
       {
           {   /*sig_name*/"isAmbTIndcdWithUnitAmbTIndcdUnit_0",   /*src_can*/"PropulsionCAN",   /*src_network_type*/"CAN",   /*src_slotid_fr*/0,   /*src_basecycle_fr*/0,  /*src_repetition_fr*/0,  /*src_startbit*/11,   /*sig_length*/2,  /*des_slotid_fr*/0,   /*des_basecycle_fr*/0,  /*des_repetition_fr*/0,   /*des_startbit*/23,    /*src_cyc*/101,  /*src_id*/0x26b,   /*src_dlc*/8,   /*des_cyc*/320,   /*des_id*/0x3a0, /*src_updatebit*/23,   /*des_updatebit*/9,      /*initvalue*/0         },
           {   /*sig_name*/"isAmbTIndcdWithUnitAmbTIndcd_0",   /*src_can*/"PropulsionCAN",   /*src_network_type*/"CAN",   /*src_slotid_fr*/0,   /*src_basecycle_fr*/0,  /*src_repetition_fr*/0,  /*src_startbit*/7,   /*sig_length*/12,  /*des_slotid_fr*/0,   /*des_basecycle_fr*/0,  /*des_repetition_fr*/0,   /*des_startbit*/19,    /*src_cyc*/101,  /*src_id*/0x26b,   /*src_dlc*/8,   /*des_cyc*/320,   /*des_id*/0x3a0, /*src_updatebit*/23,   /*des_updatebit*/9,      /*initvalue*/1000         },
           {   /*sig_name*/"isAmbTIndcdWithUnitQF_0",   /*src_can*/"PropulsionCAN",   /*src_network_type*/"CAN",   /*src_slotid_fr*/0,   /*src_basecycle_fr*/0,  /*src_repetition_fr*/0,  /*src_startbit*/9,   /*sig_length*/2,  /*des_slotid_fr*/0,   /*des_basecycle_fr*/0,  /*des_repetition_fr*/0,   /*des_startbit*/21,    /*src_cyc*/101,  /*src_id*/0x26b,   /*src_dlc*/8,   /*des_cyc*/320,   /*des_id*/0x3a0, /*src_updatebit*/23,   /*des_updatebit*/9,      /*initvalue*/0         },
           {   /*sig_name*/"isADataRawSafeALgt_0",   /*src_can*/"ZCUD_CAN1",   /*src_network_type*/"CAN",   /*src_slotid_fr*/0,   /*src_basecycle_fr*/0,  /*src_repetition_fr*/0,  /*src_startbit*/38,   /*sig_length*/15,  /*des_slotid_fr*/0,   /*des_basecycle_fr*/0,  /*des_repetition_fr*/0,   /*des_startbit*/38,    /*src_cyc*/101,  /*src_id*/0x12,   /*src_dlc*/8,   /*des_cyc*/10,   /*des_id*/0xa0, /*src_updatebit*/56,   /*des_updatebit*/56,      /*initvalue*/0         },
           {   /*sig_name*/"isADataRawSafeALgt1Qf_0",   /*src_can*/"ZCUD_CAN1",   /*src_network_type*/"CAN",   /*src_slotid_fr*/0,   /*src_basecycle_fr*/0,  /*src_repetition_fr*/0,  /*src_startbit*/9,   /*sig_length*/2,  /*des_slotid_fr*/0,   /*des_basecycle_fr*/0,  /*des_repetition_fr*/0,   /*des_startbit*/9,    /*src_cyc*/101,  /*src_id*/0x12,   /*src_dlc*/8,   /*des_cyc*/10,   /*des_id*/0xa0, /*src_updatebit*/56,   /*des_updatebit*/56,      /*initvalue*/1         },
           {   /*sig_name*/"isADataRawSafeALat_0",   /*src_can*/"ZCUD_CAN1",   /*src_network_type*/"CAN",   /*src_slotid_fr*/0,   /*src_basecycle_fr*/0,  /*src_repetition_fr*/0,  /*src_startbit*/23,   /*sig_length*/15,  /*des_slotid_fr*/0,   /*des_basecycle_fr*/0,  /*des_repetition_fr*/0,   /*des_startbit*/23,    /*src_cyc*/101,  /*src_id*/0x12,   /*src_dlc*/8,   /*des_cyc*/10,   /*des_id*/0xa0, /*src_updatebit*/56,   /*des_updatebit*/56,      /*initvalue*/0         },
           {   /*sig_name*/"isADataRawSafeAVert_0",   /*src_can*/"ZCUD_CAN1",   /*src_network_type*/"CAN",   /*src_slotid_fr*/0,   /*src_basecycle_fr*/0,  /*src_repetition_fr*/0,  /*src_startbit*/55,   /*sig_length*/15,  /*des_slotid_fr*/0,   /*des_basecycle_fr*/0,  /*des_repetition_fr*/0,   /*des_startbit*/55,    /*src_cyc*/101,  /*src_id*/0x12,   /*src_dlc*/8,   /*des_cyc*/10,   /*des_id*/0xa0, /*src_updatebit*/56,   /*des_updatebit*/56,      /*initvalue*/1155         },
           {   /*sig_name*/"isADataRawSafeALat1Qf_0",   /*src_can*/"ZCUD_CAN1",   /*src_network_type*/"CAN",   /*src_slotid_fr*/0,   /*src_basecycle_fr*/0,  /*src_repetition_fr*/0,  /*src_startbit*/11,   /*sig_length*/2,  /*des_slotid_fr*/0,   /*des_basecycle_fr*/0,  /*des_repetition_fr*/0,   /*des_startbit*/11,    /*src_cyc*/101,  /*src_id*/0x12,   /*src_dlc*/8,   /*des_cyc*/10,   /*des_id*/0xa0, /*src_updatebit*/56,   /*des_updatebit*/56,      /*initvalue*/1         },
           {   /*sig_name*/"isADataRawSafeChks_0",   /*src_can*/"ZCUD_CAN1",   /*src_network_type*/"CAN",   /*src_slotid_fr*/0,   /*src_basecycle_fr*/0,  /*src_repetition_fr*/0,  /*src_startbit*/7,   /*sig_length*/8,  /*des_slotid_fr*/0,   /*des_basecycle_fr*/0,  /*des_repetition_fr*/0,   /*des_startbit*/7,    /*src_cyc*/101,  /*src_id*/0x12,   /*src_dlc*/8,   /*des_cyc*/10,   /*des_id*/0xa0, /*src_updatebit*/56,   /*des_updatebit*/56,      /*initvalue*/255         },
           {   /*sig_name*/"isADataRawSafeAVertQf_0",   /*src_can*/"ZCUD_CAN1",   /*src_network_type*/"CAN",   /*src_slotid_fr*/0,   /*src_basecycle_fr*/0,  /*src_repetition_fr*/0,  /*src_startbit*/24,   /*sig_length*/2,  /*des_slotid_fr*/0,   /*des_basecycle_fr*/0,  /*des_repetition_fr*/0,   /*des_startbit*/24,    /*src_cyc*/101,  /*src_id*/0x12,   /*src_dlc*/8,   /*des_cyc*/10,   /*des_id*/0xa0, /*src_updatebit*/56,   /*des_updatebit*/56,      /*initvalue*/1         },
           {   /*sig_name*/"isADataRawSafeCntr_0",   /*src_can*/"ZCUD_CAN1",   /*src_network_type*/"CAN",   /*src_slotid_fr*/0,   /*src_basecycle_fr*/0,  /*src_repetition_fr*/0,  /*src_startbit*/15,   /*sig_length*/4,  /*des_slotid_fr*/0,   /*des_basecycle_fr*/0,  /*des_repetition_fr*/0,   /*des_startbit*/15,    /*src_cyc*/101,  /*src_id*/0x12,   /*src_dlc*/8,   /*des_cyc*/10,   /*des_id*/0xa0, /*src_updatebit*/56,   /*des_updatebit*/56,      /*initvalue*/0         },
           {   /*sig_name*/"isAgDataCmpQualityYawRateCmpQuality_0",   /*src_can*/"ZCUD_CAN1",   /*src_network_type*/"CAN",   /*src_slotid_fr*/0,   /*src_basecycle_fr*/0,  /*src_repetition_fr*/0,  /*src_startbit*/23,   /*sig_length*/8,  /*des_slotid_fr*/0,   /*des_basecycle_fr*/0,  /*des_repetition_fr*/0,   /*des_startbit*/23,    /*src_cyc*/101,  /*src_id*/0x230,   /*src_dlc*/8,   /*des_cyc*/100,   /*des_id*/0x1a, /*src_updatebit*/31,   /*des_updatebit*/43,      /*initvalue*/0         },
           {   /*sig_name*/"isAgDataCmpQualityRollRateCmpQuality_0",   /*src_can*/"ZCUD_CAN1",   /*src_network_type*/"CAN",   /*src_slotid_fr*/0,   /*src_basecycle_fr*/0,  /*src_repetition_fr*/0,  /*src_startbit*/15,   /*sig_length*/8,  /*des_slotid_fr*/0,   /*des_basecycle_fr*/0,  /*des_repetition_fr*/0,   /*des_startbit*/15,    /*src_cyc*/101,  /*src_id*/0x230,   /*src_dlc*/8,   /*des_cyc*/100,   /*des_id*/0x1a, /*src_updatebit*/31,   /*des_updatebit*/43,      /*initvalue*/0         },
           {   /*sig_name*/"isAgDataCmpQualityPitchRateCmpQuality_0",   /*src_can*/"ZCUD_CAN1",   /*src_network_type*/"CAN",   /*src_slotid_fr*/0,   /*src_basecycle_fr*/0,  /*src_repetition_fr*/0,  /*src_startbit*/7,   /*sig_length*/8,  /*des_slotid_fr*/0,   /*des_basecycle_fr*/0,  /*des_repetition_fr*/0,   /*des_startbit*/7,    /*src_cyc*/101,  /*src_id*/0x230,   /*src_dlc*/8,   /*des_cyc*/100,   /*des_id*/0x1a, /*src_updatebit*/31,   /*des_updatebit*/43,      /*initvalue*/0         },
           {   /*sig_name*/"isIDcDcActLoSideChks_0",   /*src_can*/"PropulsionCAN",   /*src_network_type*/"CAN",   /*src_slotid_fr*/0,   /*src_basecycle_fr*/0,  /*src_repetition_fr*/0,  /*src_startbit*/31,   /*sig_length*/8,  /*des_slotid_fr*/0,   /*des_basecycle_fr*/0,  /*des_repetition_fr*/0,   /*des_startbit*/15,    /*src_cyc*/101,  /*src_id*/0x149,   /*src_dlc*/8,   /*des_cyc*/200,   /*des_id*/0x244, /*src_updatebit*/20,   /*des_updatebit*/4,      /*initvalue*/0         },
           {   /*sig_name*/"isIDcDcActLoSideCntr_0",   /*src_can*/"PropulsionCAN",   /*src_network_type*/"CAN",   /*src_slotid_fr*/0,   /*src_basecycle_fr*/0,  /*src_repetition_fr*/0,  /*src_startbit*/19,   /*sig_length*/4,  /*des_slotid_fr*/0,   /*des_basecycle_fr*/0,  /*des_repetition_fr*/0,   /*des_startbit*/3,    /*src_cyc*/101,  /*src_id*/0x149,   /*src_dlc*/8,   /*des_cyc*/200,   /*des_id*/0x244, /*src_updatebit*/20,   /*des_updatebit*/4,      /*initvalue*/0         },
           {   /*sig_name*/"isIDcDcActLoSideIDcDcActLoSide_0",   /*src_can*/"PropulsionCAN",   /*src_network_type*/"CAN",   /*src_slotid_fr*/0,   /*src_basecycle_fr*/0,  /*src_repetition_fr*/0,  /*src_startbit*/39,   /*sig_length*/12,  /*des_slotid_fr*/0,   /*des_basecycle_fr*/0,  /*des_repetition_fr*/0,   /*des_startbit*/23,    /*src_cyc*/101,  /*src_id*/0x149,   /*src_dlc*/8,   /*des_cyc*/200,   /*des_id*/0x244, /*src_updatebit*/20,   /*des_updatebit*/4,      /*initvalue*/0         },
           {   /*sig_name*/"isAgDataRawSafeYawRate_0",   /*src_can*/"ZCUD_CAN1",   /*src_network_type*/"CAN",   /*src_slotid_fr*/0,   /*src_basecycle_fr*/0,  /*src_repetition_fr*/0,  /*src_startbit*/31,   /*sig_length*/16,  /*des_slotid_fr*/0,   /*des_basecycle_fr*/0,  /*des_repetition_fr*/0,   /*des_startbit*/23,    /*src_cyc*/101,  /*src_id*/0x89,   /*src_dlc*/8,   /*des_cyc*/10,   /*des_id*/0x1b0, /*src_updatebit*/5,   /*des_updatebit*/55,      /*initvalue*/0         },
           {   /*sig_name*/"isAgDataRawSafeRollRateQf_0",   /*src_can*/"ZCUD_CAN1",   /*src_network_type*/"CAN",   /*src_slotid_fr*/0,   /*src_basecycle_fr*/0,  /*src_repetition_fr*/0,  /*src_startbit*/51,   /*sig_length*/2,  /*des_slotid_fr*/0,   /*des_basecycle_fr*/0,  /*des_repetition_fr*/0,   /*des_startbit*/43,    /*src_cyc*/101,  /*src_id*/0x89,   /*src_dlc*/8,   /*des_cyc*/10,   /*des_id*/0x1b0, /*src_updatebit*/5,   /*des_updatebit*/55,      /*initvalue*/1         },
           {   /*sig_name*/"isAgDataRawSafeCntr_0",   /*src_can*/"ZCUD_CAN1",   /*src_network_type*/"CAN",   /*src_slotid_fr*/0,   /*src_basecycle_fr*/0,  /*src_repetition_fr*/0,  /*src_startbit*/55,   /*sig_length*/4,  /*des_slotid_fr*/0,   /*des_basecycle_fr*/0,  /*des_repetition_fr*/0,   /*des_startbit*/47,    /*src_cyc*/101,  /*src_id*/0x89,   /*src_dlc*/8,   /*des_cyc*/10,   /*des_id*/0x1b0, /*src_updatebit*/5,   /*des_updatebit*/55,      /*initvalue*/0         },
           {   /*sig_name*/"isAgDataRawSafeChks_0",   /*src_can*/"ZCUD_CAN1",   /*src_network_type*/"CAN",   /*src_slotid_fr*/0,   /*src_basecycle_fr*/0,  /*src_repetition_fr*/0,  /*src_startbit*/47,   /*sig_length*/8,  /*des_slotid_fr*/0,   /*des_basecycle_fr*/0,  /*des_repetition_fr*/0,   /*des_startbit*/39,    /*src_cyc*/101,  /*src_id*/0x89,   /*src_dlc*/8,   /*des_cyc*/10,   /*des_id*/0x1b0, /*src_updatebit*/5,   /*des_updatebit*/55,      /*initvalue*/255         },
           {   /*sig_name*/"isAgDataRawSafeYawRateQf_0",   /*src_can*/"ZCUD_CAN1",   /*src_network_type*/"CAN",   /*src_slotid_fr*/0,   /*src_basecycle_fr*/0,  /*src_repetition_fr*/0,  /*src_startbit*/49,   /*sig_length*/2,  /*des_slotid_fr*/0,   /*des_basecycle_fr*/0,  /*des_repetition_fr*/0,   /*des_startbit*/41,    /*src_cyc*/101,  /*src_id*/0x89,   /*src_dlc*/8,   /*des_cyc*/10,   /*des_id*/0x1b0, /*src_updatebit*/5,   /*des_updatebit*/55,      /*initvalue*/1         },
           {   /*sig_name*/"isAgDataRawSafeRollRate_0",   /*src_can*/"ZCUD_CAN1",   /*src_network_type*/"CAN",   /*src_slotid_fr*/0,   /*src_basecycle_fr*/0,  /*src_repetition_fr*/0,  /*src_startbit*/15,   /*sig_length*/16,  /*des_slotid_fr*/0,   /*des_basecycle_fr*/0,  /*des_repetition_fr*/0,   /*des_startbit*/7,    /*src_cyc*/101,  /*src_id*/0x89,   /*src_dlc*/8,   /*des_cyc*/10,   /*des_id*/0x1b0, /*src_updatebit*/5,   /*des_updatebit*/55,      /*initvalue*/0         },
           {   /*sig_name*/"isAsyDataWithCmpSafeALat1Qf_0",   /*src_can*/"ZCUD_CAN1",   /*src_network_type*/"CAN",   /*src_slotid_fr*/0,   /*src_basecycle_fr*/0,  /*src_repetition_fr*/0,  /*src_startbit*/41,   /*sig_length*/2,  /*des_slotid_fr*/0,   /*des_basecycle_fr*/0,  /*des_repetition_fr*/0,   /*des_startbit*/41,    /*src_cyc*/101,  /*src_id*/0x13,   /*src_dlc*/8,   /*des_cyc*/10,   /*des_id*/0x51, /*src_updatebit*/56,   /*des_updatebit*/56,      /*initvalue*/1         },
           {   /*sig_name*/"isAsyDataWithCmpSafeChks_0",   /*src_can*/"ZCUD_CAN1",   /*src_network_type*/"CAN",   /*src_slotid_fr*/0,   /*src_basecycle_fr*/0,  /*src_repetition_fr*/0,  /*src_startbit*/23,   /*sig_length*/8,  /*des_slotid_fr*/0,   /*des_basecycle_fr*/0,  /*des_repetition_fr*/0,   /*des_startbit*/23,    /*src_cyc*/101,  /*src_id*/0x13,   /*src_dlc*/8,   /*des_cyc*/10,   /*des_id*/0x51, /*src_updatebit*/56,   /*des_updatebit*/56,      /*initvalue*/255         },
           {   /*sig_name*/"isAsyDataWithCmpSafeYawRateWithCmp_0",   /*src_can*/"ZCUD_CAN1",   /*src_network_type*/"CAN",   /*src_slotid_fr*/0,   /*src_basecycle_fr*/0,  /*src_repetition_fr*/0,  /*src_startbit*/7,   /*sig_length*/16,  /*des_slotid_fr*/0,   /*des_basecycle_fr*/0,  /*des_repetition_fr*/0,   /*des_startbit*/7,    /*src_cyc*/101,  /*src_id*/0x13,   /*src_dlc*/8,   /*des_cyc*/10,   /*des_id*/0x51, /*src_updatebit*/56,   /*des_updatebit*/56,      /*initvalue*/0         },
           {   /*sig_name*/"isAsyDataWithCmpSafeALatWithCmp_0",   /*src_can*/"ZCUD_CAN1",   /*src_network_type*/"CAN",   /*src_slotid_fr*/0,   /*src_basecycle_fr*/0,  /*src_repetition_fr*/0,  /*src_startbit*/55,   /*sig_length*/15,  /*des_slotid_fr*/0,   /*des_basecycle_fr*/0,  /*des_repetition_fr*/0,   /*des_startbit*/55,    /*src_cyc*/101,  /*src_id*/0x13,   /*src_dlc*/8,   /*des_cyc*/10,   /*des_id*/0x51, /*src_updatebit*/56,   /*des_updatebit*/56,      /*initvalue*/0         },
           {   /*sig_name*/"isAsyDataWithCmpSafeGrdtOfALgt_0",   /*src_can*/"ZCUD_CAN1",   /*src_network_type*/"CAN",   /*src_slotid_fr*/0,   /*src_basecycle_fr*/0,  /*src_repetition_fr*/0,  /*src_startbit*/31,   /*sig_length*/14,  /*des_slotid_fr*/0,   /*des_basecycle_fr*/0,  /*des_repetition_fr*/0,   /*des_startbit*/31,    /*src_cyc*/101,  /*src_id*/0x13,   /*src_dlc*/8,   /*des_cyc*/10,   /*des_id*/0x51, /*src_updatebit*/56,   /*des_updatebit*/56,      /*initvalue*/0         },
           {   /*sig_name*/"isAsyDataWithCmpSafeYawRateQf_0",   /*src_can*/"ZCUD_CAN1",   /*src_network_type*/"CAN",   /*src_slotid_fr*/0,   /*src_basecycle_fr*/0,  /*src_repetition_fr*/0,  /*src_startbit*/33,   /*sig_length*/2,  /*des_slotid_fr*/0,   /*des_basecycle_fr*/0,  /*des_repetition_fr*/0,   /*des_startbit*/33,    /*src_cyc*/101,  /*src_id*/0x13,   /*src_dlc*/8,   /*des_cyc*/10,   /*des_id*/0x51, /*src_updatebit*/56,   /*des_updatebit*/56,      /*initvalue*/1         },
           {   /*sig_name*/"isAsyDataWithCmpSafeCntr_0",   /*src_can*/"ZCUD_CAN1",   /*src_network_type*/"CAN",   /*src_slotid_fr*/0,   /*src_basecycle_fr*/0,  /*src_repetition_fr*/0,  /*src_startbit*/47,   /*sig_length*/4,  /*des_slotid_fr*/0,   /*des_basecycle_fr*/0,  /*des_repetition_fr*/0,   /*des_startbit*/47,    /*src_cyc*/101,  /*src_id*/0x13,   /*src_dlc*/8,   /*des_cyc*/10,   /*des_id*/0x51, /*src_updatebit*/56,   /*des_updatebit*/56,      /*initvalue*/0         },
           {   /*sig_name*/"isAsyDataWithCmpSafeALgt1Qf_0",   /*src_can*/"ZCUD_CAN1",   /*src_network_type*/"CAN",   /*src_slotid_fr*/0,   /*src_basecycle_fr*/0,  /*src_repetition_fr*/0,  /*src_startbit*/43,   /*sig_length*/2,  /*des_slotid_fr*/0,   /*des_basecycle_fr*/0,  /*des_repetition_fr*/0,   /*des_startbit*/43,    /*src_cyc*/101,  /*src_id*/0x13,   /*src_dlc*/8,   /*des_cyc*/10,   /*des_id*/0x51, /*src_updatebit*/56,   /*des_updatebit*/56,      /*initvalue*/1         },
           {   /*sig_name*/"isCrashSts2_0",   /*src_can*/"ZCUD_CAN1",   /*src_network_type*/"CAN",   /*src_slotid_fr*/0,   /*src_basecycle_fr*/0,  /*src_repetition_fr*/0,  /*src_startbit*/29,   /*sig_length*/2,  /*des_slotid_fr*/0,   /*des_basecycle_fr*/0,  /*des_repetition_fr*/0,   /*des_startbit*/7,    /*src_cyc*/101,  /*src_id*/0x21,   /*src_dlc*/8,   /*des_cyc*/Event,   /*des_id*/0x2f, /*src_updatebit*/30,   /*des_updatebit*/5,      /*initvalue*/0         }
       }
   },
   {
       /*des_can*/ "ZCU_CANFD1",
       /*networktype*/ "CANFD",
       0,
       {
           0
       }
   },
   {
       /*des_can*/ "ZCUD_CANFD3",
       /*networktype*/ "CANFD",
       65,
       {
           {   /*sig_name*/"isBattRemainTimeToEmpty_0",   /*src_can*/"CEM_LIN6",   /*src_network_type*/"LIN",   /*src_slotid_fr*/0,   /*src_basecycle_fr*/0,  /*src_repetition_fr*/0,  /*src_startbit*/0,   /*sig_length*/15,  /*des_slotid_fr*/0,   /*des_basecycle_fr*/0,  /*des_repetition_fr*/0,   /*des_startbit*/111,    /*src_cyc*/101,  /*src_id*/6,   /*src_dlc*/7,   /*des_cyc*/100,   /*des_id*/0x239, /*src_updatebit*/1000,   /*des_updatebit*/112,      /*initvalue*/0         },
           {   /*sig_name*/"isSteerWhlSnsrChks_0",   /*src_can*/"ChassisCAN1",   /*src_network_type*/"CAN",   /*src_slotid_fr*/0,   /*src_basecycle_fr*/0,  /*src_repetition_fr*/0,  /*src_startbit*/39,   /*sig_length*/8,  /*des_slotid_fr*/0,   /*des_basecycle_fr*/0,  /*des_repetition_fr*/0,   /*des_startbit*/26,    /*src_cyc*/101,  /*src_id*/0x40,   /*src_dlc*/8,   /*des_cyc*/10,   /*des_id*/0x55, /*src_updatebit*/7,   /*des_updatebit*/44,      /*initvalue*/0         },
           {   /*sig_name*/"isSteerWhlSnsrQf_0",   /*src_can*/"ChassisCAN1",   /*src_network_type*/"CAN",   /*src_slotid_fr*/0,   /*src_basecycle_fr*/0,  /*src_repetition_fr*/0,  /*src_startbit*/23,   /*sig_length*/2,  /*des_slotid_fr*/0,   /*des_basecycle_fr*/0,  /*des_repetition_fr*/0,   /*des_startbit*/46,    /*src_cyc*/101,  /*src_id*/0x40,   /*src_dlc*/8,   /*des_cyc*/10,   /*des_id*/0x55, /*src_updatebit*/7,   /*des_updatebit*/44,      /*initvalue*/1         },
           {   /*sig_name*/"isSteerWhlSnsrAgSpd_0",   /*src_can*/"ChassisCAN1",   /*src_network_type*/"CAN",   /*src_slotid_fr*/0,   /*src_basecycle_fr*/0,  /*src_repetition_fr*/0,  /*src_startbit*/21,   /*sig_length*/14,  /*des_slotid_fr*/0,   /*des_basecycle_fr*/0,  /*des_repetition_fr*/0,   /*des_startbit*/8,    /*src_cyc*/101,  /*src_id*/0x40,   /*src_dlc*/8,   /*des_cyc*/10,   /*des_id*/0x55, /*src_updatebit*/7,   /*des_updatebit*/44,      /*initvalue*/0         },
           {   /*sig_name*/"isSteerWhlSnsrCntr_0",   /*src_can*/"ChassisCAN1",   /*src_network_type*/"CAN",   /*src_slotid_fr*/0,   /*src_basecycle_fr*/0,  /*src_repetition_fr*/0,  /*src_startbit*/47,   /*sig_length*/4,  /*des_slotid_fr*/0,   /*des_basecycle_fr*/0,  /*des_repetition_fr*/0,   /*des_startbit*/34,    /*src_cyc*/101,  /*src_id*/0x40,   /*src_dlc*/8,   /*des_cyc*/10,   /*des_id*/0x55, /*src_updatebit*/7,   /*des_updatebit*/44,      /*initvalue*/0         },
           {   /*sig_name*/"isSteerWhlSnsrAg_0",   /*src_can*/"ChassisCAN1",   /*src_network_type*/"CAN",   /*src_slotid_fr*/0,   /*src_basecycle_fr*/0,  /*src_repetition_fr*/0,  /*src_startbit*/6,   /*sig_length*/15,  /*des_slotid_fr*/0,   /*des_basecycle_fr*/0,  /*des_repetition_fr*/0,   /*des_startbit*/7,    /*src_cyc*/101,  /*src_id*/0x40,   /*src_dlc*/8,   /*des_cyc*/10,   /*des_id*/0x55, /*src_updatebit*/7,   /*des_updatebit*/44,      /*initvalue*/0         },
           {   /*sig_name*/"isWhlRotToothCntrReLe_0",   /*src_can*/"ChassisCANFD2",   /*src_network_type*/"CANFD",   /*src_slotid_fr*/0,   /*src_basecycle_fr*/0,  /*src_repetition_fr*/0,  /*src_startbit*/127,   /*sig_length*/8,  /*des_slotid_fr*/0,   /*des_basecycle_fr*/0,  /*des_repetition_fr*/0,   /*des_startbit*/399,    /*src_cyc*/101,  /*src_id*/0x67,   /*src_dlc*/64,   /*des_cyc*/10,   /*des_id*/0x55, /*src_updatebit*/139,   /*des_updatebit*/411,      /*initvalue*/0         },
           {   /*sig_name*/"isWhlRotToothCntrReRi_0",   /*src_can*/"ChassisCANFD2",   /*src_network_type*/"CANFD",   /*src_slotid_fr*/0,   /*src_basecycle_fr*/0,  /*src_repetition_fr*/0,  /*src_startbit*/135,   /*sig_length*/8,  /*des_slotid_fr*/0,   /*des_basecycle_fr*/0,  /*des_repetition_fr*/0,   /*des_startbit*/407,    /*src_cyc*/101,  /*src_id*/0x67,   /*src_dlc*/64,   /*des_cyc*/10,   /*des_id*/0x55, /*src_updatebit*/139,   /*des_updatebit*/411,      /*initvalue*/0         },
           {   /*sig_name*/"isWhlRotToothCntrFrntRi_0",   /*src_can*/"ChassisCANFD2",   /*src_network_type*/"CANFD",   /*src_slotid_fr*/0,   /*src_basecycle_fr*/0,  /*src_repetition_fr*/0,  /*src_startbit*/119,   /*sig_length*/8,  /*des_slotid_fr*/0,   /*des_basecycle_fr*/0,  /*des_repetition_fr*/0,   /*des_startbit*/391,    /*src_cyc*/101,  /*src_id*/0x67,   /*src_dlc*/64,   /*des_cyc*/10,   /*des_id*/0x55, /*src_updatebit*/139,   /*des_updatebit*/411,      /*initvalue*/0         },
           {   /*sig_name*/"isWhlRotToothCntrCntr_0",   /*src_can*/"ChassisCANFD2",   /*src_network_type*/"CANFD",   /*src_slotid_fr*/0,   /*src_basecycle_fr*/0,  /*src_repetition_fr*/0,  /*src_startbit*/143,   /*sig_length*/4,  /*des_slotid_fr*/0,   /*des_basecycle_fr*/0,  /*des_repetition_fr*/0,   /*des_startbit*/415,    /*src_cyc*/101,  /*src_id*/0x67,   /*src_dlc*/64,   /*des_cyc*/10,   /*des_id*/0x55, /*src_updatebit*/139,   /*des_updatebit*/411,      /*initvalue*/0         },
           {   /*sig_name*/"isWhlRotToothCntrFrntLe_0",   /*src_can*/"ChassisCANFD2",   /*src_network_type*/"CANFD",   /*src_slotid_fr*/0,   /*src_basecycle_fr*/0,  /*src_repetition_fr*/0,  /*src_startbit*/111,   /*sig_length*/8,  /*des_slotid_fr*/0,   /*des_basecycle_fr*/0,  /*des_repetition_fr*/0,   /*des_startbit*/383,    /*src_cyc*/101,  /*src_id*/0x67,   /*src_dlc*/64,   /*des_cyc*/10,   /*des_id*/0x55, /*src_updatebit*/139,   /*des_updatebit*/411,      /*initvalue*/0         },
           {   /*sig_name*/"isWhlRotToothCntrChks_0",   /*src_can*/"ChassisCANFD2",   /*src_network_type*/"CANFD",   /*src_slotid_fr*/0,   /*src_basecycle_fr*/0,  /*src_repetition_fr*/0,  /*src_startbit*/103,   /*sig_length*/8,  /*des_slotid_fr*/0,   /*des_basecycle_fr*/0,  /*des_repetition_fr*/0,   /*des_startbit*/375,    /*src_cyc*/101,  /*src_id*/0x67,   /*src_dlc*/64,   /*des_cyc*/10,   /*des_id*/0x55, /*src_updatebit*/139,   /*des_updatebit*/411,      /*initvalue*/0         },
           {   /*sig_name*/"isWhlFastSpdSafeQF_0",   /*src_can*/"ChassisCANFD2",   /*src_network_type*/"CANFD",   /*src_slotid_fr*/0,   /*src_basecycle_fr*/0,  /*src_repetition_fr*/0,  /*src_startbit*/489,   /*sig_length*/2,  /*des_slotid_fr*/0,   /*des_basecycle_fr*/0,  /*des_repetition_fr*/0,   /*des_startbit*/444,    /*src_cyc*/101,  /*src_id*/0x5a,   /*src_dlc*/64,   /*des_cyc*/10,   /*des_id*/0x55, /*src_updatebit*/506,   /*des_updatebit*/442,      /*initvalue*/1         },
           {   /*sig_name*/"isWhlFastSpdSafeCntr_0",   /*src_can*/"ChassisCANFD2",   /*src_network_type*/"CANFD",   /*src_slotid_fr*/0,   /*src_basecycle_fr*/0,  /*src_repetition_fr*/0,  /*src_startbit*/493,   /*sig_length*/4,  /*des_slotid_fr*/0,   /*des_basecycle_fr*/0,  /*des_repetition_fr*/0,   /*des_startbit*/432,    /*src_cyc*/101,  /*src_id*/0x5a,   /*src_dlc*/64,   /*des_cyc*/10,   /*des_id*/0x55, /*src_updatebit*/506,   /*des_updatebit*/442,      /*initvalue*/0         },
           {   /*sig_name*/"isWhlFastSpdSafeChks_0",   /*src_can*/"ChassisCANFD2",   /*src_network_type*/"CANFD",   /*src_slotid_fr*/0,   /*src_basecycle_fr*/0,  /*src_repetition_fr*/0,  /*src_startbit*/485,   /*sig_length*/8,  /*des_slotid_fr*/0,   /*des_basecycle_fr*/0,  /*des_repetition_fr*/0,   /*des_startbit*/424,    /*src_cyc*/101,  /*src_id*/0x5a,   /*src_dlc*/64,   /*des_cyc*/10,   /*des_id*/0x55, /*src_updatebit*/506,   /*des_updatebit*/442,      /*initvalue*/0         },
           {   /*sig_name*/"isWhlFastSpdSafeA_0",   /*src_can*/"ChassisCANFD2",   /*src_network_type*/"CANFD",   /*src_slotid_fr*/0,   /*src_basecycle_fr*/0,  /*src_repetition_fr*/0,  /*src_startbit*/468,   /*sig_length*/15,  /*des_slotid_fr*/0,   /*des_basecycle_fr*/0,  /*des_repetition_fr*/0,   /*des_startbit*/423,    /*src_cyc*/101,  /*src_id*/0x5a,   /*src_dlc*/64,   /*des_cyc*/10,   /*des_id*/0x55, /*src_updatebit*/506,   /*des_updatebit*/442,      /*initvalue*/0         },
           {   /*sig_name*/"isGearLvrIndcn_0",   /*src_can*/"ChassisCANFD2",   /*src_network_type*/"CANFD",   /*src_slotid_fr*/0,   /*src_basecycle_fr*/0,  /*src_repetition_fr*/0,  /*src_startbit*/71,   /*sig_length*/3,  /*des_slotid_fr*/0,   /*des_basecycle_fr*/0,  /*des_repetition_fr*/0,   /*des_startbit*/43,    /*src_cyc*/101,  /*src_id*/0x7c,   /*src_dlc*/64,   /*des_cyc*/10,   /*des_id*/0x55, /*src_updatebit*/68,   /*des_updatebit*/40,      /*initvalue*/7         },
           {   /*sig_name*/"isDstEstimdToEmptyForDrvgElecPredTyp2_0",   /*src_can*/"ChassisCANFD2",   /*src_network_type*/"CANFD",   /*src_slotid_fr*/0,   /*src_basecycle_fr*/0,  /*src_repetition_fr*/0,  /*src_startbit*/147,   /*sig_length*/11,  /*des_slotid_fr*/0,   /*des_basecycle_fr*/0,  /*des_repetition_fr*/0,   /*des_startbit*/35,    /*src_cyc*/101,  /*src_id*/0x7c,   /*src_dlc*/64,   /*des_cyc*/200,   /*des_id*/0x271, /*src_updatebit*/152,   /*des_updatebit*/40,      /*initvalue*/0         },
           {   /*sig_name*/"isVehSpdLgtCntr_0",   /*src_can*/"ChassisCANFD2",   /*src_network_type*/"CANFD",   /*src_slotid_fr*/0,   /*src_basecycle_fr*/0,  /*src_repetition_fr*/0,  /*src_startbit*/216,   /*sig_length*/4,  /*des_slotid_fr*/0,   /*des_basecycle_fr*/0,  /*des_repetition_fr*/0,   /*des_startbit*/144,    /*src_cyc*/101,  /*src_id*/0x9f,   /*src_dlc*/64,   /*des_cyc*/10,   /*des_id*/0x55, /*src_updatebit*/471,   /*des_updatebit*/154,      /*initvalue*/0         },
           {   /*sig_name*/"isVehSpdLgtA_0",   /*src_can*/"ChassisCANFD2",   /*src_network_type*/"CANFD",   /*src_slotid_fr*/0,   /*src_basecycle_fr*/0,  /*src_repetition_fr*/0,  /*src_startbit*/207,   /*sig_length*/15,  /*des_slotid_fr*/0,   /*des_basecycle_fr*/0,  /*des_repetition_fr*/0,   /*des_startbit*/135,    /*src_cyc*/101,  /*src_id*/0x9f,   /*src_dlc*/64,   /*des_cyc*/10,   /*des_id*/0x55, /*src_updatebit*/471,   /*des_updatebit*/154,      /*initvalue*/0         },
           {   /*sig_name*/"isVehSpdLgtQf_0",   /*src_can*/"ChassisCANFD2",   /*src_network_type*/"CANFD",   /*src_slotid_fr*/0,   /*src_basecycle_fr*/0,  /*src_repetition_fr*/0,  /*src_startbit*/228,   /*sig_length*/2,  /*des_slotid_fr*/0,   /*des_basecycle_fr*/0,  /*des_repetition_fr*/0,   /*des_startbit*/156,    /*src_cyc*/101,  /*src_id*/0x9f,   /*src_dlc*/64,   /*des_cyc*/10,   /*des_id*/0x55, /*src_updatebit*/471,   /*des_updatebit*/154,      /*initvalue*/1         },
           {   /*sig_name*/"isVehSpdLgtChks_0",   /*src_can*/"ChassisCANFD2",   /*src_network_type*/"CANFD",   /*src_slotid_fr*/0,   /*src_basecycle_fr*/0,  /*src_repetition_fr*/0,  /*src_startbit*/208,   /*sig_length*/8,  /*des_slotid_fr*/0,   /*des_basecycle_fr*/0,  /*des_repetition_fr*/0,   /*des_startbit*/136,    /*src_cyc*/101,  /*src_id*/0x9f,   /*src_dlc*/64,   /*des_cyc*/10,   /*des_id*/0x55, /*src_updatebit*/471,   /*des_updatebit*/154,      /*initvalue*/0         },
           {   /*sig_name*/"isDstToEmptyIndcdDstToEmpty2_0",   /*src_can*/"ChassisCANFD2",   /*src_network_type*/"CANFD",   /*src_slotid_fr*/0,   /*src_basecycle_fr*/0,  /*src_repetition_fr*/0,  /*src_startbit*/127,   /*sig_length*/13,  /*des_slotid_fr*/0,   /*des_basecycle_fr*/0,  /*des_repetition_fr*/0,   /*des_startbit*/87,    /*src_cyc*/101,  /*src_id*/0x7c,   /*src_dlc*/64,   /*des_cyc*/200,   /*des_id*/0x271, /*src_updatebit*/130,   /*des_updatebit*/90,      /*initvalue*/0         },
           {   /*sig_name*/"isDrvrGearShiftDirReq1DwnTipAut_0",   /*src_can*/"PropulsionCAN",   /*src_network_type*/"CAN",   /*src_slotid_fr*/0,   /*src_basecycle_fr*/0,  /*src_repetition_fr*/0,  /*src_startbit*/13,   /*sig_length*/1,  /*des_slotid_fr*/0,   /*des_basecycle_fr*/0,  /*des_repetition_fr*/0,   /*des_startbit*/34,    /*src_cyc*/101,  /*src_id*/0x136,   /*src_dlc*/8,   /*des_cyc*/50,   /*des_id*/0x153, /*src_updatebit*/1,   /*des_updatebit*/46,      /*initvalue*/0         },
           {   /*sig_name*/"isDrvrGearShiftDirReq1DwnDwnTipAut_0",   /*src_can*/"PropulsionCAN",   /*src_network_type*/"CAN",   /*src_slotid_fr*/0,   /*src_basecycle_fr*/0,  /*src_repetition_fr*/0,  /*src_startbit*/12,   /*sig_length*/1,  /*des_slotid_fr*/0,   /*des_basecycle_fr*/0,  /*des_repetition_fr*/0,   /*des_startbit*/35,    /*src_cyc*/101,  /*src_id*/0x136,   /*src_dlc*/8,   /*des_cyc*/50,   /*des_id*/0x153, /*src_updatebit*/1,   /*des_updatebit*/46,      /*initvalue*/0         },
           {   /*sig_name*/"isDrvrGearShiftDirReq1UpUpTipAut_0",   /*src_can*/"PropulsionCAN",   /*src_network_type*/"CAN",   /*src_slotid_fr*/0,   /*src_basecycle_fr*/0,  /*src_repetition_fr*/0,  /*src_startbit*/0,   /*sig_length*/1,  /*des_slotid_fr*/0,   /*des_basecycle_fr*/0,  /*des_repetition_fr*/0,   /*des_startbit*/47,    /*src_cyc*/101,  /*src_id*/0x136,   /*src_dlc*/8,   /*des_cyc*/50,   /*des_id*/0x153, /*src_updatebit*/1,   /*des_updatebit*/46,      /*initvalue*/0         },
           {   /*sig_name*/"isDrvrGearShiftDirReq1Chks_0",   /*src_can*/"PropulsionCAN",   /*src_network_type*/"CAN",   /*src_slotid_fr*/0,   /*src_basecycle_fr*/0,  /*src_repetition_fr*/0,  /*src_startbit*/23,   /*sig_length*/8,  /*des_slotid_fr*/0,   /*des_basecycle_fr*/0,  /*des_repetition_fr*/0,   /*des_startbit*/31,    /*src_cyc*/101,  /*src_id*/0x136,   /*src_dlc*/8,   /*des_cyc*/50,   /*des_id*/0x153, /*src_updatebit*/1,   /*des_updatebit*/46,      /*initvalue*/0         },
           {   /*sig_name*/"isDrvrGearShiftDirReq1Cntr_0",   /*src_can*/"PropulsionCAN",   /*src_network_type*/"CAN",   /*src_slotid_fr*/0,   /*src_basecycle_fr*/0,  /*src_repetition_fr*/0,  /*src_startbit*/11,   /*sig_length*/4,  /*des_slotid_fr*/0,   /*des_basecycle_fr*/0,  /*des_repetition_fr*/0,   /*des_startbit*/39,    /*src_cyc*/101,  /*src_id*/0x136,   /*src_dlc*/8,   /*des_cyc*/50,   /*des_id*/0x153, /*src_updatebit*/1,   /*des_updatebit*/46,      /*initvalue*/0         },
           {   /*sig_name*/"isDrvrGearShiftDirReq1UpTipAut_0",   /*src_can*/"PropulsionCAN",   /*src_network_type*/"CAN",   /*src_slotid_fr*/0,   /*src_basecycle_fr*/0,  /*src_repetition_fr*/0,  /*src_startbit*/15,   /*sig_length*/1,  /*des_slotid_fr*/0,   /*des_basecycle_fr*/0,  /*des_repetition_fr*/0,   /*des_startbit*/32,    /*src_cyc*/101,  /*src_id*/0x136,   /*src_dlc*/8,   /*des_cyc*/50,   /*des_id*/0x153, /*src_updatebit*/1,   /*des_updatebit*/46,      /*initvalue*/0         },
           {   /*sig_name*/"isDrvrGearShiftDirReq1PosnAut_0",   /*src_can*/"PropulsionCAN",   /*src_network_type*/"CAN",   /*src_slotid_fr*/0,   /*src_basecycle_fr*/0,  /*src_repetition_fr*/0,  /*src_startbit*/14,   /*sig_length*/1,  /*des_slotid_fr*/0,   /*des_basecycle_fr*/0,  /*des_repetition_fr*/0,   /*des_startbit*/33,    /*src_cyc*/101,  /*src_id*/0x136,   /*src_dlc*/8,   /*des_cyc*/50,   /*des_id*/0x153, /*src_updatebit*/1,   /*des_updatebit*/46,      /*initvalue*/0         },
           {   /*sig_name*/"isDstEstimdToEmptyForDynElec_0",   /*src_can*/"ChassisCANFD2",   /*src_network_type*/"CANFD",   /*src_slotid_fr*/0,   /*src_basecycle_fr*/0,  /*src_repetition_fr*/0,  /*src_startbit*/135,   /*sig_length*/11,  /*des_slotid_fr*/0,   /*des_basecycle_fr*/0,  /*des_repetition_fr*/0,   /*des_startbit*/55,    /*src_cyc*/101,  /*src_id*/0x28e,   /*src_dlc*/64,   /*des_cyc*/200,   /*des_id*/0x271, /*src_updatebit*/140,   /*des_updatebit*/60,      /*initvalue*/0         },
           {   /*sig_name*/"isYawRateReqdByDrvr_0",   /*src_can*/"ChassisCANFD2",   /*src_network_type*/"CANFD",   /*src_slotid_fr*/0,   /*src_basecycle_fr*/0,  /*src_repetition_fr*/0,  /*src_startbit*/263,   /*sig_length*/16,  /*des_slotid_fr*/0,   /*des_basecycle_fr*/0,  /*des_repetition_fr*/0,   /*des_startbit*/223,    /*src_cyc*/101,  /*src_id*/0x9f,   /*src_dlc*/64,   /*des_cyc*/10,   /*des_id*/0x55, /*src_updatebit*/469,   /*des_updatebit*/124,      /*initvalue*/0         },
           {   /*sig_name*/"isDstToEmptyIndcdDstToEmpty3_0",   /*src_can*/"ChassisCANFD2",   /*src_network_type*/"CANFD",   /*src_slotid_fr*/0,   /*src_basecycle_fr*/0,  /*src_repetition_fr*/0,  /*src_startbit*/151,   /*sig_length*/13,  /*des_slotid_fr*/0,   /*des_basecycle_fr*/0,  /*des_repetition_fr*/0,   /*des_startbit*/103,    /*src_cyc*/101,  /*src_id*/0x28e,   /*src_dlc*/64,   /*des_cyc*/200,   /*des_id*/0x271, /*src_updatebit*/154,   /*des_updatebit*/106,      /*initvalue*/0         },
           {   /*sig_name*/"isBattIRaw_0",   /*src_can*/"CEM_LIN6",   /*src_network_type*/"LIN",   /*src_slotid_fr*/0,   /*src_basecycle_fr*/0,  /*src_repetition_fr*/0,  /*src_startbit*/0,   /*sig_length*/16,  /*des_slotid_fr*/0,   /*des_basecycle_fr*/0,  /*des_repetition_fr*/0,   /*des_startbit*/95,    /*src_cyc*/101,  /*src_id*/2,   /*src_dlc*/8,   /*des_cyc*/100,   /*des_id*/0x239, /*src_updatebit*/1000,   /*des_updatebit*/128,      /*initvalue*/32768         },
           {   /*sig_name*/"isPtTqAtWhlFrntActCntr_0",   /*src_can*/"ChassisCANFD2",   /*src_network_type*/"CANFD",   /*src_slotid_fr*/0,   /*src_basecycle_fr*/0,  /*src_repetition_fr*/0,  /*src_startbit*/63,   /*sig_length*/4,  /*des_slotid_fr*/0,   /*des_basecycle_fr*/0,  /*des_repetition_fr*/0,   /*des_startbit*/63,    /*src_cyc*/101,  /*src_id*/0x7c,   /*src_dlc*/64,   /*des_cyc*/100,   /*des_id*/0x239, /*src_updatebit*/56,   /*des_updatebit*/56,      /*initvalue*/0         },
           {   /*sig_name*/"isPtTqAtWhlFrntActPtTqAtAxleFrntAct_0",   /*src_can*/"ChassisCANFD2",   /*src_network_type*/"CANFD",   /*src_slotid_fr*/0,   /*src_basecycle_fr*/0,  /*src_repetition_fr*/0,  /*src_startbit*/7,   /*sig_length*/16,  /*des_slotid_fr*/0,   /*des_basecycle_fr*/0,  /*des_repetition_fr*/0,   /*des_startbit*/7,    /*src_cyc*/101,  /*src_id*/0x7c,   /*src_dlc*/64,   /*des_cyc*/100,   /*des_id*/0x239, /*src_updatebit*/56,   /*des_updatebit*/56,      /*initvalue*/0         },
           {   /*sig_name*/"isPtTqAtWhlFrntActPtTqAtWhlFrntLeAct_0",   /*src_can*/"ChassisCANFD2",   /*src_network_type*/"CANFD",   /*src_slotid_fr*/0,   /*src_basecycle_fr*/0,  /*src_repetition_fr*/0,  /*src_startbit*/23,   /*sig_length*/16,  /*des_slotid_fr*/0,   /*des_basecycle_fr*/0,  /*des_repetition_fr*/0,   /*des_startbit*/23,    /*src_cyc*/101,  /*src_id*/0x7c,   /*src_dlc*/64,   /*des_cyc*/100,   /*des_id*/0x239, /*src_updatebit*/56,   /*des_updatebit*/56,      /*initvalue*/0         },
           {   /*sig_name*/"isPtTqAtWhlFrntActPtTqAtWhlsFrntQly_0",   /*src_can*/"ChassisCANFD2",   /*src_network_type*/"CANFD",   /*src_slotid_fr*/0,   /*src_basecycle_fr*/0,  /*src_repetition_fr*/0,  /*src_startbit*/59,   /*sig_length*/3,  /*des_slotid_fr*/0,   /*des_basecycle_fr*/0,  /*des_repetition_fr*/0,   /*des_startbit*/59,    /*src_cyc*/101,  /*src_id*/0x7c,   /*src_dlc*/64,   /*des_cyc*/100,   /*des_id*/0x239, /*src_updatebit*/56,   /*des_updatebit*/56,      /*initvalue*/0         },
           {   /*sig_name*/"isPtTqAtWhlFrntActPtTqAtWhlFrntRiAct_0",   /*src_can*/"ChassisCANFD2",   /*src_network_type*/"CANFD",   /*src_slotid_fr*/0,   /*src_basecycle_fr*/0,  /*src_repetition_fr*/0,  /*src_startbit*/39,   /*sig_length*/16,  /*des_slotid_fr*/0,   /*des_basecycle_fr*/0,  /*des_repetition_fr*/0,   /*des_startbit*/39,    /*src_cyc*/101,  /*src_id*/0x7c,   /*src_dlc*/64,   /*des_cyc*/100,   /*des_id*/0x239, /*src_updatebit*/56,   /*des_updatebit*/56,      /*initvalue*/0         },
           {   /*sig_name*/"isPtTqAtWhlFrntActChks_0",   /*src_can*/"ChassisCANFD2",   /*src_network_type*/"CANFD",   /*src_slotid_fr*/0,   /*src_basecycle_fr*/0,  /*src_repetition_fr*/0,  /*src_startbit*/55,   /*sig_length*/8,  /*des_slotid_fr*/0,   /*des_basecycle_fr*/0,  /*des_repetition_fr*/0,   /*des_startbit*/55,    /*src_cyc*/101,  /*src_id*/0x7c,   /*src_dlc*/64,   /*des_cyc*/100,   /*des_id*/0x239, /*src_updatebit*/56,   /*des_updatebit*/56,      /*initvalue*/0         },
           {   /*sig_name*/"isDstToEmptyIndcdDstToEmpty1_0",   /*src_can*/"ChassisCANFD2",   /*src_network_type*/"CANFD",   /*src_slotid_fr*/0,   /*src_basecycle_fr*/0,  /*src_repetition_fr*/0,  /*src_startbit*/111,   /*sig_length*/13,  /*des_slotid_fr*/0,   /*des_basecycle_fr*/0,  /*des_repetition_fr*/0,   /*des_startbit*/71,    /*src_cyc*/101,  /*src_id*/0x7c,   /*src_dlc*/64,   /*des_cyc*/200,   /*des_id*/0x271, /*src_updatebit*/114,   /*des_updatebit*/74,      /*initvalue*/0         },
           {   /*sig_name*/"isBrkTracCtrlActv_0",   /*src_can*/"ChassisCAN1",   /*src_network_type*/"CAN",   /*src_slotid_fr*/0,   /*src_basecycle_fr*/0,  /*src_repetition_fr*/0,  /*src_startbit*/20,   /*sig_length*/1,  /*des_slotid_fr*/0,   /*des_basecycle_fr*/0,  /*des_repetition_fr*/0,   /*des_startbit*/66,    /*src_cyc*/101,  /*src_id*/0x14b,   /*src_dlc*/8,   /*des_cyc*/10,   /*des_id*/0x66, /*src_updatebit*/21,   /*des_updatebit*/65,      /*initvalue*/0         },
           {   /*sig_name*/"isAbsCtrlActvCtrlSts1_0",   /*src_can*/"ChassisCAN1",   /*src_network_type*/"CAN",   /*src_slotid_fr*/0,   /*src_basecycle_fr*/0,  /*src_repetition_fr*/0,  /*src_startbit*/43,   /*sig_length*/1,  /*des_slotid_fr*/0,   /*des_basecycle_fr*/0,  /*des_repetition_fr*/0,   /*des_startbit*/139,    /*src_cyc*/101,  /*src_id*/0xb9,   /*src_dlc*/8,   /*des_cyc*/10,   /*des_id*/0x66, /*src_updatebit*/24,   /*des_updatebit*/138,      /*initvalue*/0         },
           {   /*sig_name*/"isAbsCtrlActvChks_0",   /*src_can*/"ChassisCAN1",   /*src_network_type*/"CAN",   /*src_slotid_fr*/0,   /*src_basecycle_fr*/0,  /*src_repetition_fr*/0,  /*src_startbit*/39,   /*sig_length*/8,  /*des_slotid_fr*/0,   /*des_basecycle_fr*/0,  /*des_repetition_fr*/0,   /*des_startbit*/135,    /*src_cyc*/101,  /*src_id*/0xb9,   /*src_dlc*/8,   /*des_cyc*/10,   /*des_id*/0x66, /*src_updatebit*/24,   /*des_updatebit*/138,      /*initvalue*/0         },
           {   /*sig_name*/"isAbsCtrlActvCntr_0",   /*src_can*/"ChassisCAN1",   /*src_network_type*/"CAN",   /*src_slotid_fr*/0,   /*src_basecycle_fr*/0,  /*src_repetition_fr*/0,  /*src_startbit*/47,   /*sig_length*/4,  /*des_slotid_fr*/0,   /*des_basecycle_fr*/0,  /*des_repetition_fr*/0,   /*des_startbit*/143,    /*src_cyc*/101,  /*src_id*/0xb9,   /*src_dlc*/8,   /*des_cyc*/10,   /*des_id*/0x66, /*src_updatebit*/24,   /*des_updatebit*/138,      /*initvalue*/0         },
           {   /*sig_name*/"isDrvrGearShiftDirReq2Cntr_0",   /*src_can*/"PropulsionCAN",   /*src_network_type*/"CAN",   /*src_slotid_fr*/0,   /*src_basecycle_fr*/0,  /*src_repetition_fr*/0,  /*src_startbit*/35,   /*sig_length*/4,  /*des_slotid_fr*/0,   /*des_basecycle_fr*/0,  /*des_repetition_fr*/0,   /*des_startbit*/53,    /*src_cyc*/101,  /*src_id*/0x136,   /*src_dlc*/8,   /*des_cyc*/50,   /*des_id*/0x153, /*src_updatebit*/25,   /*des_updatebit*/60,      /*initvalue*/0         },
           {   /*sig_name*/"isDrvrGearShiftDirReq2Chks_0",   /*src_can*/"PropulsionCAN",   /*src_network_type*/"CAN",   /*src_slotid_fr*/0,   /*src_basecycle_fr*/0,  /*src_repetition_fr*/0,  /*src_startbit*/47,   /*sig_length*/8,  /*des_slotid_fr*/0,   /*des_basecycle_fr*/0,  /*des_repetition_fr*/0,   /*des_startbit*/45,    /*src_cyc*/101,  /*src_id*/0x136,   /*src_dlc*/8,   /*des_cyc*/50,   /*des_id*/0x153, /*src_updatebit*/25,   /*des_updatebit*/60,      /*initvalue*/0         },
           {   /*sig_name*/"isDrvrGearShiftDirReq2UpTipAut_0",   /*src_can*/"PropulsionCAN",   /*src_network_type*/"CAN",   /*src_slotid_fr*/0,   /*src_basecycle_fr*/0,  /*src_repetition_fr*/0,  /*src_startbit*/39,   /*sig_length*/1,  /*des_slotid_fr*/0,   /*des_basecycle_fr*/0,  /*des_repetition_fr*/0,   /*des_startbit*/62,    /*src_cyc*/101,  /*src_id*/0x136,   /*src_dlc*/8,   /*des_cyc*/50,   /*des_id*/0x153, /*src_updatebit*/25,   /*des_updatebit*/60,      /*initvalue*/0         },
           {   /*sig_name*/"isDrvrGearShiftDirReq2PosnAut_0",   /*src_can*/"PropulsionCAN",   /*src_network_type*/"CAN",   /*src_slotid_fr*/0,   /*src_basecycle_fr*/0,  /*src_repetition_fr*/0,  /*src_startbit*/38,   /*sig_length*/1,  /*des_slotid_fr*/0,   /*des_basecycle_fr*/0,  /*des_repetition_fr*/0,   /*des_startbit*/63,    /*src_cyc*/101,  /*src_id*/0x136,   /*src_dlc*/8,   /*des_cyc*/50,   /*des_id*/0x153, /*src_updatebit*/25,   /*des_updatebit*/60,      /*initvalue*/0         },
           {   /*sig_name*/"isDrvrGearShiftDirReq2DwnDwnTipAut_0",   /*src_can*/"PropulsionCAN",   /*src_network_type*/"CAN",   /*src_slotid_fr*/0,   /*src_basecycle_fr*/0,  /*src_repetition_fr*/0,  /*src_startbit*/36,   /*sig_length*/1,  /*des_slotid_fr*/0,   /*des_basecycle_fr*/0,  /*des_repetition_fr*/0,   /*des_startbit*/49,    /*src_cyc*/101,  /*src_id*/0x136,   /*src_dlc*/8,   /*des_cyc*/50,   /*des_id*/0x153, /*src_updatebit*/25,   /*des_updatebit*/60,      /*initvalue*/0         },
           {   /*sig_name*/"isDrvrGearShiftDirReq2UpUpTipAut_0",   /*src_can*/"PropulsionCAN",   /*src_network_type*/"CAN",   /*src_slotid_fr*/0,   /*src_basecycle_fr*/0,  /*src_repetition_fr*/0,  /*src_startbit*/24,   /*sig_length*/1,  /*des_slotid_fr*/0,   /*des_basecycle_fr*/0,  /*des_repetition_fr*/0,   /*des_startbit*/61,    /*src_cyc*/101,  /*src_id*/0x136,   /*src_dlc*/8,   /*des_cyc*/50,   /*des_id*/0x153, /*src_updatebit*/25,   /*des_updatebit*/60,      /*initvalue*/0         },
           {   /*sig_name*/"isDrvrGearShiftDirReq2DwnTipAut_0",   /*src_can*/"PropulsionCAN",   /*src_network_type*/"CAN",   /*src_slotid_fr*/0,   /*src_basecycle_fr*/0,  /*src_repetition_fr*/0,  /*src_startbit*/37,   /*sig_length*/1,  /*des_slotid_fr*/0,   /*des_basecycle_fr*/0,  /*des_repetition_fr*/0,   /*des_startbit*/48,    /*src_cyc*/101,  /*src_id*/0x136,   /*src_dlc*/8,   /*des_cyc*/50,   /*des_id*/0x153, /*src_updatebit*/25,   /*des_updatebit*/60,      /*initvalue*/0         },
           {   /*sig_name*/"isWhlSpdCircumlFrntCntr_0",   /*src_can*/"ChassisCANFD2",   /*src_network_type*/"CANFD",   /*src_slotid_fr*/0,   /*src_basecycle_fr*/0,  /*src_repetition_fr*/0,  /*src_startbit*/33,   /*sig_length*/4,  /*des_slotid_fr*/0,   /*des_basecycle_fr*/0,  /*des_repetition_fr*/0,   /*des_startbit*/177,    /*src_cyc*/101,  /*src_id*/0x67,   /*src_dlc*/64,   /*des_cyc*/10,   /*des_id*/0x66, /*src_updatebit*/41,   /*des_updatebit*/185,      /*initvalue*/0         },
           {   /*sig_name*/"isWhlSpdCircumlFrntWhlSpdCircumlFrntRi_0",   /*src_can*/"ChassisCANFD2",   /*src_network_type*/"CANFD",   /*src_slotid_fr*/0,   /*src_basecycle_fr*/0,  /*src_repetition_fr*/0,  /*src_startbit*/8,   /*sig_length*/15,  /*des_slotid_fr*/0,   /*des_basecycle_fr*/0,  /*des_repetition_fr*/0,   /*des_startbit*/152,    /*src_cyc*/101,  /*src_id*/0x67,   /*src_dlc*/64,   /*des_cyc*/10,   /*des_id*/0x66, /*src_updatebit*/41,   /*des_updatebit*/185,      /*initvalue*/0         },
           {   /*sig_name*/"isWhlSpdCircumlFrntLe_0",   /*src_can*/"ChassisCANFD2",   /*src_network_type*/"CANFD",   /*src_slotid_fr*/0,   /*src_basecycle_fr*/0,  /*src_repetition_fr*/0,  /*src_startbit*/7,   /*sig_length*/15,  /*des_slotid_fr*/0,   /*des_basecycle_fr*/0,  /*des_repetition_fr*/0,   /*des_startbit*/151,    /*src_cyc*/101,  /*src_id*/0x67,   /*src_dlc*/64,   /*des_cyc*/10,   /*des_id*/0x66, /*src_updatebit*/41,   /*des_updatebit*/185,      /*initvalue*/0         },
           {   /*sig_name*/"isWhlSpdCircumlFrntRiQf_0",   /*src_can*/"ChassisCANFD2",   /*src_network_type*/"CANFD",   /*src_slotid_fr*/0,   /*src_basecycle_fr*/0,  /*src_repetition_fr*/0,  /*src_startbit*/43,   /*sig_length*/2,  /*des_slotid_fr*/0,   /*des_basecycle_fr*/0,  /*des_repetition_fr*/0,   /*des_startbit*/187,    /*src_cyc*/101,  /*src_id*/0x67,   /*src_dlc*/64,   /*des_cyc*/10,   /*des_id*/0x66, /*src_updatebit*/41,   /*des_updatebit*/185,      /*initvalue*/1         },
           {   /*sig_name*/"isWhlSpdCircumlFrntChks_0",   /*src_can*/"ChassisCANFD2",   /*src_network_type*/"CANFD",   /*src_slotid_fr*/0,   /*src_basecycle_fr*/0,  /*src_repetition_fr*/0,  /*src_startbit*/25,   /*sig_length*/8,  /*des_slotid_fr*/0,   /*des_basecycle_fr*/0,  /*des_repetition_fr*/0,   /*des_startbit*/169,    /*src_cyc*/101,  /*src_id*/0x67,   /*src_dlc*/64,   /*des_cyc*/10,   /*des_id*/0x66, /*src_updatebit*/41,   /*des_updatebit*/185,      /*initvalue*/0         },
           {   /*sig_name*/"isWhlSpdCircumlFrntLeQf_0",   /*src_can*/"ChassisCANFD2",   /*src_network_type*/"CANFD",   /*src_slotid_fr*/0,   /*src_basecycle_fr*/0,  /*src_repetition_fr*/0,  /*src_startbit*/45,   /*sig_length*/2,  /*des_slotid_fr*/0,   /*des_basecycle_fr*/0,  /*des_repetition_fr*/0,   /*des_startbit*/189,    /*src_cyc*/101,  /*src_id*/0x67,   /*src_dlc*/64,   /*des_cyc*/10,   /*des_id*/0x66, /*src_updatebit*/41,   /*des_updatebit*/185,      /*initvalue*/1         },
           {   /*sig_name*/"isDstEstimdToEmptyForDrvgElec_0",   /*src_can*/"ChassisCANFD2",   /*src_network_type*/"CANFD",   /*src_slotid_fr*/0,   /*src_basecycle_fr*/0,  /*src_repetition_fr*/0,  /*src_startbit*/143,   /*sig_length*/11,  /*des_slotid_fr*/0,   /*des_basecycle_fr*/0,  /*des_repetition_fr*/0,   /*des_startbit*/31,    /*src_cyc*/101,  /*src_id*/0x7c,   /*src_dlc*/64,   /*des_cyc*/200,   /*des_id*/0x271, /*src_updatebit*/148,   /*des_updatebit*/36,      /*initvalue*/0         },
           {   /*sig_name*/"isWhlSpdCircumlReCntr_0",   /*src_can*/"ChassisCANFD2",   /*src_network_type*/"CANFD",   /*src_slotid_fr*/0,   /*src_basecycle_fr*/0,  /*src_repetition_fr*/0,  /*src_startbit*/81,   /*sig_length*/4,  /*des_slotid_fr*/0,   /*des_basecycle_fr*/0,  /*des_repetition_fr*/0,   /*des_startbit*/225,    /*src_cyc*/101,  /*src_id*/0x67,   /*src_dlc*/64,   /*des_cyc*/10,   /*des_id*/0x66, /*src_updatebit*/89,   /*des_updatebit*/233,      /*initvalue*/0         },
           {   /*sig_name*/"isWhlSpdCircumlReChks_0",   /*src_can*/"ChassisCANFD2",   /*src_network_type*/"CANFD",   /*src_slotid_fr*/0,   /*src_basecycle_fr*/0,  /*src_repetition_fr*/0,  /*src_startbit*/73,   /*sig_length*/8,  /*des_slotid_fr*/0,   /*des_basecycle_fr*/0,  /*des_repetition_fr*/0,   /*des_startbit*/217,    /*src_cyc*/101,  /*src_id*/0x67,   /*src_dlc*/64,   /*des_cyc*/10,   /*des_id*/0x66, /*src_updatebit*/89,   /*des_updatebit*/233,      /*initvalue*/0         },
           {   /*sig_name*/"isWhlSpdCircumlReRiQf_0",   /*src_can*/"ChassisCANFD2",   /*src_network_type*/"CANFD",   /*src_slotid_fr*/0,   /*src_basecycle_fr*/0,  /*src_repetition_fr*/0,  /*src_startbit*/91,   /*sig_length*/2,  /*des_slotid_fr*/0,   /*des_basecycle_fr*/0,  /*des_repetition_fr*/0,   /*des_startbit*/235,    /*src_cyc*/101,  /*src_id*/0x67,   /*src_dlc*/64,   /*des_cyc*/10,   /*des_id*/0x66, /*src_updatebit*/89,   /*des_updatebit*/233,      /*initvalue*/1         },
           {   /*sig_name*/"isWhlSpdCircumlReLeQf_0",   /*src_can*/"ChassisCANFD2",   /*src_network_type*/"CANFD",   /*src_slotid_fr*/0,   /*src_basecycle_fr*/0,  /*src_repetition_fr*/0,  /*src_startbit*/93,   /*sig_length*/2,  /*des_slotid_fr*/0,   /*des_basecycle_fr*/0,  /*des_repetition_fr*/0,   /*des_startbit*/237,    /*src_cyc*/101,  /*src_id*/0x67,   /*src_dlc*/64,   /*des_cyc*/10,   /*des_id*/0x66, /*src_updatebit*/89,   /*des_updatebit*/233,      /*initvalue*/1         },
           {   /*sig_name*/"isWhlSpdCircumlReLe_0",   /*src_can*/"ChassisCANFD2",   /*src_network_type*/"CANFD",   /*src_slotid_fr*/0,   /*src_basecycle_fr*/0,  /*src_repetition_fr*/0,  /*src_startbit*/55,   /*sig_length*/15,  /*des_slotid_fr*/0,   /*des_basecycle_fr*/0,  /*des_repetition_fr*/0,   /*des_startbit*/199,    /*src_cyc*/101,  /*src_id*/0x67,   /*src_dlc*/64,   /*des_cyc*/10,   /*des_id*/0x66, /*src_updatebit*/89,   /*des_updatebit*/233,      /*initvalue*/0         },
           {   /*sig_name*/"isWhlSpdCircumlReRi_0",   /*src_can*/"ChassisCANFD2",   /*src_network_type*/"CANFD",   /*src_slotid_fr*/0,   /*src_basecycle_fr*/0,  /*src_repetition_fr*/0,  /*src_startbit*/56,   /*sig_length*/15,  /*des_slotid_fr*/0,   /*des_basecycle_fr*/0,  /*des_repetition_fr*/0,   /*des_startbit*/200,    /*src_cyc*/101,  /*src_id*/0x67,   /*src_dlc*/64,   /*des_cyc*/10,   /*des_id*/0x66, /*src_updatebit*/89,   /*des_updatebit*/233,      /*initvalue*/0         }
       }
   },
   {
       /*des_can*/ "ChassisCANFD2",
       /*networktype*/ "CANFD",
       94,
       {
           {   /*sig_name*/"isBltLockStAtRowSecRiBltLockSt1_0",   /*src_can*/"ZCUD_CAN1",   /*src_network_type*/"CAN",   /*src_slotid_fr*/0,   /*src_basecycle_fr*/0,  /*src_repetition_fr*/0,  /*src_startbit*/14,   /*sig_length*/1,  /*des_slotid_fr*/0,   /*des_basecycle_fr*/0,  /*des_repetition_fr*/0,   /*des_startbit*/14,    /*src_cyc*/101,  /*src_id*/0x70,   /*src_dlc*/8,   /*des_cyc*/40,   /*des_id*/0x13c, /*src_updatebit*/12,   /*des_updatebit*/12,      /*initvalue*/0         },
           {   /*sig_name*/"isBltLockStAtRowSecRiBltLockEquid_0",   /*src_can*/"ZCUD_CAN1",   /*src_network_type*/"CAN",   /*src_slotid_fr*/0,   /*src_basecycle_fr*/0,  /*src_repetition_fr*/0,  /*src_startbit*/15,   /*sig_length*/1,  /*des_slotid_fr*/0,   /*des_basecycle_fr*/0,  /*des_repetition_fr*/0,   /*des_startbit*/15,    /*src_cyc*/101,  /*src_id*/0x70,   /*src_dlc*/8,   /*des_cyc*/40,   /*des_id*/0x13c, /*src_updatebit*/12,   /*des_updatebit*/12,      /*initvalue*/1         },
           {   /*sig_name*/"isBltLockStAtRowSecRiBltLockSts_0",   /*src_can*/"ZCUD_CAN1",   /*src_network_type*/"CAN",   /*src_slotid_fr*/0,   /*src_basecycle_fr*/0,  /*src_repetition_fr*/0,  /*src_startbit*/13,   /*sig_length*/1,  /*des_slotid_fr*/0,   /*des_basecycle_fr*/0,  /*des_repetition_fr*/0,   /*des_startbit*/13,    /*src_cyc*/101,  /*src_id*/0x70,   /*src_dlc*/8,   /*des_cyc*/40,   /*des_id*/0x13c, /*src_updatebit*/12,   /*des_updatebit*/12,      /*initvalue*/1         },
           {   /*sig_name*/"isTotDstTrvld_0",   /*src_can*/"PropulsionCAN",   /*src_network_type*/"CAN",   /*src_slotid_fr*/0,   /*src_basecycle_fr*/0,  /*src_repetition_fr*/0,  /*src_startbit*/32,   /*sig_length*/25,  /*des_slotid_fr*/0,   /*des_basecycle_fr*/0,  /*des_repetition_fr*/0,   /*des_startbit*/136,    /*src_cyc*/101,  /*src_id*/0x15e,   /*src_dlc*/8,   /*des_cyc*/450,   /*des_id*/0x335, /*src_updatebit*/16,   /*des_updatebit*/121,      /*initvalue*/0         },
           {   /*sig_name*/"isSteerWhlSnsrChks_0",   /*src_can*/"ChassisCAN1",   /*src_network_type*/"CAN",   /*src_slotid_fr*/0,   /*src_basecycle_fr*/0,  /*src_repetition_fr*/0,  /*src_startbit*/39,   /*sig_length*/8,  /*des_slotid_fr*/0,   /*des_basecycle_fr*/0,  /*des_repetition_fr*/0,   /*des_startbit*/402,    /*src_cyc*/101,  /*src_id*/0x40,   /*src_dlc*/8,   /*des_cyc*/10,   /*des_id*/0x4f, /*src_updatebit*/7,   /*des_updatebit*/420,      /*initvalue*/0         },
           {   /*sig_name*/"isSteerWhlSnsrQf_0",   /*src_can*/"ChassisCAN1",   /*src_network_type*/"CAN",   /*src_slotid_fr*/0,   /*src_basecycle_fr*/0,  /*src_repetition_fr*/0,  /*src_startbit*/23,   /*sig_length*/2,  /*des_slotid_fr*/0,   /*des_basecycle_fr*/0,  /*des_repetition_fr*/0,   /*des_startbit*/422,    /*src_cyc*/101,  /*src_id*/0x40,   /*src_dlc*/8,   /*des_cyc*/10,   /*des_id*/0x4f, /*src_updatebit*/7,   /*des_updatebit*/420,      /*initvalue*/1         },
           {   /*sig_name*/"isSteerWhlSnsrAgSpd_0",   /*src_can*/"ChassisCAN1",   /*src_network_type*/"CAN",   /*src_slotid_fr*/0,   /*src_basecycle_fr*/0,  /*src_repetition_fr*/0,  /*src_startbit*/21,   /*sig_length*/14,  /*des_slotid_fr*/0,   /*des_basecycle_fr*/0,  /*des_repetition_fr*/0,   /*des_startbit*/384,    /*src_cyc*/101,  /*src_id*/0x40,   /*src_dlc*/8,   /*des_cyc*/10,   /*des_id*/0x4f, /*src_updatebit*/7,   /*des_updatebit*/420,      /*initvalue*/0         },
           {   /*sig_name*/"isSteerWhlSnsrCntr_0",   /*src_can*/"ChassisCAN1",   /*src_network_type*/"CAN",   /*src_slotid_fr*/0,   /*src_basecycle_fr*/0,  /*src_repetition_fr*/0,  /*src_startbit*/47,   /*sig_length*/4,  /*des_slotid_fr*/0,   /*des_basecycle_fr*/0,  /*des_repetition_fr*/0,   /*des_startbit*/410,    /*src_cyc*/101,  /*src_id*/0x40,   /*src_dlc*/8,   /*des_cyc*/10,   /*des_id*/0x4f, /*src_updatebit*/7,   /*des_updatebit*/420,      /*initvalue*/0         },
           {   /*sig_name*/"isSteerWhlSnsrAg_0",   /*src_can*/"ChassisCAN1",   /*src_network_type*/"CAN",   /*src_slotid_fr*/0,   /*src_basecycle_fr*/0,  /*src_repetition_fr*/0,  /*src_startbit*/6,   /*sig_length*/15,  /*des_slotid_fr*/0,   /*des_basecycle_fr*/0,  /*des_repetition_fr*/0,   /*des_startbit*/383,    /*src_cyc*/101,  /*src_id*/0x40,   /*src_dlc*/8,   /*des_cyc*/10,   /*des_id*/0x4f, /*src_updatebit*/7,   /*des_updatebit*/420,      /*initvalue*/0         },
           {   /*sig_name*/"isDrvrGearShiftParkReqSts_0",   /*src_can*/"PropulsionCAN",   /*src_network_type*/"CAN",   /*src_slotid_fr*/0,   /*src_basecycle_fr*/0,  /*src_repetition_fr*/0,  /*src_startbit*/13,   /*sig_length*/2,  /*des_slotid_fr*/0,   /*des_basecycle_fr*/0,  /*des_repetition_fr*/0,   /*des_startbit*/339,    /*src_cyc*/101,  /*src_id*/0x135,   /*src_dlc*/8,   /*des_cyc*/10,   /*des_id*/0x4f, /*src_updatebit*/15,   /*des_updatebit*/336,      /*initvalue*/0         },
           {   /*sig_name*/"isDrvrGearShiftParkReqCntr_0",   /*src_can*/"PropulsionCAN",   /*src_network_type*/"CAN",   /*src_slotid_fr*/0,   /*src_basecycle_fr*/0,  /*src_repetition_fr*/0,  /*src_startbit*/11,   /*sig_length*/4,  /*des_slotid_fr*/0,   /*des_basecycle_fr*/0,  /*des_repetition_fr*/0,   /*des_startbit*/343,    /*src_cyc*/101,  /*src_id*/0x135,   /*src_dlc*/8,   /*des_cyc*/10,   /*des_id*/0x4f, /*src_updatebit*/15,   /*des_updatebit*/336,      /*initvalue*/0         },
           {   /*sig_name*/"isDrvrGearShiftParkReqChks_0",   /*src_can*/"PropulsionCAN",   /*src_network_type*/"CAN",   /*src_slotid_fr*/0,   /*src_basecycle_fr*/0,  /*src_repetition_fr*/0,  /*src_startbit*/23,   /*sig_length*/8,  /*des_slotid_fr*/0,   /*des_basecycle_fr*/0,  /*des_repetition_fr*/0,   /*des_startbit*/335,    /*src_cyc*/101,  /*src_id*/0x135,   /*src_dlc*/8,   /*des_cyc*/10,   /*des_id*/0x4f, /*src_updatebit*/15,   /*des_updatebit*/336,      /*initvalue*/0         },
           {   /*sig_name*/"isDrvrGearShiftParkReq1_0",   /*src_can*/"PropulsionCAN",   /*src_network_type*/"CAN",   /*src_slotid_fr*/0,   /*src_basecycle_fr*/0,  /*src_repetition_fr*/0,  /*src_startbit*/14,   /*sig_length*/1,  /*des_slotid_fr*/0,   /*des_basecycle_fr*/0,  /*des_repetition_fr*/0,   /*des_startbit*/337,    /*src_cyc*/101,  /*src_id*/0x135,   /*src_dlc*/8,   /*des_cyc*/10,   /*des_id*/0x4f, /*src_updatebit*/15,   /*des_updatebit*/336,      /*initvalue*/0         },
           {   /*sig_name*/"isBltLockStAtRowSecMidBltLockEquid_0",   /*src_can*/"ZCUD_CAN1",   /*src_network_type*/"CAN",   /*src_slotid_fr*/0,   /*src_basecycle_fr*/0,  /*src_repetition_fr*/0,  /*src_startbit*/3,   /*sig_length*/1,  /*des_slotid_fr*/0,   /*des_basecycle_fr*/0,  /*des_repetition_fr*/0,   /*des_startbit*/3,    /*src_cyc*/101,  /*src_id*/0x70,   /*src_dlc*/8,   /*des_cyc*/40,   /*des_id*/0x13c, /*src_updatebit*/0,   /*des_updatebit*/0,      /*initvalue*/1         },
           {   /*sig_name*/"isBltLockStAtRowSecMidBltLockSts_0",   /*src_can*/"ZCUD_CAN1",   /*src_network_type*/"CAN",   /*src_slotid_fr*/0,   /*src_basecycle_fr*/0,  /*src_repetition_fr*/0,  /*src_startbit*/1,   /*sig_length*/1,  /*des_slotid_fr*/0,   /*des_basecycle_fr*/0,  /*des_repetition_fr*/0,   /*des_startbit*/1,    /*src_cyc*/101,  /*src_id*/0x70,   /*src_dlc*/8,   /*des_cyc*/40,   /*des_id*/0x13c, /*src_updatebit*/0,   /*des_updatebit*/0,      /*initvalue*/1         },
           {   /*sig_name*/"isBltLockStAtRowSecMidBltLockSt1_0",   /*src_can*/"ZCUD_CAN1",   /*src_network_type*/"CAN",   /*src_slotid_fr*/0,   /*src_basecycle_fr*/0,  /*src_repetition_fr*/0,  /*src_startbit*/2,   /*sig_length*/1,  /*des_slotid_fr*/0,   /*des_basecycle_fr*/0,  /*des_repetition_fr*/0,   /*des_startbit*/2,    /*src_cyc*/101,  /*src_id*/0x70,   /*src_dlc*/8,   /*des_cyc*/40,   /*des_id*/0x13c, /*src_updatebit*/0,   /*des_updatebit*/0,      /*initvalue*/0         },
           {   /*sig_name*/"isTqAssAddl_0",   /*src_can*/"ChassisCAN1",   /*src_network_type*/"CAN",   /*src_slotid_fr*/0,   /*src_basecycle_fr*/0,  /*src_repetition_fr*/0,  /*src_startbit*/53,   /*sig_length*/14,  /*des_slotid_fr*/0,   /*des_basecycle_fr*/0,  /*des_repetition_fr*/0,   /*des_startbit*/175,    /*src_cyc*/101,  /*src_id*/0x46,   /*src_dlc*/8,   /*des_cyc*/450,   /*des_id*/0x335, /*src_updatebit*/54,   /*des_updatebit*/177,      /*initvalue*/0         },
           {   /*sig_name*/"isBltLockStAtRowThrdLeBltLockSt1_0",   /*src_can*/"ZCUD_CAN1",   /*src_network_type*/"CAN",   /*src_slotid_fr*/0,   /*src_basecycle_fr*/0,  /*src_repetition_fr*/0,  /*src_startbit*/10,   /*sig_length*/1,  /*des_slotid_fr*/0,   /*des_basecycle_fr*/0,  /*des_repetition_fr*/0,   /*des_startbit*/10,    /*src_cyc*/101,  /*src_id*/0x70,   /*src_dlc*/8,   /*des_cyc*/40,   /*des_id*/0x13c, /*src_updatebit*/8,   /*des_updatebit*/8,      /*initvalue*/0         },
           {   /*sig_name*/"isBltLockStAtRowThrdLeBltLockEquid_0",   /*src_can*/"ZCUD_CAN1",   /*src_network_type*/"CAN",   /*src_slotid_fr*/0,   /*src_basecycle_fr*/0,  /*src_repetition_fr*/0,  /*src_startbit*/11,   /*sig_length*/1,  /*des_slotid_fr*/0,   /*des_basecycle_fr*/0,  /*des_repetition_fr*/0,   /*des_startbit*/11,    /*src_cyc*/101,  /*src_id*/0x70,   /*src_dlc*/8,   /*des_cyc*/40,   /*des_id*/0x13c, /*src_updatebit*/8,   /*des_updatebit*/8,      /*initvalue*/1         },
           {   /*sig_name*/"isBltLockStAtRowThrdLeBltLockSts_0",   /*src_can*/"ZCUD_CAN1",   /*src_network_type*/"CAN",   /*src_slotid_fr*/0,   /*src_basecycle_fr*/0,  /*src_repetition_fr*/0,  /*src_startbit*/9,   /*sig_length*/1,  /*des_slotid_fr*/0,   /*des_basecycle_fr*/0,  /*des_repetition_fr*/0,   /*des_startbit*/9,    /*src_cyc*/101,  /*src_id*/0x70,   /*src_dlc*/8,   /*des_cyc*/40,   /*des_id*/0x13c, /*src_updatebit*/8,   /*des_updatebit*/8,      /*initvalue*/1         },
           {   /*sig_name*/"isHWASyncStsGroupH1SyncSts_0",   /*src_can*/"ZCUD_CANFD3",   /*src_network_type*/"CANFD",   /*src_slotid_fr*/0,   /*src_basecycle_fr*/0,  /*src_repetition_fr*/0,  /*src_startbit*/2,   /*sig_length*/2,  /*des_slotid_fr*/0,   /*des_basecycle_fr*/0,  /*des_repetition_fr*/0,   /*des_startbit*/228,    /*src_cyc*/101,  /*src_id*/0x2c2,   /*src_dlc*/64,   /*des_cyc*/40,   /*des_id*/0x13c, /*src_updatebit*/0,   /*des_updatebit*/226,      /*initvalue*/0         },
           {   /*sig_name*/"isHWASyncStsGroupH1SyncOvrdIndcn_0",   /*src_can*/"ZCUD_CANFD3",   /*src_network_type*/"CANFD",   /*src_slotid_fr*/0,   /*src_basecycle_fr*/0,  /*src_repetition_fr*/0,  /*src_startbit*/5,   /*sig_length*/3,  /*des_slotid_fr*/0,   /*des_basecycle_fr*/0,  /*des_repetition_fr*/0,   /*des_startbit*/231,    /*src_cyc*/101,  /*src_id*/0x2c2,   /*src_dlc*/64,   /*des_cyc*/40,   /*des_id*/0x13c, /*src_updatebit*/0,   /*des_updatebit*/226,      /*initvalue*/0         },
           {   /*sig_name*/"isSolarSnsrLeValue_0",   /*src_can*/"CEM_LIN1",   /*src_network_type*/"LIN",   /*src_slotid_fr*/0,   /*src_basecycle_fr*/0,  /*src_repetition_fr*/0,  /*src_startbit*/16,   /*sig_length*/8,  /*des_slotid_fr*/0,   /*des_basecycle_fr*/0,  /*des_repetition_fr*/0,   /*des_startbit*/135,    /*src_cyc*/101,  /*src_id*/2,   /*src_dlc*/8,   /*des_cyc*/200,   /*des_id*/0x2a4, /*src_updatebit*/1000,   /*des_updatebit*/1,      /*initvalue*/51         },
           {   /*sig_name*/"isBattIMidAvb_0",   /*src_can*/"CEM_LIN6",   /*src_network_type*/"LIN",   /*src_slotid_fr*/0,   /*src_basecycle_fr*/0,  /*src_repetition_fr*/0,  /*src_startbit*/0,   /*sig_length*/16,  /*des_slotid_fr*/0,   /*des_basecycle_fr*/0,  /*des_repetition_fr*/0,   /*des_startbit*/7,    /*src_cyc*/101,  /*src_id*/32,   /*src_dlc*/7,   /*des_cyc*/20,   /*des_id*/0xdf, /*src_updatebit*/1000,   /*des_updatebit*/23,      /*initvalue*/32768         },
           {   /*sig_name*/"isManSyncnIndcnReqR1_0",   /*src_can*/"ZCUD_CANFD3",   /*src_network_type*/"CANFD",   /*src_slotid_fr*/0,   /*src_basecycle_fr*/0,  /*src_repetition_fr*/0,  /*src_startbit*/7,   /*sig_length*/2,  /*des_slotid_fr*/0,   /*des_basecycle_fr*/0,  /*des_repetition_fr*/0,   /*des_startbit*/159,    /*src_cyc*/101,  /*src_id*/0x200,   /*src_dlc*/64,   /*des_cyc*/20,   /*des_id*/0xdf, /*src_updatebit*/5,   /*des_updatebit*/157,      /*initvalue*/0         },
           {   /*sig_name*/"isBltLockStAtRowThrdMidBltLockEquid_0",   /*src_can*/"ZCUD_CAN1",   /*src_network_type*/"CAN",   /*src_slotid_fr*/0,   /*src_basecycle_fr*/0,  /*src_repetition_fr*/0,  /*src_startbit*/43,   /*sig_length*/1,  /*des_slotid_fr*/0,   /*des_basecycle_fr*/0,  /*des_repetition_fr*/0,   /*des_startbit*/23,    /*src_cyc*/101,  /*src_id*/0x225,   /*src_dlc*/8,   /*des_cyc*/40,   /*des_id*/0x13c, /*src_updatebit*/40,   /*des_updatebit*/20,      /*initvalue*/1         },
           {   /*sig_name*/"isBltLockStAtRowThrdMidBltLockSts_0",   /*src_can*/"ZCUD_CAN1",   /*src_network_type*/"CAN",   /*src_slotid_fr*/0,   /*src_basecycle_fr*/0,  /*src_repetition_fr*/0,  /*src_startbit*/41,   /*sig_length*/1,  /*des_slotid_fr*/0,   /*des_basecycle_fr*/0,  /*des_repetition_fr*/0,   /*des_startbit*/21,    /*src_cyc*/101,  /*src_id*/0x225,   /*src_dlc*/8,   /*des_cyc*/40,   /*des_id*/0x13c, /*src_updatebit*/40,   /*des_updatebit*/20,      /*initvalue*/1         },
           {   /*sig_name*/"isBltLockStAtRowThrdMidBltLockSt1_0",   /*src_can*/"ZCUD_CAN1",   /*src_network_type*/"CAN",   /*src_slotid_fr*/0,   /*src_basecycle_fr*/0,  /*src_repetition_fr*/0,  /*src_startbit*/42,   /*sig_length*/1,  /*des_slotid_fr*/0,   /*des_basecycle_fr*/0,  /*des_repetition_fr*/0,   /*des_startbit*/22,    /*src_cyc*/101,  /*src_id*/0x225,   /*src_dlc*/8,   /*des_cyc*/40,   /*des_id*/0x13c, /*src_updatebit*/40,   /*des_updatebit*/20,      /*initvalue*/0         },
           {   /*sig_name*/"isADataRawSafeALgt_0",   /*src_can*/"ZCUD_CAN1",   /*src_network_type*/"CAN",   /*src_slotid_fr*/0,   /*src_basecycle_fr*/0,  /*src_repetition_fr*/0,  /*src_startbit*/38,   /*sig_length*/15,  /*des_slotid_fr*/0,   /*des_basecycle_fr*/0,  /*des_repetition_fr*/0,   /*des_startbit*/8,    /*src_cyc*/101,  /*src_id*/0x12,   /*src_dlc*/8,   /*des_cyc*/10,   /*des_id*/0x4f, /*src_updatebit*/56,   /*des_updatebit*/56,      /*initvalue*/0         },
           {   /*sig_name*/"isADataRawSafeALgt1Qf_0",   /*src_can*/"ZCUD_CAN1",   /*src_network_type*/"CAN",   /*src_slotid_fr*/0,   /*src_basecycle_fr*/0,  /*src_repetition_fr*/0,  /*src_startbit*/9,   /*sig_length*/2,  /*des_slotid_fr*/0,   /*des_basecycle_fr*/0,  /*des_repetition_fr*/0,   /*des_startbit*/60,    /*src_cyc*/101,  /*src_id*/0x12,   /*src_dlc*/8,   /*des_cyc*/10,   /*des_id*/0x4f, /*src_updatebit*/56,   /*des_updatebit*/56,      /*initvalue*/1         },
           {   /*sig_name*/"isADataRawSafeALat_0",   /*src_can*/"ZCUD_CAN1",   /*src_network_type*/"CAN",   /*src_slotid_fr*/0,   /*src_basecycle_fr*/0,  /*src_repetition_fr*/0,  /*src_startbit*/23,   /*sig_length*/15,  /*des_slotid_fr*/0,   /*des_basecycle_fr*/0,  /*des_repetition_fr*/0,   /*des_startbit*/7,    /*src_cyc*/101,  /*src_id*/0x12,   /*src_dlc*/8,   /*des_cyc*/10,   /*des_id*/0x4f, /*src_updatebit*/56,   /*des_updatebit*/56,      /*initvalue*/0         },
           {   /*sig_name*/"isADataRawSafeAVert_0",   /*src_can*/"ZCUD_CAN1",   /*src_network_type*/"CAN",   /*src_slotid_fr*/0,   /*src_basecycle_fr*/0,  /*src_repetition_fr*/0,  /*src_startbit*/55,   /*sig_length*/15,  /*des_slotid_fr*/0,   /*des_basecycle_fr*/0,  /*des_repetition_fr*/0,   /*des_startbit*/25,    /*src_cyc*/101,  /*src_id*/0x12,   /*src_dlc*/8,   /*des_cyc*/10,   /*des_id*/0x4f, /*src_updatebit*/56,   /*des_updatebit*/56,      /*initvalue*/1155         },
           {   /*sig_name*/"isADataRawSafeALat1Qf_0",   /*src_can*/"ZCUD_CAN1",   /*src_network_type*/"CAN",   /*src_slotid_fr*/0,   /*src_basecycle_fr*/0,  /*src_repetition_fr*/0,  /*src_startbit*/11,   /*sig_length*/2,  /*des_slotid_fr*/0,   /*des_basecycle_fr*/0,  /*des_repetition_fr*/0,   /*des_startbit*/62,    /*src_cyc*/101,  /*src_id*/0x12,   /*src_dlc*/8,   /*des_cyc*/10,   /*des_id*/0x4f, /*src_updatebit*/56,   /*des_updatebit*/56,      /*initvalue*/1         },
           {   /*sig_name*/"isADataRawSafeChks_0",   /*src_can*/"ZCUD_CAN1",   /*src_network_type*/"CAN",   /*src_slotid_fr*/0,   /*src_basecycle_fr*/0,  /*src_repetition_fr*/0,  /*src_startbit*/7,   /*sig_length*/8,  /*des_slotid_fr*/0,   /*des_basecycle_fr*/0,  /*des_repetition_fr*/0,   /*des_startbit*/42,    /*src_cyc*/101,  /*src_id*/0x12,   /*src_dlc*/8,   /*des_cyc*/10,   /*des_id*/0x4f, /*src_updatebit*/56,   /*des_updatebit*/56,      /*initvalue*/255         },
           {   /*sig_name*/"isADataRawSafeAVertQf_0",   /*src_can*/"ZCUD_CAN1",   /*src_network_type*/"CAN",   /*src_slotid_fr*/0,   /*src_basecycle_fr*/0,  /*src_repetition_fr*/0,  /*src_startbit*/24,   /*sig_length*/2,  /*des_slotid_fr*/0,   /*des_basecycle_fr*/0,  /*des_repetition_fr*/0,   /*des_startbit*/58,    /*src_cyc*/101,  /*src_id*/0x12,   /*src_dlc*/8,   /*des_cyc*/10,   /*des_id*/0x4f, /*src_updatebit*/56,   /*des_updatebit*/56,      /*initvalue*/1         },
           {   /*sig_name*/"isADataRawSafeCntr_0",   /*src_can*/"ZCUD_CAN1",   /*src_network_type*/"CAN",   /*src_slotid_fr*/0,   /*src_basecycle_fr*/0,  /*src_repetition_fr*/0,  /*src_startbit*/15,   /*sig_length*/4,  /*des_slotid_fr*/0,   /*des_basecycle_fr*/0,  /*des_repetition_fr*/0,   /*des_startbit*/50,    /*src_cyc*/101,  /*src_id*/0x12,   /*src_dlc*/8,   /*des_cyc*/10,   /*des_id*/0x4f, /*src_updatebit*/56,   /*des_updatebit*/56,      /*initvalue*/0         },
           {   /*sig_name*/"isBattURaw_0",   /*src_can*/"CEM_LIN6",   /*src_network_type*/"LIN",   /*src_slotid_fr*/0,   /*src_basecycle_fr*/0,  /*src_repetition_fr*/0,  /*src_startbit*/15,   /*sig_length*/9,  /*des_slotid_fr*/0,   /*des_basecycle_fr*/0,  /*des_repetition_fr*/0,   /*des_startbit*/440,    /*src_cyc*/101,  /*src_id*/6,   /*src_dlc*/7,   /*des_cyc*/450,   /*des_id*/0x35c, /*src_updatebit*/1000,   /*des_updatebit*/441,      /*initvalue*/0         },
           {   /*sig_name*/"isBltLockStAtDrvrBltLockSt1_0",   /*src_can*/"ZCUD_CAN1",   /*src_network_type*/"CAN",   /*src_slotid_fr*/0,   /*src_basecycle_fr*/0,  /*src_repetition_fr*/0,  /*src_startbit*/57,   /*sig_length*/1,  /*des_slotid_fr*/0,   /*des_basecycle_fr*/0,  /*des_repetition_fr*/0,   /*des_startbit*/31,    /*src_cyc*/101,  /*src_id*/0x89,   /*src_dlc*/8,   /*des_cyc*/40,   /*des_id*/0x13c, /*src_updatebit*/7,   /*des_updatebit*/29,      /*initvalue*/1         },
           {   /*sig_name*/"isBltLockStAtDrvrBltLockSts_0",   /*src_can*/"ZCUD_CAN1",   /*src_network_type*/"CAN",   /*src_slotid_fr*/0,   /*src_basecycle_fr*/0,  /*src_repetition_fr*/0,  /*src_startbit*/56,   /*sig_length*/1,  /*des_slotid_fr*/0,   /*des_basecycle_fr*/0,  /*des_repetition_fr*/0,   /*des_startbit*/30,    /*src_cyc*/101,  /*src_id*/0x89,   /*src_dlc*/8,   /*des_cyc*/40,   /*des_id*/0x13c, /*src_updatebit*/7,   /*des_updatebit*/29,      /*initvalue*/0         },
           {   /*sig_name*/"isBattIShrtAvb_0",   /*src_can*/"CEM_LIN6",   /*src_network_type*/"LIN",   /*src_slotid_fr*/0,   /*src_basecycle_fr*/0,  /*src_repetition_fr*/0,  /*src_startbit*/16,   /*sig_length*/16,  /*des_slotid_fr*/0,   /*des_basecycle_fr*/0,  /*des_repetition_fr*/0,   /*des_startbit*/31,    /*src_cyc*/101,  /*src_id*/32,   /*src_dlc*/7,   /*des_cyc*/20,   /*des_id*/0xdf, /*src_updatebit*/1000,   /*des_updatebit*/22,      /*initvalue*/32768         },
           {   /*sig_name*/"isBrkPedlSts_0",   /*src_can*/"ZCUD_CAN1",   /*src_network_type*/"CAN",   /*src_slotid_fr*/0,   /*src_basecycle_fr*/0,  /*src_repetition_fr*/0,  /*src_startbit*/31,   /*sig_length*/1,  /*des_slotid_fr*/0,   /*des_basecycle_fr*/0,  /*des_repetition_fr*/0,   /*des_startbit*/320,    /*src_cyc*/101,  /*src_id*/0x21,   /*src_dlc*/8,   /*des_cyc*/450,   /*des_id*/0x35c, /*src_updatebit*/15,   /*des_updatebit*/464,      /*initvalue*/0         },
           {   /*sig_name*/"isBltLockStSafeAtDrvrBltLockStErrSts_0",   /*src_can*/"ZCUD_CAN1",   /*src_network_type*/"CAN",   /*src_slotid_fr*/0,   /*src_basecycle_fr*/0,  /*src_repetition_fr*/0,  /*src_startbit*/12,   /*sig_length*/1,  /*des_slotid_fr*/0,   /*des_basecycle_fr*/0,  /*des_repetition_fr*/0,   /*des_startbit*/466,    /*src_cyc*/101,  /*src_id*/0x21,   /*src_dlc*/8,   /*des_cyc*/450,   /*des_id*/0x35c, /*src_updatebit*/14,   /*des_updatebit*/465,      /*initvalue*/0         },
           {   /*sig_name*/"isBltLockStSafeAtDrvrCntr_0",   /*src_can*/"ZCUD_CAN1",   /*src_network_type*/"CAN",   /*src_slotid_fr*/0,   /*src_basecycle_fr*/0,  /*src_repetition_fr*/0,  /*src_startbit*/11,   /*sig_length*/4,  /*des_slotid_fr*/0,   /*des_basecycle_fr*/0,  /*des_repetition_fr*/0,   /*des_startbit*/471,    /*src_cyc*/101,  /*src_id*/0x21,   /*src_dlc*/8,   /*des_cyc*/450,   /*des_id*/0x35c, /*src_updatebit*/14,   /*des_updatebit*/465,      /*initvalue*/0         },
           {   /*sig_name*/"isBltLockStSafeAtDrvrChks_0",   /*src_can*/"ZCUD_CAN1",   /*src_network_type*/"CAN",   /*src_slotid_fr*/0,   /*src_basecycle_fr*/0,  /*src_repetition_fr*/0,  /*src_startbit*/23,   /*sig_length*/8,  /*des_slotid_fr*/0,   /*des_basecycle_fr*/0,  /*des_repetition_fr*/0,   /*des_startbit*/463,    /*src_cyc*/101,  /*src_id*/0x21,   /*src_dlc*/8,   /*des_cyc*/450,   /*des_id*/0x35c, /*src_updatebit*/14,   /*des_updatebit*/465,      /*initvalue*/255         },
           {   /*sig_name*/"isBltLockStSafeAtDrvrBltLockSt1_0",   /*src_can*/"ZCUD_CAN1",   /*src_network_type*/"CAN",   /*src_slotid_fr*/0,   /*src_basecycle_fr*/0,  /*src_repetition_fr*/0,  /*src_startbit*/13,   /*sig_length*/1,  /*des_slotid_fr*/0,   /*des_basecycle_fr*/0,  /*des_repetition_fr*/0,   /*des_startbit*/467,    /*src_cyc*/101,  /*src_id*/0x21,   /*src_dlc*/8,   /*des_cyc*/450,   /*des_id*/0x35c, /*src_updatebit*/14,   /*des_updatebit*/465,      /*initvalue*/1         },
           {   /*sig_name*/"isRainfallAmnt_0",   /*src_can*/"CEM_LIN1",   /*src_network_type*/"LIN",   /*src_slotid_fr*/0,   /*src_basecycle_fr*/0,  /*src_repetition_fr*/0,  /*src_startbit*/8,   /*sig_length*/4,  /*des_slotid_fr*/0,   /*des_basecycle_fr*/0,  /*des_repetition_fr*/0,   /*des_startbit*/324,    /*src_cyc*/101,  /*src_id*/2,   /*src_dlc*/8,   /*des_cyc*/10,   /*des_id*/0x4f, /*src_updatebit*/1000,   /*des_updatebit*/320,      /*initvalue*/14         },
           {   /*sig_name*/"isTrlrPrsnt_0",   /*src_can*/"ZCUD_CAN1",   /*src_network_type*/"CAN",   /*src_slotid_fr*/0,   /*src_basecycle_fr*/0,  /*src_repetition_fr*/0,  /*src_startbit*/13,   /*sig_length*/1,  /*des_slotid_fr*/0,   /*des_basecycle_fr*/0,  /*des_repetition_fr*/0,   /*des_startbit*/354,    /*src_cyc*/101,  /*src_id*/0xd0,   /*src_dlc*/4,   /*des_cyc*/10,   /*des_id*/0x4f, /*src_updatebit*/20,   /*des_updatebit*/353,      /*initvalue*/0         },
           {   /*sig_name*/"isGearShiftUnitSts_0",   /*src_can*/"PropulsionCAN",   /*src_network_type*/"CAN",   /*src_slotid_fr*/0,   /*src_basecycle_fr*/0,  /*src_repetition_fr*/0,  /*src_startbit*/26,   /*sig_length*/3,  /*des_slotid_fr*/0,   /*des_basecycle_fr*/0,  /*des_repetition_fr*/0,   /*des_startbit*/5,    /*src_cyc*/101,  /*src_id*/0x135,   /*src_dlc*/8,   /*des_cyc*/200,   /*des_id*/0x2a4, /*src_updatebit*/27,   /*des_updatebit*/2,      /*initvalue*/0         },
           {   /*sig_name*/"isBltLockStAtRowSecLeBltLockEquid_0",   /*src_can*/"ZCUD_CAN1",   /*src_network_type*/"CAN",   /*src_slotid_fr*/0,   /*src_basecycle_fr*/0,  /*src_repetition_fr*/0,  /*src_startbit*/7,   /*sig_length*/1,  /*des_slotid_fr*/0,   /*des_basecycle_fr*/0,  /*des_repetition_fr*/0,   /*des_startbit*/7,    /*src_cyc*/101,  /*src_id*/0x70,   /*src_dlc*/8,   /*des_cyc*/40,   /*des_id*/0x13c, /*src_updatebit*/4,   /*des_updatebit*/4,      /*initvalue*/1         },
           {   /*sig_name*/"isBltLockStAtRowSecLeBltLockSts_0",   /*src_can*/"ZCUD_CAN1",   /*src_network_type*/"CAN",   /*src_slotid_fr*/0,   /*src_basecycle_fr*/0,  /*src_repetition_fr*/0,  /*src_startbit*/5,   /*sig_length*/1,  /*des_slotid_fr*/0,   /*des_basecycle_fr*/0,  /*des_repetition_fr*/0,   /*des_startbit*/5,    /*src_cyc*/101,  /*src_id*/0x70,   /*src_dlc*/8,   /*des_cyc*/40,   /*des_id*/0x13c, /*src_updatebit*/4,   /*des_updatebit*/4,      /*initvalue*/1         },
           {   /*sig_name*/"isBltLockStAtRowSecLeBltLockSt1_0",   /*src_can*/"ZCUD_CAN1",   /*src_network_type*/"CAN",   /*src_slotid_fr*/0,   /*src_basecycle_fr*/0,  /*src_repetition_fr*/0,  /*src_startbit*/6,   /*sig_length*/1,  /*des_slotid_fr*/0,   /*des_basecycle_fr*/0,  /*des_repetition_fr*/0,   /*des_startbit*/6,    /*src_cyc*/101,  /*src_id*/0x70,   /*src_dlc*/8,   /*des_cyc*/40,   /*des_id*/0x13c, /*src_updatebit*/4,   /*des_updatebit*/4,      /*initvalue*/0         },
           {   /*sig_name*/"isSteerWhlTqAddl_0",   /*src_can*/"ChassisCAN1",   /*src_network_type*/"CAN",   /*src_slotid_fr*/0,   /*src_basecycle_fr*/0,  /*src_repetition_fr*/0,  /*src_startbit*/39,   /*sig_length*/14,  /*des_slotid_fr*/0,   /*des_basecycle_fr*/0,  /*des_repetition_fr*/0,   /*des_startbit*/135,    /*src_cyc*/101,  /*src_id*/0x46,   /*src_dlc*/8,   /*des_cyc*/450,   /*des_id*/0x335, /*src_updatebit*/41,   /*des_updatebit*/137,      /*initvalue*/0         },
           {   /*sig_name*/"isAgDataRaw2SafeCntr_0",   /*src_can*/"ZCUD_CAN1",   /*src_network_type*/"CAN",   /*src_slotid_fr*/0,   /*src_basecycle_fr*/0,  /*src_repetition_fr*/0,  /*src_startbit*/3,   /*sig_length*/4,  /*des_slotid_fr*/0,   /*des_basecycle_fr*/0,  /*des_repetition_fr*/0,   /*des_startbit*/95,    /*src_cyc*/101,  /*src_id*/0x142,   /*src_dlc*/8,   /*des_cyc*/10,   /*des_id*/0x4f, /*src_updatebit*/6,   /*des_updatebit*/89,      /*initvalue*/0         },
           {   /*sig_name*/"isAgDataRaw2SafeChks_0",   /*src_can*/"ZCUD_CAN1",   /*src_network_type*/"CAN",   /*src_slotid_fr*/0,   /*src_basecycle_fr*/0,  /*src_repetition_fr*/0,  /*src_startbit*/15,   /*sig_length*/8,  /*des_slotid_fr*/0,   /*des_basecycle_fr*/0,  /*des_repetition_fr*/0,   /*des_startbit*/87,    /*src_cyc*/101,  /*src_id*/0x142,   /*src_dlc*/8,   /*des_cyc*/10,   /*des_id*/0x4f, /*src_updatebit*/6,   /*des_updatebit*/89,      /*initvalue*/255         },
           {   /*sig_name*/"isAgDataRaw2SafePitchRate_0",   /*src_can*/"ZCUD_CAN1",   /*src_network_type*/"CAN",   /*src_slotid_fr*/0,   /*src_basecycle_fr*/0,  /*src_repetition_fr*/0,  /*src_startbit*/23,   /*sig_length*/16,  /*des_slotid_fr*/0,   /*des_basecycle_fr*/0,  /*des_repetition_fr*/0,   /*des_startbit*/71,    /*src_cyc*/101,  /*src_id*/0x142,   /*src_dlc*/8,   /*des_cyc*/10,   /*des_id*/0x4f, /*src_updatebit*/6,   /*des_updatebit*/89,      /*initvalue*/0         },
           {   /*sig_name*/"isAgDataRaw2SafePitchRateQf_0",   /*src_can*/"ZCUD_CAN1",   /*src_network_type*/"CAN",   /*src_slotid_fr*/0,   /*src_basecycle_fr*/0,  /*src_repetition_fr*/0,  /*src_startbit*/5,   /*sig_length*/2,  /*des_slotid_fr*/0,   /*des_basecycle_fr*/0,  /*des_repetition_fr*/0,   /*des_startbit*/91,    /*src_cyc*/101,  /*src_id*/0x142,   /*src_dlc*/8,   /*des_cyc*/10,   /*des_id*/0x4f, /*src_updatebit*/6,   /*des_updatebit*/89,      /*initvalue*/1         },
           {   /*sig_name*/"isAgDataRawSafeYawRate_0",   /*src_can*/"ZCUD_CAN1",   /*src_network_type*/"CAN",   /*src_slotid_fr*/0,   /*src_basecycle_fr*/0,  /*src_repetition_fr*/0,  /*src_startbit*/31,   /*sig_length*/16,  /*des_slotid_fr*/0,   /*des_basecycle_fr*/0,  /*des_repetition_fr*/0,   /*des_startbit*/119,    /*src_cyc*/101,  /*src_id*/0x89,   /*src_dlc*/8,   /*des_cyc*/10,   /*des_id*/0x4f, /*src_updatebit*/5,   /*des_updatebit*/88,      /*initvalue*/0         },
           {   /*sig_name*/"isAgDataRawSafeRollRateQf_0",   /*src_can*/"ZCUD_CAN1",   /*src_network_type*/"CAN",   /*src_slotid_fr*/0,   /*src_basecycle_fr*/0,  /*src_repetition_fr*/0,  /*src_startbit*/51,   /*sig_length*/2,  /*des_slotid_fr*/0,   /*des_basecycle_fr*/0,  /*des_repetition_fr*/0,   /*des_startbit*/139,    /*src_cyc*/101,  /*src_id*/0x89,   /*src_dlc*/8,   /*des_cyc*/10,   /*des_id*/0x4f, /*src_updatebit*/5,   /*des_updatebit*/88,      /*initvalue*/1         },
           {   /*sig_name*/"isAgDataRawSafeCntr_0",   /*src_can*/"ZCUD_CAN1",   /*src_network_type*/"CAN",   /*src_slotid_fr*/0,   /*src_basecycle_fr*/0,  /*src_repetition_fr*/0,  /*src_startbit*/55,   /*sig_length*/4,  /*des_slotid_fr*/0,   /*des_basecycle_fr*/0,  /*des_repetition_fr*/0,   /*des_startbit*/143,    /*src_cyc*/101,  /*src_id*/0x89,   /*src_dlc*/8,   /*des_cyc*/10,   /*des_id*/0x4f, /*src_updatebit*/5,   /*des_updatebit*/88,      /*initvalue*/0         },
           {   /*sig_name*/"isAgDataRawSafeChks_0",   /*src_can*/"ZCUD_CAN1",   /*src_network_type*/"CAN",   /*src_slotid_fr*/0,   /*src_basecycle_fr*/0,  /*src_repetition_fr*/0,  /*src_startbit*/47,   /*sig_length*/8,  /*des_slotid_fr*/0,   /*des_basecycle_fr*/0,  /*des_repetition_fr*/0,   /*des_startbit*/135,    /*src_cyc*/101,  /*src_id*/0x89,   /*src_dlc*/8,   /*des_cyc*/10,   /*des_id*/0x4f, /*src_updatebit*/5,   /*des_updatebit*/88,      /*initvalue*/255         },
           {   /*sig_name*/"isAgDataRawSafeYawRateQf_0",   /*src_can*/"ZCUD_CAN1",   /*src_network_type*/"CAN",   /*src_slotid_fr*/0,   /*src_basecycle_fr*/0,  /*src_repetition_fr*/0,  /*src_startbit*/49,   /*sig_length*/2,  /*des_slotid_fr*/0,   /*des_basecycle_fr*/0,  /*des_repetition_fr*/0,   /*des_startbit*/137,    /*src_cyc*/101,  /*src_id*/0x89,   /*src_dlc*/8,   /*des_cyc*/10,   /*des_id*/0x4f, /*src_updatebit*/5,   /*des_updatebit*/88,      /*initvalue*/1         },
           {   /*sig_name*/"isAgDataRawSafeRollRate_0",   /*src_can*/"ZCUD_CAN1",   /*src_network_type*/"CAN",   /*src_slotid_fr*/0,   /*src_basecycle_fr*/0,  /*src_repetition_fr*/0,  /*src_startbit*/15,   /*sig_length*/16,  /*des_slotid_fr*/0,   /*des_basecycle_fr*/0,  /*des_repetition_fr*/0,   /*des_startbit*/103,    /*src_cyc*/101,  /*src_id*/0x89,   /*src_dlc*/8,   /*des_cyc*/10,   /*des_id*/0x4f, /*src_updatebit*/5,   /*des_updatebit*/88,      /*initvalue*/0         },
           {   /*sig_name*/"isBltLockStAtPassBltLockSt1_0",   /*src_can*/"ZCUD_CAN1",   /*src_network_type*/"CAN",   /*src_slotid_fr*/0,   /*src_basecycle_fr*/0,  /*src_repetition_fr*/0,  /*src_startbit*/63,   /*sig_length*/1,  /*des_slotid_fr*/0,   /*des_basecycle_fr*/0,  /*des_repetition_fr*/0,   /*des_startbit*/28,    /*src_cyc*/101,  /*src_id*/0x89,   /*src_dlc*/8,   /*des_cyc*/40,   /*des_id*/0x13c, /*src_updatebit*/6,   /*des_updatebit*/26,      /*initvalue*/1         },
           {   /*sig_name*/"isBltLockStAtPassBltLockSts_0",   /*src_can*/"ZCUD_CAN1",   /*src_network_type*/"CAN",   /*src_slotid_fr*/0,   /*src_basecycle_fr*/0,  /*src_repetition_fr*/0,  /*src_startbit*/62,   /*sig_length*/1,  /*des_slotid_fr*/0,   /*des_basecycle_fr*/0,  /*des_repetition_fr*/0,   /*des_startbit*/27,    /*src_cyc*/101,  /*src_id*/0x89,   /*src_dlc*/8,   /*des_cyc*/40,   /*des_id*/0x13c, /*src_updatebit*/6,   /*des_updatebit*/26,      /*initvalue*/0         },
           {   /*sig_name*/"isPinionSteerAgGroupPinionSteerAg1Qf_0",   /*src_can*/"ChassisCAN1",   /*src_network_type*/"CAN",   /*src_slotid_fr*/0,   /*src_basecycle_fr*/0,  /*src_repetition_fr*/0,  /*src_startbit*/15,   /*sig_length*/2,  /*des_slotid_fr*/0,   /*des_basecycle_fr*/0,  /*des_repetition_fr*/0,   /*des_startbit*/31,    /*src_cyc*/101,  /*src_id*/0x4e,   /*src_dlc*/8,   /*des_cyc*/450,   /*des_id*/0x335, /*src_updatebit*/57,   /*des_updatebit*/7,      /*initvalue*/1         },
           {   /*sig_name*/"isPinionSteerAgGroupCntr_0",   /*src_can*/"ChassisCAN1",   /*src_network_type*/"CAN",   /*src_slotid_fr*/0,   /*src_basecycle_fr*/0,  /*src_repetition_fr*/0,  /*src_startbit*/63,   /*sig_length*/4,  /*des_slotid_fr*/0,   /*des_basecycle_fr*/0,  /*des_repetition_fr*/0,   /*des_startbit*/63,    /*src_cyc*/101,  /*src_id*/0x4e,   /*src_dlc*/8,   /*des_cyc*/450,   /*des_id*/0x335, /*src_updatebit*/57,   /*des_updatebit*/7,      /*initvalue*/0         },
           {   /*sig_name*/"isPinionSteerAgGroupSteerWhlTq_0",   /*src_can*/"ChassisCAN1",   /*src_network_type*/"CAN",   /*src_slotid_fr*/0,   /*src_basecycle_fr*/0,  /*src_repetition_fr*/0,  /*src_startbit*/29,   /*sig_length*/14,  /*des_slotid_fr*/0,   /*des_basecycle_fr*/0,  /*des_repetition_fr*/0,   /*des_startbit*/45,    /*src_cyc*/101,  /*src_id*/0x4e,   /*src_dlc*/8,   /*des_cyc*/450,   /*des_id*/0x335, /*src_updatebit*/57,   /*des_updatebit*/7,      /*initvalue*/0         },
           {   /*sig_name*/"isPinionSteerAgGroupPinionSteerAg1_0",   /*src_can*/"ChassisCAN1",   /*src_network_type*/"CAN",   /*src_slotid_fr*/0,   /*src_basecycle_fr*/0,  /*src_repetition_fr*/0,  /*src_startbit*/46,   /*sig_length*/15,  /*des_slotid_fr*/0,   /*des_basecycle_fr*/0,  /*des_repetition_fr*/0,   /*des_startbit*/6,    /*src_cyc*/101,  /*src_id*/0x4e,   /*src_dlc*/8,   /*des_cyc*/450,   /*des_id*/0x335, /*src_updatebit*/57,   /*des_updatebit*/7,      /*initvalue*/0         },
           {   /*sig_name*/"isPinionSteerAgGroupPinionSteerAgSpd1_0",   /*src_can*/"ChassisCAN1",   /*src_network_type*/"CAN",   /*src_slotid_fr*/0,   /*src_basecycle_fr*/0,  /*src_repetition_fr*/0,  /*src_startbit*/13,   /*sig_length*/14,  /*des_slotid_fr*/0,   /*des_basecycle_fr*/0,  /*des_repetition_fr*/0,   /*des_startbit*/29,    /*src_cyc*/101,  /*src_id*/0x4e,   /*src_dlc*/8,   /*des_cyc*/450,   /*des_id*/0x335, /*src_updatebit*/57,   /*des_updatebit*/7,      /*initvalue*/0         },
           {   /*sig_name*/"isPinionSteerAgGroupSteerWhlTqQf_0",   /*src_can*/"ChassisCAN1",   /*src_network_type*/"CAN",   /*src_slotid_fr*/0,   /*src_basecycle_fr*/0,  /*src_repetition_fr*/0,  /*src_startbit*/59,   /*sig_length*/2,  /*des_slotid_fr*/0,   /*des_basecycle_fr*/0,  /*des_repetition_fr*/0,   /*des_startbit*/59,    /*src_cyc*/101,  /*src_id*/0x4e,   /*src_dlc*/8,   /*des_cyc*/450,   /*des_id*/0x335, /*src_updatebit*/57,   /*des_updatebit*/7,      /*initvalue*/1         },
           {   /*sig_name*/"isPinionSteerAgGroupPinionSteerAgSpd1Qf_0",   /*src_can*/"ChassisCAN1",   /*src_network_type*/"CAN",   /*src_slotid_fr*/0,   /*src_basecycle_fr*/0,  /*src_repetition_fr*/0,  /*src_startbit*/31,   /*sig_length*/2,  /*des_slotid_fr*/0,   /*des_basecycle_fr*/0,  /*des_repetition_fr*/0,   /*des_startbit*/47,    /*src_cyc*/101,  /*src_id*/0x4e,   /*src_dlc*/8,   /*des_cyc*/450,   /*des_id*/0x335, /*src_updatebit*/57,   /*des_updatebit*/7,      /*initvalue*/1         },
           {   /*sig_name*/"isPinionSteerAgGroupChks_0",   /*src_can*/"ChassisCAN1",   /*src_network_type*/"CAN",   /*src_slotid_fr*/0,   /*src_basecycle_fr*/0,  /*src_repetition_fr*/0,  /*src_startbit*/7,   /*sig_length*/8,  /*des_slotid_fr*/0,   /*des_basecycle_fr*/0,  /*des_repetition_fr*/0,   /*des_startbit*/23,    /*src_cyc*/101,  /*src_id*/0x4e,   /*src_dlc*/8,   /*des_cyc*/450,   /*des_id*/0x335, /*src_updatebit*/57,   /*des_updatebit*/7,      /*initvalue*/0         },
           {   /*sig_name*/"isBltLockStAtRowThrdRiBltLockSts_0",   /*src_can*/"ZCUD_CAN1",   /*src_network_type*/"CAN",   /*src_slotid_fr*/0,   /*src_basecycle_fr*/0,  /*src_repetition_fr*/0,  /*src_startbit*/21,   /*sig_length*/1,  /*des_slotid_fr*/0,   /*des_basecycle_fr*/0,  /*des_repetition_fr*/0,   /*des_startbit*/17,    /*src_cyc*/101,  /*src_id*/0x70,   /*src_dlc*/8,   /*des_cyc*/40,   /*des_id*/0x13c, /*src_updatebit*/20,   /*des_updatebit*/16,      /*initvalue*/1         },
           {   /*sig_name*/"isBltLockStAtRowThrdRiBltLockEquid_0",   /*src_can*/"ZCUD_CAN1",   /*src_network_type*/"CAN",   /*src_slotid_fr*/0,   /*src_basecycle_fr*/0,  /*src_repetition_fr*/0,  /*src_startbit*/23,   /*sig_length*/1,  /*des_slotid_fr*/0,   /*des_basecycle_fr*/0,  /*des_repetition_fr*/0,   /*des_startbit*/19,    /*src_cyc*/101,  /*src_id*/0x70,   /*src_dlc*/8,   /*des_cyc*/40,   /*des_id*/0x13c, /*src_updatebit*/20,   /*des_updatebit*/16,      /*initvalue*/1         },
           {   /*sig_name*/"isBltLockStAtRowThrdRiBltLockSt1_0",   /*src_can*/"ZCUD_CAN1",   /*src_network_type*/"CAN",   /*src_slotid_fr*/0,   /*src_basecycle_fr*/0,  /*src_repetition_fr*/0,  /*src_startbit*/22,   /*sig_length*/1,  /*des_slotid_fr*/0,   /*des_basecycle_fr*/0,  /*des_repetition_fr*/0,   /*des_startbit*/18,    /*src_cyc*/101,  /*src_id*/0x70,   /*src_dlc*/8,   /*des_cyc*/40,   /*des_id*/0x13c, /*src_updatebit*/20,   /*des_updatebit*/16,      /*initvalue*/0         },
           {   /*sig_name*/"isIntgtIMUDataRawSafeAvert_0",   /*src_can*/"ZCUD_CANFD3",   /*src_network_type*/"CANFD",   /*src_slotid_fr*/0,   /*src_basecycle_fr*/0,  /*src_repetition_fr*/0,  /*src_startbit*/257,   /*sig_length*/15,  /*des_slotid_fr*/0,   /*des_basecycle_fr*/0,  /*des_repetition_fr*/0,   /*des_startbit*/398,    /*src_cyc*/101,  /*src_id*/0x32,   /*src_dlc*/64,   /*des_cyc*/450,   /*des_id*/0x35c, /*src_updatebit*/298,   /*des_updatebit*/335,      /*initvalue*/1155         },
           {   /*sig_name*/"isIntgtIMUDataRawSafeAVertQf_0",   /*src_can*/"ZCUD_CANFD3",   /*src_network_type*/"CANFD",   /*src_slotid_fr*/0,   /*src_basecycle_fr*/0,  /*src_repetition_fr*/0,  /*src_startbit*/290,   /*sig_length*/2,  /*des_slotid_fr*/0,   /*des_basecycle_fr*/0,  /*des_repetition_fr*/0,   /*des_startbit*/447,    /*src_cyc*/101,  /*src_id*/0x32,   /*src_dlc*/64,   /*des_cyc*/450,   /*des_id*/0x35c, /*src_updatebit*/298,   /*des_updatebit*/335,      /*initvalue*/1         },
           {   /*sig_name*/"isIntgtIMUDataRawSafeALat1Qf_0",   /*src_can*/"ZCUD_CANFD3",   /*src_network_type*/"CANFD",   /*src_slotid_fr*/0,   /*src_basecycle_fr*/0,  /*src_repetition_fr*/0,  /*src_startbit*/294,   /*sig_length*/2,  /*des_slotid_fr*/0,   /*des_basecycle_fr*/0,  /*des_repetition_fr*/0,   /*des_startbit*/439,    /*src_cyc*/101,  /*src_id*/0x32,   /*src_dlc*/64,   /*des_cyc*/450,   /*des_id*/0x35c, /*src_updatebit*/298,   /*des_updatebit*/335,      /*initvalue*/1         },
           {   /*sig_name*/"isIntgtIMUDataRawSafeALgt_0",   /*src_can*/"ZCUD_CANFD3",   /*src_network_type*/"CANFD",   /*src_slotid_fr*/0,   /*src_basecycle_fr*/0,  /*src_repetition_fr*/0,  /*src_startbit*/240,   /*sig_length*/15,  /*des_slotid_fr*/0,   /*des_basecycle_fr*/0,  /*des_repetition_fr*/0,   /*des_startbit*/334,    /*src_cyc*/101,  /*src_id*/0x32,   /*src_dlc*/64,   /*des_cyc*/450,   /*des_id*/0x35c, /*src_updatebit*/298,   /*des_updatebit*/335,      /*initvalue*/0         },
           {   /*sig_name*/"isIntgtIMUDataRawSafePitchRate_0",   /*src_can*/"ZCUD_CANFD3",   /*src_network_type*/"CANFD",   /*src_slotid_fr*/0,   /*src_basecycle_fr*/0,  /*src_repetition_fr*/0,  /*src_startbit*/191,   /*sig_length*/16,  /*des_slotid_fr*/0,   /*des_basecycle_fr*/0,  /*des_repetition_fr*/0,   /*des_startbit*/415,    /*src_cyc*/101,  /*src_id*/0x32,   /*src_dlc*/64,   /*des_cyc*/450,   /*des_id*/0x35c, /*src_updatebit*/298,   /*des_updatebit*/335,      /*initvalue*/0         },
           {   /*sig_name*/"isIntgtIMUDataRawSafeYawRate_0",   /*src_can*/"ZCUD_CANFD3",   /*src_network_type*/"CANFD",   /*src_slotid_fr*/0,   /*src_basecycle_fr*/0,  /*src_repetition_fr*/0,  /*src_startbit*/223,   /*sig_length*/16,  /*des_slotid_fr*/0,   /*des_basecycle_fr*/0,  /*des_repetition_fr*/0,   /*des_startbit*/367,    /*src_cyc*/101,  /*src_id*/0x32,   /*src_dlc*/64,   /*des_cyc*/450,   /*des_id*/0x35c, /*src_updatebit*/298,   /*des_updatebit*/335,      /*initvalue*/0         },
           {   /*sig_name*/"isIntgtIMUDataRawSafeRollRate_0",   /*src_can*/"ZCUD_CANFD3",   /*src_network_type*/"CANFD",   /*src_slotid_fr*/0,   /*src_basecycle_fr*/0,  /*src_repetition_fr*/0,  /*src_startbit*/207,   /*sig_length*/16,  /*des_slotid_fr*/0,   /*des_basecycle_fr*/0,  /*des_repetition_fr*/0,   /*des_startbit*/351,    /*src_cyc*/101,  /*src_id*/0x32,   /*src_dlc*/64,   /*des_cyc*/450,   /*des_id*/0x35c, /*src_updatebit*/298,   /*des_updatebit*/335,      /*initvalue*/0         },
           {   /*sig_name*/"isIntgtIMUDataRawSafeALat_0",   /*src_can*/"ZCUD_CANFD3",   /*src_network_type*/"CANFD",   /*src_slotid_fr*/0,   /*src_basecycle_fr*/0,  /*src_repetition_fr*/0,  /*src_startbit*/239,   /*sig_length*/15,  /*des_slotid_fr*/0,   /*des_basecycle_fr*/0,  /*des_repetition_fr*/0,   /*des_startbit*/383,    /*src_cyc*/101,  /*src_id*/0x32,   /*src_dlc*/64,   /*des_cyc*/450,   /*des_id*/0x35c, /*src_updatebit*/298,   /*des_updatebit*/335,      /*initvalue*/0         },
           {   /*sig_name*/"isIntgtIMUDataRawSafeChks_0",   /*src_can*/"ZCUD_CANFD3",   /*src_network_type*/"CANFD",   /*src_slotid_fr*/0,   /*src_basecycle_fr*/0,  /*src_repetition_fr*/0,  /*src_startbit*/274,   /*sig_length*/8,  /*des_slotid_fr*/0,   /*des_basecycle_fr*/0,  /*des_repetition_fr*/0,   /*des_startbit*/431,    /*src_cyc*/101,  /*src_id*/0x32,   /*src_dlc*/64,   /*des_cyc*/450,   /*des_id*/0x35c, /*src_updatebit*/298,   /*des_updatebit*/335,      /*initvalue*/255         },
           {   /*sig_name*/"isIntgtIMUDataRawSafeCntr_0",   /*src_can*/"ZCUD_CANFD3",   /*src_network_type*/"CANFD",   /*src_slotid_fr*/0,   /*src_basecycle_fr*/0,  /*src_repetition_fr*/0,  /*src_startbit*/282,   /*sig_length*/4,  /*des_slotid_fr*/0,   /*des_basecycle_fr*/0,  /*des_repetition_fr*/0,   /*des_startbit*/435,    /*src_cyc*/101,  /*src_id*/0x32,   /*src_dlc*/64,   /*des_cyc*/450,   /*des_id*/0x35c, /*src_updatebit*/298,   /*des_updatebit*/335,      /*initvalue*/0         },
           {   /*sig_name*/"isIntgtIMUDataRawSafeYawRateQf_0",   /*src_can*/"ZCUD_CANFD3",   /*src_network_type*/"CANFD",   /*src_slotid_fr*/0,   /*src_basecycle_fr*/0,  /*src_repetition_fr*/0,  /*src_startbit*/300,   /*sig_length*/2,  /*des_slotid_fr*/0,   /*des_basecycle_fr*/0,  /*des_repetition_fr*/0,   /*des_startbit*/443,    /*src_cyc*/101,  /*src_id*/0x32,   /*src_dlc*/64,   /*des_cyc*/450,   /*des_id*/0x35c, /*src_updatebit*/298,   /*des_updatebit*/335,      /*initvalue*/1         },
           {   /*sig_name*/"isIntgtIMUDataRawSafePitchRateQf_0",   /*src_can*/"ZCUD_CANFD3",   /*src_network_type*/"CANFD",   /*src_slotid_fr*/0,   /*src_basecycle_fr*/0,  /*src_repetition_fr*/0,  /*src_startbit*/288,   /*sig_length*/2,  /*des_slotid_fr*/0,   /*des_basecycle_fr*/0,  /*des_repetition_fr*/0,   /*des_startbit*/384,    /*src_cyc*/101,  /*src_id*/0x32,   /*src_dlc*/64,   /*des_cyc*/450,   /*des_id*/0x35c, /*src_updatebit*/298,   /*des_updatebit*/335,      /*initvalue*/1         },
           {   /*sig_name*/"isIntgtIMUDataRawSafeALgt1Qf_0",   /*src_can*/"ZCUD_CANFD3",   /*src_network_type*/"CANFD",   /*src_slotid_fr*/0,   /*src_basecycle_fr*/0,  /*src_repetition_fr*/0,  /*src_startbit*/292,   /*sig_length*/2,  /*des_slotid_fr*/0,   /*des_basecycle_fr*/0,  /*des_repetition_fr*/0,   /*des_startbit*/437,    /*src_cyc*/101,  /*src_id*/0x32,   /*src_dlc*/64,   /*des_cyc*/450,   /*des_id*/0x35c, /*src_updatebit*/298,   /*des_updatebit*/335,      /*initvalue*/1         },
           {   /*sig_name*/"isIntgtIMUDataRawSafeRollRateQf_0",   /*src_can*/"ZCUD_CANFD3",   /*src_network_type*/"CANFD",   /*src_slotid_fr*/0,   /*src_basecycle_fr*/0,  /*src_repetition_fr*/0,  /*src_startbit*/302,   /*sig_length*/2,  /*des_slotid_fr*/0,   /*des_basecycle_fr*/0,  /*des_repetition_fr*/0,   /*des_startbit*/445,    /*src_cyc*/101,  /*src_id*/0x32,   /*src_dlc*/64,   /*des_cyc*/450,   /*des_id*/0x35c, /*src_updatebit*/298,   /*des_updatebit*/335,      /*initvalue*/1         },
           {   /*sig_name*/"isCrashSts2_0",   /*src_can*/"ZCUD_CAN1",   /*src_network_type*/"CAN",   /*src_slotid_fr*/0,   /*src_basecycle_fr*/0,  /*src_repetition_fr*/0,  /*src_startbit*/29,   /*sig_length*/2,  /*des_slotid_fr*/0,   /*des_basecycle_fr*/0,  /*des_repetition_fr*/0,   /*des_startbit*/505,    /*src_cyc*/101,  /*src_id*/0x21,   /*src_dlc*/8,   /*des_cyc*/10,   /*des_id*/0x4f, /*src_updatebit*/30,   /*des_updatebit*/488,      /*initvalue*/0         },
           {   /*sig_name*/"isSolarSnsrRiValue_0",   /*src_can*/"CEM_LIN1",   /*src_network_type*/"LIN",   /*src_slotid_fr*/0,   /*src_basecycle_fr*/0,  /*src_repetition_fr*/0,  /*src_startbit*/24,   /*sig_length*/8,  /*des_slotid_fr*/0,   /*des_basecycle_fr*/0,  /*des_repetition_fr*/0,   /*des_startbit*/143,    /*src_cyc*/101,  /*src_id*/2,   /*src_dlc*/8,   /*des_cyc*/200,   /*des_id*/0x2a4, /*src_updatebit*/1000,   /*des_updatebit*/0,      /*initvalue*/51         },
           {   /*sig_name*/"isCrashStsSafeChks_0",   /*src_can*/"ZCUD_CAN1",   /*src_network_type*/"CAN",   /*src_slotid_fr*/0,   /*src_basecycle_fr*/0,  /*src_repetition_fr*/0,  /*src_startbit*/15,   /*sig_length*/8,  /*des_slotid_fr*/0,   /*des_basecycle_fr*/0,  /*des_repetition_fr*/0,   /*des_startbit*/215,    /*src_cyc*/101,  /*src_id*/0x10,   /*src_dlc*/4,   /*des_cyc*/10,   /*des_id*/0x59, /*src_updatebit*/5,   /*des_updatebit*/218,      /*initvalue*/255         },
           {   /*sig_name*/"isCrashStsSafeSts_0",   /*src_can*/"ZCUD_CAN1",   /*src_network_type*/"CAN",   /*src_slotid_fr*/0,   /*src_basecycle_fr*/0,  /*src_repetition_fr*/0,  /*src_startbit*/4,   /*sig_length*/1,  /*des_slotid_fr*/0,   /*des_basecycle_fr*/0,  /*des_repetition_fr*/0,   /*des_startbit*/219,    /*src_cyc*/101,  /*src_id*/0x10,   /*src_dlc*/4,   /*des_cyc*/10,   /*des_id*/0x59, /*src_updatebit*/5,   /*des_updatebit*/218,      /*initvalue*/0         },
           {   /*sig_name*/"isCrashStsSafeCntr_0",   /*src_can*/"ZCUD_CAN1",   /*src_network_type*/"CAN",   /*src_slotid_fr*/0,   /*src_basecycle_fr*/0,  /*src_repetition_fr*/0,  /*src_startbit*/3,   /*sig_length*/4,  /*des_slotid_fr*/0,   /*des_basecycle_fr*/0,  /*des_repetition_fr*/0,   /*des_startbit*/223,    /*src_cyc*/101,  /*src_id*/0x10,   /*src_dlc*/4,   /*des_cyc*/10,   /*des_id*/0x59, /*src_updatebit*/5,   /*des_updatebit*/218,      /*initvalue*/0         }
       }
   },
   {
       /*des_can*/ "ZCUD_CAN1",
       /*networktype*/ "CAN",
       99,
       {
           {   /*sig_name*/"isTrsmActrPosnSafeTrsmActrPosnChks_0",   /*src_can*/"ChassisCANFD2",   /*src_network_type*/"CANFD",   /*src_slotid_fr*/0,   /*src_basecycle_fr*/0,  /*src_repetition_fr*/0,  /*src_startbit*/119,   /*sig_length*/8,  /*des_slotid_fr*/0,   /*des_basecycle_fr*/0,  /*des_repetition_fr*/0,   /*des_startbit*/15,    /*src_cyc*/101,  /*src_id*/0x47c,   /*src_dlc*/64,   /*des_cyc*/1000,   /*des_id*/0x399, /*src_updatebit*/120,   /*des_updatebit*/7,      /*initvalue*/0         },
           {   /*sig_name*/"isTrsmActrPosnSafeTrsmActrPosnCntr_0",   /*src_can*/"ChassisCANFD2",   /*src_network_type*/"CANFD",   /*src_slotid_fr*/0,   /*src_basecycle_fr*/0,  /*src_repetition_fr*/0,  /*src_startbit*/127,   /*sig_length*/4,  /*des_slotid_fr*/0,   /*des_basecycle_fr*/0,  /*des_repetition_fr*/0,   /*des_startbit*/3,    /*src_cyc*/101,  /*src_id*/0x47c,   /*src_dlc*/64,   /*des_cyc*/1000,   /*des_id*/0x399, /*src_updatebit*/120,   /*des_updatebit*/7,      /*initvalue*/0         },
           {   /*sig_name*/"isTrsmActrPosnSafeTrsmActrPosn_0",   /*src_can*/"ChassisCANFD2",   /*src_network_type*/"CANFD",   /*src_slotid_fr*/0,   /*src_basecycle_fr*/0,  /*src_repetition_fr*/0,  /*src_startbit*/123,   /*sig_length*/3,  /*des_slotid_fr*/0,   /*des_basecycle_fr*/0,  /*des_repetition_fr*/0,   /*des_startbit*/6,    /*src_cyc*/101,  /*src_id*/0x47c,   /*src_dlc*/64,   /*des_cyc*/1000,   /*des_id*/0x399, /*src_updatebit*/120,   /*des_updatebit*/7,      /*initvalue*/7         },
           {   /*sig_name*/"isSwtIndcrIndcrTypExtReq_0",   /*src_can*/"ChassisCAN1",   /*src_network_type*/"CAN",   /*src_slotid_fr*/0,   /*src_basecycle_fr*/0,  /*src_repetition_fr*/0,  /*src_startbit*/15,   /*sig_length*/2,  /*des_slotid_fr*/0,   /*des_basecycle_fr*/0,  /*des_repetition_fr*/0,   /*des_startbit*/5,    /*src_cyc*/101,  /*src_id*/0x2e6,   /*src_dlc*/8,   /*des_cyc*/40,   /*des_id*/0x78, /*src_updatebit*/9,   /*des_updatebit*/6,      /*initvalue*/0         },
           {   /*sig_name*/"isSwtIndcrIndcrTypExtReqChks_0",   /*src_can*/"ChassisCAN1",   /*src_network_type*/"CAN",   /*src_slotid_fr*/0,   /*src_basecycle_fr*/0,  /*src_repetition_fr*/0,  /*src_startbit*/7,   /*sig_length*/8,  /*des_slotid_fr*/0,   /*des_basecycle_fr*/0,  /*des_repetition_fr*/0,   /*des_startbit*/15,    /*src_cyc*/101,  /*src_id*/0x2e6,   /*src_dlc*/8,   /*des_cyc*/40,   /*des_id*/0x78, /*src_updatebit*/9,   /*des_updatebit*/6,      /*initvalue*/0         },
           {   /*sig_name*/"isSwtIndcrIndcrTypExtReqCntr_0",   /*src_can*/"ChassisCAN1",   /*src_network_type*/"CAN",   /*src_slotid_fr*/0,   /*src_basecycle_fr*/0,  /*src_repetition_fr*/0,  /*src_startbit*/13,   /*sig_length*/2,  /*des_slotid_fr*/0,   /*des_basecycle_fr*/0,  /*des_repetition_fr*/0,   /*des_startbit*/3,    /*src_cyc*/101,  /*src_id*/0x2e6,   /*src_dlc*/8,   /*des_cyc*/40,   /*des_id*/0x78, /*src_updatebit*/9,   /*des_updatebit*/6,      /*initvalue*/0         },
           {   /*sig_name*/"isSwtIndcrIndcrTypExtReqToUpdQf_0",   /*src_can*/"ChassisCAN1",   /*src_network_type*/"CAN",   /*src_slotid_fr*/0,   /*src_basecycle_fr*/0,  /*src_repetition_fr*/0,  /*src_startbit*/11,   /*sig_length*/2,  /*des_slotid_fr*/0,   /*des_basecycle_fr*/0,  /*des_repetition_fr*/0,   /*des_startbit*/1,    /*src_cyc*/101,  /*src_id*/0x2e6,   /*src_dlc*/8,   /*des_cyc*/40,   /*des_id*/0x78, /*src_updatebit*/9,   /*des_updatebit*/6,      /*initvalue*/1         },
           {   /*sig_name*/"isCrsCtrlrMsg_0",   /*src_can*/"ChassisCANFD2",   /*src_network_type*/"CANFD",   /*src_slotid_fr*/0,   /*src_basecycle_fr*/0,  /*src_repetition_fr*/0,  /*src_startbit*/7,   /*sig_length*/3,  /*des_slotid_fr*/0,   /*des_basecycle_fr*/0,  /*des_repetition_fr*/0,   /*des_startbit*/15,    /*src_cyc*/101,  /*src_id*/0x11e,   /*src_dlc*/64,   /*des_cyc*/420,   /*des_id*/0x351, /*src_updatebit*/4,   /*des_updatebit*/12,      /*initvalue*/0         },
           {   /*sig_name*/"isBrkTqAtWhlsReq_0",   /*src_can*/"ChassisCANFD2",   /*src_network_type*/"CANFD",   /*src_slotid_fr*/0,   /*src_basecycle_fr*/0,  /*src_repetition_fr*/0,  /*src_startbit*/231,   /*sig_length*/12,  /*des_slotid_fr*/0,   /*des_basecycle_fr*/0,  /*des_repetition_fr*/0,   /*des_startbit*/23,    /*src_cyc*/101,  /*src_id*/0x5a,   /*src_dlc*/64,   /*des_cyc*/420,   /*des_id*/0x351, /*src_updatebit*/498,   /*des_updatebit*/27,      /*initvalue*/0         },
           {   /*sig_name*/"isBrkFricTqTotAtWhlsActBrkFricTqTotAtWhlsAct_0",   /*src_can*/"ChassisCANFD2",   /*src_network_type*/"CANFD",   /*src_slotid_fr*/0,   /*src_basecycle_fr*/0,  /*src_repetition_fr*/0,  /*src_startbit*/167,   /*sig_length*/15,  /*des_slotid_fr*/0,   /*des_basecycle_fr*/0,  /*des_repetition_fr*/0,   /*des_startbit*/6,    /*src_cyc*/101,  /*src_id*/0x5a,   /*src_dlc*/64,   /*des_cyc*/70,   /*des_id*/0x235, /*src_updatebit*/432,   /*des_updatebit*/7,      /*initvalue*/0         },
           {   /*sig_name*/"isBrkFricTqTotAtWhlsActChks_0",   /*src_can*/"ChassisCANFD2",   /*src_network_type*/"CANFD",   /*src_slotid_fr*/0,   /*src_basecycle_fr*/0,  /*src_repetition_fr*/0,  /*src_startbit*/168,   /*sig_length*/8,  /*des_slotid_fr*/0,   /*des_basecycle_fr*/0,  /*des_repetition_fr*/0,   /*des_startbit*/23,    /*src_cyc*/101,  /*src_id*/0x5a,   /*src_dlc*/64,   /*des_cyc*/70,   /*des_id*/0x235, /*src_updatebit*/432,   /*des_updatebit*/7,      /*initvalue*/0         },
           {   /*sig_name*/"isBrkFricTqTotAtWhlsActCntr_0",   /*src_can*/"ChassisCANFD2",   /*src_network_type*/"CANFD",   /*src_slotid_fr*/0,   /*src_basecycle_fr*/0,  /*src_repetition_fr*/0,  /*src_startbit*/176,   /*sig_length*/4,  /*des_slotid_fr*/0,   /*des_basecycle_fr*/0,  /*des_repetition_fr*/0,   /*des_startbit*/31,    /*src_cyc*/101,  /*src_id*/0x5a,   /*src_dlc*/64,   /*des_cyc*/70,   /*des_id*/0x235, /*src_updatebit*/432,   /*des_updatebit*/7,      /*initvalue*/0         },
           {   /*sig_name*/"isCrsCtrlrStbOk_0",   /*src_can*/"ChassisCANFD2",   /*src_network_type*/"CANFD",   /*src_slotid_fr*/0,   /*src_basecycle_fr*/0,  /*src_repetition_fr*/0,  /*src_startbit*/3,   /*sig_length*/1,  /*des_slotid_fr*/0,   /*des_basecycle_fr*/0,  /*des_repetition_fr*/0,   /*des_startbit*/5,    /*src_cyc*/101,  /*src_id*/0x11e,   /*src_dlc*/64,   /*des_cyc*/350,   /*des_id*/0x388, /*src_updatebit*/2,   /*des_updatebit*/4,      /*initvalue*/0         },
           {   /*sig_name*/"isSteerWhlSnsrChks_0",   /*src_can*/"ChassisCAN1",   /*src_network_type*/"CAN",   /*src_slotid_fr*/0,   /*src_basecycle_fr*/0,  /*src_repetition_fr*/0,  /*src_startbit*/39,   /*sig_length*/8,  /*des_slotid_fr*/0,   /*des_basecycle_fr*/0,  /*des_repetition_fr*/0,   /*des_startbit*/47,    /*src_cyc*/101,  /*src_id*/0x40,   /*src_dlc*/8,   /*des_cyc*/10,   /*des_id*/0x1b, /*src_updatebit*/7,   /*des_updatebit*/15,      /*initvalue*/0         },
           {   /*sig_name*/"isSteerWhlSnsrQf_0",   /*src_can*/"ChassisCAN1",   /*src_network_type*/"CAN",   /*src_slotid_fr*/0,   /*src_basecycle_fr*/0,  /*src_repetition_fr*/0,  /*src_startbit*/23,   /*sig_length*/2,  /*des_slotid_fr*/0,   /*des_basecycle_fr*/0,  /*des_repetition_fr*/0,   /*des_startbit*/31,    /*src_cyc*/101,  /*src_id*/0x40,   /*src_dlc*/8,   /*des_cyc*/10,   /*des_id*/0x1b, /*src_updatebit*/7,   /*des_updatebit*/15,      /*initvalue*/1         },
           {   /*sig_name*/"isSteerWhlSnsrAgSpd_0",   /*src_can*/"ChassisCAN1",   /*src_network_type*/"CAN",   /*src_slotid_fr*/0,   /*src_basecycle_fr*/0,  /*src_repetition_fr*/0,  /*src_startbit*/21,   /*sig_length*/14,  /*des_slotid_fr*/0,   /*des_basecycle_fr*/0,  /*des_repetition_fr*/0,   /*des_startbit*/29,    /*src_cyc*/101,  /*src_id*/0x40,   /*src_dlc*/8,   /*des_cyc*/10,   /*des_id*/0x1b, /*src_updatebit*/7,   /*des_updatebit*/15,      /*initvalue*/0         },
           {   /*sig_name*/"isSteerWhlSnsrCntr_0",   /*src_can*/"ChassisCAN1",   /*src_network_type*/"CAN",   /*src_slotid_fr*/0,   /*src_basecycle_fr*/0,  /*src_repetition_fr*/0,  /*src_startbit*/47,   /*sig_length*/4,  /*des_slotid_fr*/0,   /*des_basecycle_fr*/0,  /*des_repetition_fr*/0,   /*des_startbit*/55,    /*src_cyc*/101,  /*src_id*/0x40,   /*src_dlc*/8,   /*des_cyc*/10,   /*des_id*/0x1b, /*src_updatebit*/7,   /*des_updatebit*/15,      /*initvalue*/0         },
           {   /*sig_name*/"isSteerWhlSnsrAg_0",   /*src_can*/"ChassisCAN1",   /*src_network_type*/"CAN",   /*src_slotid_fr*/0,   /*src_basecycle_fr*/0,  /*src_repetition_fr*/0,  /*src_startbit*/6,   /*sig_length*/15,  /*des_slotid_fr*/0,   /*des_basecycle_fr*/0,  /*des_repetition_fr*/0,   /*des_startbit*/14,    /*src_cyc*/101,  /*src_id*/0x40,   /*src_dlc*/8,   /*des_cyc*/10,   /*des_id*/0x1b, /*src_updatebit*/7,   /*des_updatebit*/15,      /*initvalue*/0         },
           {   /*sig_name*/"isOxygenCooltFlowSts_0",   /*src_can*/"ChassisCANFD2",   /*src_network_type*/"CANFD",   /*src_slotid_fr*/0,   /*src_basecycle_fr*/0,  /*src_repetition_fr*/0,  /*src_startbit*/321,   /*sig_length*/1,  /*des_slotid_fr*/0,   /*des_basecycle_fr*/0,  /*des_repetition_fr*/0,   /*des_startbit*/14,    /*src_cyc*/101,  /*src_id*/0x300,   /*src_dlc*/64,   /*des_cyc*/200,   /*des_id*/0x20, /*src_updatebit*/320,   /*des_updatebit*/13,      /*initvalue*/0         },
           {   /*sig_name*/"isPassAirbLampStsRecPassAirbLampStsCntr_0",   /*src_can*/"CEM_LIN3",   /*src_network_type*/"LIN",   /*src_slotid_fr*/0,   /*src_basecycle_fr*/0,  /*src_repetition_fr*/0,  /*src_startbit*/32,   /*sig_length*/4,  /*des_slotid_fr*/0,   /*des_basecycle_fr*/0,  /*des_repetition_fr*/0,   /*des_startbit*/43,    /*src_cyc*/101,  /*src_id*/32,   /*src_dlc*/7,   /*des_cyc*/800,   /*des_id*/0x390, /*src_updatebit*/1000,   /*des_updatebit*/63,      /*initvalue*/0         },
           {   /*sig_name*/"isPassAirbLampStsRecPassAirbLampStsChks_0",   /*src_can*/"CEM_LIN3",   /*src_network_type*/"LIN",   /*src_slotid_fr*/0,   /*src_basecycle_fr*/0,  /*src_repetition_fr*/0,  /*src_startbit*/24,   /*sig_length*/8,  /*des_slotid_fr*/0,   /*des_basecycle_fr*/0,  /*des_repetition_fr*/0,   /*des_startbit*/55,    /*src_cyc*/101,  /*src_id*/32,   /*src_dlc*/7,   /*des_cyc*/800,   /*des_id*/0x390, /*src_updatebit*/1000,   /*des_updatebit*/63,      /*initvalue*/255         },
           {   /*sig_name*/"isPassAirbLampStsRecPassAirbLampSts_0",   /*src_can*/"CEM_LIN3",   /*src_network_type*/"LIN",   /*src_slotid_fr*/0,   /*src_basecycle_fr*/0,  /*src_repetition_fr*/0,  /*src_startbit*/36,   /*sig_length*/2,  /*des_slotid_fr*/0,   /*des_basecycle_fr*/0,  /*des_repetition_fr*/0,   /*des_startbit*/45,    /*src_cyc*/101,  /*src_id*/32,   /*src_dlc*/7,   /*des_cyc*/800,   /*des_id*/0x390, /*src_updatebit*/1000,   /*des_updatebit*/63,      /*initvalue*/1         },
           {   /*sig_name*/"isEngSt1WdStsChks_0",   /*src_can*/"PropulsionCAN",   /*src_network_type*/"CAN",   /*src_slotid_fr*/0,   /*src_basecycle_fr*/0,  /*src_repetition_fr*/0,  /*src_startbit*/23,   /*sig_length*/8,  /*des_slotid_fr*/0,   /*des_basecycle_fr*/0,  /*des_repetition_fr*/0,   /*des_startbit*/23,    /*src_cyc*/101,  /*src_id*/0x4b,   /*src_dlc*/8,   /*des_cyc*/620,   /*des_id*/0x370, /*src_updatebit*/8,   /*des_updatebit*/8,      /*initvalue*/0         },
           {   /*sig_name*/"isEngSt1WdStsCntr_0",   /*src_can*/"PropulsionCAN",   /*src_network_type*/"CAN",   /*src_slotid_fr*/0,   /*src_basecycle_fr*/0,  /*src_repetition_fr*/0,  /*src_startbit*/31,   /*sig_length*/4,  /*des_slotid_fr*/0,   /*des_basecycle_fr*/0,  /*des_repetition_fr*/0,   /*des_startbit*/31,    /*src_cyc*/101,  /*src_id*/0x4b,   /*src_dlc*/8,   /*des_cyc*/620,   /*des_id*/0x370, /*src_updatebit*/8,   /*des_updatebit*/8,      /*initvalue*/0         },
           {   /*sig_name*/"isEngSt1WdStsEngSt1WdSts_0",   /*src_can*/"PropulsionCAN",   /*src_network_type*/"CAN",   /*src_slotid_fr*/0,   /*src_basecycle_fr*/0,  /*src_repetition_fr*/0,  /*src_startbit*/27,   /*sig_length*/4,  /*des_slotid_fr*/0,   /*des_basecycle_fr*/0,  /*des_repetition_fr*/0,   /*des_startbit*/27,    /*src_cyc*/101,  /*src_id*/0x4b,   /*src_dlc*/8,   /*des_cyc*/620,   /*des_id*/0x370, /*src_updatebit*/8,   /*des_updatebit*/8,      /*initvalue*/0         },
           {   /*sig_name*/"isGearLvrIndcn_0",   /*src_can*/"ChassisCANFD2",   /*src_network_type*/"CANFD",   /*src_slotid_fr*/0,   /*src_basecycle_fr*/0,  /*src_repetition_fr*/0,  /*src_startbit*/71,   /*sig_length*/3,  /*des_slotid_fr*/0,   /*des_basecycle_fr*/0,  /*des_repetition_fr*/0,   /*des_startbit*/54,    /*src_cyc*/101,  /*src_id*/0x7c,   /*src_dlc*/64,   /*des_cyc*/40,   /*des_id*/0x78, /*src_updatebit*/68,   /*des_updatebit*/55,      /*initvalue*/7         },
           {   /*sig_name*/"isThrPos_0",   /*src_can*/"ChassisCANFD2",   /*src_network_type*/"CANFD",   /*src_slotid_fr*/0,   /*src_basecycle_fr*/0,  /*src_repetition_fr*/0,  /*src_startbit*/151,   /*sig_length*/8,  /*des_slotid_fr*/0,   /*des_basecycle_fr*/0,  /*des_repetition_fr*/0,   /*des_startbit*/39,    /*src_cyc*/101,  /*src_id*/0xe4,   /*src_dlc*/64,   /*des_cyc*/100,   /*des_id*/0x206, /*src_updatebit*/40,   /*des_updatebit*/47,      /*initvalue*/0         },
           {   /*sig_name*/"isAmbTIndcdWithUnitAmbTIndcdUnit_0",   /*src_can*/"PropulsionCAN",   /*src_network_type*/"CAN",   /*src_slotid_fr*/0,   /*src_basecycle_fr*/0,  /*src_repetition_fr*/0,  /*src_startbit*/11,   /*sig_length*/2,  /*des_slotid_fr*/0,   /*des_basecycle_fr*/0,  /*des_repetition_fr*/0,   /*des_startbit*/39,    /*src_cyc*/101,  /*src_id*/0x26b,   /*src_dlc*/8,   /*des_cyc*/420,   /*des_id*/0x351, /*src_updatebit*/23,   /*des_updatebit*/0,      /*initvalue*/0         },
           {   /*sig_name*/"isAmbTIndcdWithUnitAmbTIndcd_0",   /*src_can*/"PropulsionCAN",   /*src_network_type*/"CAN",   /*src_slotid_fr*/0,   /*src_basecycle_fr*/0,  /*src_repetition_fr*/0,  /*src_startbit*/7,   /*sig_length*/12,  /*des_slotid_fr*/0,   /*des_basecycle_fr*/0,  /*des_repetition_fr*/0,   /*des_startbit*/35,    /*src_cyc*/101,  /*src_id*/0x26b,   /*src_dlc*/8,   /*des_cyc*/420,   /*des_id*/0x351, /*src_updatebit*/23,   /*des_updatebit*/0,      /*initvalue*/1000         },
           {   /*sig_name*/"isAmbTIndcdWithUnitQF_0",   /*src_can*/"PropulsionCAN",   /*src_network_type*/"CAN",   /*src_slotid_fr*/0,   /*src_basecycle_fr*/0,  /*src_repetition_fr*/0,  /*src_startbit*/9,   /*sig_length*/2,  /*des_slotid_fr*/0,   /*des_basecycle_fr*/0,  /*des_repetition_fr*/0,   /*des_startbit*/37,    /*src_cyc*/101,  /*src_id*/0x26b,   /*src_dlc*/8,   /*des_cyc*/420,   /*des_id*/0x351, /*src_updatebit*/23,   /*des_updatebit*/0,      /*initvalue*/0         },
           {   /*sig_name*/"isHvBattLimnIndcn_0",   /*src_can*/"PropulsionCAN",   /*src_network_type*/"CAN",   /*src_slotid_fr*/0,   /*src_basecycle_fr*/0,  /*src_repetition_fr*/0,  /*src_startbit*/15,   /*sig_length*/16,  /*des_slotid_fr*/0,   /*des_basecycle_fr*/0,  /*des_repetition_fr*/0,   /*des_startbit*/23,    /*src_cyc*/101,  /*src_id*/0x141,   /*src_dlc*/8,   /*des_cyc*/15,   /*des_id*/0x5b, /*src_updatebit*/31,   /*des_updatebit*/11,      /*initvalue*/0         },
           {   /*sig_name*/"isVehSpdLgtCntr_0",   /*src_can*/"ChassisCANFD2",   /*src_network_type*/"CANFD",   /*src_slotid_fr*/0,   /*src_basecycle_fr*/0,  /*src_repetition_fr*/0,  /*src_startbit*/216,   /*sig_length*/4,  /*des_slotid_fr*/0,   /*des_basecycle_fr*/0,  /*des_repetition_fr*/0,   /*des_startbit*/47,    /*src_cyc*/101,  /*src_id*/0x9f,   /*src_dlc*/64,   /*des_cyc*/20,   /*des_id*/0x76, /*src_updatebit*/471,   /*des_updatebit*/23,      /*initvalue*/0         },
           {   /*sig_name*/"isVehSpdLgtA_0",   /*src_can*/"ChassisCANFD2",   /*src_network_type*/"CANFD",   /*src_slotid_fr*/0,   /*src_basecycle_fr*/0,  /*src_repetition_fr*/0,  /*src_startbit*/207,   /*sig_length*/15,  /*des_slotid_fr*/0,   /*des_basecycle_fr*/0,  /*des_repetition_fr*/0,   /*des_startbit*/22,    /*src_cyc*/101,  /*src_id*/0x9f,   /*src_dlc*/64,   /*des_cyc*/20,   /*des_id*/0x76, /*src_updatebit*/471,   /*des_updatebit*/23,      /*initvalue*/0         },
           {   /*sig_name*/"isVehSpdLgtQf_0",   /*src_can*/"ChassisCANFD2",   /*src_network_type*/"CANFD",   /*src_slotid_fr*/0,   /*src_basecycle_fr*/0,  /*src_repetition_fr*/0,  /*src_startbit*/228,   /*sig_length*/2,  /*des_slotid_fr*/0,   /*des_basecycle_fr*/0,  /*des_repetition_fr*/0,   /*des_startbit*/43,    /*src_cyc*/101,  /*src_id*/0x9f,   /*src_dlc*/64,   /*des_cyc*/20,   /*des_id*/0x76, /*src_updatebit*/471,   /*des_updatebit*/23,      /*initvalue*/1         },
           {   /*sig_name*/"isVehSpdLgtChks_0",   /*src_can*/"ChassisCANFD2",   /*src_network_type*/"CANFD",   /*src_slotid_fr*/0,   /*src_basecycle_fr*/0,  /*src_repetition_fr*/0,  /*src_startbit*/208,   /*sig_length*/8,  /*des_slotid_fr*/0,   /*des_basecycle_fr*/0,  /*des_repetition_fr*/0,   /*des_startbit*/39,    /*src_cyc*/101,  /*src_id*/0x9f,   /*src_dlc*/64,   /*des_cyc*/20,   /*des_id*/0x76, /*src_updatebit*/471,   /*des_updatebit*/23,      /*initvalue*/0         },
           {   /*sig_name*/"isWhlMotSysSpdAct_0",   /*src_can*/"PropulsionCAN",   /*src_network_type*/"CAN",   /*src_slotid_fr*/0,   /*src_basecycle_fr*/0,  /*src_repetition_fr*/0,  /*src_startbit*/6,   /*sig_length*/16,  /*des_slotid_fr*/0,   /*des_basecycle_fr*/0,  /*des_repetition_fr*/0,   /*des_startbit*/7,    /*src_cyc*/101,  /*src_id*/0x117,   /*src_dlc*/8,   /*des_cyc*/100,   /*des_id*/0x209, /*src_updatebit*/7,   /*des_updatebit*/17,      /*initvalue*/20000         },
           {   /*sig_name*/"isHvBattPreChrgReq_0",   /*src_can*/"PropulsionCAN",   /*src_network_type*/"CAN",   /*src_slotid_fr*/0,   /*src_basecycle_fr*/0,  /*src_repetition_fr*/0,  /*src_startbit*/48,   /*sig_length*/1,  /*des_slotid_fr*/0,   /*des_basecycle_fr*/0,  /*des_repetition_fr*/0,   /*des_startbit*/52,    /*src_cyc*/101,  /*src_id*/0x14f,   /*src_dlc*/8,   /*des_cyc*/150,   /*des_id*/0x371, /*src_updatebit*/49,   /*des_updatebit*/51,      /*initvalue*/0         },
           {   /*sig_name*/"isCrsCtrlrActvnOk_0",   /*src_can*/"ChassisCANFD2",   /*src_network_type*/"CANFD",   /*src_slotid_fr*/0,   /*src_basecycle_fr*/0,  /*src_repetition_fr*/0,  /*src_startbit*/73,   /*sig_length*/1,  /*des_slotid_fr*/0,   /*des_basecycle_fr*/0,  /*des_repetition_fr*/0,   /*des_startbit*/7,    /*src_cyc*/101,  /*src_id*/0x45f,   /*src_dlc*/64,   /*des_cyc*/350,   /*des_id*/0x388, /*src_updatebit*/72,   /*des_updatebit*/6,      /*initvalue*/0         },
           {   /*sig_name*/"isEngN2_0",   /*src_can*/"ChassisCANFD2",   /*src_network_type*/"CANFD",   /*src_slotid_fr*/0,   /*src_basecycle_fr*/0,  /*src_repetition_fr*/0,  /*src_startbit*/183,   /*sig_length*/15,  /*des_slotid_fr*/0,   /*des_basecycle_fr*/0,  /*des_repetition_fr*/0,   /*des_startbit*/14,    /*src_cyc*/101,  /*src_id*/0x28e,   /*src_dlc*/64,   /*des_cyc*/150,   /*des_id*/0x371, /*src_updatebit*/184,   /*des_updatebit*/15,      /*initvalue*/0         },
           {   /*sig_name*/"isDispOfPrpsnMod_0",   /*src_can*/"PropulsionCAN",   /*src_network_type*/"CAN",   /*src_slotid_fr*/0,   /*src_basecycle_fr*/0,  /*src_repetition_fr*/0,  /*src_startbit*/14,   /*sig_length*/4,  /*des_slotid_fr*/0,   /*des_basecycle_fr*/0,  /*des_repetition_fr*/0,   /*des_startbit*/60,    /*src_cyc*/101,  /*src_id*/0x27f,   /*src_dlc*/8,   /*des_cyc*/800,   /*des_id*/0x390, /*src_updatebit*/10,   /*des_updatebit*/56,      /*initvalue*/0         },
           {   /*sig_name*/"isDispOfPrpsnModForEv_0",   /*src_can*/"PropulsionCAN",   /*src_network_type*/"CAN",   /*src_slotid_fr*/0,   /*src_basecycle_fr*/0,  /*src_repetition_fr*/0,  /*src_startbit*/35,   /*sig_length*/4,  /*des_slotid_fr*/0,   /*des_basecycle_fr*/0,  /*des_repetition_fr*/0,   /*des_startbit*/7,    /*src_cyc*/101,  /*src_id*/0x295,   /*src_dlc*/8,   /*des_cyc*/800,   /*des_id*/0x390, /*src_updatebit*/0,   /*des_updatebit*/3,      /*initvalue*/0         },
           {   /*sig_name*/"isEngNSafeEngNGrdt_0",   /*src_can*/"PropulsionCAN",   /*src_network_type*/"CAN",   /*src_slotid_fr*/0,   /*src_basecycle_fr*/0,  /*src_repetition_fr*/0,  /*src_startbit*/15,   /*sig_length*/16,  /*des_slotid_fr*/0,   /*des_basecycle_fr*/0,  /*des_repetition_fr*/0,   /*des_startbit*/7,    /*src_cyc*/101,  /*src_id*/0x101,   /*src_dlc*/8,   /*des_cyc*/30,   /*des_id*/0x13a, /*src_updatebit*/51,   /*des_updatebit*/44,      /*initvalue*/0         },
           {   /*sig_name*/"isEngNSafeEngN_0",   /*src_can*/"PropulsionCAN",   /*src_network_type*/"CAN",   /*src_slotid_fr*/0,   /*src_basecycle_fr*/0,  /*src_repetition_fr*/0,  /*src_startbit*/30,   /*sig_length*/15,  /*des_slotid_fr*/0,   /*des_basecycle_fr*/0,  /*des_repetition_fr*/0,   /*des_startbit*/23,    /*src_cyc*/101,  /*src_id*/0x101,   /*src_dlc*/8,   /*des_cyc*/30,   /*des_id*/0x13a, /*src_updatebit*/51,   /*des_updatebit*/44,      /*initvalue*/0         },
           {   /*sig_name*/"isEngNSafeEngNCntr_0",   /*src_can*/"PropulsionCAN",   /*src_network_type*/"CAN",   /*src_slotid_fr*/0,   /*src_basecycle_fr*/0,  /*src_repetition_fr*/0,  /*src_startbit*/55,   /*sig_length*/4,  /*des_slotid_fr*/0,   /*des_basecycle_fr*/0,  /*des_repetition_fr*/0,   /*des_startbit*/32,    /*src_cyc*/101,  /*src_id*/0x101,   /*src_dlc*/8,   /*des_cyc*/30,   /*des_id*/0x13a, /*src_updatebit*/51,   /*des_updatebit*/44,      /*initvalue*/0         },
           {   /*sig_name*/"isEngNSafeEngNChks_0",   /*src_can*/"PropulsionCAN",   /*src_network_type*/"CAN",   /*src_slotid_fr*/0,   /*src_basecycle_fr*/0,  /*src_repetition_fr*/0,  /*src_startbit*/47,   /*sig_length*/8,  /*des_slotid_fr*/0,   /*des_basecycle_fr*/0,  /*des_repetition_fr*/0,   /*des_startbit*/24,    /*src_cyc*/101,  /*src_id*/0x101,   /*src_dlc*/8,   /*des_cyc*/30,   /*des_id*/0x13a, /*src_updatebit*/51,   /*des_updatebit*/44,      /*initvalue*/0         },
           {   /*sig_name*/"isIsgSpdActSgn_0",   /*src_can*/"ChassisCANFD2",   /*src_network_type*/"CANFD",   /*src_slotid_fr*/0,   /*src_basecycle_fr*/0,  /*src_repetition_fr*/0,  /*src_startbit*/439,   /*sig_length*/16,  /*des_slotid_fr*/0,   /*des_basecycle_fr*/0,  /*des_repetition_fr*/0,   /*des_startbit*/39,    /*src_cyc*/101,  /*src_id*/0x7c,   /*src_dlc*/64,   /*des_cyc*/150,   /*des_id*/0x371, /*src_updatebit*/112,   /*des_updatebit*/53,      /*initvalue*/20000         },
           {   /*sig_name*/"isDrvrCrsCtrlFctSeld_0",   /*src_can*/"PropulsionCAN",   /*src_network_type*/"CAN",   /*src_slotid_fr*/0,   /*src_basecycle_fr*/0,  /*src_repetition_fr*/0,  /*src_startbit*/15,   /*sig_length*/3,  /*des_slotid_fr*/0,   /*des_basecycle_fr*/0,  /*des_repetition_fr*/0,   /*des_startbit*/27,    /*src_cyc*/101,  /*src_id*/0x195,   /*src_dlc*/8,   /*des_cyc*/350,   /*des_id*/0x384, /*src_updatebit*/12,   /*des_updatebit*/24,      /*initvalue*/0         },
           {   /*sig_name*/"isAccrpedlStsChks_0",   /*src_can*/"ChassisCAN1",   /*src_network_type*/"CAN",   /*src_slotid_fr*/0,   /*src_basecycle_fr*/0,  /*src_repetition_fr*/0,  /*src_startbit*/7,   /*sig_length*/8,  /*des_slotid_fr*/0,   /*des_basecycle_fr*/0,  /*des_repetition_fr*/0,   /*des_startbit*/55,    /*src_cyc*/101,  /*src_id*/0x1c7,   /*src_dlc*/8,   /*des_cyc*/15,   /*des_id*/0x24, /*src_updatebit*/57,   /*des_updatebit*/58,      /*initvalue*/0         },
           {   /*sig_name*/"isAccrpedlStsCntr_0",   /*src_can*/"ChassisCAN1",   /*src_network_type*/"CAN",   /*src_slotid_fr*/0,   /*src_basecycle_fr*/0,  /*src_repetition_fr*/0,  /*src_startbit*/15,   /*sig_length*/4,  /*des_slotid_fr*/0,   /*des_basecycle_fr*/0,  /*des_repetition_fr*/0,   /*des_startbit*/63,    /*src_cyc*/101,  /*src_id*/0x1c7,   /*src_dlc*/8,   /*des_cyc*/15,   /*des_id*/0x24, /*src_updatebit*/57,   /*des_updatebit*/58,      /*initvalue*/0         },
           {   /*sig_name*/"isAccrpedlStsFltSts_0",   /*src_can*/"ChassisCAN1",   /*src_network_type*/"CAN",   /*src_slotid_fr*/0,   /*src_basecycle_fr*/0,  /*src_repetition_fr*/0,  /*src_startbit*/11,   /*sig_length*/1,  /*des_slotid_fr*/0,   /*des_basecycle_fr*/0,  /*des_repetition_fr*/0,   /*des_startbit*/59,    /*src_cyc*/101,  /*src_id*/0x1c7,   /*src_dlc*/8,   /*des_cyc*/15,   /*des_id*/0x24, /*src_updatebit*/57,   /*des_updatebit*/58,      /*initvalue*/0         },
           {   /*sig_name*/"isBrkTracCtrlActv_0",   /*src_can*/"ChassisCAN1",   /*src_network_type*/"CAN",   /*src_slotid_fr*/0,   /*src_basecycle_fr*/0,  /*src_repetition_fr*/0,  /*src_startbit*/20,   /*sig_length*/1,  /*des_slotid_fr*/0,   /*des_basecycle_fr*/0,  /*des_repetition_fr*/0,   /*des_startbit*/21,    /*src_cyc*/101,  /*src_id*/0x14b,   /*src_dlc*/8,   /*des_cyc*/350,   /*des_id*/0x384, /*src_updatebit*/21,   /*des_updatebit*/20,      /*initvalue*/0         },
           {   /*sig_name*/"isChrgnOrDisChrgnStsFb_0",   /*src_can*/"ChassisCANFD2",   /*src_network_type*/"CANFD",   /*src_slotid_fr*/0,   /*src_basecycle_fr*/0,  /*src_repetition_fr*/0,  /*src_startbit*/207,   /*sig_length*/5,  /*des_slotid_fr*/0,   /*des_basecycle_fr*/0,  /*des_repetition_fr*/0,   /*des_startbit*/7,    /*src_cyc*/101,  /*src_id*/0x20e,   /*src_dlc*/64,   /*des_cyc*/60,   /*des_id*/0x215, /*src_updatebit*/202,   /*des_updatebit*/2,      /*initvalue*/0         },
           {   /*sig_name*/"isAbsSts_0",   /*src_can*/"ChassisCANFD2",   /*src_network_type*/"CANFD",   /*src_slotid_fr*/0,   /*src_basecycle_fr*/0,  /*src_repetition_fr*/0,  /*src_startbit*/40,   /*sig_length*/1,  /*des_slotid_fr*/0,   /*des_basecycle_fr*/0,  /*des_repetition_fr*/0,   /*des_startbit*/25,    /*src_cyc*/101,  /*src_id*/0x67,   /*src_dlc*/64,   /*des_cyc*/420,   /*des_id*/0x345, /*src_updatebit*/88,   /*des_updatebit*/24,      /*initvalue*/0         },
           {   /*sig_name*/"isAbsCtrlActvCtrlSts1_0",   /*src_can*/"ChassisCAN1",   /*src_network_type*/"CAN",   /*src_slotid_fr*/0,   /*src_basecycle_fr*/0,  /*src_repetition_fr*/0,  /*src_startbit*/43,   /*sig_length*/1,  /*des_slotid_fr*/0,   /*des_basecycle_fr*/0,  /*des_repetition_fr*/0,   /*des_startbit*/27,    /*src_cyc*/101,  /*src_id*/0xb9,   /*src_dlc*/8,   /*des_cyc*/420,   /*des_id*/0x345, /*src_updatebit*/24,   /*des_updatebit*/26,      /*initvalue*/0         },
           {   /*sig_name*/"isAbsCtrlActvChks_0",   /*src_can*/"ChassisCAN1",   /*src_network_type*/"CAN",   /*src_slotid_fr*/0,   /*src_basecycle_fr*/0,  /*src_repetition_fr*/0,  /*src_startbit*/39,   /*sig_length*/8,  /*des_slotid_fr*/0,   /*des_basecycle_fr*/0,  /*des_repetition_fr*/0,   /*des_startbit*/23,    /*src_cyc*/101,  /*src_id*/0xb9,   /*src_dlc*/8,   /*des_cyc*/420,   /*des_id*/0x345, /*src_updatebit*/24,   /*des_updatebit*/26,      /*initvalue*/0         },
           {   /*sig_name*/"isAbsCtrlActvCntr_0",   /*src_can*/"ChassisCAN1",   /*src_network_type*/"CAN",   /*src_slotid_fr*/0,   /*src_basecycle_fr*/0,  /*src_repetition_fr*/0,  /*src_startbit*/47,   /*sig_length*/4,  /*des_slotid_fr*/0,   /*des_basecycle_fr*/0,  /*des_repetition_fr*/0,   /*des_startbit*/31,    /*src_cyc*/101,  /*src_id*/0xb9,   /*src_dlc*/8,   /*des_cyc*/420,   /*des_id*/0x345, /*src_updatebit*/24,   /*des_updatebit*/26,      /*initvalue*/0         },
           {   /*sig_name*/"isWhlDirRotlReLe_0",   /*src_can*/"ChassisCAN1",   /*src_network_type*/"CAN",   /*src_slotid_fr*/0,   /*src_basecycle_fr*/0,  /*src_repetition_fr*/0,  /*src_startbit*/27,   /*sig_length*/2,  /*des_slotid_fr*/0,   /*des_basecycle_fr*/0,  /*des_repetition_fr*/0,   /*des_startbit*/59,    /*src_cyc*/101,  /*src_id*/0x2e,   /*src_dlc*/8,   /*des_cyc*/15,   /*des_id*/0x5b, /*src_updatebit*/38,   /*des_updatebit*/43,      /*initvalue*/0         },
           {   /*sig_name*/"isWhlDirRotlReCntr_0",   /*src_can*/"ChassisCAN1",   /*src_network_type*/"CAN",   /*src_slotid_fr*/0,   /*src_basecycle_fr*/0,  /*src_repetition_fr*/0,  /*src_startbit*/31,   /*sig_length*/4,  /*des_slotid_fr*/0,   /*des_basecycle_fr*/0,  /*des_repetition_fr*/0,   /*des_startbit*/63,    /*src_cyc*/101,  /*src_id*/0x2e,   /*src_dlc*/8,   /*des_cyc*/15,   /*des_id*/0x5b, /*src_updatebit*/38,   /*des_updatebit*/43,      /*initvalue*/0         },
           {   /*sig_name*/"isWhlDirRotlReChks_0",   /*src_can*/"ChassisCAN1",   /*src_network_type*/"CAN",   /*src_slotid_fr*/0,   /*src_basecycle_fr*/0,  /*src_repetition_fr*/0,  /*src_startbit*/23,   /*sig_length*/8,  /*des_slotid_fr*/0,   /*des_basecycle_fr*/0,  /*des_repetition_fr*/0,   /*des_startbit*/55,    /*src_cyc*/101,  /*src_id*/0x2e,   /*src_dlc*/8,   /*des_cyc*/15,   /*des_id*/0x5b, /*src_updatebit*/38,   /*des_updatebit*/43,      /*initvalue*/0         },
           {   /*sig_name*/"isWhlDirRotlReRi_0",   /*src_can*/"ChassisCAN1",   /*src_network_type*/"CAN",   /*src_slotid_fr*/0,   /*src_basecycle_fr*/0,  /*src_repetition_fr*/0,  /*src_startbit*/25,   /*sig_length*/2,  /*des_slotid_fr*/0,   /*des_basecycle_fr*/0,  /*des_repetition_fr*/0,   /*des_startbit*/57,    /*src_cyc*/101,  /*src_id*/0x2e,   /*src_dlc*/8,   /*des_cyc*/15,   /*des_id*/0x5b, /*src_updatebit*/38,   /*des_updatebit*/43,      /*initvalue*/0         },
           {   /*sig_name*/"isHvSysRlyStsChks_0",   /*src_can*/"PropulsionCAN",   /*src_network_type*/"CAN",   /*src_slotid_fr*/0,   /*src_basecycle_fr*/0,  /*src_repetition_fr*/0,  /*src_startbit*/7,   /*sig_length*/8,  /*des_slotid_fr*/0,   /*des_basecycle_fr*/0,  /*des_repetition_fr*/0,   /*des_startbit*/39,    /*src_cyc*/101,  /*src_id*/0x161,   /*src_dlc*/8,   /*des_cyc*/200,   /*des_id*/0x140, /*src_updatebit*/9,   /*des_updatebit*/30,      /*initvalue*/0         },
           {   /*sig_name*/"isHvSysRlyStsCntr_0",   /*src_can*/"PropulsionCAN",   /*src_network_type*/"CAN",   /*src_slotid_fr*/0,   /*src_basecycle_fr*/0,  /*src_repetition_fr*/0,  /*src_startbit*/15,   /*sig_length*/4,  /*des_slotid_fr*/0,   /*des_basecycle_fr*/0,  /*des_repetition_fr*/0,   /*des_startbit*/27,    /*src_cyc*/101,  /*src_id*/0x161,   /*src_dlc*/8,   /*des_cyc*/200,   /*des_id*/0x140, /*src_updatebit*/9,   /*des_updatebit*/30,      /*initvalue*/0         },
           {   /*sig_name*/"isHvSysRlyStsHvSysRlySts_0",   /*src_can*/"PropulsionCAN",   /*src_network_type*/"CAN",   /*src_slotid_fr*/0,   /*src_basecycle_fr*/0,  /*src_repetition_fr*/0,  /*src_startbit*/11,   /*sig_length*/2,  /*des_slotid_fr*/0,   /*des_basecycle_fr*/0,  /*des_repetition_fr*/0,   /*des_startbit*/29,    /*src_cyc*/101,  /*src_id*/0x161,   /*src_dlc*/8,   /*des_cyc*/200,   /*des_id*/0x140, /*src_updatebit*/9,   /*des_updatebit*/30,      /*initvalue*/2         },
           {   /*sig_name*/"isWhlDirRotlFrntLe_0",   /*src_can*/"ChassisCAN1",   /*src_network_type*/"CAN",   /*src_slotid_fr*/0,   /*src_basecycle_fr*/0,  /*src_repetition_fr*/0,  /*src_startbit*/11,   /*sig_length*/2,  /*des_slotid_fr*/0,   /*des_basecycle_fr*/0,  /*des_repetition_fr*/0,   /*des_startbit*/59,    /*src_cyc*/101,  /*src_id*/0x2e,   /*src_dlc*/8,   /*des_cyc*/15,   /*des_id*/0x110, /*src_updatebit*/39,   /*des_updatebit*/40,      /*initvalue*/0         },
           {   /*sig_name*/"isWhlDirRotlFrntCntr_0",   /*src_can*/"ChassisCAN1",   /*src_network_type*/"CAN",   /*src_slotid_fr*/0,   /*src_basecycle_fr*/0,  /*src_repetition_fr*/0,  /*src_startbit*/15,   /*sig_length*/4,  /*des_slotid_fr*/0,   /*des_basecycle_fr*/0,  /*des_repetition_fr*/0,   /*des_startbit*/63,    /*src_cyc*/101,  /*src_id*/0x2e,   /*src_dlc*/8,   /*des_cyc*/15,   /*des_id*/0x110, /*src_updatebit*/39,   /*des_updatebit*/40,      /*initvalue*/0         },
           {   /*sig_name*/"isWhlDirRotlFrntRi_0",   /*src_can*/"ChassisCAN1",   /*src_network_type*/"CAN",   /*src_slotid_fr*/0,   /*src_basecycle_fr*/0,  /*src_repetition_fr*/0,  /*src_startbit*/9,   /*sig_length*/2,  /*des_slotid_fr*/0,   /*des_basecycle_fr*/0,  /*des_repetition_fr*/0,   /*des_startbit*/57,    /*src_cyc*/101,  /*src_id*/0x2e,   /*src_dlc*/8,   /*des_cyc*/15,   /*des_id*/0x110, /*src_updatebit*/39,   /*des_updatebit*/40,      /*initvalue*/0         },
           {   /*sig_name*/"isWhlDirRotlFrntChks_0",   /*src_can*/"ChassisCAN1",   /*src_network_type*/"CAN",   /*src_slotid_fr*/0,   /*src_basecycle_fr*/0,  /*src_repetition_fr*/0,  /*src_startbit*/7,   /*sig_length*/8,  /*des_slotid_fr*/0,   /*des_basecycle_fr*/0,  /*des_repetition_fr*/0,   /*des_startbit*/55,    /*src_cyc*/101,  /*src_id*/0x2e,   /*src_dlc*/8,   /*des_cyc*/15,   /*des_id*/0x110, /*src_updatebit*/39,   /*des_updatebit*/40,      /*initvalue*/0         },
           {   /*sig_name*/"isPinionSteerAgMax1_0",   /*src_can*/"ChassisCAN1",   /*src_network_type*/"CAN",   /*src_slotid_fr*/0,   /*src_basecycle_fr*/0,  /*src_repetition_fr*/0,  /*src_startbit*/54,   /*sig_length*/15,  /*des_slotid_fr*/0,   /*des_basecycle_fr*/0,  /*des_repetition_fr*/0,   /*des_startbit*/55,    /*src_cyc*/101,  /*src_id*/0x3bb,   /*src_dlc*/8,   /*des_cyc*/800,   /*des_id*/0x398, /*src_updatebit*/55,   /*des_updatebit*/56,      /*initvalue*/0         },
           {   /*sig_name*/"isTrsmParkLockdCntr_0",   /*src_can*/"PropulsionCAN",   /*src_network_type*/"CAN",   /*src_slotid_fr*/0,   /*src_basecycle_fr*/0,  /*src_repetition_fr*/0,  /*src_startbit*/19,   /*sig_length*/4,  /*des_slotid_fr*/0,   /*des_basecycle_fr*/0,  /*des_repetition_fr*/0,   /*des_startbit*/51,    /*src_cyc*/101,  /*src_id*/0x131,   /*src_dlc*/8,   /*des_cyc*/40,   /*des_id*/0xea, /*src_updatebit*/23,   /*des_updatebit*/54,      /*initvalue*/0         },
           {   /*sig_name*/"isTrsmParkLockdChks_0",   /*src_can*/"PropulsionCAN",   /*src_network_type*/"CAN",   /*src_slotid_fr*/0,   /*src_basecycle_fr*/0,  /*src_repetition_fr*/0,  /*src_startbit*/31,   /*sig_length*/8,  /*des_slotid_fr*/0,   /*des_basecycle_fr*/0,  /*des_repetition_fr*/0,   /*des_startbit*/63,    /*src_cyc*/101,  /*src_id*/0x131,   /*src_dlc*/8,   /*des_cyc*/40,   /*des_id*/0xea, /*src_updatebit*/23,   /*des_updatebit*/54,      /*initvalue*/0         },
           {   /*sig_name*/"isTrsmParkLockdTrsmParkLockd_0",   /*src_can*/"PropulsionCAN",   /*src_network_type*/"CAN",   /*src_slotid_fr*/0,   /*src_basecycle_fr*/0,  /*src_repetition_fr*/0,  /*src_startbit*/21,   /*sig_length*/2,  /*des_slotid_fr*/0,   /*des_basecycle_fr*/0,  /*des_repetition_fr*/0,   /*des_startbit*/53,    /*src_cyc*/101,  /*src_id*/0x131,   /*src_dlc*/8,   /*des_cyc*/40,   /*des_id*/0xea, /*src_updatebit*/23,   /*des_updatebit*/54,      /*initvalue*/3         },
           {   /*sig_name*/"isWhlSpdCircumlFrntCntr_0",   /*src_can*/"ChassisCANFD2",   /*src_network_type*/"CANFD",   /*src_slotid_fr*/0,   /*src_basecycle_fr*/0,  /*src_repetition_fr*/0,  /*src_startbit*/33,   /*sig_length*/4,  /*des_slotid_fr*/0,   /*des_basecycle_fr*/0,  /*des_repetition_fr*/0,   /*des_startbit*/31,    /*src_cyc*/101,  /*src_id*/0x67,   /*src_dlc*/64,   /*des_cyc*/15,   /*des_id*/0x110, /*src_updatebit*/41,   /*des_updatebit*/7,      /*initvalue*/0         },
           {   /*sig_name*/"isWhlSpdCircumlFrntWhlSpdCircumlFrntRi_0",   /*src_can*/"ChassisCANFD2",   /*src_network_type*/"CANFD",   /*src_slotid_fr*/0,   /*src_basecycle_fr*/0,  /*src_repetition_fr*/0,  /*src_startbit*/8,   /*sig_length*/15,  /*des_slotid_fr*/0,   /*des_basecycle_fr*/0,  /*des_repetition_fr*/0,   /*des_startbit*/39,    /*src_cyc*/101,  /*src_id*/0x67,   /*src_dlc*/64,   /*des_cyc*/15,   /*des_id*/0x110, /*src_updatebit*/41,   /*des_updatebit*/7,      /*initvalue*/0         },
           {   /*sig_name*/"isWhlSpdCircumlFrntLe_0",   /*src_can*/"ChassisCANFD2",   /*src_network_type*/"CANFD",   /*src_slotid_fr*/0,   /*src_basecycle_fr*/0,  /*src_repetition_fr*/0,  /*src_startbit*/7,   /*sig_length*/15,  /*des_slotid_fr*/0,   /*des_basecycle_fr*/0,  /*des_repetition_fr*/0,   /*des_startbit*/6,    /*src_cyc*/101,  /*src_id*/0x67,   /*src_dlc*/64,   /*des_cyc*/15,   /*des_id*/0x110, /*src_updatebit*/41,   /*des_updatebit*/7,      /*initvalue*/0         },
           {   /*sig_name*/"isWhlSpdCircumlFrntRiQf_0",   /*src_can*/"ChassisCANFD2",   /*src_network_type*/"CANFD",   /*src_slotid_fr*/0,   /*src_basecycle_fr*/0,  /*src_repetition_fr*/0,  /*src_startbit*/43,   /*sig_length*/2,  /*des_slotid_fr*/0,   /*des_basecycle_fr*/0,  /*des_repetition_fr*/0,   /*des_startbit*/25,    /*src_cyc*/101,  /*src_id*/0x67,   /*src_dlc*/64,   /*des_cyc*/15,   /*des_id*/0x110, /*src_updatebit*/41,   /*des_updatebit*/7,      /*initvalue*/1         },
           {   /*sig_name*/"isWhlSpdCircumlFrntChks_0",   /*src_can*/"ChassisCANFD2",   /*src_network_type*/"CANFD",   /*src_slotid_fr*/0,   /*src_basecycle_fr*/0,  /*src_repetition_fr*/0,  /*src_startbit*/25,   /*sig_length*/8,  /*des_slotid_fr*/0,   /*des_basecycle_fr*/0,  /*des_repetition_fr*/0,   /*des_startbit*/23,    /*src_cyc*/101,  /*src_id*/0x67,   /*src_dlc*/64,   /*des_cyc*/15,   /*des_id*/0x110, /*src_updatebit*/41,   /*des_updatebit*/7,      /*initvalue*/0         },
           {   /*sig_name*/"isWhlSpdCircumlFrntLeQf_0",   /*src_can*/"ChassisCANFD2",   /*src_network_type*/"CANFD",   /*src_slotid_fr*/0,   /*src_basecycle_fr*/0,  /*src_repetition_fr*/0,  /*src_startbit*/45,   /*sig_length*/2,  /*des_slotid_fr*/0,   /*des_basecycle_fr*/0,  /*des_repetition_fr*/0,   /*des_startbit*/27,    /*src_cyc*/101,  /*src_id*/0x67,   /*src_dlc*/64,   /*des_cyc*/15,   /*des_id*/0x110, /*src_updatebit*/41,   /*des_updatebit*/7,      /*initvalue*/1         },
           {   /*sig_name*/"isPinionSteerAgGroupPinionSteerAg1Qf_0",   /*src_can*/"ChassisCAN1",   /*src_network_type*/"CAN",   /*src_slotid_fr*/0,   /*src_basecycle_fr*/0,  /*src_repetition_fr*/0,  /*src_startbit*/15,   /*sig_length*/2,  /*des_slotid_fr*/0,   /*des_basecycle_fr*/0,  /*des_repetition_fr*/0,   /*des_startbit*/15,    /*src_cyc*/101,  /*src_id*/0x4e,   /*src_dlc*/8,   /*des_cyc*/150,   /*des_id*/0x378, /*src_updatebit*/57,   /*des_updatebit*/57,      /*initvalue*/1         },
           {   /*sig_name*/"isPinionSteerAgGroupCntr_0",   /*src_can*/"ChassisCAN1",   /*src_network_type*/"CAN",   /*src_slotid_fr*/0,   /*src_basecycle_fr*/0,  /*src_repetition_fr*/0,  /*src_startbit*/63,   /*sig_length*/4,  /*des_slotid_fr*/0,   /*des_basecycle_fr*/0,  /*des_repetition_fr*/0,   /*des_startbit*/63,    /*src_cyc*/101,  /*src_id*/0x4e,   /*src_dlc*/8,   /*des_cyc*/150,   /*des_id*/0x378, /*src_updatebit*/57,   /*des_updatebit*/57,      /*initvalue*/0         },
           {   /*sig_name*/"isPinionSteerAgGroupSteerWhlTq_0",   /*src_can*/"ChassisCAN1",   /*src_network_type*/"CAN",   /*src_slotid_fr*/0,   /*src_basecycle_fr*/0,  /*src_repetition_fr*/0,  /*src_startbit*/29,   /*sig_length*/14,  /*des_slotid_fr*/0,   /*des_basecycle_fr*/0,  /*des_repetition_fr*/0,   /*des_startbit*/29,    /*src_cyc*/101,  /*src_id*/0x4e,   /*src_dlc*/8,   /*des_cyc*/150,   /*des_id*/0x378, /*src_updatebit*/57,   /*des_updatebit*/57,      /*initvalue*/0         },
           {   /*sig_name*/"isPinionSteerAgGroupPinionSteerAg1_0",   /*src_can*/"ChassisCAN1",   /*src_network_type*/"CAN",   /*src_slotid_fr*/0,   /*src_basecycle_fr*/0,  /*src_repetition_fr*/0,  /*src_startbit*/46,   /*sig_length*/15,  /*des_slotid_fr*/0,   /*des_basecycle_fr*/0,  /*des_repetition_fr*/0,   /*des_startbit*/46,    /*src_cyc*/101,  /*src_id*/0x4e,   /*src_dlc*/8,   /*des_cyc*/150,   /*des_id*/0x378, /*src_updatebit*/57,   /*des_updatebit*/57,      /*initvalue*/0         },
           {   /*sig_name*/"isPinionSteerAgGroupPinionSteerAgSpd1_0",   /*src_can*/"ChassisCAN1",   /*src_network_type*/"CAN",   /*src_slotid_fr*/0,   /*src_basecycle_fr*/0,  /*src_repetition_fr*/0,  /*src_startbit*/13,   /*sig_length*/14,  /*des_slotid_fr*/0,   /*des_basecycle_fr*/0,  /*des_repetition_fr*/0,   /*des_startbit*/13,    /*src_cyc*/101,  /*src_id*/0x4e,   /*src_dlc*/8,   /*des_cyc*/150,   /*des_id*/0x378, /*src_updatebit*/57,   /*des_updatebit*/57,      /*initvalue*/0         },
           {   /*sig_name*/"isPinionSteerAgGroupSteerWhlTqQf_0",   /*src_can*/"ChassisCAN1",   /*src_network_type*/"CAN",   /*src_slotid_fr*/0,   /*src_basecycle_fr*/0,  /*src_repetition_fr*/0,  /*src_startbit*/59,   /*sig_length*/2,  /*des_slotid_fr*/0,   /*des_basecycle_fr*/0,  /*des_repetition_fr*/0,   /*des_startbit*/59,    /*src_cyc*/101,  /*src_id*/0x4e,   /*src_dlc*/8,   /*des_cyc*/150,   /*des_id*/0x378, /*src_updatebit*/57,   /*des_updatebit*/57,      /*initvalue*/1         },
           {   /*sig_name*/"isPinionSteerAgGroupPinionSteerAgSpd1Qf_0",   /*src_can*/"ChassisCAN1",   /*src_network_type*/"CAN",   /*src_slotid_fr*/0,   /*src_basecycle_fr*/0,  /*src_repetition_fr*/0,  /*src_startbit*/31,   /*sig_length*/2,  /*des_slotid_fr*/0,   /*des_basecycle_fr*/0,  /*des_repetition_fr*/0,   /*des_startbit*/31,    /*src_cyc*/101,  /*src_id*/0x4e,   /*src_dlc*/8,   /*des_cyc*/150,   /*des_id*/0x378, /*src_updatebit*/57,   /*des_updatebit*/57,      /*initvalue*/1         },
           {   /*sig_name*/"isPinionSteerAgGroupChks_0",   /*src_can*/"ChassisCAN1",   /*src_network_type*/"CAN",   /*src_slotid_fr*/0,   /*src_basecycle_fr*/0,  /*src_repetition_fr*/0,  /*src_startbit*/7,   /*sig_length*/8,  /*des_slotid_fr*/0,   /*des_basecycle_fr*/0,  /*des_repetition_fr*/0,   /*des_startbit*/7,    /*src_cyc*/101,  /*src_id*/0x4e,   /*src_dlc*/8,   /*des_cyc*/150,   /*des_id*/0x378, /*src_updatebit*/57,   /*des_updatebit*/57,      /*initvalue*/0         },
           {   /*sig_name*/"isAccrPedlRatCntr_0",   /*src_can*/"ChassisCANFD2",   /*src_network_type*/"CANFD",   /*src_slotid_fr*/0,   /*src_basecycle_fr*/0,  /*src_repetition_fr*/0,  /*src_startbit*/115,   /*sig_length*/4,  /*des_slotid_fr*/0,   /*des_basecycle_fr*/0,  /*des_repetition_fr*/0,   /*des_startbit*/31,    /*src_cyc*/101,  /*src_id*/0xde,   /*src_dlc*/64,   /*des_cyc*/100,   /*des_id*/0x206, /*src_updatebit*/168,   /*des_updatebit*/7,      /*initvalue*/0         },
           {   /*sig_name*/"isAccrPedlRatChks_0",   /*src_can*/"ChassisCANFD2",   /*src_network_type*/"CANFD",   /*src_slotid_fr*/0,   /*src_basecycle_fr*/0,  /*src_repetition_fr*/0,  /*src_startbit*/107,   /*sig_length*/8,  /*des_slotid_fr*/0,   /*des_basecycle_fr*/0,  /*des_repetition_fr*/0,   /*des_startbit*/23,    /*src_cyc*/101,  /*src_id*/0xde,   /*src_dlc*/64,   /*des_cyc*/100,   /*des_id*/0x206, /*src_updatebit*/168,   /*des_updatebit*/7,      /*initvalue*/0         },
           {   /*sig_name*/"isAccrPedlRatAccrPedlRat_0",   /*src_can*/"ChassisCANFD2",   /*src_network_type*/"CANFD",   /*src_slotid_fr*/0,   /*src_basecycle_fr*/0,  /*src_repetition_fr*/0,  /*src_startbit*/90,   /*sig_length*/15,  /*des_slotid_fr*/0,   /*des_basecycle_fr*/0,  /*des_repetition_fr*/0,   /*des_startbit*/6,    /*src_cyc*/101,  /*src_id*/0xde,   /*src_dlc*/64,   /*des_cyc*/100,   /*des_id*/0x206, /*src_updatebit*/168,   /*des_updatebit*/7,      /*initvalue*/0         },
           {   /*sig_name*/"isWhlSpdCircumlReCntr_0",   /*src_can*/"ChassisCANFD2",   /*src_network_type*/"CANFD",   /*src_slotid_fr*/0,   /*src_basecycle_fr*/0,  /*src_repetition_fr*/0,  /*src_startbit*/81,   /*sig_length*/4,  /*des_slotid_fr*/0,   /*des_basecycle_fr*/0,  /*des_repetition_fr*/0,   /*des_startbit*/31,    /*src_cyc*/101,  /*src_id*/0x67,   /*src_dlc*/64,   /*des_cyc*/15,   /*des_id*/0x11a, /*src_updatebit*/89,   /*des_updatebit*/7,      /*initvalue*/0         },
           {   /*sig_name*/"isWhlSpdCircumlReChks_0",   /*src_can*/"ChassisCANFD2",   /*src_network_type*/"CANFD",   /*src_slotid_fr*/0,   /*src_basecycle_fr*/0,  /*src_repetition_fr*/0,  /*src_startbit*/73,   /*sig_length*/8,  /*des_slotid_fr*/0,   /*des_basecycle_fr*/0,  /*des_repetition_fr*/0,   /*des_startbit*/23,    /*src_cyc*/101,  /*src_id*/0x67,   /*src_dlc*/64,   /*des_cyc*/15,   /*des_id*/0x11a, /*src_updatebit*/89,   /*des_updatebit*/7,      /*initvalue*/0         },
           {   /*sig_name*/"isWhlSpdCircumlReRiQf_0",   /*src_can*/"ChassisCANFD2",   /*src_network_type*/"CANFD",   /*src_slotid_fr*/0,   /*src_basecycle_fr*/0,  /*src_repetition_fr*/0,  /*src_startbit*/91,   /*sig_length*/2,  /*des_slotid_fr*/0,   /*des_basecycle_fr*/0,  /*des_repetition_fr*/0,   /*des_startbit*/25,    /*src_cyc*/101,  /*src_id*/0x67,   /*src_dlc*/64,   /*des_cyc*/15,   /*des_id*/0x11a, /*src_updatebit*/89,   /*des_updatebit*/7,      /*initvalue*/1         },
           {   /*sig_name*/"isWhlSpdCircumlReLeQf_0",   /*src_can*/"ChassisCANFD2",   /*src_network_type*/"CANFD",   /*src_slotid_fr*/0,   /*src_basecycle_fr*/0,  /*src_repetition_fr*/0,  /*src_startbit*/93,   /*sig_length*/2,  /*des_slotid_fr*/0,   /*des_basecycle_fr*/0,  /*des_repetition_fr*/0,   /*des_startbit*/27,    /*src_cyc*/101,  /*src_id*/0x67,   /*src_dlc*/64,   /*des_cyc*/15,   /*des_id*/0x11a, /*src_updatebit*/89,   /*des_updatebit*/7,      /*initvalue*/1         },
           {   /*sig_name*/"isWhlSpdCircumlReLe_0",   /*src_can*/"ChassisCANFD2",   /*src_network_type*/"CANFD",   /*src_slotid_fr*/0,   /*src_basecycle_fr*/0,  /*src_repetition_fr*/0,  /*src_startbit*/55,   /*sig_length*/15,  /*des_slotid_fr*/0,   /*des_basecycle_fr*/0,  /*des_repetition_fr*/0,   /*des_startbit*/6,    /*src_cyc*/101,  /*src_id*/0x67,   /*src_dlc*/64,   /*des_cyc*/15,   /*des_id*/0x11a, /*src_updatebit*/89,   /*des_updatebit*/7,      /*initvalue*/0         },
           {   /*sig_name*/"isWhlSpdCircumlReRi_0",   /*src_can*/"ChassisCANFD2",   /*src_network_type*/"CANFD",   /*src_slotid_fr*/0,   /*src_basecycle_fr*/0,  /*src_repetition_fr*/0,  /*src_startbit*/56,   /*sig_length*/15,  /*des_slotid_fr*/0,   /*des_basecycle_fr*/0,  /*des_repetition_fr*/0,   /*des_startbit*/39,    /*src_cyc*/101,  /*src_id*/0x67,   /*src_dlc*/64,   /*des_cyc*/15,   /*des_id*/0x11a, /*src_updatebit*/89,   /*des_updatebit*/7,      /*initvalue*/0         },
           {   /*sig_name*/"isCrsCtrlrSts_0",   /*src_can*/"PropulsionCAN",   /*src_network_type*/"CAN",   /*src_slotid_fr*/0,   /*src_basecycle_fr*/0,  /*src_repetition_fr*/0,  /*src_startbit*/2,   /*sig_length*/3,  /*des_slotid_fr*/0,   /*des_basecycle_fr*/0,  /*des_repetition_fr*/0,   /*des_startbit*/31,    /*src_cyc*/101,  /*src_id*/0x196,   /*src_dlc*/8,   /*des_cyc*/350,   /*des_id*/0x384, /*src_updatebit*/39,   /*des_updatebit*/28,      /*initvalue*/1         },
           {   /*sig_name*/"isAccrPedlRatGrdt_0",   /*src_can*/"ChassisCAN1",   /*src_network_type*/"CAN",   /*src_slotid_fr*/0,   /*src_basecycle_fr*/0,  /*src_repetition_fr*/0,  /*src_startbit*/22,   /*sig_length*/15,  /*des_slotid_fr*/0,   /*des_basecycle_fr*/0,  /*des_repetition_fr*/0,   /*des_startbit*/54,    /*src_cyc*/101,  /*src_id*/0x108,   /*src_dlc*/8,   /*des_cyc*/100,   /*des_id*/0x206, /*src_updatebit*/23,   /*des_updatebit*/55,      /*initvalue*/0         },
           {   /*sig_name*/"isBattFltStsPrimChks_0",   /*src_can*/"CEM_LIN6",   /*src_network_type*/"LIN",   /*src_slotid_fr*/0,   /*src_basecycle_fr*/0,  /*src_repetition_fr*/0,  /*src_startbit*/48,   /*sig_length*/8,  /*des_slotid_fr*/0,   /*des_basecycle_fr*/0,  /*des_repetition_fr*/0,   /*des_startbit*/7,    /*src_cyc*/101,  /*src_id*/8,   /*src_dlc*/8,   /*des_cyc*/70,   /*des_id*/0x99, /*src_updatebit*/1000,   /*des_updatebit*/23,      /*initvalue*/0         },
           {   /*sig_name*/"isBattFltStsPrimBattFltStsPrm_0",   /*src_can*/"CEM_LIN6",   /*src_network_type*/"LIN",   /*src_slotid_fr*/0,   /*src_basecycle_fr*/0,  /*src_repetition_fr*/0,  /*src_startbit*/44,   /*sig_length*/4,  /*des_slotid_fr*/0,   /*des_basecycle_fr*/0,  /*des_repetition_fr*/0,   /*des_startbit*/15,    /*src_cyc*/101,  /*src_id*/8,   /*src_dlc*/8,   /*des_cyc*/70,   /*des_id*/0x99, /*src_updatebit*/1000,   /*des_updatebit*/23,      /*initvalue*/0         },
           {   /*sig_name*/"isBattFltStsPrimCntr_0",   /*src_can*/"CEM_LIN6",   /*src_network_type*/"LIN",   /*src_slotid_fr*/0,   /*src_basecycle_fr*/0,  /*src_repetition_fr*/0,  /*src_startbit*/56,   /*sig_length*/4,  /*des_slotid_fr*/0,   /*des_basecycle_fr*/0,  /*des_repetition_fr*/0,   /*des_startbit*/11,    /*src_cyc*/101,  /*src_id*/8,   /*src_dlc*/8,   /*des_cyc*/70,   /*des_id*/0x99, /*src_updatebit*/1000,   /*des_updatebit*/23,      /*initvalue*/0         }
       }
   },
   {
       /*des_can*/ "ZCUD_CANFD4",
       /*networktype*/ "CANFD",
       4,
       {
           {   /*sig_name*/"isVehSpdLgtCntr_0",   /*src_can*/"ChassisCANFD2",   /*src_network_type*/"CANFD",   /*src_slotid_fr*/0,   /*src_basecycle_fr*/0,  /*src_repetition_fr*/0,  /*src_startbit*/216,   /*sig_length*/4,  /*des_slotid_fr*/0,   /*des_basecycle_fr*/0,  /*des_repetition_fr*/0,   /*des_startbit*/72,    /*src_cyc*/101,  /*src_id*/0x9f,   /*src_dlc*/64,   /*des_cyc*/20,   /*des_id*/0x100, /*src_updatebit*/471,   /*des_updatebit*/82,      /*initvalue*/0         },
           {   /*sig_name*/"isVehSpdLgtA_0",   /*src_can*/"ChassisCANFD2",   /*src_network_type*/"CANFD",   /*src_slotid_fr*/0,   /*src_basecycle_fr*/0,  /*src_repetition_fr*/0,  /*src_startbit*/207,   /*sig_length*/15,  /*des_slotid_fr*/0,   /*des_basecycle_fr*/0,  /*des_repetition_fr*/0,   /*des_startbit*/63,    /*src_cyc*/101,  /*src_id*/0x9f,   /*src_dlc*/64,   /*des_cyc*/20,   /*des_id*/0x100, /*src_updatebit*/471,   /*des_updatebit*/82,      /*initvalue*/0         },
           {   /*sig_name*/"isVehSpdLgtQf_0",   /*src_can*/"ChassisCANFD2",   /*src_network_type*/"CANFD",   /*src_slotid_fr*/0,   /*src_basecycle_fr*/0,  /*src_repetition_fr*/0,  /*src_startbit*/228,   /*sig_length*/2,  /*des_slotid_fr*/0,   /*des_basecycle_fr*/0,  /*des_repetition_fr*/0,   /*des_startbit*/84,    /*src_cyc*/101,  /*src_id*/0x9f,   /*src_dlc*/64,   /*des_cyc*/20,   /*des_id*/0x100, /*src_updatebit*/471,   /*des_updatebit*/82,      /*initvalue*/1         },
           {   /*sig_name*/"isVehSpdLgtChks_0",   /*src_can*/"ChassisCANFD2",   /*src_network_type*/"CANFD",   /*src_slotid_fr*/0,   /*src_basecycle_fr*/0,  /*src_repetition_fr*/0,  /*src_startbit*/208,   /*sig_length*/8,  /*des_slotid_fr*/0,   /*des_basecycle_fr*/0,  /*des_repetition_fr*/0,   /*des_startbit*/64,    /*src_cyc*/101,  /*src_id*/0x9f,   /*src_dlc*/64,   /*des_cyc*/20,   /*des_id*/0x100, /*src_updatebit*/471,   /*des_updatebit*/82,      /*initvalue*/0         }
       }
   },
   {
       /*des_can*/ "ZCU_CANFD2",
       /*networktype*/ "CANFD",
       0,
       {
           0
       }
   },
   {
       /*des_can*/ "BodyExposedCAN",
       /*networktype*/ "CAN",
       4,
       {
           {   /*sig_name*/"isVehSpdLgtCntr_0",   /*src_can*/"ChassisCANFD2",   /*src_network_type*/"CANFD",   /*src_slotid_fr*/0,   /*src_basecycle_fr*/0,  /*src_repetition_fr*/0,  /*src_startbit*/216,   /*sig_length*/4,  /*des_slotid_fr*/0,   /*des_basecycle_fr*/0,  /*des_repetition_fr*/0,   /*des_startbit*/31,    /*src_cyc*/101,  /*src_id*/0x9f,   /*src_dlc*/64,   /*des_cyc*/450,   /*des_id*/0x3a1, /*src_updatebit*/471,   /*des_updatebit*/7,      /*initvalue*/0         },
           {   /*sig_name*/"isVehSpdLgtA_0",   /*src_can*/"ChassisCANFD2",   /*src_network_type*/"CANFD",   /*src_slotid_fr*/0,   /*src_basecycle_fr*/0,  /*src_repetition_fr*/0,  /*src_startbit*/207,   /*sig_length*/15,  /*des_slotid_fr*/0,   /*des_basecycle_fr*/0,  /*des_repetition_fr*/0,   /*des_startbit*/6,    /*src_cyc*/101,  /*src_id*/0x9f,   /*src_dlc*/64,   /*des_cyc*/450,   /*des_id*/0x3a1, /*src_updatebit*/471,   /*des_updatebit*/7,      /*initvalue*/0         },
           {   /*sig_name*/"isVehSpdLgtQf_0",   /*src_can*/"ChassisCANFD2",   /*src_network_type*/"CANFD",   /*src_slotid_fr*/0,   /*src_basecycle_fr*/0,  /*src_repetition_fr*/0,  /*src_startbit*/228,   /*sig_length*/2,  /*des_slotid_fr*/0,   /*des_basecycle_fr*/0,  /*des_repetition_fr*/0,   /*des_startbit*/27,    /*src_cyc*/101,  /*src_id*/0x9f,   /*src_dlc*/64,   /*des_cyc*/450,   /*des_id*/0x3a1, /*src_updatebit*/471,   /*des_updatebit*/7,      /*initvalue*/1         },
           {   /*sig_name*/"isVehSpdLgtChks_0",   /*src_can*/"ChassisCANFD2",   /*src_network_type*/"CANFD",   /*src_slotid_fr*/0,   /*src_basecycle_fr*/0,  /*src_repetition_fr*/0,  /*src_startbit*/208,   /*sig_length*/8,  /*des_slotid_fr*/0,   /*des_basecycle_fr*/0,  /*des_repetition_fr*/0,   /*des_startbit*/23,    /*src_cyc*/101,  /*src_id*/0x9f,   /*src_dlc*/64,   /*des_cyc*/450,   /*des_id*/0x3a1, /*src_updatebit*/471,   /*des_updatebit*/7,      /*initvalue*/0         }
       }
   }
};

  struct gSignalG{
//    int num[1000];
    char sigGroup_s[1000];
    char sig_name[1000];
    char scr_can[1000];
    char scr_network_type[1000];
    int scr_slotid_fr;
    int scr_basecycle_fr;
    int scr_repetition_fr;
    int scr_startbit;
    int sigG_length;
    int des_slotid_fr;
    int des_basecycle_fr;
    int des_repetition_fr;
    int des_startbit;
    int scr_cyc;
    int scr_id;
    int scr_dlc;
    int des_id;  
    int updatebit_S;
    int updatebit_D;
  };
    
 //data for Signal group routing test
  struct SignalGroup{ 
    char des_can[20]; 
    char des_networktype[20];
    int sum;
    struct gSignalG GSignalG[2500];
  };
  
  struct SignalGroup test_sigG[network_quantity]={
    
       {
       /*des_can*/ "ZCUD_LIN1",
       /*networktype*/ "LIN",
       0,
       {
           0
       }
   },
   {
       /*des_can*/ "CEM_LIN3",
       /*networktype*/ "LIN",
       9,
       {
           {   /*sigGroup_s*/"igVehSpdLgt_0",   /*sig_name*/"isVehSpdLgtCntr_0",   /*src_can*/"ChassisCANFD2",   /*src_network_type*/"CANFD",   /*src_slotid_fr*/0,   /*src_basecycle_fr*/0,  /*src_repetition_fr*/0,  /*src_startbit*/216,   /*sigG_length*/4,  /*des_slotid_fr*/0,   /*des_basecycle_fr*/0,  /*des_repetition_fr*/0,   /*des_startbit*/40,    /*src_cyc*/101,  /*src_id*/0x9f,   /*src_dlc*/64,   /*des_id*/36, /*updatebit_S*/471,   /*updatebit_D*/1000         },
           {   /*sigGroup_s*/"igVehSpdLgt_0",   /*sig_name*/"isVehSpdLgtA_0",   /*src_can*/"ChassisCANFD2",   /*src_network_type*/"CANFD",   /*src_slotid_fr*/0,   /*src_basecycle_fr*/0,  /*src_repetition_fr*/0,  /*src_startbit*/207,   /*sigG_length*/15,  /*des_slotid_fr*/0,   /*des_basecycle_fr*/0,  /*des_repetition_fr*/0,   /*des_startbit*/17,    /*src_cyc*/101,  /*src_id*/0x9f,   /*src_dlc*/64,   /*des_id*/36, /*updatebit_S*/471,   /*updatebit_D*/1000         },
           {   /*sigGroup_s*/"igVehSpdLgt_0",   /*sig_name*/"isVehSpdLgtQf_0",   /*src_can*/"ChassisCANFD2",   /*src_network_type*/"CANFD",   /*src_slotid_fr*/0,   /*src_basecycle_fr*/0,  /*src_repetition_fr*/0,  /*src_startbit*/228,   /*sigG_length*/2,  /*des_slotid_fr*/0,   /*des_basecycle_fr*/0,  /*des_repetition_fr*/0,   /*des_startbit*/44,    /*src_cyc*/101,  /*src_id*/0x9f,   /*src_dlc*/64,   /*des_id*/36, /*updatebit_S*/471,   /*updatebit_D*/1000         },
           {   /*sigGroup_s*/"igVehSpdLgt_0",   /*sig_name*/"isVehSpdLgtChks_0",   /*src_can*/"ChassisCANFD2",   /*src_network_type*/"CANFD",   /*src_slotid_fr*/0,   /*src_basecycle_fr*/0,  /*src_repetition_fr*/0,  /*src_startbit*/208,   /*sigG_length*/8,  /*des_slotid_fr*/0,   /*des_basecycle_fr*/0,  /*des_repetition_fr*/0,   /*des_startbit*/32,    /*src_cyc*/101,  /*src_id*/0x9f,   /*src_dlc*/64,   /*des_id*/36, /*updatebit_S*/471,   /*updatebit_D*/1000         },
           {   /*sigGroup_s*/"igPassAirbLampReq_0",   /*sig_name*/"isPassAirbLampReqPassAirbLampEnaReq_0",   /*src_can*/"ZCUD_CAN1",   /*src_network_type*/"CAN",   /*src_slotid_fr*/0,   /*src_basecycle_fr*/0,  /*src_repetition_fr*/0,  /*src_startbit*/53,   /*sigG_length*/2,  /*des_slotid_fr*/0,   /*des_basecycle_fr*/0,  /*des_repetition_fr*/0,   /*des_startbit*/44,    /*src_cyc*/101,  /*src_id*/0x142,   /*src_dlc*/8,   /*des_id*/0, /*updatebit_S*/33,   /*updatebit_D*/1000         },
           {   /*sigGroup_s*/"igPassAirbLampReq_0",   /*sig_name*/"isPassAirbLampReqChgOfPassAirbSts_0",   /*src_can*/"ZCUD_CAN1",   /*src_network_type*/"CAN",   /*src_slotid_fr*/0,   /*src_basecycle_fr*/0,  /*src_repetition_fr*/0,  /*src_startbit*/32,   /*sigG_length*/1,  /*des_slotid_fr*/0,   /*des_basecycle_fr*/0,  /*des_repetition_fr*/0,   /*des_startbit*/48,    /*src_cyc*/101,  /*src_id*/0x142,   /*src_dlc*/8,   /*des_id*/0, /*updatebit_S*/33,   /*updatebit_D*/1000         },
           {   /*sigGroup_s*/"igPassAirbLampReq_0",   /*sig_name*/"isPassAirbLampReqChks_0",   /*src_can*/"ZCUD_CAN1",   /*src_network_type*/"CAN",   /*src_slotid_fr*/0,   /*src_basecycle_fr*/0,  /*src_repetition_fr*/0,  /*src_startbit*/47,   /*sigG_length*/8,  /*des_slotid_fr*/0,   /*des_basecycle_fr*/0,  /*des_repetition_fr*/0,   /*des_startbit*/32,    /*src_cyc*/101,  /*src_id*/0x142,   /*src_dlc*/8,   /*des_id*/0, /*updatebit_S*/33,   /*updatebit_D*/1000         },
           {   /*sigGroup_s*/"igPassAirbLampReq_0",   /*sig_name*/"isPassAirbLampReqPassAirbLampDiReq_0",   /*src_can*/"ZCUD_CAN1",   /*src_network_type*/"CAN",   /*src_slotid_fr*/0,   /*src_basecycle_fr*/0,  /*src_repetition_fr*/0,  /*src_startbit*/55,   /*sigG_length*/2,  /*des_slotid_fr*/0,   /*des_basecycle_fr*/0,  /*des_repetition_fr*/0,   /*des_startbit*/46,    /*src_cyc*/101,  /*src_id*/0x142,   /*src_dlc*/8,   /*des_id*/0, /*updatebit_S*/33,   /*updatebit_D*/1000         },
           {   /*sigGroup_s*/"igPassAirbLampReq_0",   /*sig_name*/"isPassAirbLampReqCntr_0",   /*src_can*/"ZCUD_CAN1",   /*src_network_type*/"CAN",   /*src_slotid_fr*/0,   /*src_basecycle_fr*/0,  /*src_repetition_fr*/0,  /*src_startbit*/51,   /*sigG_length*/4,  /*des_slotid_fr*/0,   /*des_basecycle_fr*/0,  /*des_repetition_fr*/0,   /*des_startbit*/40,    /*src_cyc*/101,  /*src_id*/0x142,   /*src_dlc*/8,   /*des_id*/0, /*updatebit_S*/33,   /*updatebit_D*/1000         }
       }
   },
   {
       /*des_can*/ "CEM_LIN2",
       /*networktype*/ "LIN",
       0,
       {
           0
       }
   },
   {
       /*des_can*/ "CEM_LIN6",
       /*networktype*/ "LIN",
       7,
       {
           {   /*sigGroup_s*/"igVehSpdLgt_0",   /*sig_name*/"isVehSpdLgtCntr_0",   /*src_can*/"ChassisCANFD2",   /*src_network_type*/"CANFD",   /*src_slotid_fr*/0,   /*src_basecycle_fr*/0,  /*src_repetition_fr*/0,  /*src_startbit*/216,   /*sigG_length*/4,  /*des_slotid_fr*/0,   /*des_basecycle_fr*/0,  /*des_repetition_fr*/0,   /*des_startbit*/26,    /*src_cyc*/101,  /*src_id*/0x9f,   /*src_dlc*/64,   /*des_id*/51, /*updatebit_S*/471,   /*updatebit_D*/1000         },
           {   /*sigGroup_s*/"igVehSpdLgt_0",   /*sig_name*/"isVehSpdLgtA_0",   /*src_can*/"ChassisCANFD2",   /*src_network_type*/"CANFD",   /*src_slotid_fr*/0,   /*src_basecycle_fr*/0,  /*src_repetition_fr*/0,  /*src_startbit*/207,   /*sigG_length*/15,  /*des_slotid_fr*/0,   /*des_basecycle_fr*/0,  /*des_repetition_fr*/0,   /*des_startbit*/1,    /*src_cyc*/101,  /*src_id*/0x9f,   /*src_dlc*/64,   /*des_id*/51, /*updatebit_S*/471,   /*updatebit_D*/1000         },
           {   /*sigGroup_s*/"igVehSpdLgt_0",   /*sig_name*/"isVehSpdLgtQf_0",   /*src_can*/"ChassisCANFD2",   /*src_network_type*/"CANFD",   /*src_slotid_fr*/0,   /*src_basecycle_fr*/0,  /*src_repetition_fr*/0,  /*src_startbit*/228,   /*sigG_length*/2,  /*des_slotid_fr*/0,   /*des_basecycle_fr*/0,  /*des_repetition_fr*/0,   /*des_startbit*/24,    /*src_cyc*/101,  /*src_id*/0x9f,   /*src_dlc*/64,   /*des_id*/51, /*updatebit_S*/471,   /*updatebit_D*/1000         },
           {   /*sigGroup_s*/"igVehSpdLgt_0",   /*sig_name*/"isVehSpdLgtChks_0",   /*src_can*/"ChassisCANFD2",   /*src_network_type*/"CANFD",   /*src_slotid_fr*/0,   /*src_basecycle_fr*/0,  /*src_repetition_fr*/0,  /*src_startbit*/208,   /*sigG_length*/8,  /*des_slotid_fr*/0,   /*des_basecycle_fr*/0,  /*des_repetition_fr*/0,   /*des_startbit*/16,    /*src_cyc*/101,  /*src_id*/0x9f,   /*src_dlc*/64,   /*des_id*/51, /*updatebit_S*/471,   /*updatebit_D*/1000         },
           {   /*sigGroup_s*/"igCrashStsSafe_0",   /*sig_name*/"isCrashStsSafeChks_0",   /*src_can*/"ZCUD_CAN1",   /*src_network_type*/"CAN",   /*src_slotid_fr*/0,   /*src_basecycle_fr*/0,  /*src_repetition_fr*/0,  /*src_startbit*/15,   /*sigG_length*/8,  /*des_slotid_fr*/0,   /*des_basecycle_fr*/0,  /*des_repetition_fr*/0,   /*des_startbit*/30,    /*src_cyc*/101,  /*src_id*/0x10,   /*src_dlc*/4,   /*des_id*/51, /*updatebit_S*/5,   /*updatebit_D*/1000         },
           {   /*sigGroup_s*/"igCrashStsSafe_0",   /*sig_name*/"isCrashStsSafeSts_0",   /*src_can*/"ZCUD_CAN1",   /*src_network_type*/"CAN",   /*src_slotid_fr*/0,   /*src_basecycle_fr*/0,  /*src_repetition_fr*/0,  /*src_startbit*/4,   /*sigG_length*/1,  /*des_slotid_fr*/0,   /*des_basecycle_fr*/0,  /*des_repetition_fr*/0,   /*des_startbit*/42,    /*src_cyc*/101,  /*src_id*/0x10,   /*src_dlc*/4,   /*des_id*/51, /*updatebit_S*/5,   /*updatebit_D*/1000         },
           {   /*sigGroup_s*/"igCrashStsSafe_0",   /*sig_name*/"isCrashStsSafeCntr_0",   /*src_can*/"ZCUD_CAN1",   /*src_network_type*/"CAN",   /*src_slotid_fr*/0,   /*src_basecycle_fr*/0,  /*src_repetition_fr*/0,  /*src_startbit*/3,   /*sigG_length*/4,  /*des_slotid_fr*/0,   /*des_basecycle_fr*/0,  /*des_repetition_fr*/0,   /*des_startbit*/38,    /*src_cyc*/101,  /*src_id*/0x10,   /*src_dlc*/4,   /*des_id*/51, /*updatebit_S*/5,   /*updatebit_D*/1000         }
       }
   },
   {
       /*des_can*/ "CEM_LIN1",
       /*networktype*/ "LIN",
       0,
       {
           0
       }
   },
   {
       /*des_can*/ "CEM_LIN4",
       /*networktype*/ "LIN",
       0,
       {
           0
       }
   },
   {
       /*des_can*/ "ZCUD_LIN2",
       /*networktype*/ "LIN",
       0,
       {
           0
       }
   },
   {
       /*des_can*/ "ZCUD_LIN3",
       /*networktype*/ "LIN",
       0,
       {
           0
       }
   },
   {
       /*des_can*/ "CEM_LIN7",
       /*networktype*/ "LIN",
       19,
       {
           {   /*sigGroup_s*/"igFctvSts_0",   /*sig_name*/"isFctvStsVlvPosn_0",   /*src_can*/"ChassisCANFD2",   /*src_network_type*/"CANFD",   /*src_slotid_fr*/0,   /*src_basecycle_fr*/0,  /*src_repetition_fr*/0,  /*src_startbit*/167,   /*sigG_length*/10,  /*des_slotid_fr*/0,   /*des_basecycle_fr*/0,  /*des_repetition_fr*/0,   /*des_startbit*/0,    /*src_cyc*/101,  /*src_id*/0x3cf,   /*src_dlc*/64,   /*des_id*/34, /*updatebit_S*/185,   /*updatebit_D*/1000         },
           {   /*sigGroup_s*/"igFctvSts_0",   /*sig_name*/"isFctvStsVlvOverTErr_0",   /*src_can*/"ChassisCANFD2",   /*src_network_type*/"CANFD",   /*src_slotid_fr*/0,   /*src_basecycle_fr*/0,  /*src_repetition_fr*/0,  /*src_startbit*/179,   /*sigG_length*/1,  /*des_slotid_fr*/0,   /*des_basecycle_fr*/0,  /*des_repetition_fr*/0,   /*des_startbit*/20,    /*src_cyc*/101,  /*src_id*/0x3cf,   /*src_dlc*/64,   /*des_id*/34, /*updatebit_S*/185,   /*updatebit_D*/1000         },
           {   /*sigGroup_s*/"igFctvSts_0",   /*sig_name*/"isFctvStsVlvCalibSts_0",   /*src_can*/"ChassisCANFD2",   /*src_network_type*/"CANFD",   /*src_slotid_fr*/0,   /*src_basecycle_fr*/0,  /*src_repetition_fr*/0,  /*src_startbit*/173,   /*sigG_length*/2,  /*des_slotid_fr*/0,   /*des_basecycle_fr*/0,  /*des_repetition_fr*/0,   /*des_startbit*/10,    /*src_cyc*/101,  /*src_id*/0x3cf,   /*src_dlc*/64,   /*des_id*/34, /*updatebit_S*/185,   /*updatebit_D*/1000         },
           {   /*sigGroup_s*/"igFctvSts_0",   /*sig_name*/"isFctvStsVlvBlkFlt_0",   /*src_can*/"ChassisCANFD2",   /*src_network_type*/"CANFD",   /*src_slotid_fr*/0,   /*src_basecycle_fr*/0,  /*src_repetition_fr*/0,  /*src_startbit*/169,   /*sigG_length*/1,  /*des_slotid_fr*/0,   /*des_basecycle_fr*/0,  /*des_repetition_fr*/0,   /*des_startbit*/14,    /*src_cyc*/101,  /*src_id*/0x3cf,   /*src_dlc*/64,   /*des_id*/34, /*updatebit_S*/185,   /*updatebit_D*/1000         },
           {   /*sigGroup_s*/"igFctvSts_0",   /*sig_name*/"isFctvStsVlvMoveSts_0",   /*src_can*/"ChassisCANFD2",   /*src_network_type*/"CANFD",   /*src_slotid_fr*/0,   /*src_basecycle_fr*/0,  /*src_repetition_fr*/0,  /*src_startbit*/182,   /*sigG_length*/1,  /*des_slotid_fr*/0,   /*des_basecycle_fr*/0,  /*des_repetition_fr*/0,   /*des_startbit*/17,    /*src_cyc*/101,  /*src_id*/0x3cf,   /*src_dlc*/64,   /*des_id*/34, /*updatebit_S*/185,   /*updatebit_D*/1000         },
           {   /*sigGroup_s*/"igFctvSts_0",   /*sig_name*/"isFctvStsVlvUnderUErr_0",   /*src_can*/"ChassisCANFD2",   /*src_network_type*/"CANFD",   /*src_slotid_fr*/0,   /*src_basecycle_fr*/0,  /*src_repetition_fr*/0,  /*src_startbit*/186,   /*sigG_length*/1,  /*des_slotid_fr*/0,   /*des_basecycle_fr*/0,  /*des_repetition_fr*/0,   /*des_startbit*/29,    /*src_cyc*/101,  /*src_id*/0x3cf,   /*src_dlc*/64,   /*des_id*/34, /*updatebit_S*/185,   /*updatebit_D*/1000         },
           {   /*sigGroup_s*/"igFctvSts_0",   /*sig_name*/"isFctvStsVlvPosnUkwnFlt_0",   /*src_can*/"ChassisCANFD2",   /*src_network_type*/"CANFD",   /*src_slotid_fr*/0,   /*src_basecycle_fr*/0,  /*src_repetition_fr*/0,  /*src_startbit*/190,   /*sigG_length*/1,  /*des_slotid_fr*/0,   /*des_basecycle_fr*/0,  /*des_repetition_fr*/0,   /*des_startbit*/25,    /*src_cyc*/101,  /*src_id*/0x3cf,   /*src_dlc*/64,   /*des_id*/34, /*updatebit_S*/185,   /*updatebit_D*/1000         },
           {   /*sigGroup_s*/"igFctvSts_0",   /*sig_name*/"isFctvStsVlvNVMFlt_0",   /*src_can*/"ChassisCANFD2",   /*src_network_type*/"CANFD",   /*src_slotid_fr*/0,   /*src_basecycle_fr*/0,  /*src_repetition_fr*/0,  /*src_startbit*/181,   /*sigG_length*/1,  /*des_slotid_fr*/0,   /*des_basecycle_fr*/0,  /*des_repetition_fr*/0,   /*des_startbit*/18,    /*src_cyc*/101,  /*src_id*/0x3cf,   /*src_dlc*/64,   /*des_id*/34, /*updatebit_S*/185,   /*updatebit_D*/1000         },
           {   /*sigGroup_s*/"igFctvSts_0",   /*sig_name*/"isFctvStsVlvOverUErr_0",   /*src_can*/"ChassisCANFD2",   /*src_network_type*/"CANFD",   /*src_slotid_fr*/0,   /*src_basecycle_fr*/0,  /*src_repetition_fr*/0,  /*src_startbit*/176,   /*sigG_length*/1,  /*des_slotid_fr*/0,   /*des_basecycle_fr*/0,  /*des_repetition_fr*/0,   /*des_startbit*/23,    /*src_cyc*/101,  /*src_id*/0x3cf,   /*src_dlc*/64,   /*des_id*/34, /*updatebit_S*/185,   /*updatebit_D*/1000         },
           {   /*sigGroup_s*/"igFctvSts_0",   /*sig_name*/"isFctvStsVlvSpdLvlSts_0",   /*src_can*/"ChassisCANFD2",   /*src_network_type*/"CANFD",   /*src_slotid_fr*/0,   /*src_basecycle_fr*/0,  /*src_repetition_fr*/0,  /*src_startbit*/171,   /*sigG_length*/2,  /*des_slotid_fr*/0,   /*des_basecycle_fr*/0,  /*des_repetition_fr*/0,   /*des_startbit*/12,    /*src_cyc*/101,  /*src_id*/0x3cf,   /*src_dlc*/64,   /*des_id*/34, /*updatebit_S*/185,   /*updatebit_D*/1000         },
           {   /*sigGroup_s*/"igFctvSts_0",   /*sig_name*/"isFctvStsVlvPosnCtrlTimeOutFlt_0",   /*src_can*/"ChassisCANFD2",   /*src_network_type*/"CANFD",   /*src_slotid_fr*/0,   /*src_basecycle_fr*/0,  /*src_repetition_fr*/0,  /*src_startbit*/191,   /*sigG_length*/1,  /*des_slotid_fr*/0,   /*des_basecycle_fr*/0,  /*des_repetition_fr*/0,   /*des_startbit*/24,    /*src_cyc*/101,  /*src_id*/0x3cf,   /*src_dlc*/64,   /*des_id*/34, /*updatebit_S*/185,   /*updatebit_D*/1000         },
           {   /*sigGroup_s*/"igFctvSts_0",   /*sig_name*/"isFctvStsVlvOpenCircFlt_0",   /*src_can*/"ChassisCANFD2",   /*src_network_type*/"CANFD",   /*src_slotid_fr*/0,   /*src_basecycle_fr*/0,  /*src_repetition_fr*/0,  /*src_startbit*/180,   /*sigG_length*/1,  /*des_slotid_fr*/0,   /*des_basecycle_fr*/0,  /*des_repetition_fr*/0,   /*des_startbit*/19,    /*src_cyc*/101,  /*src_id*/0x3cf,   /*src_dlc*/64,   /*des_id*/34, /*updatebit_S*/185,   /*updatebit_D*/1000         },
           {   /*sigGroup_s*/"igFctvSts_0",   /*sig_name*/"isFctvStsVlvOverTWarn_0",   /*src_can*/"ChassisCANFD2",   /*src_network_type*/"CANFD",   /*src_slotid_fr*/0,   /*src_basecycle_fr*/0,  /*src_repetition_fr*/0,  /*src_startbit*/177,   /*sigG_length*/1,  /*des_slotid_fr*/0,   /*des_basecycle_fr*/0,  /*des_repetition_fr*/0,   /*des_startbit*/22,    /*src_cyc*/101,  /*src_id*/0x3cf,   /*src_dlc*/64,   /*des_id*/34, /*updatebit_S*/185,   /*updatebit_D*/1000         },
           {   /*sigGroup_s*/"igFctvSts_0",   /*sig_name*/"isFctvStsVlvSelfLearnFlt_0",   /*src_can*/"ChassisCANFD2",   /*src_network_type*/"CANFD",   /*src_slotid_fr*/0,   /*src_basecycle_fr*/0,  /*src_repetition_fr*/0,  /*src_startbit*/188,   /*sigG_length*/1,  /*des_slotid_fr*/0,   /*des_basecycle_fr*/0,  /*des_repetition_fr*/0,   /*des_startbit*/27,    /*src_cyc*/101,  /*src_id*/0x3cf,   /*src_dlc*/64,   /*des_id*/34, /*updatebit_S*/185,   /*updatebit_D*/1000         },
           {   /*sigGroup_s*/"igFctvSts_0",   /*sig_name*/"isFctvStsVlvCmdPosnErr_0",   /*src_can*/"ChassisCANFD2",   /*src_network_type*/"CANFD",   /*src_slotid_fr*/0,   /*src_basecycle_fr*/0,  /*src_repetition_fr*/0,  /*src_startbit*/168,   /*sigG_length*/1,  /*des_slotid_fr*/0,   /*des_basecycle_fr*/0,  /*des_repetition_fr*/0,   /*des_startbit*/15,    /*src_cyc*/101,  /*src_id*/0x3cf,   /*src_dlc*/64,   /*des_id*/34, /*updatebit_S*/185,   /*updatebit_D*/1000         },
           {   /*sigGroup_s*/"igFctvSts_0",   /*sig_name*/"isFctvStsVlvShoCircFlt_0",   /*src_can*/"ChassisCANFD2",   /*src_network_type*/"CANFD",   /*src_slotid_fr*/0,   /*src_basecycle_fr*/0,  /*src_repetition_fr*/0,  /*src_startbit*/187,   /*sigG_length*/1,  /*des_slotid_fr*/0,   /*des_basecycle_fr*/0,  /*des_repetition_fr*/0,   /*des_startbit*/28,    /*src_cyc*/101,  /*src_id*/0x3cf,   /*src_dlc*/64,   /*des_id*/34, /*updatebit_S*/185,   /*updatebit_D*/1000         },
           {   /*sigGroup_s*/"igFctvSts_0",   /*sig_name*/"isFctvStsVlvLoTErr_0",   /*src_can*/"ChassisCANFD2",   /*src_network_type*/"CANFD",   /*src_slotid_fr*/0,   /*src_basecycle_fr*/0,  /*src_repetition_fr*/0,  /*src_startbit*/183,   /*sigG_length*/1,  /*des_slotid_fr*/0,   /*des_basecycle_fr*/0,  /*des_repetition_fr*/0,   /*des_startbit*/16,    /*src_cyc*/101,  /*src_id*/0x3cf,   /*src_dlc*/64,   /*des_id*/34, /*updatebit_S*/185,   /*updatebit_D*/1000         },
           {   /*sigGroup_s*/"igFctvSts_0",   /*sig_name*/"isFctvStsVlvPreHeatgSts_0",   /*src_can*/"ChassisCANFD2",   /*src_network_type*/"CANFD",   /*src_slotid_fr*/0,   /*src_basecycle_fr*/0,  /*src_repetition_fr*/0,  /*src_startbit*/189,   /*sigG_length*/1,  /*des_slotid_fr*/0,   /*des_basecycle_fr*/0,  /*des_repetition_fr*/0,   /*des_startbit*/26,    /*src_cyc*/101,  /*src_id*/0x3cf,   /*src_dlc*/64,   /*des_id*/34, /*updatebit_S*/185,   /*updatebit_D*/1000         },
           {   /*sigGroup_s*/"igFctvSts_0",   /*sig_name*/"isFctvStsVlvOverTrvlFlt_0",   /*src_can*/"ChassisCANFD2",   /*src_network_type*/"CANFD",   /*src_slotid_fr*/0,   /*src_basecycle_fr*/0,  /*src_repetition_fr*/0,  /*src_startbit*/178,   /*sigG_length*/1,  /*des_slotid_fr*/0,   /*des_basecycle_fr*/0,  /*des_repetition_fr*/0,   /*des_startbit*/21,    /*src_cyc*/101,  /*src_id*/0x3cf,   /*src_dlc*/64,   /*des_id*/34, /*updatebit_S*/185,   /*updatebit_D*/1000         }
       }
   },
   {
       /*des_can*/ "PropulsionCAN",
       /*networktype*/ "CAN",
       17,
       {
           {   /*sigGroup_s*/"igPtTqAtAxleMaxReq_0",   /*sig_name*/"isPtTqAtAxleMaxReqCntr_0",   /*src_can*/"ChassisCANFD2",   /*src_network_type*/"CANFD",   /*src_slotid_fr*/0,   /*src_basecycle_fr*/0,  /*src_repetition_fr*/0,  /*src_startbit*/235,   /*sigG_length*/4,  /*des_slotid_fr*/0,   /*des_basecycle_fr*/0,  /*des_repetition_fr*/0,   /*des_startbit*/19,    /*src_cyc*/101,  /*src_id*/0x67,   /*src_dlc*/64,   /*des_id*/0x41, /*updatebit_S*/465,   /*updatebit_D*/20         },
           {   /*sigGroup_s*/"igPtTqAtAxleMaxReq_0",   /*sig_name*/"isPtTqAtAxleMaxReqChks_0",   /*src_can*/"ChassisCANFD2",   /*src_network_type*/"CANFD",   /*src_slotid_fr*/0,   /*src_basecycle_fr*/0,  /*src_repetition_fr*/0,  /*src_startbit*/227,   /*sigG_length*/8,  /*des_slotid_fr*/0,   /*des_basecycle_fr*/0,  /*des_repetition_fr*/0,   /*des_startbit*/31,    /*src_cyc*/101,  /*src_id*/0x67,   /*src_dlc*/64,   /*des_id*/0x41, /*updatebit_S*/465,   /*updatebit_D*/20         },
           {   /*sigGroup_s*/"igPtTqAtAxleMaxReq_0",   /*sig_name*/"isPtTqAtAxleMaxReqPtTqAtAxleReReq_0",   /*src_can*/"ChassisCANFD2",   /*src_network_type*/"CANFD",   /*src_slotid_fr*/0,   /*src_basecycle_fr*/0,  /*src_repetition_fr*/0,  /*src_startbit*/211,   /*sigG_length*/16,  /*des_slotid_fr*/0,   /*des_basecycle_fr*/0,  /*des_repetition_fr*/0,   /*des_startbit*/55,    /*src_cyc*/101,  /*src_id*/0x67,   /*src_dlc*/64,   /*des_id*/0x41, /*updatebit_S*/465,   /*updatebit_D*/20         },
           {   /*sigGroup_s*/"igPtTqAtAxleMaxReq_0",   /*sig_name*/"isPtTqAtAxleMaxReqPtTqAtAxleFrntReq_0",   /*src_can*/"ChassisCANFD2",   /*src_network_type*/"CANFD",   /*src_slotid_fr*/0,   /*src_basecycle_fr*/0,  /*src_repetition_fr*/0,  /*src_startbit*/195,   /*sigG_length*/16,  /*des_slotid_fr*/0,   /*des_basecycle_fr*/0,  /*des_repetition_fr*/0,   /*des_startbit*/39,    /*src_cyc*/101,  /*src_id*/0x67,   /*src_dlc*/64,   /*des_id*/0x41, /*updatebit_S*/465,   /*updatebit_D*/20         },
           {   /*sigGroup_s*/"igVehSpdLgt_0",   /*sig_name*/"isVehSpdLgtCntr_0",   /*src_can*/"ChassisCANFD2",   /*src_network_type*/"CANFD",   /*src_slotid_fr*/0,   /*src_basecycle_fr*/0,  /*src_repetition_fr*/0,  /*src_startbit*/216,   /*sigG_length*/4,  /*des_slotid_fr*/0,   /*des_basecycle_fr*/0,  /*des_repetition_fr*/0,   /*des_startbit*/63,    /*src_cyc*/101,  /*src_id*/0x9f,   /*src_dlc*/64,   /*des_id*/0x76, /*updatebit_S*/471,   /*updatebit_D*/39         },
           {   /*sigGroup_s*/"igVehSpdLgt_0",   /*sig_name*/"isVehSpdLgtA_0",   /*src_can*/"ChassisCANFD2",   /*src_network_type*/"CANFD",   /*src_slotid_fr*/0,   /*src_basecycle_fr*/0,  /*src_repetition_fr*/0,  /*src_startbit*/207,   /*sigG_length*/15,  /*des_slotid_fr*/0,   /*des_basecycle_fr*/0,  /*des_repetition_fr*/0,   /*des_startbit*/38,    /*src_cyc*/101,  /*src_id*/0x9f,   /*src_dlc*/64,   /*des_id*/0x76, /*updatebit_S*/471,   /*updatebit_D*/39         },
           {   /*sigGroup_s*/"igVehSpdLgt_0",   /*sig_name*/"isVehSpdLgtQf_0",   /*src_can*/"ChassisCANFD2",   /*src_network_type*/"CANFD",   /*src_slotid_fr*/0,   /*src_basecycle_fr*/0,  /*src_repetition_fr*/0,  /*src_startbit*/228,   /*sigG_length*/2,  /*des_slotid_fr*/0,   /*des_basecycle_fr*/0,  /*des_repetition_fr*/0,   /*des_startbit*/59,    /*src_cyc*/101,  /*src_id*/0x9f,   /*src_dlc*/64,   /*des_id*/0x76, /*updatebit_S*/471,   /*updatebit_D*/39         },
           {   /*sigGroup_s*/"igVehSpdLgt_0",   /*sig_name*/"isVehSpdLgtChks_0",   /*src_can*/"ChassisCANFD2",   /*src_network_type*/"CANFD",   /*src_slotid_fr*/0,   /*src_basecycle_fr*/0,  /*src_repetition_fr*/0,  /*src_startbit*/208,   /*sigG_length*/8,  /*des_slotid_fr*/0,   /*des_basecycle_fr*/0,  /*des_repetition_fr*/0,   /*des_startbit*/55,    /*src_cyc*/101,  /*src_id*/0x9f,   /*src_dlc*/64,   /*des_id*/0x76, /*updatebit_S*/471,   /*updatebit_D*/39         },
           {   /*sigGroup_s*/"igBattSocRaw_0",   /*sig_name*/"isBattSocRawChks_0",   /*src_can*/"CEM_LIN6",   /*src_network_type*/"LIN",   /*src_slotid_fr*/0,   /*src_basecycle_fr*/0,  /*src_repetition_fr*/0,  /*src_startbit*/42,   /*sigG_length*/8,  /*des_slotid_fr*/0,   /*des_basecycle_fr*/0,  /*des_repetition_fr*/0,   /*des_startbit*/53,    /*src_cyc*/101,  /*src_id*/32,   /*src_dlc*/7,   /*des_id*/0x198, /*updatebit_S*/1000,   /*updatebit_D*/32         },
           {   /*sigGroup_s*/"igBattSocRaw_0",   /*sig_name*/"isBattSocRawSoc_0",   /*src_can*/"CEM_LIN6",   /*src_network_type*/"LIN",   /*src_slotid_fr*/0,   /*src_basecycle_fr*/0,  /*src_repetition_fr*/0,  /*src_startbit*/32,   /*sigG_length*/10,  /*des_slotid_fr*/0,   /*des_basecycle_fr*/0,  /*des_repetition_fr*/0,   /*des_startbit*/47,    /*src_cyc*/101,  /*src_id*/32,   /*src_dlc*/7,   /*des_id*/0x198, /*updatebit_S*/1000,   /*updatebit_D*/32         },
           {   /*sigGroup_s*/"igBattSocRaw_0",   /*sig_name*/"isBattSocRawCntr_0",   /*src_can*/"CEM_LIN6",   /*src_network_type*/"LIN",   /*src_slotid_fr*/0,   /*src_basecycle_fr*/0,  /*src_repetition_fr*/0,  /*src_startbit*/50,   /*sigG_length*/4,  /*des_slotid_fr*/0,   /*des_basecycle_fr*/0,  /*des_repetition_fr*/0,   /*des_startbit*/61,    /*src_cyc*/101,  /*src_id*/32,   /*src_dlc*/7,   /*des_id*/0x198, /*updatebit_S*/1000,   /*updatebit_D*/32         },
           {   /*sigGroup_s*/"igStcStsMinToDmc_0",   /*sig_name*/"isStcStsMinToDmcStcStsToDmcFrnt_0",   /*src_can*/"ChassisCANFD2",   /*src_network_type*/"CANFD",   /*src_slotid_fr*/0,   /*src_basecycle_fr*/0,  /*src_repetition_fr*/0,  /*src_startbit*/399,   /*sigG_length*/8,  /*des_slotid_fr*/0,   /*des_basecycle_fr*/0,  /*des_repetition_fr*/0,   /*des_startbit*/47,    /*src_cyc*/101,  /*src_id*/0x55,   /*src_dlc*/64,   /*des_id*/0x54, /*updatebit_S*/411,   /*updatebit_D*/59         },
           {   /*sigGroup_s*/"igStcStsMinToDmc_0",   /*sig_name*/"isStcStsMinToDmcCntr_0",   /*src_can*/"ChassisCANFD2",   /*src_network_type*/"CANFD",   /*src_slotid_fr*/0,   /*src_basecycle_fr*/0,  /*src_repetition_fr*/0,  /*src_startbit*/415,   /*sigG_length*/4,  /*des_slotid_fr*/0,   /*des_basecycle_fr*/0,  /*des_repetition_fr*/0,   /*des_startbit*/63,    /*src_cyc*/101,  /*src_id*/0x55,   /*src_dlc*/64,   /*des_id*/0x54, /*updatebit_S*/411,   /*updatebit_D*/59         },
           {   /*sigGroup_s*/"igStcStsMinToDmc_0",   /*sig_name*/"isStcStsMinToDmcChks_0",   /*src_can*/"ChassisCANFD2",   /*src_network_type*/"CANFD",   /*src_slotid_fr*/0,   /*src_basecycle_fr*/0,  /*src_repetition_fr*/0,  /*src_startbit*/391,   /*sigG_length*/8,  /*des_slotid_fr*/0,   /*des_basecycle_fr*/0,  /*des_repetition_fr*/0,   /*des_startbit*/39,    /*src_cyc*/101,  /*src_id*/0x55,   /*src_dlc*/64,   /*des_id*/0x54, /*updatebit_S*/411,   /*updatebit_D*/59         },
           {   /*sigGroup_s*/"igStcStsMinToDmc_0",   /*sig_name*/"isStcStsMinToDmcStcStsToDmcRear_0",   /*src_can*/"ChassisCANFD2",   /*src_network_type*/"CANFD",   /*src_slotid_fr*/0,   /*src_basecycle_fr*/0,  /*src_repetition_fr*/0,  /*src_startbit*/407,   /*sigG_length*/8,  /*des_slotid_fr*/0,   /*des_basecycle_fr*/0,  /*des_repetition_fr*/0,   /*des_startbit*/55,    /*src_cyc*/101,  /*src_id*/0x55,   /*src_dlc*/64,   /*des_id*/0x54, /*updatebit_S*/411,   /*updatebit_D*/59         },
           {   /*sigGroup_s*/"igStcStsMinToDmc_0",   /*sig_name*/"isStcStsMinToDmcEngRotTarSpdDMCFrnt_0",   /*src_can*/"ChassisCANFD2",   /*src_network_type*/"CANFD",   /*src_slotid_fr*/0,   /*src_basecycle_fr*/0,  /*src_repetition_fr*/0,  /*src_startbit*/359,   /*sigG_length*/16,  /*des_slotid_fr*/0,   /*des_basecycle_fr*/0,  /*des_repetition_fr*/0,   /*des_startbit*/7,    /*src_cyc*/101,  /*src_id*/0x55,   /*src_dlc*/64,   /*des_id*/0x54, /*updatebit_S*/411,   /*updatebit_D*/59         },
           {   /*sigGroup_s*/"igStcStsMinToDmc_0",   /*sig_name*/"isStcStsMinToDmcEngRotTarSpdDMCRear_0",   /*src_can*/"ChassisCANFD2",   /*src_network_type*/"CANFD",   /*src_slotid_fr*/0,   /*src_basecycle_fr*/0,  /*src_repetition_fr*/0,  /*src_startbit*/375,   /*sigG_length*/16,  /*des_slotid_fr*/0,   /*des_basecycle_fr*/0,  /*des_repetition_fr*/0,   /*des_startbit*/23,    /*src_cyc*/101,  /*src_id*/0x55,   /*src_dlc*/64,   /*des_id*/0x54, /*updatebit_S*/411,   /*updatebit_D*/59         }
       }
   },
   {
       /*des_can*/ "ChassisCAN1",
       /*networktype*/ "CAN",
       31,
       {
           {   /*sigGroup_s*/"igAmbTIndcdWithUnit_0",   /*sig_name*/"isAmbTIndcdWithUnitAmbTIndcdUnit_0",   /*src_can*/"PropulsionCAN",   /*src_network_type*/"CAN",   /*src_slotid_fr*/0,   /*src_basecycle_fr*/0,  /*src_repetition_fr*/0,  /*src_startbit*/11,   /*sigG_length*/2,  /*des_slotid_fr*/0,   /*des_basecycle_fr*/0,  /*des_repetition_fr*/0,   /*des_startbit*/23,    /*src_cyc*/101,  /*src_id*/0x26b,   /*src_dlc*/8,   /*des_id*/0x3a0, /*updatebit_S*/23,   /*updatebit_D*/9         },
           {   /*sigGroup_s*/"igAmbTIndcdWithUnit_0",   /*sig_name*/"isAmbTIndcdWithUnitAmbTIndcd_0",   /*src_can*/"PropulsionCAN",   /*src_network_type*/"CAN",   /*src_slotid_fr*/0,   /*src_basecycle_fr*/0,  /*src_repetition_fr*/0,  /*src_startbit*/7,   /*sigG_length*/12,  /*des_slotid_fr*/0,   /*des_basecycle_fr*/0,  /*des_repetition_fr*/0,   /*des_startbit*/19,    /*src_cyc*/101,  /*src_id*/0x26b,   /*src_dlc*/8,   /*des_id*/0x3a0, /*updatebit_S*/23,   /*updatebit_D*/9         },
           {   /*sigGroup_s*/"igAmbTIndcdWithUnit_0",   /*sig_name*/"isAmbTIndcdWithUnitQF_0",   /*src_can*/"PropulsionCAN",   /*src_network_type*/"CAN",   /*src_slotid_fr*/0,   /*src_basecycle_fr*/0,  /*src_repetition_fr*/0,  /*src_startbit*/9,   /*sigG_length*/2,  /*des_slotid_fr*/0,   /*des_basecycle_fr*/0,  /*des_repetition_fr*/0,   /*des_startbit*/21,    /*src_cyc*/101,  /*src_id*/0x26b,   /*src_dlc*/8,   /*des_id*/0x3a0, /*updatebit_S*/23,   /*updatebit_D*/9         },
           {   /*sigGroup_s*/"igADataRawSafe_0",   /*sig_name*/"isADataRawSafeALgt_0",   /*src_can*/"ZCUD_CAN1",   /*src_network_type*/"CAN",   /*src_slotid_fr*/0,   /*src_basecycle_fr*/0,  /*src_repetition_fr*/0,  /*src_startbit*/38,   /*sigG_length*/15,  /*des_slotid_fr*/0,   /*des_basecycle_fr*/0,  /*des_repetition_fr*/0,   /*des_startbit*/38,    /*src_cyc*/101,  /*src_id*/0x12,   /*src_dlc*/8,   /*des_id*/0xa0, /*updatebit_S*/56,   /*updatebit_D*/56         },
           {   /*sigGroup_s*/"igADataRawSafe_0",   /*sig_name*/"isADataRawSafeALgt1Qf_0",   /*src_can*/"ZCUD_CAN1",   /*src_network_type*/"CAN",   /*src_slotid_fr*/0,   /*src_basecycle_fr*/0,  /*src_repetition_fr*/0,  /*src_startbit*/9,   /*sigG_length*/2,  /*des_slotid_fr*/0,   /*des_basecycle_fr*/0,  /*des_repetition_fr*/0,   /*des_startbit*/9,    /*src_cyc*/101,  /*src_id*/0x12,   /*src_dlc*/8,   /*des_id*/0xa0, /*updatebit_S*/56,   /*updatebit_D*/56         },
           {   /*sigGroup_s*/"igADataRawSafe_0",   /*sig_name*/"isADataRawSafeALat_0",   /*src_can*/"ZCUD_CAN1",   /*src_network_type*/"CAN",   /*src_slotid_fr*/0,   /*src_basecycle_fr*/0,  /*src_repetition_fr*/0,  /*src_startbit*/23,   /*sigG_length*/15,  /*des_slotid_fr*/0,   /*des_basecycle_fr*/0,  /*des_repetition_fr*/0,   /*des_startbit*/23,    /*src_cyc*/101,  /*src_id*/0x12,   /*src_dlc*/8,   /*des_id*/0xa0, /*updatebit_S*/56,   /*updatebit_D*/56         },
           {   /*sigGroup_s*/"igADataRawSafe_0",   /*sig_name*/"isADataRawSafeAVert_0",   /*src_can*/"ZCUD_CAN1",   /*src_network_type*/"CAN",   /*src_slotid_fr*/0,   /*src_basecycle_fr*/0,  /*src_repetition_fr*/0,  /*src_startbit*/55,   /*sigG_length*/15,  /*des_slotid_fr*/0,   /*des_basecycle_fr*/0,  /*des_repetition_fr*/0,   /*des_startbit*/55,    /*src_cyc*/101,  /*src_id*/0x12,   /*src_dlc*/8,   /*des_id*/0xa0, /*updatebit_S*/56,   /*updatebit_D*/56         },
           {   /*sigGroup_s*/"igADataRawSafe_0",   /*sig_name*/"isADataRawSafeALat1Qf_0",   /*src_can*/"ZCUD_CAN1",   /*src_network_type*/"CAN",   /*src_slotid_fr*/0,   /*src_basecycle_fr*/0,  /*src_repetition_fr*/0,  /*src_startbit*/11,   /*sigG_length*/2,  /*des_slotid_fr*/0,   /*des_basecycle_fr*/0,  /*des_repetition_fr*/0,   /*des_startbit*/11,    /*src_cyc*/101,  /*src_id*/0x12,   /*src_dlc*/8,   /*des_id*/0xa0, /*updatebit_S*/56,   /*updatebit_D*/56         },
           {   /*sigGroup_s*/"igADataRawSafe_0",   /*sig_name*/"isADataRawSafeChks_0",   /*src_can*/"ZCUD_CAN1",   /*src_network_type*/"CAN",   /*src_slotid_fr*/0,   /*src_basecycle_fr*/0,  /*src_repetition_fr*/0,  /*src_startbit*/7,   /*sigG_length*/8,  /*des_slotid_fr*/0,   /*des_basecycle_fr*/0,  /*des_repetition_fr*/0,   /*des_startbit*/7,    /*src_cyc*/101,  /*src_id*/0x12,   /*src_dlc*/8,   /*des_id*/0xa0, /*updatebit_S*/56,   /*updatebit_D*/56         },
           {   /*sigGroup_s*/"igADataRawSafe_0",   /*sig_name*/"isADataRawSafeAVertQf_0",   /*src_can*/"ZCUD_CAN1",   /*src_network_type*/"CAN",   /*src_slotid_fr*/0,   /*src_basecycle_fr*/0,  /*src_repetition_fr*/0,  /*src_startbit*/24,   /*sigG_length*/2,  /*des_slotid_fr*/0,   /*des_basecycle_fr*/0,  /*des_repetition_fr*/0,   /*des_startbit*/24,    /*src_cyc*/101,  /*src_id*/0x12,   /*src_dlc*/8,   /*des_id*/0xa0, /*updatebit_S*/56,   /*updatebit_D*/56         },
           {   /*sigGroup_s*/"igADataRawSafe_0",   /*sig_name*/"isADataRawSafeCntr_0",   /*src_can*/"ZCUD_CAN1",   /*src_network_type*/"CAN",   /*src_slotid_fr*/0,   /*src_basecycle_fr*/0,  /*src_repetition_fr*/0,  /*src_startbit*/15,   /*sigG_length*/4,  /*des_slotid_fr*/0,   /*des_basecycle_fr*/0,  /*des_repetition_fr*/0,   /*des_startbit*/15,    /*src_cyc*/101,  /*src_id*/0x12,   /*src_dlc*/8,   /*des_id*/0xa0, /*updatebit_S*/56,   /*updatebit_D*/56         },
           {   /*sigGroup_s*/"igAgDataCmpQuality_0",   /*sig_name*/"isAgDataCmpQualityYawRateCmpQuality_0",   /*src_can*/"ZCUD_CAN1",   /*src_network_type*/"CAN",   /*src_slotid_fr*/0,   /*src_basecycle_fr*/0,  /*src_repetition_fr*/0,  /*src_startbit*/23,   /*sigG_length*/8,  /*des_slotid_fr*/0,   /*des_basecycle_fr*/0,  /*des_repetition_fr*/0,   /*des_startbit*/23,    /*src_cyc*/101,  /*src_id*/0x230,   /*src_dlc*/8,   /*des_id*/0x1a, /*updatebit_S*/31,   /*updatebit_D*/43         },
           {   /*sigGroup_s*/"igAgDataCmpQuality_0",   /*sig_name*/"isAgDataCmpQualityRollRateCmpQuality_0",   /*src_can*/"ZCUD_CAN1",   /*src_network_type*/"CAN",   /*src_slotid_fr*/0,   /*src_basecycle_fr*/0,  /*src_repetition_fr*/0,  /*src_startbit*/15,   /*sigG_length*/8,  /*des_slotid_fr*/0,   /*des_basecycle_fr*/0,  /*des_repetition_fr*/0,   /*des_startbit*/15,    /*src_cyc*/101,  /*src_id*/0x230,   /*src_dlc*/8,   /*des_id*/0x1a, /*updatebit_S*/31,   /*updatebit_D*/43         },
           {   /*sigGroup_s*/"igAgDataCmpQuality_0",   /*sig_name*/"isAgDataCmpQualityPitchRateCmpQuality_0",   /*src_can*/"ZCUD_CAN1",   /*src_network_type*/"CAN",   /*src_slotid_fr*/0,   /*src_basecycle_fr*/0,  /*src_repetition_fr*/0,  /*src_startbit*/7,   /*sigG_length*/8,  /*des_slotid_fr*/0,   /*des_basecycle_fr*/0,  /*des_repetition_fr*/0,   /*des_startbit*/7,    /*src_cyc*/101,  /*src_id*/0x230,   /*src_dlc*/8,   /*des_id*/0x1a, /*updatebit_S*/31,   /*updatebit_D*/43         },
           {   /*sigGroup_s*/"igIDcDcActLoSide_0",   /*sig_name*/"isIDcDcActLoSideChks_0",   /*src_can*/"PropulsionCAN",   /*src_network_type*/"CAN",   /*src_slotid_fr*/0,   /*src_basecycle_fr*/0,  /*src_repetition_fr*/0,  /*src_startbit*/31,   /*sigG_length*/8,  /*des_slotid_fr*/0,   /*des_basecycle_fr*/0,  /*des_repetition_fr*/0,   /*des_startbit*/15,    /*src_cyc*/101,  /*src_id*/0x149,   /*src_dlc*/8,   /*des_id*/0x244, /*updatebit_S*/20,   /*updatebit_D*/4         },
           {   /*sigGroup_s*/"igIDcDcActLoSide_0",   /*sig_name*/"isIDcDcActLoSideCntr_0",   /*src_can*/"PropulsionCAN",   /*src_network_type*/"CAN",   /*src_slotid_fr*/0,   /*src_basecycle_fr*/0,  /*src_repetition_fr*/0,  /*src_startbit*/19,   /*sigG_length*/4,  /*des_slotid_fr*/0,   /*des_basecycle_fr*/0,  /*des_repetition_fr*/0,   /*des_startbit*/3,    /*src_cyc*/101,  /*src_id*/0x149,   /*src_dlc*/8,   /*des_id*/0x244, /*updatebit_S*/20,   /*updatebit_D*/4         },
           {   /*sigGroup_s*/"igIDcDcActLoSide_0",   /*sig_name*/"isIDcDcActLoSideIDcDcActLoSide_0",   /*src_can*/"PropulsionCAN",   /*src_network_type*/"CAN",   /*src_slotid_fr*/0,   /*src_basecycle_fr*/0,  /*src_repetition_fr*/0,  /*src_startbit*/39,   /*sigG_length*/12,  /*des_slotid_fr*/0,   /*des_basecycle_fr*/0,  /*des_repetition_fr*/0,   /*des_startbit*/23,    /*src_cyc*/101,  /*src_id*/0x149,   /*src_dlc*/8,   /*des_id*/0x244, /*updatebit_S*/20,   /*updatebit_D*/4         },
           {   /*sigGroup_s*/"igAgDataRawSafe_0",   /*sig_name*/"isAgDataRawSafeYawRate_0",   /*src_can*/"ZCUD_CAN1",   /*src_network_type*/"CAN",   /*src_slotid_fr*/0,   /*src_basecycle_fr*/0,  /*src_repetition_fr*/0,  /*src_startbit*/31,   /*sigG_length*/16,  /*des_slotid_fr*/0,   /*des_basecycle_fr*/0,  /*des_repetition_fr*/0,   /*des_startbit*/23,    /*src_cyc*/101,  /*src_id*/0x89,   /*src_dlc*/8,   /*des_id*/0x1b0, /*updatebit_S*/5,   /*updatebit_D*/55         },
           {   /*sigGroup_s*/"igAgDataRawSafe_0",   /*sig_name*/"isAgDataRawSafeRollRateQf_0",   /*src_can*/"ZCUD_CAN1",   /*src_network_type*/"CAN",   /*src_slotid_fr*/0,   /*src_basecycle_fr*/0,  /*src_repetition_fr*/0,  /*src_startbit*/51,   /*sigG_length*/2,  /*des_slotid_fr*/0,   /*des_basecycle_fr*/0,  /*des_repetition_fr*/0,   /*des_startbit*/43,    /*src_cyc*/101,  /*src_id*/0x89,   /*src_dlc*/8,   /*des_id*/0x1b0, /*updatebit_S*/5,   /*updatebit_D*/55         },
           {   /*sigGroup_s*/"igAgDataRawSafe_0",   /*sig_name*/"isAgDataRawSafeCntr_0",   /*src_can*/"ZCUD_CAN1",   /*src_network_type*/"CAN",   /*src_slotid_fr*/0,   /*src_basecycle_fr*/0,  /*src_repetition_fr*/0,  /*src_startbit*/55,   /*sigG_length*/4,  /*des_slotid_fr*/0,   /*des_basecycle_fr*/0,  /*des_repetition_fr*/0,   /*des_startbit*/47,    /*src_cyc*/101,  /*src_id*/0x89,   /*src_dlc*/8,   /*des_id*/0x1b0, /*updatebit_S*/5,   /*updatebit_D*/55         },
           {   /*sigGroup_s*/"igAgDataRawSafe_0",   /*sig_name*/"isAgDataRawSafeChks_0",   /*src_can*/"ZCUD_CAN1",   /*src_network_type*/"CAN",   /*src_slotid_fr*/0,   /*src_basecycle_fr*/0,  /*src_repetition_fr*/0,  /*src_startbit*/47,   /*sigG_length*/8,  /*des_slotid_fr*/0,   /*des_basecycle_fr*/0,  /*des_repetition_fr*/0,   /*des_startbit*/39,    /*src_cyc*/101,  /*src_id*/0x89,   /*src_dlc*/8,   /*des_id*/0x1b0, /*updatebit_S*/5,   /*updatebit_D*/55         },
           {   /*sigGroup_s*/"igAgDataRawSafe_0",   /*sig_name*/"isAgDataRawSafeYawRateQf_0",   /*src_can*/"ZCUD_CAN1",   /*src_network_type*/"CAN",   /*src_slotid_fr*/0,   /*src_basecycle_fr*/0,  /*src_repetition_fr*/0,  /*src_startbit*/49,   /*sigG_length*/2,  /*des_slotid_fr*/0,   /*des_basecycle_fr*/0,  /*des_repetition_fr*/0,   /*des_startbit*/41,    /*src_cyc*/101,  /*src_id*/0x89,   /*src_dlc*/8,   /*des_id*/0x1b0, /*updatebit_S*/5,   /*updatebit_D*/55         },
           {   /*sigGroup_s*/"igAgDataRawSafe_0",   /*sig_name*/"isAgDataRawSafeRollRate_0",   /*src_can*/"ZCUD_CAN1",   /*src_network_type*/"CAN",   /*src_slotid_fr*/0,   /*src_basecycle_fr*/0,  /*src_repetition_fr*/0,  /*src_startbit*/15,   /*sigG_length*/16,  /*des_slotid_fr*/0,   /*des_basecycle_fr*/0,  /*des_repetition_fr*/0,   /*des_startbit*/7,    /*src_cyc*/101,  /*src_id*/0x89,   /*src_dlc*/8,   /*des_id*/0x1b0, /*updatebit_S*/5,   /*updatebit_D*/55         },
           {   /*sigGroup_s*/"igAsyDataWithCmpSafe_0",   /*sig_name*/"isAsyDataWithCmpSafeALat1Qf_0",   /*src_can*/"ZCUD_CAN1",   /*src_network_type*/"CAN",   /*src_slotid_fr*/0,   /*src_basecycle_fr*/0,  /*src_repetition_fr*/0,  /*src_startbit*/41,   /*sigG_length*/2,  /*des_slotid_fr*/0,   /*des_basecycle_fr*/0,  /*des_repetition_fr*/0,   /*des_startbit*/41,    /*src_cyc*/101,  /*src_id*/0x13,   /*src_dlc*/8,   /*des_id*/0x51, /*updatebit_S*/56,   /*updatebit_D*/56         },
           {   /*sigGroup_s*/"igAsyDataWithCmpSafe_0",   /*sig_name*/"isAsyDataWithCmpSafeChks_0",   /*src_can*/"ZCUD_CAN1",   /*src_network_type*/"CAN",   /*src_slotid_fr*/0,   /*src_basecycle_fr*/0,  /*src_repetition_fr*/0,  /*src_startbit*/23,   /*sigG_length*/8,  /*des_slotid_fr*/0,   /*des_basecycle_fr*/0,  /*des_repetition_fr*/0,   /*des_startbit*/23,    /*src_cyc*/101,  /*src_id*/0x13,   /*src_dlc*/8,   /*des_id*/0x51, /*updatebit_S*/56,   /*updatebit_D*/56         },
           {   /*sigGroup_s*/"igAsyDataWithCmpSafe_0",   /*sig_name*/"isAsyDataWithCmpSafeYawRateWithCmp_0",   /*src_can*/"ZCUD_CAN1",   /*src_network_type*/"CAN",   /*src_slotid_fr*/0,   /*src_basecycle_fr*/0,  /*src_repetition_fr*/0,  /*src_startbit*/7,   /*sigG_length*/16,  /*des_slotid_fr*/0,   /*des_basecycle_fr*/0,  /*des_repetition_fr*/0,   /*des_startbit*/7,    /*src_cyc*/101,  /*src_id*/0x13,   /*src_dlc*/8,   /*des_id*/0x51, /*updatebit_S*/56,   /*updatebit_D*/56         },
           {   /*sigGroup_s*/"igAsyDataWithCmpSafe_0",   /*sig_name*/"isAsyDataWithCmpSafeALatWithCmp_0",   /*src_can*/"ZCUD_CAN1",   /*src_network_type*/"CAN",   /*src_slotid_fr*/0,   /*src_basecycle_fr*/0,  /*src_repetition_fr*/0,  /*src_startbit*/55,   /*sigG_length*/15,  /*des_slotid_fr*/0,   /*des_basecycle_fr*/0,  /*des_repetition_fr*/0,   /*des_startbit*/55,    /*src_cyc*/101,  /*src_id*/0x13,   /*src_dlc*/8,   /*des_id*/0x51, /*updatebit_S*/56,   /*updatebit_D*/56         },
           {   /*sigGroup_s*/"igAsyDataWithCmpSafe_0",   /*sig_name*/"isAsyDataWithCmpSafeGrdtOfALgt_0",   /*src_can*/"ZCUD_CAN1",   /*src_network_type*/"CAN",   /*src_slotid_fr*/0,   /*src_basecycle_fr*/0,  /*src_repetition_fr*/0,  /*src_startbit*/31,   /*sigG_length*/14,  /*des_slotid_fr*/0,   /*des_basecycle_fr*/0,  /*des_repetition_fr*/0,   /*des_startbit*/31,    /*src_cyc*/101,  /*src_id*/0x13,   /*src_dlc*/8,   /*des_id*/0x51, /*updatebit_S*/56,   /*updatebit_D*/56         },
           {   /*sigGroup_s*/"igAsyDataWithCmpSafe_0",   /*sig_name*/"isAsyDataWithCmpSafeYawRateQf_0",   /*src_can*/"ZCUD_CAN1",   /*src_network_type*/"CAN",   /*src_slotid_fr*/0,   /*src_basecycle_fr*/0,  /*src_repetition_fr*/0,  /*src_startbit*/33,   /*sigG_length*/2,  /*des_slotid_fr*/0,   /*des_basecycle_fr*/0,  /*des_repetition_fr*/0,   /*des_startbit*/33,    /*src_cyc*/101,  /*src_id*/0x13,   /*src_dlc*/8,   /*des_id*/0x51, /*updatebit_S*/56,   /*updatebit_D*/56         },
           {   /*sigGroup_s*/"igAsyDataWithCmpSafe_0",   /*sig_name*/"isAsyDataWithCmpSafeCntr_0",   /*src_can*/"ZCUD_CAN1",   /*src_network_type*/"CAN",   /*src_slotid_fr*/0,   /*src_basecycle_fr*/0,  /*src_repetition_fr*/0,  /*src_startbit*/47,   /*sigG_length*/4,  /*des_slotid_fr*/0,   /*des_basecycle_fr*/0,  /*des_repetition_fr*/0,   /*des_startbit*/47,    /*src_cyc*/101,  /*src_id*/0x13,   /*src_dlc*/8,   /*des_id*/0x51, /*updatebit_S*/56,   /*updatebit_D*/56         },
           {   /*sigGroup_s*/"igAsyDataWithCmpSafe_0",   /*sig_name*/"isAsyDataWithCmpSafeALgt1Qf_0",   /*src_can*/"ZCUD_CAN1",   /*src_network_type*/"CAN",   /*src_slotid_fr*/0,   /*src_basecycle_fr*/0,  /*src_repetition_fr*/0,  /*src_startbit*/43,   /*sigG_length*/2,  /*des_slotid_fr*/0,   /*des_basecycle_fr*/0,  /*des_repetition_fr*/0,   /*des_startbit*/43,    /*src_cyc*/101,  /*src_id*/0x13,   /*src_dlc*/8,   /*des_id*/0x51, /*updatebit_S*/56,   /*updatebit_D*/56         }
       }
   },
   {
       /*des_can*/ "ZCU_CANFD1",
       /*networktype*/ "CANFD",
       0,
       {
           0
       }
   },
   {
       /*des_can*/ "ZCUD_CANFD3",
       /*networktype*/ "CANFD",
       54,
       {
           {   /*sigGroup_s*/"igSteerWhlSnsr_0",   /*sig_name*/"isSteerWhlSnsrChks_0",   /*src_can*/"ChassisCAN1",   /*src_network_type*/"CAN",   /*src_slotid_fr*/0,   /*src_basecycle_fr*/0,  /*src_repetition_fr*/0,  /*src_startbit*/39,   /*sigG_length*/8,  /*des_slotid_fr*/0,   /*des_basecycle_fr*/0,  /*des_repetition_fr*/0,   /*des_startbit*/26,    /*src_cyc*/101,  /*src_id*/0x40,   /*src_dlc*/8,   /*des_id*/0x55, /*updatebit_S*/7,   /*updatebit_D*/44         },
           {   /*sigGroup_s*/"igSteerWhlSnsr_0",   /*sig_name*/"isSteerWhlSnsrQf_0",   /*src_can*/"ChassisCAN1",   /*src_network_type*/"CAN",   /*src_slotid_fr*/0,   /*src_basecycle_fr*/0,  /*src_repetition_fr*/0,  /*src_startbit*/23,   /*sigG_length*/2,  /*des_slotid_fr*/0,   /*des_basecycle_fr*/0,  /*des_repetition_fr*/0,   /*des_startbit*/46,    /*src_cyc*/101,  /*src_id*/0x40,   /*src_dlc*/8,   /*des_id*/0x55, /*updatebit_S*/7,   /*updatebit_D*/44         },
           {   /*sigGroup_s*/"igSteerWhlSnsr_0",   /*sig_name*/"isSteerWhlSnsrAgSpd_0",   /*src_can*/"ChassisCAN1",   /*src_network_type*/"CAN",   /*src_slotid_fr*/0,   /*src_basecycle_fr*/0,  /*src_repetition_fr*/0,  /*src_startbit*/21,   /*sigG_length*/14,  /*des_slotid_fr*/0,   /*des_basecycle_fr*/0,  /*des_repetition_fr*/0,   /*des_startbit*/8,    /*src_cyc*/101,  /*src_id*/0x40,   /*src_dlc*/8,   /*des_id*/0x55, /*updatebit_S*/7,   /*updatebit_D*/44         },
           {   /*sigGroup_s*/"igSteerWhlSnsr_0",   /*sig_name*/"isSteerWhlSnsrCntr_0",   /*src_can*/"ChassisCAN1",   /*src_network_type*/"CAN",   /*src_slotid_fr*/0,   /*src_basecycle_fr*/0,  /*src_repetition_fr*/0,  /*src_startbit*/47,   /*sigG_length*/4,  /*des_slotid_fr*/0,   /*des_basecycle_fr*/0,  /*des_repetition_fr*/0,   /*des_startbit*/34,    /*src_cyc*/101,  /*src_id*/0x40,   /*src_dlc*/8,   /*des_id*/0x55, /*updatebit_S*/7,   /*updatebit_D*/44         },
           {   /*sigGroup_s*/"igSteerWhlSnsr_0",   /*sig_name*/"isSteerWhlSnsrAg_0",   /*src_can*/"ChassisCAN1",   /*src_network_type*/"CAN",   /*src_slotid_fr*/0,   /*src_basecycle_fr*/0,  /*src_repetition_fr*/0,  /*src_startbit*/6,   /*sigG_length*/15,  /*des_slotid_fr*/0,   /*des_basecycle_fr*/0,  /*des_repetition_fr*/0,   /*des_startbit*/7,    /*src_cyc*/101,  /*src_id*/0x40,   /*src_dlc*/8,   /*des_id*/0x55, /*updatebit_S*/7,   /*updatebit_D*/44         },
           {   /*sigGroup_s*/"igWhlRotToothCntr_0",   /*sig_name*/"isWhlRotToothCntrReLe_0",   /*src_can*/"ChassisCANFD2",   /*src_network_type*/"CANFD",   /*src_slotid_fr*/0,   /*src_basecycle_fr*/0,  /*src_repetition_fr*/0,  /*src_startbit*/127,   /*sigG_length*/8,  /*des_slotid_fr*/0,   /*des_basecycle_fr*/0,  /*des_repetition_fr*/0,   /*des_startbit*/399,    /*src_cyc*/101,  /*src_id*/0x67,   /*src_dlc*/64,   /*des_id*/0x55, /*updatebit_S*/139,   /*updatebit_D*/411         },
           {   /*sigGroup_s*/"igWhlRotToothCntr_0",   /*sig_name*/"isWhlRotToothCntrReRi_0",   /*src_can*/"ChassisCANFD2",   /*src_network_type*/"CANFD",   /*src_slotid_fr*/0,   /*src_basecycle_fr*/0,  /*src_repetition_fr*/0,  /*src_startbit*/135,   /*sigG_length*/8,  /*des_slotid_fr*/0,   /*des_basecycle_fr*/0,  /*des_repetition_fr*/0,   /*des_startbit*/407,    /*src_cyc*/101,  /*src_id*/0x67,   /*src_dlc*/64,   /*des_id*/0x55, /*updatebit_S*/139,   /*updatebit_D*/411         },
           {   /*sigGroup_s*/"igWhlRotToothCntr_0",   /*sig_name*/"isWhlRotToothCntrFrntRi_0",   /*src_can*/"ChassisCANFD2",   /*src_network_type*/"CANFD",   /*src_slotid_fr*/0,   /*src_basecycle_fr*/0,  /*src_repetition_fr*/0,  /*src_startbit*/119,   /*sigG_length*/8,  /*des_slotid_fr*/0,   /*des_basecycle_fr*/0,  /*des_repetition_fr*/0,   /*des_startbit*/391,    /*src_cyc*/101,  /*src_id*/0x67,   /*src_dlc*/64,   /*des_id*/0x55, /*updatebit_S*/139,   /*updatebit_D*/411         },
           {   /*sigGroup_s*/"igWhlRotToothCntr_0",   /*sig_name*/"isWhlRotToothCntrCntr_0",   /*src_can*/"ChassisCANFD2",   /*src_network_type*/"CANFD",   /*src_slotid_fr*/0,   /*src_basecycle_fr*/0,  /*src_repetition_fr*/0,  /*src_startbit*/143,   /*sigG_length*/4,  /*des_slotid_fr*/0,   /*des_basecycle_fr*/0,  /*des_repetition_fr*/0,   /*des_startbit*/415,    /*src_cyc*/101,  /*src_id*/0x67,   /*src_dlc*/64,   /*des_id*/0x55, /*updatebit_S*/139,   /*updatebit_D*/411         },
           {   /*sigGroup_s*/"igWhlRotToothCntr_0",   /*sig_name*/"isWhlRotToothCntrFrntLe_0",   /*src_can*/"ChassisCANFD2",   /*src_network_type*/"CANFD",   /*src_slotid_fr*/0,   /*src_basecycle_fr*/0,  /*src_repetition_fr*/0,  /*src_startbit*/111,   /*sigG_length*/8,  /*des_slotid_fr*/0,   /*des_basecycle_fr*/0,  /*des_repetition_fr*/0,   /*des_startbit*/383,    /*src_cyc*/101,  /*src_id*/0x67,   /*src_dlc*/64,   /*des_id*/0x55, /*updatebit_S*/139,   /*updatebit_D*/411         },
           {   /*sigGroup_s*/"igWhlRotToothCntr_0",   /*sig_name*/"isWhlRotToothCntrChks_0",   /*src_can*/"ChassisCANFD2",   /*src_network_type*/"CANFD",   /*src_slotid_fr*/0,   /*src_basecycle_fr*/0,  /*src_repetition_fr*/0,  /*src_startbit*/103,   /*sigG_length*/8,  /*des_slotid_fr*/0,   /*des_basecycle_fr*/0,  /*des_repetition_fr*/0,   /*des_startbit*/375,    /*src_cyc*/101,  /*src_id*/0x67,   /*src_dlc*/64,   /*des_id*/0x55, /*updatebit_S*/139,   /*updatebit_D*/411         },
           {   /*sigGroup_s*/"igWhlFastSpdSafe_0",   /*sig_name*/"isWhlFastSpdSafeQF_0",   /*src_can*/"ChassisCANFD2",   /*src_network_type*/"CANFD",   /*src_slotid_fr*/0,   /*src_basecycle_fr*/0,  /*src_repetition_fr*/0,  /*src_startbit*/489,   /*sigG_length*/2,  /*des_slotid_fr*/0,   /*des_basecycle_fr*/0,  /*des_repetition_fr*/0,   /*des_startbit*/444,    /*src_cyc*/101,  /*src_id*/0x5a,   /*src_dlc*/64,   /*des_id*/0x55, /*updatebit_S*/506,   /*updatebit_D*/442         },
           {   /*sigGroup_s*/"igWhlFastSpdSafe_0",   /*sig_name*/"isWhlFastSpdSafeCntr_0",   /*src_can*/"ChassisCANFD2",   /*src_network_type*/"CANFD",   /*src_slotid_fr*/0,   /*src_basecycle_fr*/0,  /*src_repetition_fr*/0,  /*src_startbit*/493,   /*sigG_length*/4,  /*des_slotid_fr*/0,   /*des_basecycle_fr*/0,  /*des_repetition_fr*/0,   /*des_startbit*/432,    /*src_cyc*/101,  /*src_id*/0x5a,   /*src_dlc*/64,   /*des_id*/0x55, /*updatebit_S*/506,   /*updatebit_D*/442         },
           {   /*sigGroup_s*/"igWhlFastSpdSafe_0",   /*sig_name*/"isWhlFastSpdSafeChks_0",   /*src_can*/"ChassisCANFD2",   /*src_network_type*/"CANFD",   /*src_slotid_fr*/0,   /*src_basecycle_fr*/0,  /*src_repetition_fr*/0,  /*src_startbit*/485,   /*sigG_length*/8,  /*des_slotid_fr*/0,   /*des_basecycle_fr*/0,  /*des_repetition_fr*/0,   /*des_startbit*/424,    /*src_cyc*/101,  /*src_id*/0x5a,   /*src_dlc*/64,   /*des_id*/0x55, /*updatebit_S*/506,   /*updatebit_D*/442         },
           {   /*sigGroup_s*/"igWhlFastSpdSafe_0",   /*sig_name*/"isWhlFastSpdSafeA_0",   /*src_can*/"ChassisCANFD2",   /*src_network_type*/"CANFD",   /*src_slotid_fr*/0,   /*src_basecycle_fr*/0,  /*src_repetition_fr*/0,  /*src_startbit*/468,   /*sigG_length*/15,  /*des_slotid_fr*/0,   /*des_basecycle_fr*/0,  /*des_repetition_fr*/0,   /*des_startbit*/423,    /*src_cyc*/101,  /*src_id*/0x5a,   /*src_dlc*/64,   /*des_id*/0x55, /*updatebit_S*/506,   /*updatebit_D*/442         },
           {   /*sigGroup_s*/"igVehSpdLgt_0",   /*sig_name*/"isVehSpdLgtCntr_0",   /*src_can*/"ChassisCANFD2",   /*src_network_type*/"CANFD",   /*src_slotid_fr*/0,   /*src_basecycle_fr*/0,  /*src_repetition_fr*/0,  /*src_startbit*/216,   /*sigG_length*/4,  /*des_slotid_fr*/0,   /*des_basecycle_fr*/0,  /*des_repetition_fr*/0,   /*des_startbit*/144,    /*src_cyc*/101,  /*src_id*/0x9f,   /*src_dlc*/64,   /*des_id*/0x55, /*updatebit_S*/471,   /*updatebit_D*/154         },
           {   /*sigGroup_s*/"igVehSpdLgt_0",   /*sig_name*/"isVehSpdLgtA_0",   /*src_can*/"ChassisCANFD2",   /*src_network_type*/"CANFD",   /*src_slotid_fr*/0,   /*src_basecycle_fr*/0,  /*src_repetition_fr*/0,  /*src_startbit*/207,   /*sigG_length*/15,  /*des_slotid_fr*/0,   /*des_basecycle_fr*/0,  /*des_repetition_fr*/0,   /*des_startbit*/135,    /*src_cyc*/101,  /*src_id*/0x9f,   /*src_dlc*/64,   /*des_id*/0x55, /*updatebit_S*/471,   /*updatebit_D*/154         },
           {   /*sigGroup_s*/"igVehSpdLgt_0",   /*sig_name*/"isVehSpdLgtQf_0",   /*src_can*/"ChassisCANFD2",   /*src_network_type*/"CANFD",   /*src_slotid_fr*/0,   /*src_basecycle_fr*/0,  /*src_repetition_fr*/0,  /*src_startbit*/228,   /*sigG_length*/2,  /*des_slotid_fr*/0,   /*des_basecycle_fr*/0,  /*des_repetition_fr*/0,   /*des_startbit*/156,    /*src_cyc*/101,  /*src_id*/0x9f,   /*src_dlc*/64,   /*des_id*/0x55, /*updatebit_S*/471,   /*updatebit_D*/154         },
           {   /*sigGroup_s*/"igVehSpdLgt_0",   /*sig_name*/"isVehSpdLgtChks_0",   /*src_can*/"ChassisCANFD2",   /*src_network_type*/"CANFD",   /*src_slotid_fr*/0,   /*src_basecycle_fr*/0,  /*src_repetition_fr*/0,  /*src_startbit*/208,   /*sigG_length*/8,  /*des_slotid_fr*/0,   /*des_basecycle_fr*/0,  /*des_repetition_fr*/0,   /*des_startbit*/136,    /*src_cyc*/101,  /*src_id*/0x9f,   /*src_dlc*/64,   /*des_id*/0x55, /*updatebit_S*/471,   /*updatebit_D*/154         },
           {   /*sigGroup_s*/"igDrvrGearShiftDirReq1_0",   /*sig_name*/"isDrvrGearShiftDirReq1DwnTipAut_0",   /*src_can*/"PropulsionCAN",   /*src_network_type*/"CAN",   /*src_slotid_fr*/0,   /*src_basecycle_fr*/0,  /*src_repetition_fr*/0,  /*src_startbit*/13,   /*sigG_length*/1,  /*des_slotid_fr*/0,   /*des_basecycle_fr*/0,  /*des_repetition_fr*/0,   /*des_startbit*/34,    /*src_cyc*/101,  /*src_id*/0x136,   /*src_dlc*/8,   /*des_id*/0x153, /*updatebit_S*/1,   /*updatebit_D*/46         },
           {   /*sigGroup_s*/"igDrvrGearShiftDirReq1_0",   /*sig_name*/"isDrvrGearShiftDirReq1DwnDwnTipAut_0",   /*src_can*/"PropulsionCAN",   /*src_network_type*/"CAN",   /*src_slotid_fr*/0,   /*src_basecycle_fr*/0,  /*src_repetition_fr*/0,  /*src_startbit*/12,   /*sigG_length*/1,  /*des_slotid_fr*/0,   /*des_basecycle_fr*/0,  /*des_repetition_fr*/0,   /*des_startbit*/35,    /*src_cyc*/101,  /*src_id*/0x136,   /*src_dlc*/8,   /*des_id*/0x153, /*updatebit_S*/1,   /*updatebit_D*/46         },
           {   /*sigGroup_s*/"igDrvrGearShiftDirReq1_0",   /*sig_name*/"isDrvrGearShiftDirReq1UpUpTipAut_0",   /*src_can*/"PropulsionCAN",   /*src_network_type*/"CAN",   /*src_slotid_fr*/0,   /*src_basecycle_fr*/0,  /*src_repetition_fr*/0,  /*src_startbit*/0,   /*sigG_length*/1,  /*des_slotid_fr*/0,   /*des_basecycle_fr*/0,  /*des_repetition_fr*/0,   /*des_startbit*/47,    /*src_cyc*/101,  /*src_id*/0x136,   /*src_dlc*/8,   /*des_id*/0x153, /*updatebit_S*/1,   /*updatebit_D*/46         },
           {   /*sigGroup_s*/"igDrvrGearShiftDirReq1_0",   /*sig_name*/"isDrvrGearShiftDirReq1Chks_0",   /*src_can*/"PropulsionCAN",   /*src_network_type*/"CAN",   /*src_slotid_fr*/0,   /*src_basecycle_fr*/0,  /*src_repetition_fr*/0,  /*src_startbit*/23,   /*sigG_length*/8,  /*des_slotid_fr*/0,   /*des_basecycle_fr*/0,  /*des_repetition_fr*/0,   /*des_startbit*/31,    /*src_cyc*/101,  /*src_id*/0x136,   /*src_dlc*/8,   /*des_id*/0x153, /*updatebit_S*/1,   /*updatebit_D*/46         },
           {   /*sigGroup_s*/"igDrvrGearShiftDirReq1_0",   /*sig_name*/"isDrvrGearShiftDirReq1Cntr_0",   /*src_can*/"PropulsionCAN",   /*src_network_type*/"CAN",   /*src_slotid_fr*/0,   /*src_basecycle_fr*/0,  /*src_repetition_fr*/0,  /*src_startbit*/11,   /*sigG_length*/4,  /*des_slotid_fr*/0,   /*des_basecycle_fr*/0,  /*des_repetition_fr*/0,   /*des_startbit*/39,    /*src_cyc*/101,  /*src_id*/0x136,   /*src_dlc*/8,   /*des_id*/0x153, /*updatebit_S*/1,   /*updatebit_D*/46         },
           {   /*sigGroup_s*/"igDrvrGearShiftDirReq1_0",   /*sig_name*/"isDrvrGearShiftDirReq1UpTipAut_0",   /*src_can*/"PropulsionCAN",   /*src_network_type*/"CAN",   /*src_slotid_fr*/0,   /*src_basecycle_fr*/0,  /*src_repetition_fr*/0,  /*src_startbit*/15,   /*sigG_length*/1,  /*des_slotid_fr*/0,   /*des_basecycle_fr*/0,  /*des_repetition_fr*/0,   /*des_startbit*/32,    /*src_cyc*/101,  /*src_id*/0x136,   /*src_dlc*/8,   /*des_id*/0x153, /*updatebit_S*/1,   /*updatebit_D*/46         },
           {   /*sigGroup_s*/"igDrvrGearShiftDirReq1_0",   /*sig_name*/"isDrvrGearShiftDirReq1PosnAut_0",   /*src_can*/"PropulsionCAN",   /*src_network_type*/"CAN",   /*src_slotid_fr*/0,   /*src_basecycle_fr*/0,  /*src_repetition_fr*/0,  /*src_startbit*/14,   /*sigG_length*/1,  /*des_slotid_fr*/0,   /*des_basecycle_fr*/0,  /*des_repetition_fr*/0,   /*des_startbit*/33,    /*src_cyc*/101,  /*src_id*/0x136,   /*src_dlc*/8,   /*des_id*/0x153, /*updatebit_S*/1,   /*updatebit_D*/46         },
           {   /*sigGroup_s*/"igPtTqAtWhlFrntAct_0",   /*sig_name*/"isPtTqAtWhlFrntActCntr_0",   /*src_can*/"ChassisCANFD2",   /*src_network_type*/"CANFD",   /*src_slotid_fr*/0,   /*src_basecycle_fr*/0,  /*src_repetition_fr*/0,  /*src_startbit*/63,   /*sigG_length*/4,  /*des_slotid_fr*/0,   /*des_basecycle_fr*/0,  /*des_repetition_fr*/0,   /*des_startbit*/63,    /*src_cyc*/101,  /*src_id*/0x7c,   /*src_dlc*/64,   /*des_id*/0x239, /*updatebit_S*/56,   /*updatebit_D*/56         },
           {   /*sigGroup_s*/"igPtTqAtWhlFrntAct_0",   /*sig_name*/"isPtTqAtWhlFrntActPtTqAtAxleFrntAct_0",   /*src_can*/"ChassisCANFD2",   /*src_network_type*/"CANFD",   /*src_slotid_fr*/0,   /*src_basecycle_fr*/0,  /*src_repetition_fr*/0,  /*src_startbit*/7,   /*sigG_length*/16,  /*des_slotid_fr*/0,   /*des_basecycle_fr*/0,  /*des_repetition_fr*/0,   /*des_startbit*/7,    /*src_cyc*/101,  /*src_id*/0x7c,   /*src_dlc*/64,   /*des_id*/0x239, /*updatebit_S*/56,   /*updatebit_D*/56         },
           {   /*sigGroup_s*/"igPtTqAtWhlFrntAct_0",   /*sig_name*/"isPtTqAtWhlFrntActPtTqAtWhlFrntLeAct_0",   /*src_can*/"ChassisCANFD2",   /*src_network_type*/"CANFD",   /*src_slotid_fr*/0,   /*src_basecycle_fr*/0,  /*src_repetition_fr*/0,  /*src_startbit*/23,   /*sigG_length*/16,  /*des_slotid_fr*/0,   /*des_basecycle_fr*/0,  /*des_repetition_fr*/0,   /*des_startbit*/23,    /*src_cyc*/101,  /*src_id*/0x7c,   /*src_dlc*/64,   /*des_id*/0x239, /*updatebit_S*/56,   /*updatebit_D*/56         },
           {   /*sigGroup_s*/"igPtTqAtWhlFrntAct_0",   /*sig_name*/"isPtTqAtWhlFrntActPtTqAtWhlsFrntQly_0",   /*src_can*/"ChassisCANFD2",   /*src_network_type*/"CANFD",   /*src_slotid_fr*/0,   /*src_basecycle_fr*/0,  /*src_repetition_fr*/0,  /*src_startbit*/59,   /*sigG_length*/3,  /*des_slotid_fr*/0,   /*des_basecycle_fr*/0,  /*des_repetition_fr*/0,   /*des_startbit*/59,    /*src_cyc*/101,  /*src_id*/0x7c,   /*src_dlc*/64,   /*des_id*/0x239, /*updatebit_S*/56,   /*updatebit_D*/56         },
           {   /*sigGroup_s*/"igPtTqAtWhlFrntAct_0",   /*sig_name*/"isPtTqAtWhlFrntActPtTqAtWhlFrntRiAct_0",   /*src_can*/"ChassisCANFD2",   /*src_network_type*/"CANFD",   /*src_slotid_fr*/0,   /*src_basecycle_fr*/0,  /*src_repetition_fr*/0,  /*src_startbit*/39,   /*sigG_length*/16,  /*des_slotid_fr*/0,   /*des_basecycle_fr*/0,  /*des_repetition_fr*/0,   /*des_startbit*/39,    /*src_cyc*/101,  /*src_id*/0x7c,   /*src_dlc*/64,   /*des_id*/0x239, /*updatebit_S*/56,   /*updatebit_D*/56         },
           {   /*sigGroup_s*/"igPtTqAtWhlFrntAct_0",   /*sig_name*/"isPtTqAtWhlFrntActChks_0",   /*src_can*/"ChassisCANFD2",   /*src_network_type*/"CANFD",   /*src_slotid_fr*/0,   /*src_basecycle_fr*/0,  /*src_repetition_fr*/0,  /*src_startbit*/55,   /*sigG_length*/8,  /*des_slotid_fr*/0,   /*des_basecycle_fr*/0,  /*des_repetition_fr*/0,   /*des_startbit*/55,    /*src_cyc*/101,  /*src_id*/0x7c,   /*src_dlc*/64,   /*des_id*/0x239, /*updatebit_S*/56,   /*updatebit_D*/56         },
           {   /*sigGroup_s*/"igAbsCtrlActv_0",   /*sig_name*/"isAbsCtrlActvCtrlSts1_0",   /*src_can*/"ChassisCAN1",   /*src_network_type*/"CAN",   /*src_slotid_fr*/0,   /*src_basecycle_fr*/0,  /*src_repetition_fr*/0,  /*src_startbit*/43,   /*sigG_length*/1,  /*des_slotid_fr*/0,   /*des_basecycle_fr*/0,  /*des_repetition_fr*/0,   /*des_startbit*/139,    /*src_cyc*/101,  /*src_id*/0xb9,   /*src_dlc*/8,   /*des_id*/0x66, /*updatebit_S*/24,   /*updatebit_D*/138         },
           {   /*sigGroup_s*/"igAbsCtrlActv_0",   /*sig_name*/"isAbsCtrlActvChks_0",   /*src_can*/"ChassisCAN1",   /*src_network_type*/"CAN",   /*src_slotid_fr*/0,   /*src_basecycle_fr*/0,  /*src_repetition_fr*/0,  /*src_startbit*/39,   /*sigG_length*/8,  /*des_slotid_fr*/0,   /*des_basecycle_fr*/0,  /*des_repetition_fr*/0,   /*des_startbit*/135,    /*src_cyc*/101,  /*src_id*/0xb9,   /*src_dlc*/8,   /*des_id*/0x66, /*updatebit_S*/24,   /*updatebit_D*/138         },
           {   /*sigGroup_s*/"igAbsCtrlActv_0",   /*sig_name*/"isAbsCtrlActvCntr_0",   /*src_can*/"ChassisCAN1",   /*src_network_type*/"CAN",   /*src_slotid_fr*/0,   /*src_basecycle_fr*/0,  /*src_repetition_fr*/0,  /*src_startbit*/47,   /*sigG_length*/4,  /*des_slotid_fr*/0,   /*des_basecycle_fr*/0,  /*des_repetition_fr*/0,   /*des_startbit*/143,    /*src_cyc*/101,  /*src_id*/0xb9,   /*src_dlc*/8,   /*des_id*/0x66, /*updatebit_S*/24,   /*updatebit_D*/138         },
           {   /*sigGroup_s*/"igDrvrGearShiftDirReq2_0",   /*sig_name*/"isDrvrGearShiftDirReq2Cntr_0",   /*src_can*/"PropulsionCAN",   /*src_network_type*/"CAN",   /*src_slotid_fr*/0,   /*src_basecycle_fr*/0,  /*src_repetition_fr*/0,  /*src_startbit*/35,   /*sigG_length*/4,  /*des_slotid_fr*/0,   /*des_basecycle_fr*/0,  /*des_repetition_fr*/0,   /*des_startbit*/53,    /*src_cyc*/101,  /*src_id*/0x136,   /*src_dlc*/8,   /*des_id*/0x153, /*updatebit_S*/25,   /*updatebit_D*/60         },
           {   /*sigGroup_s*/"igDrvrGearShiftDirReq2_0",   /*sig_name*/"isDrvrGearShiftDirReq2Chks_0",   /*src_can*/"PropulsionCAN",   /*src_network_type*/"CAN",   /*src_slotid_fr*/0,   /*src_basecycle_fr*/0,  /*src_repetition_fr*/0,  /*src_startbit*/47,   /*sigG_length*/8,  /*des_slotid_fr*/0,   /*des_basecycle_fr*/0,  /*des_repetition_fr*/0,   /*des_startbit*/45,    /*src_cyc*/101,  /*src_id*/0x136,   /*src_dlc*/8,   /*des_id*/0x153, /*updatebit_S*/25,   /*updatebit_D*/60         },
           {   /*sigGroup_s*/"igDrvrGearShiftDirReq2_0",   /*sig_name*/"isDrvrGearShiftDirReq2UpTipAut_0",   /*src_can*/"PropulsionCAN",   /*src_network_type*/"CAN",   /*src_slotid_fr*/0,   /*src_basecycle_fr*/0,  /*src_repetition_fr*/0,  /*src_startbit*/39,   /*sigG_length*/1,  /*des_slotid_fr*/0,   /*des_basecycle_fr*/0,  /*des_repetition_fr*/0,   /*des_startbit*/62,    /*src_cyc*/101,  /*src_id*/0x136,   /*src_dlc*/8,   /*des_id*/0x153, /*updatebit_S*/25,   /*updatebit_D*/60         },
           {   /*sigGroup_s*/"igDrvrGearShiftDirReq2_0",   /*sig_name*/"isDrvrGearShiftDirReq2PosnAut_0",   /*src_can*/"PropulsionCAN",   /*src_network_type*/"CAN",   /*src_slotid_fr*/0,   /*src_basecycle_fr*/0,  /*src_repetition_fr*/0,  /*src_startbit*/38,   /*sigG_length*/1,  /*des_slotid_fr*/0,   /*des_basecycle_fr*/0,  /*des_repetition_fr*/0,   /*des_startbit*/63,    /*src_cyc*/101,  /*src_id*/0x136,   /*src_dlc*/8,   /*des_id*/0x153, /*updatebit_S*/25,   /*updatebit_D*/60         },
           {   /*sigGroup_s*/"igDrvrGearShiftDirReq2_0",   /*sig_name*/"isDrvrGearShiftDirReq2DwnDwnTipAut_0",   /*src_can*/"PropulsionCAN",   /*src_network_type*/"CAN",   /*src_slotid_fr*/0,   /*src_basecycle_fr*/0,  /*src_repetition_fr*/0,  /*src_startbit*/36,   /*sigG_length*/1,  /*des_slotid_fr*/0,   /*des_basecycle_fr*/0,  /*des_repetition_fr*/0,   /*des_startbit*/49,    /*src_cyc*/101,  /*src_id*/0x136,   /*src_dlc*/8,   /*des_id*/0x153, /*updatebit_S*/25,   /*updatebit_D*/60         },
           {   /*sigGroup_s*/"igDrvrGearShiftDirReq2_0",   /*sig_name*/"isDrvrGearShiftDirReq2UpUpTipAut_0",   /*src_can*/"PropulsionCAN",   /*src_network_type*/"CAN",   /*src_slotid_fr*/0,   /*src_basecycle_fr*/0,  /*src_repetition_fr*/0,  /*src_startbit*/24,   /*sigG_length*/1,  /*des_slotid_fr*/0,   /*des_basecycle_fr*/0,  /*des_repetition_fr*/0,   /*des_startbit*/61,    /*src_cyc*/101,  /*src_id*/0x136,   /*src_dlc*/8,   /*des_id*/0x153, /*updatebit_S*/25,   /*updatebit_D*/60         },
           {   /*sigGroup_s*/"igDrvrGearShiftDirReq2_0",   /*sig_name*/"isDrvrGearShiftDirReq2DwnTipAut_0",   /*src_can*/"PropulsionCAN",   /*src_network_type*/"CAN",   /*src_slotid_fr*/0,   /*src_basecycle_fr*/0,  /*src_repetition_fr*/0,  /*src_startbit*/37,   /*sigG_length*/1,  /*des_slotid_fr*/0,   /*des_basecycle_fr*/0,  /*des_repetition_fr*/0,   /*des_startbit*/48,    /*src_cyc*/101,  /*src_id*/0x136,   /*src_dlc*/8,   /*des_id*/0x153, /*updatebit_S*/25,   /*updatebit_D*/60         },
           {   /*sigGroup_s*/"igWhlSpdCircumlFrnt_0",   /*sig_name*/"isWhlSpdCircumlFrntCntr_0",   /*src_can*/"ChassisCANFD2",   /*src_network_type*/"CANFD",   /*src_slotid_fr*/0,   /*src_basecycle_fr*/0,  /*src_repetition_fr*/0,  /*src_startbit*/33,   /*sigG_length*/4,  /*des_slotid_fr*/0,   /*des_basecycle_fr*/0,  /*des_repetition_fr*/0,   /*des_startbit*/177,    /*src_cyc*/101,  /*src_id*/0x67,   /*src_dlc*/64,   /*des_id*/0x66, /*updatebit_S*/41,   /*updatebit_D*/185         },
           {   /*sigGroup_s*/"igWhlSpdCircumlFrnt_0",   /*sig_name*/"isWhlSpdCircumlFrntWhlSpdCircumlFrntRi_0",   /*src_can*/"ChassisCANFD2",   /*src_network_type*/"CANFD",   /*src_slotid_fr*/0,   /*src_basecycle_fr*/0,  /*src_repetition_fr*/0,  /*src_startbit*/8,   /*sigG_length*/15,  /*des_slotid_fr*/0,   /*des_basecycle_fr*/0,  /*des_repetition_fr*/0,   /*des_startbit*/152,    /*src_cyc*/101,  /*src_id*/0x67,   /*src_dlc*/64,   /*des_id*/0x66, /*updatebit_S*/41,   /*updatebit_D*/185         },
           {   /*sigGroup_s*/"igWhlSpdCircumlFrnt_0",   /*sig_name*/"isWhlSpdCircumlFrntLe_0",   /*src_can*/"ChassisCANFD2",   /*src_network_type*/"CANFD",   /*src_slotid_fr*/0,   /*src_basecycle_fr*/0,  /*src_repetition_fr*/0,  /*src_startbit*/7,   /*sigG_length*/15,  /*des_slotid_fr*/0,   /*des_basecycle_fr*/0,  /*des_repetition_fr*/0,   /*des_startbit*/151,    /*src_cyc*/101,  /*src_id*/0x67,   /*src_dlc*/64,   /*des_id*/0x66, /*updatebit_S*/41,   /*updatebit_D*/185         },
           {   /*sigGroup_s*/"igWhlSpdCircumlFrnt_0",   /*sig_name*/"isWhlSpdCircumlFrntRiQf_0",   /*src_can*/"ChassisCANFD2",   /*src_network_type*/"CANFD",   /*src_slotid_fr*/0,   /*src_basecycle_fr*/0,  /*src_repetition_fr*/0,  /*src_startbit*/43,   /*sigG_length*/2,  /*des_slotid_fr*/0,   /*des_basecycle_fr*/0,  /*des_repetition_fr*/0,   /*des_startbit*/187,    /*src_cyc*/101,  /*src_id*/0x67,   /*src_dlc*/64,   /*des_id*/0x66, /*updatebit_S*/41,   /*updatebit_D*/185         },
           {   /*sigGroup_s*/"igWhlSpdCircumlFrnt_0",   /*sig_name*/"isWhlSpdCircumlFrntChks_0",   /*src_can*/"ChassisCANFD2",   /*src_network_type*/"CANFD",   /*src_slotid_fr*/0,   /*src_basecycle_fr*/0,  /*src_repetition_fr*/0,  /*src_startbit*/25,   /*sigG_length*/8,  /*des_slotid_fr*/0,   /*des_basecycle_fr*/0,  /*des_repetition_fr*/0,   /*des_startbit*/169,    /*src_cyc*/101,  /*src_id*/0x67,   /*src_dlc*/64,   /*des_id*/0x66, /*updatebit_S*/41,   /*updatebit_D*/185         },
           {   /*sigGroup_s*/"igWhlSpdCircumlFrnt_0",   /*sig_name*/"isWhlSpdCircumlFrntLeQf_0",   /*src_can*/"ChassisCANFD2",   /*src_network_type*/"CANFD",   /*src_slotid_fr*/0,   /*src_basecycle_fr*/0,  /*src_repetition_fr*/0,  /*src_startbit*/45,   /*sigG_length*/2,  /*des_slotid_fr*/0,   /*des_basecycle_fr*/0,  /*des_repetition_fr*/0,   /*des_startbit*/189,    /*src_cyc*/101,  /*src_id*/0x67,   /*src_dlc*/64,   /*des_id*/0x66, /*updatebit_S*/41,   /*updatebit_D*/185         },
           {   /*sigGroup_s*/"igWhlSpdCircumlRe_0",   /*sig_name*/"isWhlSpdCircumlReCntr_0",   /*src_can*/"ChassisCANFD2",   /*src_network_type*/"CANFD",   /*src_slotid_fr*/0,   /*src_basecycle_fr*/0,  /*src_repetition_fr*/0,  /*src_startbit*/81,   /*sigG_length*/4,  /*des_slotid_fr*/0,   /*des_basecycle_fr*/0,  /*des_repetition_fr*/0,   /*des_startbit*/225,    /*src_cyc*/101,  /*src_id*/0x67,   /*src_dlc*/64,   /*des_id*/0x66, /*updatebit_S*/89,   /*updatebit_D*/233         },
           {   /*sigGroup_s*/"igWhlSpdCircumlRe_0",   /*sig_name*/"isWhlSpdCircumlReChks_0",   /*src_can*/"ChassisCANFD2",   /*src_network_type*/"CANFD",   /*src_slotid_fr*/0,   /*src_basecycle_fr*/0,  /*src_repetition_fr*/0,  /*src_startbit*/73,   /*sigG_length*/8,  /*des_slotid_fr*/0,   /*des_basecycle_fr*/0,  /*des_repetition_fr*/0,   /*des_startbit*/217,    /*src_cyc*/101,  /*src_id*/0x67,   /*src_dlc*/64,   /*des_id*/0x66, /*updatebit_S*/89,   /*updatebit_D*/233         },
           {   /*sigGroup_s*/"igWhlSpdCircumlRe_0",   /*sig_name*/"isWhlSpdCircumlReRiQf_0",   /*src_can*/"ChassisCANFD2",   /*src_network_type*/"CANFD",   /*src_slotid_fr*/0,   /*src_basecycle_fr*/0,  /*src_repetition_fr*/0,  /*src_startbit*/91,   /*sigG_length*/2,  /*des_slotid_fr*/0,   /*des_basecycle_fr*/0,  /*des_repetition_fr*/0,   /*des_startbit*/235,    /*src_cyc*/101,  /*src_id*/0x67,   /*src_dlc*/64,   /*des_id*/0x66, /*updatebit_S*/89,   /*updatebit_D*/233         },
           {   /*sigGroup_s*/"igWhlSpdCircumlRe_0",   /*sig_name*/"isWhlSpdCircumlReLeQf_0",   /*src_can*/"ChassisCANFD2",   /*src_network_type*/"CANFD",   /*src_slotid_fr*/0,   /*src_basecycle_fr*/0,  /*src_repetition_fr*/0,  /*src_startbit*/93,   /*sigG_length*/2,  /*des_slotid_fr*/0,   /*des_basecycle_fr*/0,  /*des_repetition_fr*/0,   /*des_startbit*/237,    /*src_cyc*/101,  /*src_id*/0x67,   /*src_dlc*/64,   /*des_id*/0x66, /*updatebit_S*/89,   /*updatebit_D*/233         },
           {   /*sigGroup_s*/"igWhlSpdCircumlRe_0",   /*sig_name*/"isWhlSpdCircumlReLe_0",   /*src_can*/"ChassisCANFD2",   /*src_network_type*/"CANFD",   /*src_slotid_fr*/0,   /*src_basecycle_fr*/0,  /*src_repetition_fr*/0,  /*src_startbit*/55,   /*sigG_length*/15,  /*des_slotid_fr*/0,   /*des_basecycle_fr*/0,  /*des_repetition_fr*/0,   /*des_startbit*/199,    /*src_cyc*/101,  /*src_id*/0x67,   /*src_dlc*/64,   /*des_id*/0x66, /*updatebit_S*/89,   /*updatebit_D*/233         },
           {   /*sigGroup_s*/"igWhlSpdCircumlRe_0",   /*sig_name*/"isWhlSpdCircumlReRi_0",   /*src_can*/"ChassisCANFD2",   /*src_network_type*/"CANFD",   /*src_slotid_fr*/0,   /*src_basecycle_fr*/0,  /*src_repetition_fr*/0,  /*src_startbit*/56,   /*sigG_length*/15,  /*des_slotid_fr*/0,   /*des_basecycle_fr*/0,  /*des_repetition_fr*/0,   /*des_startbit*/200,    /*src_cyc*/101,  /*src_id*/0x67,   /*src_dlc*/64,   /*des_id*/0x66, /*updatebit_S*/89,   /*updatebit_D*/233         }
       }
   },
   {
       /*des_can*/ "ChassisCANFD2",
       /*networktype*/ "CANFD",
       80,
       {
           {   /*sigGroup_s*/"igBltLockStAtRowSecRi_0",   /*sig_name*/"isBltLockStAtRowSecRiBltLockSt1_0",   /*src_can*/"ZCUD_CAN1",   /*src_network_type*/"CAN",   /*src_slotid_fr*/0,   /*src_basecycle_fr*/0,  /*src_repetition_fr*/0,  /*src_startbit*/14,   /*sigG_length*/1,  /*des_slotid_fr*/0,   /*des_basecycle_fr*/0,  /*des_repetition_fr*/0,   /*des_startbit*/14,    /*src_cyc*/101,  /*src_id*/0x70,   /*src_dlc*/8,   /*des_id*/0x13c, /*updatebit_S*/12,   /*updatebit_D*/12         },
           {   /*sigGroup_s*/"igBltLockStAtRowSecRi_0",   /*sig_name*/"isBltLockStAtRowSecRiBltLockEquid_0",   /*src_can*/"ZCUD_CAN1",   /*src_network_type*/"CAN",   /*src_slotid_fr*/0,   /*src_basecycle_fr*/0,  /*src_repetition_fr*/0,  /*src_startbit*/15,   /*sigG_length*/1,  /*des_slotid_fr*/0,   /*des_basecycle_fr*/0,  /*des_repetition_fr*/0,   /*des_startbit*/15,    /*src_cyc*/101,  /*src_id*/0x70,   /*src_dlc*/8,   /*des_id*/0x13c, /*updatebit_S*/12,   /*updatebit_D*/12         },
           {   /*sigGroup_s*/"igBltLockStAtRowSecRi_0",   /*sig_name*/"isBltLockStAtRowSecRiBltLockSts_0",   /*src_can*/"ZCUD_CAN1",   /*src_network_type*/"CAN",   /*src_slotid_fr*/0,   /*src_basecycle_fr*/0,  /*src_repetition_fr*/0,  /*src_startbit*/13,   /*sigG_length*/1,  /*des_slotid_fr*/0,   /*des_basecycle_fr*/0,  /*des_repetition_fr*/0,   /*des_startbit*/13,    /*src_cyc*/101,  /*src_id*/0x70,   /*src_dlc*/8,   /*des_id*/0x13c, /*updatebit_S*/12,   /*updatebit_D*/12         },
           {   /*sigGroup_s*/"igSteerWhlSnsr_0",   /*sig_name*/"isSteerWhlSnsrChks_0",   /*src_can*/"ChassisCAN1",   /*src_network_type*/"CAN",   /*src_slotid_fr*/0,   /*src_basecycle_fr*/0,  /*src_repetition_fr*/0,  /*src_startbit*/39,   /*sigG_length*/8,  /*des_slotid_fr*/0,   /*des_basecycle_fr*/0,  /*des_repetition_fr*/0,   /*des_startbit*/402,    /*src_cyc*/101,  /*src_id*/0x40,   /*src_dlc*/8,   /*des_id*/0x4f, /*updatebit_S*/7,   /*updatebit_D*/420         },
           {   /*sigGroup_s*/"igSteerWhlSnsr_0",   /*sig_name*/"isSteerWhlSnsrQf_0",   /*src_can*/"ChassisCAN1",   /*src_network_type*/"CAN",   /*src_slotid_fr*/0,   /*src_basecycle_fr*/0,  /*src_repetition_fr*/0,  /*src_startbit*/23,   /*sigG_length*/2,  /*des_slotid_fr*/0,   /*des_basecycle_fr*/0,  /*des_repetition_fr*/0,   /*des_startbit*/422,    /*src_cyc*/101,  /*src_id*/0x40,   /*src_dlc*/8,   /*des_id*/0x4f, /*updatebit_S*/7,   /*updatebit_D*/420         },
           {   /*sigGroup_s*/"igSteerWhlSnsr_0",   /*sig_name*/"isSteerWhlSnsrAgSpd_0",   /*src_can*/"ChassisCAN1",   /*src_network_type*/"CAN",   /*src_slotid_fr*/0,   /*src_basecycle_fr*/0,  /*src_repetition_fr*/0,  /*src_startbit*/21,   /*sigG_length*/14,  /*des_slotid_fr*/0,   /*des_basecycle_fr*/0,  /*des_repetition_fr*/0,   /*des_startbit*/384,    /*src_cyc*/101,  /*src_id*/0x40,   /*src_dlc*/8,   /*des_id*/0x4f, /*updatebit_S*/7,   /*updatebit_D*/420         },
           {   /*sigGroup_s*/"igSteerWhlSnsr_0",   /*sig_name*/"isSteerWhlSnsrCntr_0",   /*src_can*/"ChassisCAN1",   /*src_network_type*/"CAN",   /*src_slotid_fr*/0,   /*src_basecycle_fr*/0,  /*src_repetition_fr*/0,  /*src_startbit*/47,   /*sigG_length*/4,  /*des_slotid_fr*/0,   /*des_basecycle_fr*/0,  /*des_repetition_fr*/0,   /*des_startbit*/410,    /*src_cyc*/101,  /*src_id*/0x40,   /*src_dlc*/8,   /*des_id*/0x4f, /*updatebit_S*/7,   /*updatebit_D*/420         },
           {   /*sigGroup_s*/"igSteerWhlSnsr_0",   /*sig_name*/"isSteerWhlSnsrAg_0",   /*src_can*/"ChassisCAN1",   /*src_network_type*/"CAN",   /*src_slotid_fr*/0,   /*src_basecycle_fr*/0,  /*src_repetition_fr*/0,  /*src_startbit*/6,   /*sigG_length*/15,  /*des_slotid_fr*/0,   /*des_basecycle_fr*/0,  /*des_repetition_fr*/0,   /*des_startbit*/383,    /*src_cyc*/101,  /*src_id*/0x40,   /*src_dlc*/8,   /*des_id*/0x4f, /*updatebit_S*/7,   /*updatebit_D*/420         },
           {   /*sigGroup_s*/"igDrvrGearShiftParkReq_0",   /*sig_name*/"isDrvrGearShiftParkReqSts_0",   /*src_can*/"PropulsionCAN",   /*src_network_type*/"CAN",   /*src_slotid_fr*/0,   /*src_basecycle_fr*/0,  /*src_repetition_fr*/0,  /*src_startbit*/13,   /*sigG_length*/2,  /*des_slotid_fr*/0,   /*des_basecycle_fr*/0,  /*des_repetition_fr*/0,   /*des_startbit*/339,    /*src_cyc*/101,  /*src_id*/0x135,   /*src_dlc*/8,   /*des_id*/0x4f, /*updatebit_S*/15,   /*updatebit_D*/336         },
           {   /*sigGroup_s*/"igDrvrGearShiftParkReq_0",   /*sig_name*/"isDrvrGearShiftParkReqCntr_0",   /*src_can*/"PropulsionCAN",   /*src_network_type*/"CAN",   /*src_slotid_fr*/0,   /*src_basecycle_fr*/0,  /*src_repetition_fr*/0,  /*src_startbit*/11,   /*sigG_length*/4,  /*des_slotid_fr*/0,   /*des_basecycle_fr*/0,  /*des_repetition_fr*/0,   /*des_startbit*/343,    /*src_cyc*/101,  /*src_id*/0x135,   /*src_dlc*/8,   /*des_id*/0x4f, /*updatebit_S*/15,   /*updatebit_D*/336         },
           {   /*sigGroup_s*/"igDrvrGearShiftParkReq_0",   /*sig_name*/"isDrvrGearShiftParkReqChks_0",   /*src_can*/"PropulsionCAN",   /*src_network_type*/"CAN",   /*src_slotid_fr*/0,   /*src_basecycle_fr*/0,  /*src_repetition_fr*/0,  /*src_startbit*/23,   /*sigG_length*/8,  /*des_slotid_fr*/0,   /*des_basecycle_fr*/0,  /*des_repetition_fr*/0,   /*des_startbit*/335,    /*src_cyc*/101,  /*src_id*/0x135,   /*src_dlc*/8,   /*des_id*/0x4f, /*updatebit_S*/15,   /*updatebit_D*/336         },
           {   /*sigGroup_s*/"igDrvrGearShiftParkReq_0",   /*sig_name*/"isDrvrGearShiftParkReq1_0",   /*src_can*/"PropulsionCAN",   /*src_network_type*/"CAN",   /*src_slotid_fr*/0,   /*src_basecycle_fr*/0,  /*src_repetition_fr*/0,  /*src_startbit*/14,   /*sigG_length*/1,  /*des_slotid_fr*/0,   /*des_basecycle_fr*/0,  /*des_repetition_fr*/0,   /*des_startbit*/337,    /*src_cyc*/101,  /*src_id*/0x135,   /*src_dlc*/8,   /*des_id*/0x4f, /*updatebit_S*/15,   /*updatebit_D*/336         },
           {   /*sigGroup_s*/"igBltLockStAtRowSecMid_0",   /*sig_name*/"isBltLockStAtRowSecMidBltLockEquid_0",   /*src_can*/"ZCUD_CAN1",   /*src_network_type*/"CAN",   /*src_slotid_fr*/0,   /*src_basecycle_fr*/0,  /*src_repetition_fr*/0,  /*src_startbit*/3,   /*sigG_length*/1,  /*des_slotid_fr*/0,   /*des_basecycle_fr*/0,  /*des_repetition_fr*/0,   /*des_startbit*/3,    /*src_cyc*/101,  /*src_id*/0x70,   /*src_dlc*/8,   /*des_id*/0x13c, /*updatebit_S*/0,   /*updatebit_D*/0         },
           {   /*sigGroup_s*/"igBltLockStAtRowSecMid_0",   /*sig_name*/"isBltLockStAtRowSecMidBltLockSts_0",   /*src_can*/"ZCUD_CAN1",   /*src_network_type*/"CAN",   /*src_slotid_fr*/0,   /*src_basecycle_fr*/0,  /*src_repetition_fr*/0,  /*src_startbit*/1,   /*sigG_length*/1,  /*des_slotid_fr*/0,   /*des_basecycle_fr*/0,  /*des_repetition_fr*/0,   /*des_startbit*/1,    /*src_cyc*/101,  /*src_id*/0x70,   /*src_dlc*/8,   /*des_id*/0x13c, /*updatebit_S*/0,   /*updatebit_D*/0         },
           {   /*sigGroup_s*/"igBltLockStAtRowSecMid_0",   /*sig_name*/"isBltLockStAtRowSecMidBltLockSt1_0",   /*src_can*/"ZCUD_CAN1",   /*src_network_type*/"CAN",   /*src_slotid_fr*/0,   /*src_basecycle_fr*/0,  /*src_repetition_fr*/0,  /*src_startbit*/2,   /*sigG_length*/1,  /*des_slotid_fr*/0,   /*des_basecycle_fr*/0,  /*des_repetition_fr*/0,   /*des_startbit*/2,    /*src_cyc*/101,  /*src_id*/0x70,   /*src_dlc*/8,   /*des_id*/0x13c, /*updatebit_S*/0,   /*updatebit_D*/0         },
           {   /*sigGroup_s*/"igBltLockStAtRowThrdLe_0",   /*sig_name*/"isBltLockStAtRowThrdLeBltLockSt1_0",   /*src_can*/"ZCUD_CAN1",   /*src_network_type*/"CAN",   /*src_slotid_fr*/0,   /*src_basecycle_fr*/0,  /*src_repetition_fr*/0,  /*src_startbit*/10,   /*sigG_length*/1,  /*des_slotid_fr*/0,   /*des_basecycle_fr*/0,  /*des_repetition_fr*/0,   /*des_startbit*/10,    /*src_cyc*/101,  /*src_id*/0x70,   /*src_dlc*/8,   /*des_id*/0x13c, /*updatebit_S*/8,   /*updatebit_D*/8         },
           {   /*sigGroup_s*/"igBltLockStAtRowThrdLe_0",   /*sig_name*/"isBltLockStAtRowThrdLeBltLockEquid_0",   /*src_can*/"ZCUD_CAN1",   /*src_network_type*/"CAN",   /*src_slotid_fr*/0,   /*src_basecycle_fr*/0,  /*src_repetition_fr*/0,  /*src_startbit*/11,   /*sigG_length*/1,  /*des_slotid_fr*/0,   /*des_basecycle_fr*/0,  /*des_repetition_fr*/0,   /*des_startbit*/11,    /*src_cyc*/101,  /*src_id*/0x70,   /*src_dlc*/8,   /*des_id*/0x13c, /*updatebit_S*/8,   /*updatebit_D*/8         },
           {   /*sigGroup_s*/"igBltLockStAtRowThrdLe_0",   /*sig_name*/"isBltLockStAtRowThrdLeBltLockSts_0",   /*src_can*/"ZCUD_CAN1",   /*src_network_type*/"CAN",   /*src_slotid_fr*/0,   /*src_basecycle_fr*/0,  /*src_repetition_fr*/0,  /*src_startbit*/9,   /*sigG_length*/1,  /*des_slotid_fr*/0,   /*des_basecycle_fr*/0,  /*des_repetition_fr*/0,   /*des_startbit*/9,    /*src_cyc*/101,  /*src_id*/0x70,   /*src_dlc*/8,   /*des_id*/0x13c, /*updatebit_S*/8,   /*updatebit_D*/8         },
           {   /*sigGroup_s*/"igHWASyncStsGroupH1_0",   /*sig_name*/"isHWASyncStsGroupH1SyncSts_0",   /*src_can*/"ZCUD_CANFD3",   /*src_network_type*/"CANFD",   /*src_slotid_fr*/0,   /*src_basecycle_fr*/0,  /*src_repetition_fr*/0,  /*src_startbit*/2,   /*sigG_length*/2,  /*des_slotid_fr*/0,   /*des_basecycle_fr*/0,  /*des_repetition_fr*/0,   /*des_startbit*/228,    /*src_cyc*/101,  /*src_id*/0x2c2,   /*src_dlc*/64,   /*des_id*/0x13c, /*updatebit_S*/0,   /*updatebit_D*/226         },
           {   /*sigGroup_s*/"igHWASyncStsGroupH1_0",   /*sig_name*/"isHWASyncStsGroupH1SyncOvrdIndcn_0",   /*src_can*/"ZCUD_CANFD3",   /*src_network_type*/"CANFD",   /*src_slotid_fr*/0,   /*src_basecycle_fr*/0,  /*src_repetition_fr*/0,  /*src_startbit*/5,   /*sigG_length*/3,  /*des_slotid_fr*/0,   /*des_basecycle_fr*/0,  /*des_repetition_fr*/0,   /*des_startbit*/231,    /*src_cyc*/101,  /*src_id*/0x2c2,   /*src_dlc*/64,   /*des_id*/0x13c, /*updatebit_S*/0,   /*updatebit_D*/226         },
           {   /*sigGroup_s*/"igBltLockStAtRowThrdMid_0",   /*sig_name*/"isBltLockStAtRowThrdMidBltLockEquid_0",   /*src_can*/"ZCUD_CAN1",   /*src_network_type*/"CAN",   /*src_slotid_fr*/0,   /*src_basecycle_fr*/0,  /*src_repetition_fr*/0,  /*src_startbit*/43,   /*sigG_length*/1,  /*des_slotid_fr*/0,   /*des_basecycle_fr*/0,  /*des_repetition_fr*/0,   /*des_startbit*/23,    /*src_cyc*/101,  /*src_id*/0x225,   /*src_dlc*/8,   /*des_id*/0x13c, /*updatebit_S*/40,   /*updatebit_D*/20         },
           {   /*sigGroup_s*/"igBltLockStAtRowThrdMid_0",   /*sig_name*/"isBltLockStAtRowThrdMidBltLockSts_0",   /*src_can*/"ZCUD_CAN1",   /*src_network_type*/"CAN",   /*src_slotid_fr*/0,   /*src_basecycle_fr*/0,  /*src_repetition_fr*/0,  /*src_startbit*/41,   /*sigG_length*/1,  /*des_slotid_fr*/0,   /*des_basecycle_fr*/0,  /*des_repetition_fr*/0,   /*des_startbit*/21,    /*src_cyc*/101,  /*src_id*/0x225,   /*src_dlc*/8,   /*des_id*/0x13c, /*updatebit_S*/40,   /*updatebit_D*/20         },
           {   /*sigGroup_s*/"igBltLockStAtRowThrdMid_0",   /*sig_name*/"isBltLockStAtRowThrdMidBltLockSt1_0",   /*src_can*/"ZCUD_CAN1",   /*src_network_type*/"CAN",   /*src_slotid_fr*/0,   /*src_basecycle_fr*/0,  /*src_repetition_fr*/0,  /*src_startbit*/42,   /*sigG_length*/1,  /*des_slotid_fr*/0,   /*des_basecycle_fr*/0,  /*des_repetition_fr*/0,   /*des_startbit*/22,    /*src_cyc*/101,  /*src_id*/0x225,   /*src_dlc*/8,   /*des_id*/0x13c, /*updatebit_S*/40,   /*updatebit_D*/20         },
           {   /*sigGroup_s*/"igADataRawSafe_0",   /*sig_name*/"isADataRawSafeALgt_0",   /*src_can*/"ZCUD_CAN1",   /*src_network_type*/"CAN",   /*src_slotid_fr*/0,   /*src_basecycle_fr*/0,  /*src_repetition_fr*/0,  /*src_startbit*/38,   /*sigG_length*/15,  /*des_slotid_fr*/0,   /*des_basecycle_fr*/0,  /*des_repetition_fr*/0,   /*des_startbit*/8,    /*src_cyc*/101,  /*src_id*/0x12,   /*src_dlc*/8,   /*des_id*/0x4f, /*updatebit_S*/56,   /*updatebit_D*/56         },
           {   /*sigGroup_s*/"igADataRawSafe_0",   /*sig_name*/"isADataRawSafeALgt1Qf_0",   /*src_can*/"ZCUD_CAN1",   /*src_network_type*/"CAN",   /*src_slotid_fr*/0,   /*src_basecycle_fr*/0,  /*src_repetition_fr*/0,  /*src_startbit*/9,   /*sigG_length*/2,  /*des_slotid_fr*/0,   /*des_basecycle_fr*/0,  /*des_repetition_fr*/0,   /*des_startbit*/60,    /*src_cyc*/101,  /*src_id*/0x12,   /*src_dlc*/8,   /*des_id*/0x4f, /*updatebit_S*/56,   /*updatebit_D*/56         },
           {   /*sigGroup_s*/"igADataRawSafe_0",   /*sig_name*/"isADataRawSafeALat_0",   /*src_can*/"ZCUD_CAN1",   /*src_network_type*/"CAN",   /*src_slotid_fr*/0,   /*src_basecycle_fr*/0,  /*src_repetition_fr*/0,  /*src_startbit*/23,   /*sigG_length*/15,  /*des_slotid_fr*/0,   /*des_basecycle_fr*/0,  /*des_repetition_fr*/0,   /*des_startbit*/7,    /*src_cyc*/101,  /*src_id*/0x12,   /*src_dlc*/8,   /*des_id*/0x4f, /*updatebit_S*/56,   /*updatebit_D*/56         },
           {   /*sigGroup_s*/"igADataRawSafe_0",   /*sig_name*/"isADataRawSafeAVert_0",   /*src_can*/"ZCUD_CAN1",   /*src_network_type*/"CAN",   /*src_slotid_fr*/0,   /*src_basecycle_fr*/0,  /*src_repetition_fr*/0,  /*src_startbit*/55,   /*sigG_length*/15,  /*des_slotid_fr*/0,   /*des_basecycle_fr*/0,  /*des_repetition_fr*/0,   /*des_startbit*/25,    /*src_cyc*/101,  /*src_id*/0x12,   /*src_dlc*/8,   /*des_id*/0x4f, /*updatebit_S*/56,   /*updatebit_D*/56         },
           {   /*sigGroup_s*/"igADataRawSafe_0",   /*sig_name*/"isADataRawSafeALat1Qf_0",   /*src_can*/"ZCUD_CAN1",   /*src_network_type*/"CAN",   /*src_slotid_fr*/0,   /*src_basecycle_fr*/0,  /*src_repetition_fr*/0,  /*src_startbit*/11,   /*sigG_length*/2,  /*des_slotid_fr*/0,   /*des_basecycle_fr*/0,  /*des_repetition_fr*/0,   /*des_startbit*/62,    /*src_cyc*/101,  /*src_id*/0x12,   /*src_dlc*/8,   /*des_id*/0x4f, /*updatebit_S*/56,   /*updatebit_D*/56         },
           {   /*sigGroup_s*/"igADataRawSafe_0",   /*sig_name*/"isADataRawSafeChks_0",   /*src_can*/"ZCUD_CAN1",   /*src_network_type*/"CAN",   /*src_slotid_fr*/0,   /*src_basecycle_fr*/0,  /*src_repetition_fr*/0,  /*src_startbit*/7,   /*sigG_length*/8,  /*des_slotid_fr*/0,   /*des_basecycle_fr*/0,  /*des_repetition_fr*/0,   /*des_startbit*/42,    /*src_cyc*/101,  /*src_id*/0x12,   /*src_dlc*/8,   /*des_id*/0x4f, /*updatebit_S*/56,   /*updatebit_D*/56         },
           {   /*sigGroup_s*/"igADataRawSafe_0",   /*sig_name*/"isADataRawSafeAVertQf_0",   /*src_can*/"ZCUD_CAN1",   /*src_network_type*/"CAN",   /*src_slotid_fr*/0,   /*src_basecycle_fr*/0,  /*src_repetition_fr*/0,  /*src_startbit*/24,   /*sigG_length*/2,  /*des_slotid_fr*/0,   /*des_basecycle_fr*/0,  /*des_repetition_fr*/0,   /*des_startbit*/58,    /*src_cyc*/101,  /*src_id*/0x12,   /*src_dlc*/8,   /*des_id*/0x4f, /*updatebit_S*/56,   /*updatebit_D*/56         },
           {   /*sigGroup_s*/"igADataRawSafe_0",   /*sig_name*/"isADataRawSafeCntr_0",   /*src_can*/"ZCUD_CAN1",   /*src_network_type*/"CAN",   /*src_slotid_fr*/0,   /*src_basecycle_fr*/0,  /*src_repetition_fr*/0,  /*src_startbit*/15,   /*sigG_length*/4,  /*des_slotid_fr*/0,   /*des_basecycle_fr*/0,  /*des_repetition_fr*/0,   /*des_startbit*/50,    /*src_cyc*/101,  /*src_id*/0x12,   /*src_dlc*/8,   /*des_id*/0x4f, /*updatebit_S*/56,   /*updatebit_D*/56         },
           {   /*sigGroup_s*/"igBltLockStAtDrvr_0",   /*sig_name*/"isBltLockStAtDrvrBltLockSt1_0",   /*src_can*/"ZCUD_CAN1",   /*src_network_type*/"CAN",   /*src_slotid_fr*/0,   /*src_basecycle_fr*/0,  /*src_repetition_fr*/0,  /*src_startbit*/57,   /*sigG_length*/1,  /*des_slotid_fr*/0,   /*des_basecycle_fr*/0,  /*des_repetition_fr*/0,   /*des_startbit*/31,    /*src_cyc*/101,  /*src_id*/0x89,   /*src_dlc*/8,   /*des_id*/0x13c, /*updatebit_S*/7,   /*updatebit_D*/29         },
           {   /*sigGroup_s*/"igBltLockStAtDrvr_0",   /*sig_name*/"isBltLockStAtDrvrBltLockSts_0",   /*src_can*/"ZCUD_CAN1",   /*src_network_type*/"CAN",   /*src_slotid_fr*/0,   /*src_basecycle_fr*/0,  /*src_repetition_fr*/0,  /*src_startbit*/56,   /*sigG_length*/1,  /*des_slotid_fr*/0,   /*des_basecycle_fr*/0,  /*des_repetition_fr*/0,   /*des_startbit*/30,    /*src_cyc*/101,  /*src_id*/0x89,   /*src_dlc*/8,   /*des_id*/0x13c, /*updatebit_S*/7,   /*updatebit_D*/29         },
           {   /*sigGroup_s*/"igBltLockStSafeAtDrvr_0",   /*sig_name*/"isBltLockStSafeAtDrvrBltLockStErrSts_0",   /*src_can*/"ZCUD_CAN1",   /*src_network_type*/"CAN",   /*src_slotid_fr*/0,   /*src_basecycle_fr*/0,  /*src_repetition_fr*/0,  /*src_startbit*/12,   /*sigG_length*/1,  /*des_slotid_fr*/0,   /*des_basecycle_fr*/0,  /*des_repetition_fr*/0,   /*des_startbit*/466,    /*src_cyc*/101,  /*src_id*/0x21,   /*src_dlc*/8,   /*des_id*/0x35c, /*updatebit_S*/14,   /*updatebit_D*/465         },
           {   /*sigGroup_s*/"igBltLockStSafeAtDrvr_0",   /*sig_name*/"isBltLockStSafeAtDrvrCntr_0",   /*src_can*/"ZCUD_CAN1",   /*src_network_type*/"CAN",   /*src_slotid_fr*/0,   /*src_basecycle_fr*/0,  /*src_repetition_fr*/0,  /*src_startbit*/11,   /*sigG_length*/4,  /*des_slotid_fr*/0,   /*des_basecycle_fr*/0,  /*des_repetition_fr*/0,   /*des_startbit*/471,    /*src_cyc*/101,  /*src_id*/0x21,   /*src_dlc*/8,   /*des_id*/0x35c, /*updatebit_S*/14,   /*updatebit_D*/465         },
           {   /*sigGroup_s*/"igBltLockStSafeAtDrvr_0",   /*sig_name*/"isBltLockStSafeAtDrvrChks_0",   /*src_can*/"ZCUD_CAN1",   /*src_network_type*/"CAN",   /*src_slotid_fr*/0,   /*src_basecycle_fr*/0,  /*src_repetition_fr*/0,  /*src_startbit*/23,   /*sigG_length*/8,  /*des_slotid_fr*/0,   /*des_basecycle_fr*/0,  /*des_repetition_fr*/0,   /*des_startbit*/463,    /*src_cyc*/101,  /*src_id*/0x21,   /*src_dlc*/8,   /*des_id*/0x35c, /*updatebit_S*/14,   /*updatebit_D*/465         },
           {   /*sigGroup_s*/"igBltLockStSafeAtDrvr_0",   /*sig_name*/"isBltLockStSafeAtDrvrBltLockSt1_0",   /*src_can*/"ZCUD_CAN1",   /*src_network_type*/"CAN",   /*src_slotid_fr*/0,   /*src_basecycle_fr*/0,  /*src_repetition_fr*/0,  /*src_startbit*/13,   /*sigG_length*/1,  /*des_slotid_fr*/0,   /*des_basecycle_fr*/0,  /*des_repetition_fr*/0,   /*des_startbit*/467,    /*src_cyc*/101,  /*src_id*/0x21,   /*src_dlc*/8,   /*des_id*/0x35c, /*updatebit_S*/14,   /*updatebit_D*/465         },
           {   /*sigGroup_s*/"igBltLockStAtRowSecLe_0",   /*sig_name*/"isBltLockStAtRowSecLeBltLockEquid_0",   /*src_can*/"ZCUD_CAN1",   /*src_network_type*/"CAN",   /*src_slotid_fr*/0,   /*src_basecycle_fr*/0,  /*src_repetition_fr*/0,  /*src_startbit*/7,   /*sigG_length*/1,  /*des_slotid_fr*/0,   /*des_basecycle_fr*/0,  /*des_repetition_fr*/0,   /*des_startbit*/7,    /*src_cyc*/101,  /*src_id*/0x70,   /*src_dlc*/8,   /*des_id*/0x13c, /*updatebit_S*/4,   /*updatebit_D*/4         },
           {   /*sigGroup_s*/"igBltLockStAtRowSecLe_0",   /*sig_name*/"isBltLockStAtRowSecLeBltLockSts_0",   /*src_can*/"ZCUD_CAN1",   /*src_network_type*/"CAN",   /*src_slotid_fr*/0,   /*src_basecycle_fr*/0,  /*src_repetition_fr*/0,  /*src_startbit*/5,   /*sigG_length*/1,  /*des_slotid_fr*/0,   /*des_basecycle_fr*/0,  /*des_repetition_fr*/0,   /*des_startbit*/5,    /*src_cyc*/101,  /*src_id*/0x70,   /*src_dlc*/8,   /*des_id*/0x13c, /*updatebit_S*/4,   /*updatebit_D*/4         },
           {   /*sigGroup_s*/"igBltLockStAtRowSecLe_0",   /*sig_name*/"isBltLockStAtRowSecLeBltLockSt1_0",   /*src_can*/"ZCUD_CAN1",   /*src_network_type*/"CAN",   /*src_slotid_fr*/0,   /*src_basecycle_fr*/0,  /*src_repetition_fr*/0,  /*src_startbit*/6,   /*sigG_length*/1,  /*des_slotid_fr*/0,   /*des_basecycle_fr*/0,  /*des_repetition_fr*/0,   /*des_startbit*/6,    /*src_cyc*/101,  /*src_id*/0x70,   /*src_dlc*/8,   /*des_id*/0x13c, /*updatebit_S*/4,   /*updatebit_D*/4         },
           {   /*sigGroup_s*/"igAgDataRaw2Safe_0",   /*sig_name*/"isAgDataRaw2SafeCntr_0",   /*src_can*/"ZCUD_CAN1",   /*src_network_type*/"CAN",   /*src_slotid_fr*/0,   /*src_basecycle_fr*/0,  /*src_repetition_fr*/0,  /*src_startbit*/3,   /*sigG_length*/4,  /*des_slotid_fr*/0,   /*des_basecycle_fr*/0,  /*des_repetition_fr*/0,   /*des_startbit*/95,    /*src_cyc*/101,  /*src_id*/0x142,   /*src_dlc*/8,   /*des_id*/0x4f, /*updatebit_S*/6,   /*updatebit_D*/89         },
           {   /*sigGroup_s*/"igAgDataRaw2Safe_0",   /*sig_name*/"isAgDataRaw2SafeChks_0",   /*src_can*/"ZCUD_CAN1",   /*src_network_type*/"CAN",   /*src_slotid_fr*/0,   /*src_basecycle_fr*/0,  /*src_repetition_fr*/0,  /*src_startbit*/15,   /*sigG_length*/8,  /*des_slotid_fr*/0,   /*des_basecycle_fr*/0,  /*des_repetition_fr*/0,   /*des_startbit*/87,    /*src_cyc*/101,  /*src_id*/0x142,   /*src_dlc*/8,   /*des_id*/0x4f, /*updatebit_S*/6,   /*updatebit_D*/89         },
           {   /*sigGroup_s*/"igAgDataRaw2Safe_0",   /*sig_name*/"isAgDataRaw2SafePitchRate_0",   /*src_can*/"ZCUD_CAN1",   /*src_network_type*/"CAN",   /*src_slotid_fr*/0,   /*src_basecycle_fr*/0,  /*src_repetition_fr*/0,  /*src_startbit*/23,   /*sigG_length*/16,  /*des_slotid_fr*/0,   /*des_basecycle_fr*/0,  /*des_repetition_fr*/0,   /*des_startbit*/71,    /*src_cyc*/101,  /*src_id*/0x142,   /*src_dlc*/8,   /*des_id*/0x4f, /*updatebit_S*/6,   /*updatebit_D*/89         },
           {   /*sigGroup_s*/"igAgDataRaw2Safe_0",   /*sig_name*/"isAgDataRaw2SafePitchRateQf_0",   /*src_can*/"ZCUD_CAN1",   /*src_network_type*/"CAN",   /*src_slotid_fr*/0,   /*src_basecycle_fr*/0,  /*src_repetition_fr*/0,  /*src_startbit*/5,   /*sigG_length*/2,  /*des_slotid_fr*/0,   /*des_basecycle_fr*/0,  /*des_repetition_fr*/0,   /*des_startbit*/91,    /*src_cyc*/101,  /*src_id*/0x142,   /*src_dlc*/8,   /*des_id*/0x4f, /*updatebit_S*/6,   /*updatebit_D*/89         },
           {   /*sigGroup_s*/"igAgDataRawSafe_0",   /*sig_name*/"isAgDataRawSafeYawRate_0",   /*src_can*/"ZCUD_CAN1",   /*src_network_type*/"CAN",   /*src_slotid_fr*/0,   /*src_basecycle_fr*/0,  /*src_repetition_fr*/0,  /*src_startbit*/31,   /*sigG_length*/16,  /*des_slotid_fr*/0,   /*des_basecycle_fr*/0,  /*des_repetition_fr*/0,   /*des_startbit*/119,    /*src_cyc*/101,  /*src_id*/0x89,   /*src_dlc*/8,   /*des_id*/0x4f, /*updatebit_S*/5,   /*updatebit_D*/88         },
           {   /*sigGroup_s*/"igAgDataRawSafe_0",   /*sig_name*/"isAgDataRawSafeRollRateQf_0",   /*src_can*/"ZCUD_CAN1",   /*src_network_type*/"CAN",   /*src_slotid_fr*/0,   /*src_basecycle_fr*/0,  /*src_repetition_fr*/0,  /*src_startbit*/51,   /*sigG_length*/2,  /*des_slotid_fr*/0,   /*des_basecycle_fr*/0,  /*des_repetition_fr*/0,   /*des_startbit*/139,    /*src_cyc*/101,  /*src_id*/0x89,   /*src_dlc*/8,   /*des_id*/0x4f, /*updatebit_S*/5,   /*updatebit_D*/88         },
           {   /*sigGroup_s*/"igAgDataRawSafe_0",   /*sig_name*/"isAgDataRawSafeCntr_0",   /*src_can*/"ZCUD_CAN1",   /*src_network_type*/"CAN",   /*src_slotid_fr*/0,   /*src_basecycle_fr*/0,  /*src_repetition_fr*/0,  /*src_startbit*/55,   /*sigG_length*/4,  /*des_slotid_fr*/0,   /*des_basecycle_fr*/0,  /*des_repetition_fr*/0,   /*des_startbit*/143,    /*src_cyc*/101,  /*src_id*/0x89,   /*src_dlc*/8,   /*des_id*/0x4f, /*updatebit_S*/5,   /*updatebit_D*/88         },
           {   /*sigGroup_s*/"igAgDataRawSafe_0",   /*sig_name*/"isAgDataRawSafeChks_0",   /*src_can*/"ZCUD_CAN1",   /*src_network_type*/"CAN",   /*src_slotid_fr*/0,   /*src_basecycle_fr*/0,  /*src_repetition_fr*/0,  /*src_startbit*/47,   /*sigG_length*/8,  /*des_slotid_fr*/0,   /*des_basecycle_fr*/0,  /*des_repetition_fr*/0,   /*des_startbit*/135,    /*src_cyc*/101,  /*src_id*/0x89,   /*src_dlc*/8,   /*des_id*/0x4f, /*updatebit_S*/5,   /*updatebit_D*/88         },
           {   /*sigGroup_s*/"igAgDataRawSafe_0",   /*sig_name*/"isAgDataRawSafeYawRateQf_0",   /*src_can*/"ZCUD_CAN1",   /*src_network_type*/"CAN",   /*src_slotid_fr*/0,   /*src_basecycle_fr*/0,  /*src_repetition_fr*/0,  /*src_startbit*/49,   /*sigG_length*/2,  /*des_slotid_fr*/0,   /*des_basecycle_fr*/0,  /*des_repetition_fr*/0,   /*des_startbit*/137,    /*src_cyc*/101,  /*src_id*/0x89,   /*src_dlc*/8,   /*des_id*/0x4f, /*updatebit_S*/5,   /*updatebit_D*/88         },
           {   /*sigGroup_s*/"igAgDataRawSafe_0",   /*sig_name*/"isAgDataRawSafeRollRate_0",   /*src_can*/"ZCUD_CAN1",   /*src_network_type*/"CAN",   /*src_slotid_fr*/0,   /*src_basecycle_fr*/0,  /*src_repetition_fr*/0,  /*src_startbit*/15,   /*sigG_length*/16,  /*des_slotid_fr*/0,   /*des_basecycle_fr*/0,  /*des_repetition_fr*/0,   /*des_startbit*/103,    /*src_cyc*/101,  /*src_id*/0x89,   /*src_dlc*/8,   /*des_id*/0x4f, /*updatebit_S*/5,   /*updatebit_D*/88         },
           {   /*sigGroup_s*/"igBltLockStAtPass_0",   /*sig_name*/"isBltLockStAtPassBltLockSt1_0",   /*src_can*/"ZCUD_CAN1",   /*src_network_type*/"CAN",   /*src_slotid_fr*/0,   /*src_basecycle_fr*/0,  /*src_repetition_fr*/0,  /*src_startbit*/63,   /*sigG_length*/1,  /*des_slotid_fr*/0,   /*des_basecycle_fr*/0,  /*des_repetition_fr*/0,   /*des_startbit*/28,    /*src_cyc*/101,  /*src_id*/0x89,   /*src_dlc*/8,   /*des_id*/0x13c, /*updatebit_S*/6,   /*updatebit_D*/26         },
           {   /*sigGroup_s*/"igBltLockStAtPass_0",   /*sig_name*/"isBltLockStAtPassBltLockSts_0",   /*src_can*/"ZCUD_CAN1",   /*src_network_type*/"CAN",   /*src_slotid_fr*/0,   /*src_basecycle_fr*/0,  /*src_repetition_fr*/0,  /*src_startbit*/62,   /*sigG_length*/1,  /*des_slotid_fr*/0,   /*des_basecycle_fr*/0,  /*des_repetition_fr*/0,   /*des_startbit*/27,    /*src_cyc*/101,  /*src_id*/0x89,   /*src_dlc*/8,   /*des_id*/0x13c, /*updatebit_S*/6,   /*updatebit_D*/26         },
           {   /*sigGroup_s*/"igPinionSteerAgGroup_0",   /*sig_name*/"isPinionSteerAgGroupPinionSteerAg1Qf_0",   /*src_can*/"ChassisCAN1",   /*src_network_type*/"CAN",   /*src_slotid_fr*/0,   /*src_basecycle_fr*/0,  /*src_repetition_fr*/0,  /*src_startbit*/15,   /*sigG_length*/2,  /*des_slotid_fr*/0,   /*des_basecycle_fr*/0,  /*des_repetition_fr*/0,   /*des_startbit*/31,    /*src_cyc*/101,  /*src_id*/0x4e,   /*src_dlc*/8,   /*des_id*/0x335, /*updatebit_S*/57,   /*updatebit_D*/7         },
           {   /*sigGroup_s*/"igPinionSteerAgGroup_0",   /*sig_name*/"isPinionSteerAgGroupCntr_0",   /*src_can*/"ChassisCAN1",   /*src_network_type*/"CAN",   /*src_slotid_fr*/0,   /*src_basecycle_fr*/0,  /*src_repetition_fr*/0,  /*src_startbit*/63,   /*sigG_length*/4,  /*des_slotid_fr*/0,   /*des_basecycle_fr*/0,  /*des_repetition_fr*/0,   /*des_startbit*/63,    /*src_cyc*/101,  /*src_id*/0x4e,   /*src_dlc*/8,   /*des_id*/0x335, /*updatebit_S*/57,   /*updatebit_D*/7         },
           {   /*sigGroup_s*/"igPinionSteerAgGroup_0",   /*sig_name*/"isPinionSteerAgGroupSteerWhlTq_0",   /*src_can*/"ChassisCAN1",   /*src_network_type*/"CAN",   /*src_slotid_fr*/0,   /*src_basecycle_fr*/0,  /*src_repetition_fr*/0,  /*src_startbit*/29,   /*sigG_length*/14,  /*des_slotid_fr*/0,   /*des_basecycle_fr*/0,  /*des_repetition_fr*/0,   /*des_startbit*/45,    /*src_cyc*/101,  /*src_id*/0x4e,   /*src_dlc*/8,   /*des_id*/0x335, /*updatebit_S*/57,   /*updatebit_D*/7         },
           {   /*sigGroup_s*/"igPinionSteerAgGroup_0",   /*sig_name*/"isPinionSteerAgGroupPinionSteerAg1_0",   /*src_can*/"ChassisCAN1",   /*src_network_type*/"CAN",   /*src_slotid_fr*/0,   /*src_basecycle_fr*/0,  /*src_repetition_fr*/0,  /*src_startbit*/46,   /*sigG_length*/15,  /*des_slotid_fr*/0,   /*des_basecycle_fr*/0,  /*des_repetition_fr*/0,   /*des_startbit*/6,    /*src_cyc*/101,  /*src_id*/0x4e,   /*src_dlc*/8,   /*des_id*/0x335, /*updatebit_S*/57,   /*updatebit_D*/7         },
           {   /*sigGroup_s*/"igPinionSteerAgGroup_0",   /*sig_name*/"isPinionSteerAgGroupPinionSteerAgSpd1_0",   /*src_can*/"ChassisCAN1",   /*src_network_type*/"CAN",   /*src_slotid_fr*/0,   /*src_basecycle_fr*/0,  /*src_repetition_fr*/0,  /*src_startbit*/13,   /*sigG_length*/14,  /*des_slotid_fr*/0,   /*des_basecycle_fr*/0,  /*des_repetition_fr*/0,   /*des_startbit*/29,    /*src_cyc*/101,  /*src_id*/0x4e,   /*src_dlc*/8,   /*des_id*/0x335, /*updatebit_S*/57,   /*updatebit_D*/7         },
           {   /*sigGroup_s*/"igPinionSteerAgGroup_0",   /*sig_name*/"isPinionSteerAgGroupSteerWhlTqQf_0",   /*src_can*/"ChassisCAN1",   /*src_network_type*/"CAN",   /*src_slotid_fr*/0,   /*src_basecycle_fr*/0,  /*src_repetition_fr*/0,  /*src_startbit*/59,   /*sigG_length*/2,  /*des_slotid_fr*/0,   /*des_basecycle_fr*/0,  /*des_repetition_fr*/0,   /*des_startbit*/59,    /*src_cyc*/101,  /*src_id*/0x4e,   /*src_dlc*/8,   /*des_id*/0x335, /*updatebit_S*/57,   /*updatebit_D*/7         },
           {   /*sigGroup_s*/"igPinionSteerAgGroup_0",   /*sig_name*/"isPinionSteerAgGroupPinionSteerAgSpd1Qf_0",   /*src_can*/"ChassisCAN1",   /*src_network_type*/"CAN",   /*src_slotid_fr*/0,   /*src_basecycle_fr*/0,  /*src_repetition_fr*/0,  /*src_startbit*/31,   /*sigG_length*/2,  /*des_slotid_fr*/0,   /*des_basecycle_fr*/0,  /*des_repetition_fr*/0,   /*des_startbit*/47,    /*src_cyc*/101,  /*src_id*/0x4e,   /*src_dlc*/8,   /*des_id*/0x335, /*updatebit_S*/57,   /*updatebit_D*/7         },
           {   /*sigGroup_s*/"igPinionSteerAgGroup_0",   /*sig_name*/"isPinionSteerAgGroupChks_0",   /*src_can*/"ChassisCAN1",   /*src_network_type*/"CAN",   /*src_slotid_fr*/0,   /*src_basecycle_fr*/0,  /*src_repetition_fr*/0,  /*src_startbit*/7,   /*sigG_length*/8,  /*des_slotid_fr*/0,   /*des_basecycle_fr*/0,  /*des_repetition_fr*/0,   /*des_startbit*/23,    /*src_cyc*/101,  /*src_id*/0x4e,   /*src_dlc*/8,   /*des_id*/0x335, /*updatebit_S*/57,   /*updatebit_D*/7         },
           {   /*sigGroup_s*/"igBltLockStAtRowThrdRi_0",   /*sig_name*/"isBltLockStAtRowThrdRiBltLockSts_0",   /*src_can*/"ZCUD_CAN1",   /*src_network_type*/"CAN",   /*src_slotid_fr*/0,   /*src_basecycle_fr*/0,  /*src_repetition_fr*/0,  /*src_startbit*/21,   /*sigG_length*/1,  /*des_slotid_fr*/0,   /*des_basecycle_fr*/0,  /*des_repetition_fr*/0,   /*des_startbit*/17,    /*src_cyc*/101,  /*src_id*/0x70,   /*src_dlc*/8,   /*des_id*/0x13c, /*updatebit_S*/20,   /*updatebit_D*/16         },
           {   /*sigGroup_s*/"igBltLockStAtRowThrdRi_0",   /*sig_name*/"isBltLockStAtRowThrdRiBltLockEquid_0",   /*src_can*/"ZCUD_CAN1",   /*src_network_type*/"CAN",   /*src_slotid_fr*/0,   /*src_basecycle_fr*/0,  /*src_repetition_fr*/0,  /*src_startbit*/23,   /*sigG_length*/1,  /*des_slotid_fr*/0,   /*des_basecycle_fr*/0,  /*des_repetition_fr*/0,   /*des_startbit*/19,    /*src_cyc*/101,  /*src_id*/0x70,   /*src_dlc*/8,   /*des_id*/0x13c, /*updatebit_S*/20,   /*updatebit_D*/16         },
           {   /*sigGroup_s*/"igBltLockStAtRowThrdRi_0",   /*sig_name*/"isBltLockStAtRowThrdRiBltLockSt1_0",   /*src_can*/"ZCUD_CAN1",   /*src_network_type*/"CAN",   /*src_slotid_fr*/0,   /*src_basecycle_fr*/0,  /*src_repetition_fr*/0,  /*src_startbit*/22,   /*sigG_length*/1,  /*des_slotid_fr*/0,   /*des_basecycle_fr*/0,  /*des_repetition_fr*/0,   /*des_startbit*/18,    /*src_cyc*/101,  /*src_id*/0x70,   /*src_dlc*/8,   /*des_id*/0x13c, /*updatebit_S*/20,   /*updatebit_D*/16         },
           {   /*sigGroup_s*/"igIntgtIMUDataRawSafe_0",   /*sig_name*/"isIntgtIMUDataRawSafeAvert_0",   /*src_can*/"ZCUD_CANFD3",   /*src_network_type*/"CANFD",   /*src_slotid_fr*/0,   /*src_basecycle_fr*/0,  /*src_repetition_fr*/0,  /*src_startbit*/257,   /*sigG_length*/15,  /*des_slotid_fr*/0,   /*des_basecycle_fr*/0,  /*des_repetition_fr*/0,   /*des_startbit*/398,    /*src_cyc*/101,  /*src_id*/0x32,   /*src_dlc*/64,   /*des_id*/0x35c, /*updatebit_S*/298,   /*updatebit_D*/335         },
           {   /*sigGroup_s*/"igIntgtIMUDataRawSafe_0",   /*sig_name*/"isIntgtIMUDataRawSafeAVertQf_0",   /*src_can*/"ZCUD_CANFD3",   /*src_network_type*/"CANFD",   /*src_slotid_fr*/0,   /*src_basecycle_fr*/0,  /*src_repetition_fr*/0,  /*src_startbit*/290,   /*sigG_length*/2,  /*des_slotid_fr*/0,   /*des_basecycle_fr*/0,  /*des_repetition_fr*/0,   /*des_startbit*/447,    /*src_cyc*/101,  /*src_id*/0x32,   /*src_dlc*/64,   /*des_id*/0x35c, /*updatebit_S*/298,   /*updatebit_D*/335         },
           {   /*sigGroup_s*/"igIntgtIMUDataRawSafe_0",   /*sig_name*/"isIntgtIMUDataRawSafeALat1Qf_0",   /*src_can*/"ZCUD_CANFD3",   /*src_network_type*/"CANFD",   /*src_slotid_fr*/0,   /*src_basecycle_fr*/0,  /*src_repetition_fr*/0,  /*src_startbit*/294,   /*sigG_length*/2,  /*des_slotid_fr*/0,   /*des_basecycle_fr*/0,  /*des_repetition_fr*/0,   /*des_startbit*/439,    /*src_cyc*/101,  /*src_id*/0x32,   /*src_dlc*/64,   /*des_id*/0x35c, /*updatebit_S*/298,   /*updatebit_D*/335         },
           {   /*sigGroup_s*/"igIntgtIMUDataRawSafe_0",   /*sig_name*/"isIntgtIMUDataRawSafeALgt_0",   /*src_can*/"ZCUD_CANFD3",   /*src_network_type*/"CANFD",   /*src_slotid_fr*/0,   /*src_basecycle_fr*/0,  /*src_repetition_fr*/0,  /*src_startbit*/240,   /*sigG_length*/15,  /*des_slotid_fr*/0,   /*des_basecycle_fr*/0,  /*des_repetition_fr*/0,   /*des_startbit*/334,    /*src_cyc*/101,  /*src_id*/0x32,   /*src_dlc*/64,   /*des_id*/0x35c, /*updatebit_S*/298,   /*updatebit_D*/335         },
           {   /*sigGroup_s*/"igIntgtIMUDataRawSafe_0",   /*sig_name*/"isIntgtIMUDataRawSafePitchRate_0",   /*src_can*/"ZCUD_CANFD3",   /*src_network_type*/"CANFD",   /*src_slotid_fr*/0,   /*src_basecycle_fr*/0,  /*src_repetition_fr*/0,  /*src_startbit*/191,   /*sigG_length*/16,  /*des_slotid_fr*/0,   /*des_basecycle_fr*/0,  /*des_repetition_fr*/0,   /*des_startbit*/415,    /*src_cyc*/101,  /*src_id*/0x32,   /*src_dlc*/64,   /*des_id*/0x35c, /*updatebit_S*/298,   /*updatebit_D*/335         },
           {   /*sigGroup_s*/"igIntgtIMUDataRawSafe_0",   /*sig_name*/"isIntgtIMUDataRawSafeYawRate_0",   /*src_can*/"ZCUD_CANFD3",   /*src_network_type*/"CANFD",   /*src_slotid_fr*/0,   /*src_basecycle_fr*/0,  /*src_repetition_fr*/0,  /*src_startbit*/223,   /*sigG_length*/16,  /*des_slotid_fr*/0,   /*des_basecycle_fr*/0,  /*des_repetition_fr*/0,   /*des_startbit*/367,    /*src_cyc*/101,  /*src_id*/0x32,   /*src_dlc*/64,   /*des_id*/0x35c, /*updatebit_S*/298,   /*updatebit_D*/335         },
           {   /*sigGroup_s*/"igIntgtIMUDataRawSafe_0",   /*sig_name*/"isIntgtIMUDataRawSafeRollRate_0",   /*src_can*/"ZCUD_CANFD3",   /*src_network_type*/"CANFD",   /*src_slotid_fr*/0,   /*src_basecycle_fr*/0,  /*src_repetition_fr*/0,  /*src_startbit*/207,   /*sigG_length*/16,  /*des_slotid_fr*/0,   /*des_basecycle_fr*/0,  /*des_repetition_fr*/0,   /*des_startbit*/351,    /*src_cyc*/101,  /*src_id*/0x32,   /*src_dlc*/64,   /*des_id*/0x35c, /*updatebit_S*/298,   /*updatebit_D*/335         },
           {   /*sigGroup_s*/"igIntgtIMUDataRawSafe_0",   /*sig_name*/"isIntgtIMUDataRawSafeALat_0",   /*src_can*/"ZCUD_CANFD3",   /*src_network_type*/"CANFD",   /*src_slotid_fr*/0,   /*src_basecycle_fr*/0,  /*src_repetition_fr*/0,  /*src_startbit*/239,   /*sigG_length*/15,  /*des_slotid_fr*/0,   /*des_basecycle_fr*/0,  /*des_repetition_fr*/0,   /*des_startbit*/383,    /*src_cyc*/101,  /*src_id*/0x32,   /*src_dlc*/64,   /*des_id*/0x35c, /*updatebit_S*/298,   /*updatebit_D*/335         },
           {   /*sigGroup_s*/"igIntgtIMUDataRawSafe_0",   /*sig_name*/"isIntgtIMUDataRawSafeChks_0",   /*src_can*/"ZCUD_CANFD3",   /*src_network_type*/"CANFD",   /*src_slotid_fr*/0,   /*src_basecycle_fr*/0,  /*src_repetition_fr*/0,  /*src_startbit*/274,   /*sigG_length*/8,  /*des_slotid_fr*/0,   /*des_basecycle_fr*/0,  /*des_repetition_fr*/0,   /*des_startbit*/431,    /*src_cyc*/101,  /*src_id*/0x32,   /*src_dlc*/64,   /*des_id*/0x35c, /*updatebit_S*/298,   /*updatebit_D*/335         },
           {   /*sigGroup_s*/"igIntgtIMUDataRawSafe_0",   /*sig_name*/"isIntgtIMUDataRawSafeCntr_0",   /*src_can*/"ZCUD_CANFD3",   /*src_network_type*/"CANFD",   /*src_slotid_fr*/0,   /*src_basecycle_fr*/0,  /*src_repetition_fr*/0,  /*src_startbit*/282,   /*sigG_length*/4,  /*des_slotid_fr*/0,   /*des_basecycle_fr*/0,  /*des_repetition_fr*/0,   /*des_startbit*/435,    /*src_cyc*/101,  /*src_id*/0x32,   /*src_dlc*/64,   /*des_id*/0x35c, /*updatebit_S*/298,   /*updatebit_D*/335         },
           {   /*sigGroup_s*/"igIntgtIMUDataRawSafe_0",   /*sig_name*/"isIntgtIMUDataRawSafeYawRateQf_0",   /*src_can*/"ZCUD_CANFD3",   /*src_network_type*/"CANFD",   /*src_slotid_fr*/0,   /*src_basecycle_fr*/0,  /*src_repetition_fr*/0,  /*src_startbit*/300,   /*sigG_length*/2,  /*des_slotid_fr*/0,   /*des_basecycle_fr*/0,  /*des_repetition_fr*/0,   /*des_startbit*/443,    /*src_cyc*/101,  /*src_id*/0x32,   /*src_dlc*/64,   /*des_id*/0x35c, /*updatebit_S*/298,   /*updatebit_D*/335         },
           {   /*sigGroup_s*/"igIntgtIMUDataRawSafe_0",   /*sig_name*/"isIntgtIMUDataRawSafePitchRateQf_0",   /*src_can*/"ZCUD_CANFD3",   /*src_network_type*/"CANFD",   /*src_slotid_fr*/0,   /*src_basecycle_fr*/0,  /*src_repetition_fr*/0,  /*src_startbit*/288,   /*sigG_length*/2,  /*des_slotid_fr*/0,   /*des_basecycle_fr*/0,  /*des_repetition_fr*/0,   /*des_startbit*/384,    /*src_cyc*/101,  /*src_id*/0x32,   /*src_dlc*/64,   /*des_id*/0x35c, /*updatebit_S*/298,   /*updatebit_D*/335         },
           {   /*sigGroup_s*/"igIntgtIMUDataRawSafe_0",   /*sig_name*/"isIntgtIMUDataRawSafeALgt1Qf_0",   /*src_can*/"ZCUD_CANFD3",   /*src_network_type*/"CANFD",   /*src_slotid_fr*/0,   /*src_basecycle_fr*/0,  /*src_repetition_fr*/0,  /*src_startbit*/292,   /*sigG_length*/2,  /*des_slotid_fr*/0,   /*des_basecycle_fr*/0,  /*des_repetition_fr*/0,   /*des_startbit*/437,    /*src_cyc*/101,  /*src_id*/0x32,   /*src_dlc*/64,   /*des_id*/0x35c, /*updatebit_S*/298,   /*updatebit_D*/335         },
           {   /*sigGroup_s*/"igIntgtIMUDataRawSafe_0",   /*sig_name*/"isIntgtIMUDataRawSafeRollRateQf_0",   /*src_can*/"ZCUD_CANFD3",   /*src_network_type*/"CANFD",   /*src_slotid_fr*/0,   /*src_basecycle_fr*/0,  /*src_repetition_fr*/0,  /*src_startbit*/302,   /*sigG_length*/2,  /*des_slotid_fr*/0,   /*des_basecycle_fr*/0,  /*des_repetition_fr*/0,   /*des_startbit*/445,    /*src_cyc*/101,  /*src_id*/0x32,   /*src_dlc*/64,   /*des_id*/0x35c, /*updatebit_S*/298,   /*updatebit_D*/335         },
           {   /*sigGroup_s*/"igCrashStsSafe_0",   /*sig_name*/"isCrashStsSafeChks_0",   /*src_can*/"ZCUD_CAN1",   /*src_network_type*/"CAN",   /*src_slotid_fr*/0,   /*src_basecycle_fr*/0,  /*src_repetition_fr*/0,  /*src_startbit*/15,   /*sigG_length*/8,  /*des_slotid_fr*/0,   /*des_basecycle_fr*/0,  /*des_repetition_fr*/0,   /*des_startbit*/215,    /*src_cyc*/101,  /*src_id*/0x10,   /*src_dlc*/4,   /*des_id*/0x59, /*updatebit_S*/5,   /*updatebit_D*/218         },
           {   /*sigGroup_s*/"igCrashStsSafe_0",   /*sig_name*/"isCrashStsSafeSts_0",   /*src_can*/"ZCUD_CAN1",   /*src_network_type*/"CAN",   /*src_slotid_fr*/0,   /*src_basecycle_fr*/0,  /*src_repetition_fr*/0,  /*src_startbit*/4,   /*sigG_length*/1,  /*des_slotid_fr*/0,   /*des_basecycle_fr*/0,  /*des_repetition_fr*/0,   /*des_startbit*/219,    /*src_cyc*/101,  /*src_id*/0x10,   /*src_dlc*/4,   /*des_id*/0x59, /*updatebit_S*/5,   /*updatebit_D*/218         },
           {   /*sigGroup_s*/"igCrashStsSafe_0",   /*sig_name*/"isCrashStsSafeCntr_0",   /*src_can*/"ZCUD_CAN1",   /*src_network_type*/"CAN",   /*src_slotid_fr*/0,   /*src_basecycle_fr*/0,  /*src_repetition_fr*/0,  /*src_startbit*/3,   /*sigG_length*/4,  /*des_slotid_fr*/0,   /*des_basecycle_fr*/0,  /*des_repetition_fr*/0,   /*des_startbit*/223,    /*src_cyc*/101,  /*src_id*/0x10,   /*src_dlc*/4,   /*des_id*/0x59, /*updatebit_S*/5,   /*updatebit_D*/218         }
       }
   },
   {
       /*des_can*/ "ZCUD_CAN1",
       /*networktype*/ "CAN",
       78,
       {
           {   /*sigGroup_s*/"igTrsmActrPosnSafe_0",   /*sig_name*/"isTrsmActrPosnSafeTrsmActrPosnChks_0",   /*src_can*/"ChassisCANFD2",   /*src_network_type*/"CANFD",   /*src_slotid_fr*/0,   /*src_basecycle_fr*/0,  /*src_repetition_fr*/0,  /*src_startbit*/119,   /*sigG_length*/8,  /*des_slotid_fr*/0,   /*des_basecycle_fr*/0,  /*des_repetition_fr*/0,   /*des_startbit*/15,    /*src_cyc*/101,  /*src_id*/0x47c,   /*src_dlc*/64,   /*des_id*/0x399, /*updatebit_S*/120,   /*updatebit_D*/7         },
           {   /*sigGroup_s*/"igTrsmActrPosnSafe_0",   /*sig_name*/"isTrsmActrPosnSafeTrsmActrPosnCntr_0",   /*src_can*/"ChassisCANFD2",   /*src_network_type*/"CANFD",   /*src_slotid_fr*/0,   /*src_basecycle_fr*/0,  /*src_repetition_fr*/0,  /*src_startbit*/127,   /*sigG_length*/4,  /*des_slotid_fr*/0,   /*des_basecycle_fr*/0,  /*des_repetition_fr*/0,   /*des_startbit*/3,    /*src_cyc*/101,  /*src_id*/0x47c,   /*src_dlc*/64,   /*des_id*/0x399, /*updatebit_S*/120,   /*updatebit_D*/7         },
           {   /*sigGroup_s*/"igTrsmActrPosnSafe_0",   /*sig_name*/"isTrsmActrPosnSafeTrsmActrPosn_0",   /*src_can*/"ChassisCANFD2",   /*src_network_type*/"CANFD",   /*src_slotid_fr*/0,   /*src_basecycle_fr*/0,  /*src_repetition_fr*/0,  /*src_startbit*/123,   /*sigG_length*/3,  /*des_slotid_fr*/0,   /*des_basecycle_fr*/0,  /*des_repetition_fr*/0,   /*des_startbit*/6,    /*src_cyc*/101,  /*src_id*/0x47c,   /*src_dlc*/64,   /*des_id*/0x399, /*updatebit_S*/120,   /*updatebit_D*/7         },
           {   /*sigGroup_s*/"igSwtIndcr_0",   /*sig_name*/"isSwtIndcrIndcrTypExtReq_0",   /*src_can*/"ChassisCAN1",   /*src_network_type*/"CAN",   /*src_slotid_fr*/0,   /*src_basecycle_fr*/0,  /*src_repetition_fr*/0,  /*src_startbit*/15,   /*sigG_length*/2,  /*des_slotid_fr*/0,   /*des_basecycle_fr*/0,  /*des_repetition_fr*/0,   /*des_startbit*/5,    /*src_cyc*/101,  /*src_id*/0x2e6,   /*src_dlc*/8,   /*des_id*/0x78, /*updatebit_S*/9,   /*updatebit_D*/6         },
           {   /*sigGroup_s*/"igSwtIndcr_0",   /*sig_name*/"isSwtIndcrIndcrTypExtReqChks_0",   /*src_can*/"ChassisCAN1",   /*src_network_type*/"CAN",   /*src_slotid_fr*/0,   /*src_basecycle_fr*/0,  /*src_repetition_fr*/0,  /*src_startbit*/7,   /*sigG_length*/8,  /*des_slotid_fr*/0,   /*des_basecycle_fr*/0,  /*des_repetition_fr*/0,   /*des_startbit*/15,    /*src_cyc*/101,  /*src_id*/0x2e6,   /*src_dlc*/8,   /*des_id*/0x78, /*updatebit_S*/9,   /*updatebit_D*/6         },
           {   /*sigGroup_s*/"igSwtIndcr_0",   /*sig_name*/"isSwtIndcrIndcrTypExtReqCntr_0",   /*src_can*/"ChassisCAN1",   /*src_network_type*/"CAN",   /*src_slotid_fr*/0,   /*src_basecycle_fr*/0,  /*src_repetition_fr*/0,  /*src_startbit*/13,   /*sigG_length*/2,  /*des_slotid_fr*/0,   /*des_basecycle_fr*/0,  /*des_repetition_fr*/0,   /*des_startbit*/3,    /*src_cyc*/101,  /*src_id*/0x2e6,   /*src_dlc*/8,   /*des_id*/0x78, /*updatebit_S*/9,   /*updatebit_D*/6         },
           {   /*sigGroup_s*/"igSwtIndcr_0",   /*sig_name*/"isSwtIndcrIndcrTypExtReqToUpdQf_0",   /*src_can*/"ChassisCAN1",   /*src_network_type*/"CAN",   /*src_slotid_fr*/0,   /*src_basecycle_fr*/0,  /*src_repetition_fr*/0,  /*src_startbit*/11,   /*sigG_length*/2,  /*des_slotid_fr*/0,   /*des_basecycle_fr*/0,  /*des_repetition_fr*/0,   /*des_startbit*/1,    /*src_cyc*/101,  /*src_id*/0x2e6,   /*src_dlc*/8,   /*des_id*/0x78, /*updatebit_S*/9,   /*updatebit_D*/6         },
           {   /*sigGroup_s*/"igBrkFricTqTotAtWhlsAct_0",   /*sig_name*/"isBrkFricTqTotAtWhlsActBrkFricTqTotAtWhlsAct_0",   /*src_can*/"ChassisCANFD2",   /*src_network_type*/"CANFD",   /*src_slotid_fr*/0,   /*src_basecycle_fr*/0,  /*src_repetition_fr*/0,  /*src_startbit*/167,   /*sigG_length*/15,  /*des_slotid_fr*/0,   /*des_basecycle_fr*/0,  /*des_repetition_fr*/0,   /*des_startbit*/6,    /*src_cyc*/101,  /*src_id*/0x5a,   /*src_dlc*/64,   /*des_id*/0x235, /*updatebit_S*/432,   /*updatebit_D*/7         },
           {   /*sigGroup_s*/"igBrkFricTqTotAtWhlsAct_0",   /*sig_name*/"isBrkFricTqTotAtWhlsActChks_0",   /*src_can*/"ChassisCANFD2",   /*src_network_type*/"CANFD",   /*src_slotid_fr*/0,   /*src_basecycle_fr*/0,  /*src_repetition_fr*/0,  /*src_startbit*/168,   /*sigG_length*/8,  /*des_slotid_fr*/0,   /*des_basecycle_fr*/0,  /*des_repetition_fr*/0,   /*des_startbit*/23,    /*src_cyc*/101,  /*src_id*/0x5a,   /*src_dlc*/64,   /*des_id*/0x235, /*updatebit_S*/432,   /*updatebit_D*/7         },
           {   /*sigGroup_s*/"igBrkFricTqTotAtWhlsAct_0",   /*sig_name*/"isBrkFricTqTotAtWhlsActCntr_0",   /*src_can*/"ChassisCANFD2",   /*src_network_type*/"CANFD",   /*src_slotid_fr*/0,   /*src_basecycle_fr*/0,  /*src_repetition_fr*/0,  /*src_startbit*/176,   /*sigG_length*/4,  /*des_slotid_fr*/0,   /*des_basecycle_fr*/0,  /*des_repetition_fr*/0,   /*des_startbit*/31,    /*src_cyc*/101,  /*src_id*/0x5a,   /*src_dlc*/64,   /*des_id*/0x235, /*updatebit_S*/432,   /*updatebit_D*/7         },
           {   /*sigGroup_s*/"igSteerWhlSnsr_0",   /*sig_name*/"isSteerWhlSnsrChks_0",   /*src_can*/"ChassisCAN1",   /*src_network_type*/"CAN",   /*src_slotid_fr*/0,   /*src_basecycle_fr*/0,  /*src_repetition_fr*/0,  /*src_startbit*/39,   /*sigG_length*/8,  /*des_slotid_fr*/0,   /*des_basecycle_fr*/0,  /*des_repetition_fr*/0,   /*des_startbit*/47,    /*src_cyc*/101,  /*src_id*/0x40,   /*src_dlc*/8,   /*des_id*/0x1b, /*updatebit_S*/7,   /*updatebit_D*/15         },
           {   /*sigGroup_s*/"igSteerWhlSnsr_0",   /*sig_name*/"isSteerWhlSnsrQf_0",   /*src_can*/"ChassisCAN1",   /*src_network_type*/"CAN",   /*src_slotid_fr*/0,   /*src_basecycle_fr*/0,  /*src_repetition_fr*/0,  /*src_startbit*/23,   /*sigG_length*/2,  /*des_slotid_fr*/0,   /*des_basecycle_fr*/0,  /*des_repetition_fr*/0,   /*des_startbit*/31,    /*src_cyc*/101,  /*src_id*/0x40,   /*src_dlc*/8,   /*des_id*/0x1b, /*updatebit_S*/7,   /*updatebit_D*/15         },
           {   /*sigGroup_s*/"igSteerWhlSnsr_0",   /*sig_name*/"isSteerWhlSnsrAgSpd_0",   /*src_can*/"ChassisCAN1",   /*src_network_type*/"CAN",   /*src_slotid_fr*/0,   /*src_basecycle_fr*/0,  /*src_repetition_fr*/0,  /*src_startbit*/21,   /*sigG_length*/14,  /*des_slotid_fr*/0,   /*des_basecycle_fr*/0,  /*des_repetition_fr*/0,   /*des_startbit*/29,    /*src_cyc*/101,  /*src_id*/0x40,   /*src_dlc*/8,   /*des_id*/0x1b, /*updatebit_S*/7,   /*updatebit_D*/15         },
           {   /*sigGroup_s*/"igSteerWhlSnsr_0",   /*sig_name*/"isSteerWhlSnsrCntr_0",   /*src_can*/"ChassisCAN1",   /*src_network_type*/"CAN",   /*src_slotid_fr*/0,   /*src_basecycle_fr*/0,  /*src_repetition_fr*/0,  /*src_startbit*/47,   /*sigG_length*/4,  /*des_slotid_fr*/0,   /*des_basecycle_fr*/0,  /*des_repetition_fr*/0,   /*des_startbit*/55,    /*src_cyc*/101,  /*src_id*/0x40,   /*src_dlc*/8,   /*des_id*/0x1b, /*updatebit_S*/7,   /*updatebit_D*/15         },
           {   /*sigGroup_s*/"igSteerWhlSnsr_0",   /*sig_name*/"isSteerWhlSnsrAg_0",   /*src_can*/"ChassisCAN1",   /*src_network_type*/"CAN",   /*src_slotid_fr*/0,   /*src_basecycle_fr*/0,  /*src_repetition_fr*/0,  /*src_startbit*/6,   /*sigG_length*/15,  /*des_slotid_fr*/0,   /*des_basecycle_fr*/0,  /*des_repetition_fr*/0,   /*des_startbit*/14,    /*src_cyc*/101,  /*src_id*/0x40,   /*src_dlc*/8,   /*des_id*/0x1b, /*updatebit_S*/7,   /*updatebit_D*/15         },
           {   /*sigGroup_s*/"igPassAirbLampStsRec_0",   /*sig_name*/"isPassAirbLampStsRecPassAirbLampStsCntr_0",   /*src_can*/"CEM_LIN3",   /*src_network_type*/"LIN",   /*src_slotid_fr*/0,   /*src_basecycle_fr*/0,  /*src_repetition_fr*/0,  /*src_startbit*/32,   /*sigG_length*/4,  /*des_slotid_fr*/0,   /*des_basecycle_fr*/0,  /*des_repetition_fr*/0,   /*des_startbit*/43,    /*src_cyc*/101,  /*src_id*/32,   /*src_dlc*/7,   /*des_id*/0x390, /*updatebit_S*/1000,   /*updatebit_D*/63         },
           {   /*sigGroup_s*/"igPassAirbLampStsRec_0",   /*sig_name*/"isPassAirbLampStsRecPassAirbLampStsChks_0",   /*src_can*/"CEM_LIN3",   /*src_network_type*/"LIN",   /*src_slotid_fr*/0,   /*src_basecycle_fr*/0,  /*src_repetition_fr*/0,  /*src_startbit*/24,   /*sigG_length*/8,  /*des_slotid_fr*/0,   /*des_basecycle_fr*/0,  /*des_repetition_fr*/0,   /*des_startbit*/55,    /*src_cyc*/101,  /*src_id*/32,   /*src_dlc*/7,   /*des_id*/0x390, /*updatebit_S*/1000,   /*updatebit_D*/63         },
           {   /*sigGroup_s*/"igPassAirbLampStsRec_0",   /*sig_name*/"isPassAirbLampStsRecPassAirbLampSts_0",   /*src_can*/"CEM_LIN3",   /*src_network_type*/"LIN",   /*src_slotid_fr*/0,   /*src_basecycle_fr*/0,  /*src_repetition_fr*/0,  /*src_startbit*/36,   /*sigG_length*/2,  /*des_slotid_fr*/0,   /*des_basecycle_fr*/0,  /*des_repetition_fr*/0,   /*des_startbit*/45,    /*src_cyc*/101,  /*src_id*/32,   /*src_dlc*/7,   /*des_id*/0x390, /*updatebit_S*/1000,   /*updatebit_D*/63         },
           {   /*sigGroup_s*/"igEngSt1WdSts_0",   /*sig_name*/"isEngSt1WdStsChks_0",   /*src_can*/"PropulsionCAN",   /*src_network_type*/"CAN",   /*src_slotid_fr*/0,   /*src_basecycle_fr*/0,  /*src_repetition_fr*/0,  /*src_startbit*/23,   /*sigG_length*/8,  /*des_slotid_fr*/0,   /*des_basecycle_fr*/0,  /*des_repetition_fr*/0,   /*des_startbit*/23,    /*src_cyc*/101,  /*src_id*/0x4b,   /*src_dlc*/8,   /*des_id*/0x370, /*updatebit_S*/8,   /*updatebit_D*/8         },
           {   /*sigGroup_s*/"igEngSt1WdSts_0",   /*sig_name*/"isEngSt1WdStsCntr_0",   /*src_can*/"PropulsionCAN",   /*src_network_type*/"CAN",   /*src_slotid_fr*/0,   /*src_basecycle_fr*/0,  /*src_repetition_fr*/0,  /*src_startbit*/31,   /*sigG_length*/4,  /*des_slotid_fr*/0,   /*des_basecycle_fr*/0,  /*des_repetition_fr*/0,   /*des_startbit*/31,    /*src_cyc*/101,  /*src_id*/0x4b,   /*src_dlc*/8,   /*des_id*/0x370, /*updatebit_S*/8,   /*updatebit_D*/8         },
           {   /*sigGroup_s*/"igEngSt1WdSts_0",   /*sig_name*/"isEngSt1WdStsEngSt1WdSts_0",   /*src_can*/"PropulsionCAN",   /*src_network_type*/"CAN",   /*src_slotid_fr*/0,   /*src_basecycle_fr*/0,  /*src_repetition_fr*/0,  /*src_startbit*/27,   /*sigG_length*/4,  /*des_slotid_fr*/0,   /*des_basecycle_fr*/0,  /*des_repetition_fr*/0,   /*des_startbit*/27,    /*src_cyc*/101,  /*src_id*/0x4b,   /*src_dlc*/8,   /*des_id*/0x370, /*updatebit_S*/8,   /*updatebit_D*/8         },
           {   /*sigGroup_s*/"igAmbTIndcdWithUnit_0",   /*sig_name*/"isAmbTIndcdWithUnitAmbTIndcdUnit_0",   /*src_can*/"PropulsionCAN",   /*src_network_type*/"CAN",   /*src_slotid_fr*/0,   /*src_basecycle_fr*/0,  /*src_repetition_fr*/0,  /*src_startbit*/11,   /*sigG_length*/2,  /*des_slotid_fr*/0,   /*des_basecycle_fr*/0,  /*des_repetition_fr*/0,   /*des_startbit*/39,    /*src_cyc*/101,  /*src_id*/0x26b,   /*src_dlc*/8,   /*des_id*/0x351, /*updatebit_S*/23,   /*updatebit_D*/0         },
           {   /*sigGroup_s*/"igAmbTIndcdWithUnit_0",   /*sig_name*/"isAmbTIndcdWithUnitAmbTIndcd_0",   /*src_can*/"PropulsionCAN",   /*src_network_type*/"CAN",   /*src_slotid_fr*/0,   /*src_basecycle_fr*/0,  /*src_repetition_fr*/0,  /*src_startbit*/7,   /*sigG_length*/12,  /*des_slotid_fr*/0,   /*des_basecycle_fr*/0,  /*des_repetition_fr*/0,   /*des_startbit*/35,    /*src_cyc*/101,  /*src_id*/0x26b,   /*src_dlc*/8,   /*des_id*/0x351, /*updatebit_S*/23,   /*updatebit_D*/0         },
           {   /*sigGroup_s*/"igAmbTIndcdWithUnit_0",   /*sig_name*/"isAmbTIndcdWithUnitQF_0",   /*src_can*/"PropulsionCAN",   /*src_network_type*/"CAN",   /*src_slotid_fr*/0,   /*src_basecycle_fr*/0,  /*src_repetition_fr*/0,  /*src_startbit*/9,   /*sigG_length*/2,  /*des_slotid_fr*/0,   /*des_basecycle_fr*/0,  /*des_repetition_fr*/0,   /*des_startbit*/37,    /*src_cyc*/101,  /*src_id*/0x26b,   /*src_dlc*/8,   /*des_id*/0x351, /*updatebit_S*/23,   /*updatebit_D*/0         },
           {   /*sigGroup_s*/"igVehSpdLgt_0",   /*sig_name*/"isVehSpdLgtCntr_0",   /*src_can*/"ChassisCANFD2",   /*src_network_type*/"CANFD",   /*src_slotid_fr*/0,   /*src_basecycle_fr*/0,  /*src_repetition_fr*/0,  /*src_startbit*/216,   /*sigG_length*/4,  /*des_slotid_fr*/0,   /*des_basecycle_fr*/0,  /*des_repetition_fr*/0,   /*des_startbit*/47,    /*src_cyc*/101,  /*src_id*/0x9f,   /*src_dlc*/64,   /*des_id*/0x76, /*updatebit_S*/471,   /*updatebit_D*/23         },
           {   /*sigGroup_s*/"igVehSpdLgt_0",   /*sig_name*/"isVehSpdLgtA_0",   /*src_can*/"ChassisCANFD2",   /*src_network_type*/"CANFD",   /*src_slotid_fr*/0,   /*src_basecycle_fr*/0,  /*src_repetition_fr*/0,  /*src_startbit*/207,   /*sigG_length*/15,  /*des_slotid_fr*/0,   /*des_basecycle_fr*/0,  /*des_repetition_fr*/0,   /*des_startbit*/22,    /*src_cyc*/101,  /*src_id*/0x9f,   /*src_dlc*/64,   /*des_id*/0x76, /*updatebit_S*/471,   /*updatebit_D*/23         },
           {   /*sigGroup_s*/"igVehSpdLgt_0",   /*sig_name*/"isVehSpdLgtQf_0",   /*src_can*/"ChassisCANFD2",   /*src_network_type*/"CANFD",   /*src_slotid_fr*/0,   /*src_basecycle_fr*/0,  /*src_repetition_fr*/0,  /*src_startbit*/228,   /*sigG_length*/2,  /*des_slotid_fr*/0,   /*des_basecycle_fr*/0,  /*des_repetition_fr*/0,   /*des_startbit*/43,    /*src_cyc*/101,  /*src_id*/0x9f,   /*src_dlc*/64,   /*des_id*/0x76, /*updatebit_S*/471,   /*updatebit_D*/23         },
           {   /*sigGroup_s*/"igVehSpdLgt_0",   /*sig_name*/"isVehSpdLgtChks_0",   /*src_can*/"ChassisCANFD2",   /*src_network_type*/"CANFD",   /*src_slotid_fr*/0,   /*src_basecycle_fr*/0,  /*src_repetition_fr*/0,  /*src_startbit*/208,   /*sigG_length*/8,  /*des_slotid_fr*/0,   /*des_basecycle_fr*/0,  /*des_repetition_fr*/0,   /*des_startbit*/39,    /*src_cyc*/101,  /*src_id*/0x9f,   /*src_dlc*/64,   /*des_id*/0x76, /*updatebit_S*/471,   /*updatebit_D*/23         },
           {   /*sigGroup_s*/"igEngNSafe_0",   /*sig_name*/"isEngNSafeEngNGrdt_0",   /*src_can*/"PropulsionCAN",   /*src_network_type*/"CAN",   /*src_slotid_fr*/0,   /*src_basecycle_fr*/0,  /*src_repetition_fr*/0,  /*src_startbit*/15,   /*sigG_length*/16,  /*des_slotid_fr*/0,   /*des_basecycle_fr*/0,  /*des_repetition_fr*/0,   /*des_startbit*/7,    /*src_cyc*/101,  /*src_id*/0x101,   /*src_dlc*/8,   /*des_id*/0x13a, /*updatebit_S*/51,   /*updatebit_D*/44         },
           {   /*sigGroup_s*/"igEngNSafe_0",   /*sig_name*/"isEngNSafeEngN_0",   /*src_can*/"PropulsionCAN",   /*src_network_type*/"CAN",   /*src_slotid_fr*/0,   /*src_basecycle_fr*/0,  /*src_repetition_fr*/0,  /*src_startbit*/30,   /*sigG_length*/15,  /*des_slotid_fr*/0,   /*des_basecycle_fr*/0,  /*des_repetition_fr*/0,   /*des_startbit*/23,    /*src_cyc*/101,  /*src_id*/0x101,   /*src_dlc*/8,   /*des_id*/0x13a, /*updatebit_S*/51,   /*updatebit_D*/44         },
           {   /*sigGroup_s*/"igEngNSafe_0",   /*sig_name*/"isEngNSafeEngNCntr_0",   /*src_can*/"PropulsionCAN",   /*src_network_type*/"CAN",   /*src_slotid_fr*/0,   /*src_basecycle_fr*/0,  /*src_repetition_fr*/0,  /*src_startbit*/55,   /*sigG_length*/4,  /*des_slotid_fr*/0,   /*des_basecycle_fr*/0,  /*des_repetition_fr*/0,   /*des_startbit*/32,    /*src_cyc*/101,  /*src_id*/0x101,   /*src_dlc*/8,   /*des_id*/0x13a, /*updatebit_S*/51,   /*updatebit_D*/44         },
           {   /*sigGroup_s*/"igEngNSafe_0",   /*sig_name*/"isEngNSafeEngNChks_0",   /*src_can*/"PropulsionCAN",   /*src_network_type*/"CAN",   /*src_slotid_fr*/0,   /*src_basecycle_fr*/0,  /*src_repetition_fr*/0,  /*src_startbit*/47,   /*sigG_length*/8,  /*des_slotid_fr*/0,   /*des_basecycle_fr*/0,  /*des_repetition_fr*/0,   /*des_startbit*/24,    /*src_cyc*/101,  /*src_id*/0x101,   /*src_dlc*/8,   /*des_id*/0x13a, /*updatebit_S*/51,   /*updatebit_D*/44         },
           {   /*sigGroup_s*/"igAccrpedlSts_0",   /*sig_name*/"isAccrpedlStsChks_0",   /*src_can*/"ChassisCAN1",   /*src_network_type*/"CAN",   /*src_slotid_fr*/0,   /*src_basecycle_fr*/0,  /*src_repetition_fr*/0,  /*src_startbit*/7,   /*sigG_length*/8,  /*des_slotid_fr*/0,   /*des_basecycle_fr*/0,  /*des_repetition_fr*/0,   /*des_startbit*/55,    /*src_cyc*/101,  /*src_id*/0x1c7,   /*src_dlc*/8,   /*des_id*/0x24, /*updatebit_S*/57,   /*updatebit_D*/58         },
           {   /*sigGroup_s*/"igAccrpedlSts_0",   /*sig_name*/"isAccrpedlStsCntr_0",   /*src_can*/"ChassisCAN1",   /*src_network_type*/"CAN",   /*src_slotid_fr*/0,   /*src_basecycle_fr*/0,  /*src_repetition_fr*/0,  /*src_startbit*/15,   /*sigG_length*/4,  /*des_slotid_fr*/0,   /*des_basecycle_fr*/0,  /*des_repetition_fr*/0,   /*des_startbit*/63,    /*src_cyc*/101,  /*src_id*/0x1c7,   /*src_dlc*/8,   /*des_id*/0x24, /*updatebit_S*/57,   /*updatebit_D*/58         },
           {   /*sigGroup_s*/"igAccrpedlSts_0",   /*sig_name*/"isAccrpedlStsFltSts_0",   /*src_can*/"ChassisCAN1",   /*src_network_type*/"CAN",   /*src_slotid_fr*/0,   /*src_basecycle_fr*/0,  /*src_repetition_fr*/0,  /*src_startbit*/11,   /*sigG_length*/1,  /*des_slotid_fr*/0,   /*des_basecycle_fr*/0,  /*des_repetition_fr*/0,   /*des_startbit*/59,    /*src_cyc*/101,  /*src_id*/0x1c7,   /*src_dlc*/8,   /*des_id*/0x24, /*updatebit_S*/57,   /*updatebit_D*/58         },
           {   /*sigGroup_s*/"igAbsCtrlActv_0",   /*sig_name*/"isAbsCtrlActvCtrlSts1_0",   /*src_can*/"ChassisCAN1",   /*src_network_type*/"CAN",   /*src_slotid_fr*/0,   /*src_basecycle_fr*/0,  /*src_repetition_fr*/0,  /*src_startbit*/43,   /*sigG_length*/1,  /*des_slotid_fr*/0,   /*des_basecycle_fr*/0,  /*des_repetition_fr*/0,   /*des_startbit*/27,    /*src_cyc*/101,  /*src_id*/0xb9,   /*src_dlc*/8,   /*des_id*/0x345, /*updatebit_S*/24,   /*updatebit_D*/26         },
           {   /*sigGroup_s*/"igAbsCtrlActv_0",   /*sig_name*/"isAbsCtrlActvChks_0",   /*src_can*/"ChassisCAN1",   /*src_network_type*/"CAN",   /*src_slotid_fr*/0,   /*src_basecycle_fr*/0,  /*src_repetition_fr*/0,  /*src_startbit*/39,   /*sigG_length*/8,  /*des_slotid_fr*/0,   /*des_basecycle_fr*/0,  /*des_repetition_fr*/0,   /*des_startbit*/23,    /*src_cyc*/101,  /*src_id*/0xb9,   /*src_dlc*/8,   /*des_id*/0x345, /*updatebit_S*/24,   /*updatebit_D*/26         },
           {   /*sigGroup_s*/"igAbsCtrlActv_0",   /*sig_name*/"isAbsCtrlActvCntr_0",   /*src_can*/"ChassisCAN1",   /*src_network_type*/"CAN",   /*src_slotid_fr*/0,   /*src_basecycle_fr*/0,  /*src_repetition_fr*/0,  /*src_startbit*/47,   /*sigG_length*/4,  /*des_slotid_fr*/0,   /*des_basecycle_fr*/0,  /*des_repetition_fr*/0,   /*des_startbit*/31,    /*src_cyc*/101,  /*src_id*/0xb9,   /*src_dlc*/8,   /*des_id*/0x345, /*updatebit_S*/24,   /*updatebit_D*/26         },
           {   /*sigGroup_s*/"igWhlDirRotlRe_0",   /*sig_name*/"isWhlDirRotlReLe_0",   /*src_can*/"ChassisCAN1",   /*src_network_type*/"CAN",   /*src_slotid_fr*/0,   /*src_basecycle_fr*/0,  /*src_repetition_fr*/0,  /*src_startbit*/27,   /*sigG_length*/2,  /*des_slotid_fr*/0,   /*des_basecycle_fr*/0,  /*des_repetition_fr*/0,   /*des_startbit*/59,    /*src_cyc*/101,  /*src_id*/0x2e,   /*src_dlc*/8,   /*des_id*/0x5b, /*updatebit_S*/38,   /*updatebit_D*/43         },
           {   /*sigGroup_s*/"igWhlDirRotlRe_0",   /*sig_name*/"isWhlDirRotlReCntr_0",   /*src_can*/"ChassisCAN1",   /*src_network_type*/"CAN",   /*src_slotid_fr*/0,   /*src_basecycle_fr*/0,  /*src_repetition_fr*/0,  /*src_startbit*/31,   /*sigG_length*/4,  /*des_slotid_fr*/0,   /*des_basecycle_fr*/0,  /*des_repetition_fr*/0,   /*des_startbit*/63,    /*src_cyc*/101,  /*src_id*/0x2e,   /*src_dlc*/8,   /*des_id*/0x5b, /*updatebit_S*/38,   /*updatebit_D*/43         },
           {   /*sigGroup_s*/"igWhlDirRotlRe_0",   /*sig_name*/"isWhlDirRotlReChks_0",   /*src_can*/"ChassisCAN1",   /*src_network_type*/"CAN",   /*src_slotid_fr*/0,   /*src_basecycle_fr*/0,  /*src_repetition_fr*/0,  /*src_startbit*/23,   /*sigG_length*/8,  /*des_slotid_fr*/0,   /*des_basecycle_fr*/0,  /*des_repetition_fr*/0,   /*des_startbit*/55,    /*src_cyc*/101,  /*src_id*/0x2e,   /*src_dlc*/8,   /*des_id*/0x5b, /*updatebit_S*/38,   /*updatebit_D*/43         },
           {   /*sigGroup_s*/"igWhlDirRotlRe_0",   /*sig_name*/"isWhlDirRotlReRi_0",   /*src_can*/"ChassisCAN1",   /*src_network_type*/"CAN",   /*src_slotid_fr*/0,   /*src_basecycle_fr*/0,  /*src_repetition_fr*/0,  /*src_startbit*/25,   /*sigG_length*/2,  /*des_slotid_fr*/0,   /*des_basecycle_fr*/0,  /*des_repetition_fr*/0,   /*des_startbit*/57,    /*src_cyc*/101,  /*src_id*/0x2e,   /*src_dlc*/8,   /*des_id*/0x5b, /*updatebit_S*/38,   /*updatebit_D*/43         },
           {   /*sigGroup_s*/"igHvSysRlySts_0",   /*sig_name*/"isHvSysRlyStsChks_0",   /*src_can*/"PropulsionCAN",   /*src_network_type*/"CAN",   /*src_slotid_fr*/0,   /*src_basecycle_fr*/0,  /*src_repetition_fr*/0,  /*src_startbit*/7,   /*sigG_length*/8,  /*des_slotid_fr*/0,   /*des_basecycle_fr*/0,  /*des_repetition_fr*/0,   /*des_startbit*/39,    /*src_cyc*/101,  /*src_id*/0x161,   /*src_dlc*/8,   /*des_id*/0x140, /*updatebit_S*/9,   /*updatebit_D*/30         },
           {   /*sigGroup_s*/"igHvSysRlySts_0",   /*sig_name*/"isHvSysRlyStsCntr_0",   /*src_can*/"PropulsionCAN",   /*src_network_type*/"CAN",   /*src_slotid_fr*/0,   /*src_basecycle_fr*/0,  /*src_repetition_fr*/0,  /*src_startbit*/15,   /*sigG_length*/4,  /*des_slotid_fr*/0,   /*des_basecycle_fr*/0,  /*des_repetition_fr*/0,   /*des_startbit*/27,    /*src_cyc*/101,  /*src_id*/0x161,   /*src_dlc*/8,   /*des_id*/0x140, /*updatebit_S*/9,   /*updatebit_D*/30         },
           {   /*sigGroup_s*/"igHvSysRlySts_0",   /*sig_name*/"isHvSysRlyStsHvSysRlySts_0",   /*src_can*/"PropulsionCAN",   /*src_network_type*/"CAN",   /*src_slotid_fr*/0,   /*src_basecycle_fr*/0,  /*src_repetition_fr*/0,  /*src_startbit*/11,   /*sigG_length*/2,  /*des_slotid_fr*/0,   /*des_basecycle_fr*/0,  /*des_repetition_fr*/0,   /*des_startbit*/29,    /*src_cyc*/101,  /*src_id*/0x161,   /*src_dlc*/8,   /*des_id*/0x140, /*updatebit_S*/9,   /*updatebit_D*/30         },
           {   /*sigGroup_s*/"igWhlDirRotlFrnt_0",   /*sig_name*/"isWhlDirRotlFrntLe_0",   /*src_can*/"ChassisCAN1",   /*src_network_type*/"CAN",   /*src_slotid_fr*/0,   /*src_basecycle_fr*/0,  /*src_repetition_fr*/0,  /*src_startbit*/11,   /*sigG_length*/2,  /*des_slotid_fr*/0,   /*des_basecycle_fr*/0,  /*des_repetition_fr*/0,   /*des_startbit*/59,    /*src_cyc*/101,  /*src_id*/0x2e,   /*src_dlc*/8,   /*des_id*/0x110, /*updatebit_S*/39,   /*updatebit_D*/40         },
           {   /*sigGroup_s*/"igWhlDirRotlFrnt_0",   /*sig_name*/"isWhlDirRotlFrntCntr_0",   /*src_can*/"ChassisCAN1",   /*src_network_type*/"CAN",   /*src_slotid_fr*/0,   /*src_basecycle_fr*/0,  /*src_repetition_fr*/0,  /*src_startbit*/15,   /*sigG_length*/4,  /*des_slotid_fr*/0,   /*des_basecycle_fr*/0,  /*des_repetition_fr*/0,   /*des_startbit*/63,    /*src_cyc*/101,  /*src_id*/0x2e,   /*src_dlc*/8,   /*des_id*/0x110, /*updatebit_S*/39,   /*updatebit_D*/40         },
           {   /*sigGroup_s*/"igWhlDirRotlFrnt_0",   /*sig_name*/"isWhlDirRotlFrntRi_0",   /*src_can*/"ChassisCAN1",   /*src_network_type*/"CAN",   /*src_slotid_fr*/0,   /*src_basecycle_fr*/0,  /*src_repetition_fr*/0,  /*src_startbit*/9,   /*sigG_length*/2,  /*des_slotid_fr*/0,   /*des_basecycle_fr*/0,  /*des_repetition_fr*/0,   /*des_startbit*/57,    /*src_cyc*/101,  /*src_id*/0x2e,   /*src_dlc*/8,   /*des_id*/0x110, /*updatebit_S*/39,   /*updatebit_D*/40         },
           {   /*sigGroup_s*/"igWhlDirRotlFrnt_0",   /*sig_name*/"isWhlDirRotlFrntChks_0",   /*src_can*/"ChassisCAN1",   /*src_network_type*/"CAN",   /*src_slotid_fr*/0,   /*src_basecycle_fr*/0,  /*src_repetition_fr*/0,  /*src_startbit*/7,   /*sigG_length*/8,  /*des_slotid_fr*/0,   /*des_basecycle_fr*/0,  /*des_repetition_fr*/0,   /*des_startbit*/55,    /*src_cyc*/101,  /*src_id*/0x2e,   /*src_dlc*/8,   /*des_id*/0x110, /*updatebit_S*/39,   /*updatebit_D*/40         },
           {   /*sigGroup_s*/"igTrsmParkLockd_0",   /*sig_name*/"isTrsmParkLockdCntr_0",   /*src_can*/"PropulsionCAN",   /*src_network_type*/"CAN",   /*src_slotid_fr*/0,   /*src_basecycle_fr*/0,  /*src_repetition_fr*/0,  /*src_startbit*/19,   /*sigG_length*/4,  /*des_slotid_fr*/0,   /*des_basecycle_fr*/0,  /*des_repetition_fr*/0,   /*des_startbit*/51,    /*src_cyc*/101,  /*src_id*/0x131,   /*src_dlc*/8,   /*des_id*/0xea, /*updatebit_S*/23,   /*updatebit_D*/54         },
           {   /*sigGroup_s*/"igTrsmParkLockd_0",   /*sig_name*/"isTrsmParkLockdChks_0",   /*src_can*/"PropulsionCAN",   /*src_network_type*/"CAN",   /*src_slotid_fr*/0,   /*src_basecycle_fr*/0,  /*src_repetition_fr*/0,  /*src_startbit*/31,   /*sigG_length*/8,  /*des_slotid_fr*/0,   /*des_basecycle_fr*/0,  /*des_repetition_fr*/0,   /*des_startbit*/63,    /*src_cyc*/101,  /*src_id*/0x131,   /*src_dlc*/8,   /*des_id*/0xea, /*updatebit_S*/23,   /*updatebit_D*/54         },
           {   /*sigGroup_s*/"igTrsmParkLockd_0",   /*sig_name*/"isTrsmParkLockdTrsmParkLockd_0",   /*src_can*/"PropulsionCAN",   /*src_network_type*/"CAN",   /*src_slotid_fr*/0,   /*src_basecycle_fr*/0,  /*src_repetition_fr*/0,  /*src_startbit*/21,   /*sigG_length*/2,  /*des_slotid_fr*/0,   /*des_basecycle_fr*/0,  /*des_repetition_fr*/0,   /*des_startbit*/53,    /*src_cyc*/101,  /*src_id*/0x131,   /*src_dlc*/8,   /*des_id*/0xea, /*updatebit_S*/23,   /*updatebit_D*/54         },
           {   /*sigGroup_s*/"igWhlSpdCircumlFrnt_0",   /*sig_name*/"isWhlSpdCircumlFrntCntr_0",   /*src_can*/"ChassisCANFD2",   /*src_network_type*/"CANFD",   /*src_slotid_fr*/0,   /*src_basecycle_fr*/0,  /*src_repetition_fr*/0,  /*src_startbit*/33,   /*sigG_length*/4,  /*des_slotid_fr*/0,   /*des_basecycle_fr*/0,  /*des_repetition_fr*/0,   /*des_startbit*/31,    /*src_cyc*/101,  /*src_id*/0x67,   /*src_dlc*/64,   /*des_id*/0x110, /*updatebit_S*/41,   /*updatebit_D*/7         },
           {   /*sigGroup_s*/"igWhlSpdCircumlFrnt_0",   /*sig_name*/"isWhlSpdCircumlFrntWhlSpdCircumlFrntRi_0",   /*src_can*/"ChassisCANFD2",   /*src_network_type*/"CANFD",   /*src_slotid_fr*/0,   /*src_basecycle_fr*/0,  /*src_repetition_fr*/0,  /*src_startbit*/8,   /*sigG_length*/15,  /*des_slotid_fr*/0,   /*des_basecycle_fr*/0,  /*des_repetition_fr*/0,   /*des_startbit*/39,    /*src_cyc*/101,  /*src_id*/0x67,   /*src_dlc*/64,   /*des_id*/0x110, /*updatebit_S*/41,   /*updatebit_D*/7         },
           {   /*sigGroup_s*/"igWhlSpdCircumlFrnt_0",   /*sig_name*/"isWhlSpdCircumlFrntLe_0",   /*src_can*/"ChassisCANFD2",   /*src_network_type*/"CANFD",   /*src_slotid_fr*/0,   /*src_basecycle_fr*/0,  /*src_repetition_fr*/0,  /*src_startbit*/7,   /*sigG_length*/15,  /*des_slotid_fr*/0,   /*des_basecycle_fr*/0,  /*des_repetition_fr*/0,   /*des_startbit*/6,    /*src_cyc*/101,  /*src_id*/0x67,   /*src_dlc*/64,   /*des_id*/0x110, /*updatebit_S*/41,   /*updatebit_D*/7         },
           {   /*sigGroup_s*/"igWhlSpdCircumlFrnt_0",   /*sig_name*/"isWhlSpdCircumlFrntRiQf_0",   /*src_can*/"ChassisCANFD2",   /*src_network_type*/"CANFD",   /*src_slotid_fr*/0,   /*src_basecycle_fr*/0,  /*src_repetition_fr*/0,  /*src_startbit*/43,   /*sigG_length*/2,  /*des_slotid_fr*/0,   /*des_basecycle_fr*/0,  /*des_repetition_fr*/0,   /*des_startbit*/25,    /*src_cyc*/101,  /*src_id*/0x67,   /*src_dlc*/64,   /*des_id*/0x110, /*updatebit_S*/41,   /*updatebit_D*/7         },
           {   /*sigGroup_s*/"igWhlSpdCircumlFrnt_0",   /*sig_name*/"isWhlSpdCircumlFrntChks_0",   /*src_can*/"ChassisCANFD2",   /*src_network_type*/"CANFD",   /*src_slotid_fr*/0,   /*src_basecycle_fr*/0,  /*src_repetition_fr*/0,  /*src_startbit*/25,   /*sigG_length*/8,  /*des_slotid_fr*/0,   /*des_basecycle_fr*/0,  /*des_repetition_fr*/0,   /*des_startbit*/23,    /*src_cyc*/101,  /*src_id*/0x67,   /*src_dlc*/64,   /*des_id*/0x110, /*updatebit_S*/41,   /*updatebit_D*/7         },
           {   /*sigGroup_s*/"igWhlSpdCircumlFrnt_0",   /*sig_name*/"isWhlSpdCircumlFrntLeQf_0",   /*src_can*/"ChassisCANFD2",   /*src_network_type*/"CANFD",   /*src_slotid_fr*/0,   /*src_basecycle_fr*/0,  /*src_repetition_fr*/0,  /*src_startbit*/45,   /*sigG_length*/2,  /*des_slotid_fr*/0,   /*des_basecycle_fr*/0,  /*des_repetition_fr*/0,   /*des_startbit*/27,    /*src_cyc*/101,  /*src_id*/0x67,   /*src_dlc*/64,   /*des_id*/0x110, /*updatebit_S*/41,   /*updatebit_D*/7         },
           {   /*sigGroup_s*/"igPinionSteerAgGroup_0",   /*sig_name*/"isPinionSteerAgGroupPinionSteerAg1Qf_0",   /*src_can*/"ChassisCAN1",   /*src_network_type*/"CAN",   /*src_slotid_fr*/0,   /*src_basecycle_fr*/0,  /*src_repetition_fr*/0,  /*src_startbit*/15,   /*sigG_length*/2,  /*des_slotid_fr*/0,   /*des_basecycle_fr*/0,  /*des_repetition_fr*/0,   /*des_startbit*/15,    /*src_cyc*/101,  /*src_id*/0x4e,   /*src_dlc*/8,   /*des_id*/0x378, /*updatebit_S*/57,   /*updatebit_D*/57         },
           {   /*sigGroup_s*/"igPinionSteerAgGroup_0",   /*sig_name*/"isPinionSteerAgGroupCntr_0",   /*src_can*/"ChassisCAN1",   /*src_network_type*/"CAN",   /*src_slotid_fr*/0,   /*src_basecycle_fr*/0,  /*src_repetition_fr*/0,  /*src_startbit*/63,   /*sigG_length*/4,  /*des_slotid_fr*/0,   /*des_basecycle_fr*/0,  /*des_repetition_fr*/0,   /*des_startbit*/63,    /*src_cyc*/101,  /*src_id*/0x4e,   /*src_dlc*/8,   /*des_id*/0x378, /*updatebit_S*/57,   /*updatebit_D*/57         },
           {   /*sigGroup_s*/"igPinionSteerAgGroup_0",   /*sig_name*/"isPinionSteerAgGroupSteerWhlTq_0",   /*src_can*/"ChassisCAN1",   /*src_network_type*/"CAN",   /*src_slotid_fr*/0,   /*src_basecycle_fr*/0,  /*src_repetition_fr*/0,  /*src_startbit*/29,   /*sigG_length*/14,  /*des_slotid_fr*/0,   /*des_basecycle_fr*/0,  /*des_repetition_fr*/0,   /*des_startbit*/29,    /*src_cyc*/101,  /*src_id*/0x4e,   /*src_dlc*/8,   /*des_id*/0x378, /*updatebit_S*/57,   /*updatebit_D*/57         },
           {   /*sigGroup_s*/"igPinionSteerAgGroup_0",   /*sig_name*/"isPinionSteerAgGroupPinionSteerAg1_0",   /*src_can*/"ChassisCAN1",   /*src_network_type*/"CAN",   /*src_slotid_fr*/0,   /*src_basecycle_fr*/0,  /*src_repetition_fr*/0,  /*src_startbit*/46,   /*sigG_length*/15,  /*des_slotid_fr*/0,   /*des_basecycle_fr*/0,  /*des_repetition_fr*/0,   /*des_startbit*/46,    /*src_cyc*/101,  /*src_id*/0x4e,   /*src_dlc*/8,   /*des_id*/0x378, /*updatebit_S*/57,   /*updatebit_D*/57         },
           {   /*sigGroup_s*/"igPinionSteerAgGroup_0",   /*sig_name*/"isPinionSteerAgGroupPinionSteerAgSpd1_0",   /*src_can*/"ChassisCAN1",   /*src_network_type*/"CAN",   /*src_slotid_fr*/0,   /*src_basecycle_fr*/0,  /*src_repetition_fr*/0,  /*src_startbit*/13,   /*sigG_length*/14,  /*des_slotid_fr*/0,   /*des_basecycle_fr*/0,  /*des_repetition_fr*/0,   /*des_startbit*/13,    /*src_cyc*/101,  /*src_id*/0x4e,   /*src_dlc*/8,   /*des_id*/0x378, /*updatebit_S*/57,   /*updatebit_D*/57         },
           {   /*sigGroup_s*/"igPinionSteerAgGroup_0",   /*sig_name*/"isPinionSteerAgGroupSteerWhlTqQf_0",   /*src_can*/"ChassisCAN1",   /*src_network_type*/"CAN",   /*src_slotid_fr*/0,   /*src_basecycle_fr*/0,  /*src_repetition_fr*/0,  /*src_startbit*/59,   /*sigG_length*/2,  /*des_slotid_fr*/0,   /*des_basecycle_fr*/0,  /*des_repetition_fr*/0,   /*des_startbit*/59,    /*src_cyc*/101,  /*src_id*/0x4e,   /*src_dlc*/8,   /*des_id*/0x378, /*updatebit_S*/57,   /*updatebit_D*/57         },
           {   /*sigGroup_s*/"igPinionSteerAgGroup_0",   /*sig_name*/"isPinionSteerAgGroupPinionSteerAgSpd1Qf_0",   /*src_can*/"ChassisCAN1",   /*src_network_type*/"CAN",   /*src_slotid_fr*/0,   /*src_basecycle_fr*/0,  /*src_repetition_fr*/0,  /*src_startbit*/31,   /*sigG_length*/2,  /*des_slotid_fr*/0,   /*des_basecycle_fr*/0,  /*des_repetition_fr*/0,   /*des_startbit*/31,    /*src_cyc*/101,  /*src_id*/0x4e,   /*src_dlc*/8,   /*des_id*/0x378, /*updatebit_S*/57,   /*updatebit_D*/57         },
           {   /*sigGroup_s*/"igPinionSteerAgGroup_0",   /*sig_name*/"isPinionSteerAgGroupChks_0",   /*src_can*/"ChassisCAN1",   /*src_network_type*/"CAN",   /*src_slotid_fr*/0,   /*src_basecycle_fr*/0,  /*src_repetition_fr*/0,  /*src_startbit*/7,   /*sigG_length*/8,  /*des_slotid_fr*/0,   /*des_basecycle_fr*/0,  /*des_repetition_fr*/0,   /*des_startbit*/7,    /*src_cyc*/101,  /*src_id*/0x4e,   /*src_dlc*/8,   /*des_id*/0x378, /*updatebit_S*/57,   /*updatebit_D*/57         },
           {   /*sigGroup_s*/"igAccrPedlRat_0",   /*sig_name*/"isAccrPedlRatCntr_0",   /*src_can*/"ChassisCANFD2",   /*src_network_type*/"CANFD",   /*src_slotid_fr*/0,   /*src_basecycle_fr*/0,  /*src_repetition_fr*/0,  /*src_startbit*/115,   /*sigG_length*/4,  /*des_slotid_fr*/0,   /*des_basecycle_fr*/0,  /*des_repetition_fr*/0,   /*des_startbit*/31,    /*src_cyc*/101,  /*src_id*/0xde,   /*src_dlc*/64,   /*des_id*/0x206, /*updatebit_S*/168,   /*updatebit_D*/7         },
           {   /*sigGroup_s*/"igAccrPedlRat_0",   /*sig_name*/"isAccrPedlRatChks_0",   /*src_can*/"ChassisCANFD2",   /*src_network_type*/"CANFD",   /*src_slotid_fr*/0,   /*src_basecycle_fr*/0,  /*src_repetition_fr*/0,  /*src_startbit*/107,   /*sigG_length*/8,  /*des_slotid_fr*/0,   /*des_basecycle_fr*/0,  /*des_repetition_fr*/0,   /*des_startbit*/23,    /*src_cyc*/101,  /*src_id*/0xde,   /*src_dlc*/64,   /*des_id*/0x206, /*updatebit_S*/168,   /*updatebit_D*/7         },
           {   /*sigGroup_s*/"igAccrPedlRat_0",   /*sig_name*/"isAccrPedlRatAccrPedlRat_0",   /*src_can*/"ChassisCANFD2",   /*src_network_type*/"CANFD",   /*src_slotid_fr*/0,   /*src_basecycle_fr*/0,  /*src_repetition_fr*/0,  /*src_startbit*/90,   /*sigG_length*/15,  /*des_slotid_fr*/0,   /*des_basecycle_fr*/0,  /*des_repetition_fr*/0,   /*des_startbit*/6,    /*src_cyc*/101,  /*src_id*/0xde,   /*src_dlc*/64,   /*des_id*/0x206, /*updatebit_S*/168,   /*updatebit_D*/7         },
           {   /*sigGroup_s*/"igWhlSpdCircumlRe_0",   /*sig_name*/"isWhlSpdCircumlReCntr_0",   /*src_can*/"ChassisCANFD2",   /*src_network_type*/"CANFD",   /*src_slotid_fr*/0,   /*src_basecycle_fr*/0,  /*src_repetition_fr*/0,  /*src_startbit*/81,   /*sigG_length*/4,  /*des_slotid_fr*/0,   /*des_basecycle_fr*/0,  /*des_repetition_fr*/0,   /*des_startbit*/31,    /*src_cyc*/101,  /*src_id*/0x67,   /*src_dlc*/64,   /*des_id*/0x11a, /*updatebit_S*/89,   /*updatebit_D*/7         },
           {   /*sigGroup_s*/"igWhlSpdCircumlRe_0",   /*sig_name*/"isWhlSpdCircumlReChks_0",   /*src_can*/"ChassisCANFD2",   /*src_network_type*/"CANFD",   /*src_slotid_fr*/0,   /*src_basecycle_fr*/0,  /*src_repetition_fr*/0,  /*src_startbit*/73,   /*sigG_length*/8,  /*des_slotid_fr*/0,   /*des_basecycle_fr*/0,  /*des_repetition_fr*/0,   /*des_startbit*/23,    /*src_cyc*/101,  /*src_id*/0x67,   /*src_dlc*/64,   /*des_id*/0x11a, /*updatebit_S*/89,   /*updatebit_D*/7         },
           {   /*sigGroup_s*/"igWhlSpdCircumlRe_0",   /*sig_name*/"isWhlSpdCircumlReRiQf_0",   /*src_can*/"ChassisCANFD2",   /*src_network_type*/"CANFD",   /*src_slotid_fr*/0,   /*src_basecycle_fr*/0,  /*src_repetition_fr*/0,  /*src_startbit*/91,   /*sigG_length*/2,  /*des_slotid_fr*/0,   /*des_basecycle_fr*/0,  /*des_repetition_fr*/0,   /*des_startbit*/25,    /*src_cyc*/101,  /*src_id*/0x67,   /*src_dlc*/64,   /*des_id*/0x11a, /*updatebit_S*/89,   /*updatebit_D*/7         },
           {   /*sigGroup_s*/"igWhlSpdCircumlRe_0",   /*sig_name*/"isWhlSpdCircumlReLeQf_0",   /*src_can*/"ChassisCANFD2",   /*src_network_type*/"CANFD",   /*src_slotid_fr*/0,   /*src_basecycle_fr*/0,  /*src_repetition_fr*/0,  /*src_startbit*/93,   /*sigG_length*/2,  /*des_slotid_fr*/0,   /*des_basecycle_fr*/0,  /*des_repetition_fr*/0,   /*des_startbit*/27,    /*src_cyc*/101,  /*src_id*/0x67,   /*src_dlc*/64,   /*des_id*/0x11a, /*updatebit_S*/89,   /*updatebit_D*/7         },
           {   /*sigGroup_s*/"igWhlSpdCircumlRe_0",   /*sig_name*/"isWhlSpdCircumlReLe_0",   /*src_can*/"ChassisCANFD2",   /*src_network_type*/"CANFD",   /*src_slotid_fr*/0,   /*src_basecycle_fr*/0,  /*src_repetition_fr*/0,  /*src_startbit*/55,   /*sigG_length*/15,  /*des_slotid_fr*/0,   /*des_basecycle_fr*/0,  /*des_repetition_fr*/0,   /*des_startbit*/6,    /*src_cyc*/101,  /*src_id*/0x67,   /*src_dlc*/64,   /*des_id*/0x11a, /*updatebit_S*/89,   /*updatebit_D*/7         },
           {   /*sigGroup_s*/"igWhlSpdCircumlRe_0",   /*sig_name*/"isWhlSpdCircumlReRi_0",   /*src_can*/"ChassisCANFD2",   /*src_network_type*/"CANFD",   /*src_slotid_fr*/0,   /*src_basecycle_fr*/0,  /*src_repetition_fr*/0,  /*src_startbit*/56,   /*sigG_length*/15,  /*des_slotid_fr*/0,   /*des_basecycle_fr*/0,  /*des_repetition_fr*/0,   /*des_startbit*/39,    /*src_cyc*/101,  /*src_id*/0x67,   /*src_dlc*/64,   /*des_id*/0x11a, /*updatebit_S*/89,   /*updatebit_D*/7         },
           {   /*sigGroup_s*/"igBattFltStsPrim_0",   /*sig_name*/"isBattFltStsPrimChks_0",   /*src_can*/"CEM_LIN6",   /*src_network_type*/"LIN",   /*src_slotid_fr*/0,   /*src_basecycle_fr*/0,  /*src_repetition_fr*/0,  /*src_startbit*/48,   /*sigG_length*/8,  /*des_slotid_fr*/0,   /*des_basecycle_fr*/0,  /*des_repetition_fr*/0,   /*des_startbit*/7,    /*src_cyc*/101,  /*src_id*/8,   /*src_dlc*/8,   /*des_id*/0x99, /*updatebit_S*/1000,   /*updatebit_D*/23         },
           {   /*sigGroup_s*/"igBattFltStsPrim_0",   /*sig_name*/"isBattFltStsPrimBattFltStsPrm_0",   /*src_can*/"CEM_LIN6",   /*src_network_type*/"LIN",   /*src_slotid_fr*/0,   /*src_basecycle_fr*/0,  /*src_repetition_fr*/0,  /*src_startbit*/44,   /*sigG_length*/4,  /*des_slotid_fr*/0,   /*des_basecycle_fr*/0,  /*des_repetition_fr*/0,   /*des_startbit*/15,    /*src_cyc*/101,  /*src_id*/8,   /*src_dlc*/8,   /*des_id*/0x99, /*updatebit_S*/1000,   /*updatebit_D*/23         },
           {   /*sigGroup_s*/"igBattFltStsPrim_0",   /*sig_name*/"isBattFltStsPrimCntr_0",   /*src_can*/"CEM_LIN6",   /*src_network_type*/"LIN",   /*src_slotid_fr*/0,   /*src_basecycle_fr*/0,  /*src_repetition_fr*/0,  /*src_startbit*/56,   /*sigG_length*/4,  /*des_slotid_fr*/0,   /*des_basecycle_fr*/0,  /*des_repetition_fr*/0,   /*des_startbit*/11,    /*src_cyc*/101,  /*src_id*/8,   /*src_dlc*/8,   /*des_id*/0x99, /*updatebit_S*/1000,   /*updatebit_D*/23         }
       }
   },
   {
       /*des_can*/ "ZCUD_CANFD4",
       /*networktype*/ "CANFD",
       4,
       {
           {   /*sigGroup_s*/"igVehSpdLgt_0",   /*sig_name*/"isVehSpdLgtCntr_0",   /*src_can*/"ChassisCANFD2",   /*src_network_type*/"CANFD",   /*src_slotid_fr*/0,   /*src_basecycle_fr*/0,  /*src_repetition_fr*/0,  /*src_startbit*/216,   /*sigG_length*/4,  /*des_slotid_fr*/0,   /*des_basecycle_fr*/0,  /*des_repetition_fr*/0,   /*des_startbit*/72,    /*src_cyc*/101,  /*src_id*/0x9f,   /*src_dlc*/64,   /*des_id*/0x100, /*updatebit_S*/471,   /*updatebit_D*/82         },
           {   /*sigGroup_s*/"igVehSpdLgt_0",   /*sig_name*/"isVehSpdLgtA_0",   /*src_can*/"ChassisCANFD2",   /*src_network_type*/"CANFD",   /*src_slotid_fr*/0,   /*src_basecycle_fr*/0,  /*src_repetition_fr*/0,  /*src_startbit*/207,   /*sigG_length*/15,  /*des_slotid_fr*/0,   /*des_basecycle_fr*/0,  /*des_repetition_fr*/0,   /*des_startbit*/63,    /*src_cyc*/101,  /*src_id*/0x9f,   /*src_dlc*/64,   /*des_id*/0x100, /*updatebit_S*/471,   /*updatebit_D*/82         },
           {   /*sigGroup_s*/"igVehSpdLgt_0",   /*sig_name*/"isVehSpdLgtQf_0",   /*src_can*/"ChassisCANFD2",   /*src_network_type*/"CANFD",   /*src_slotid_fr*/0,   /*src_basecycle_fr*/0,  /*src_repetition_fr*/0,  /*src_startbit*/228,   /*sigG_length*/2,  /*des_slotid_fr*/0,   /*des_basecycle_fr*/0,  /*des_repetition_fr*/0,   /*des_startbit*/84,    /*src_cyc*/101,  /*src_id*/0x9f,   /*src_dlc*/64,   /*des_id*/0x100, /*updatebit_S*/471,   /*updatebit_D*/82         },
           {   /*sigGroup_s*/"igVehSpdLgt_0",   /*sig_name*/"isVehSpdLgtChks_0",   /*src_can*/"ChassisCANFD2",   /*src_network_type*/"CANFD",   /*src_slotid_fr*/0,   /*src_basecycle_fr*/0,  /*src_repetition_fr*/0,  /*src_startbit*/208,   /*sigG_length*/8,  /*des_slotid_fr*/0,   /*des_basecycle_fr*/0,  /*des_repetition_fr*/0,   /*des_startbit*/64,    /*src_cyc*/101,  /*src_id*/0x9f,   /*src_dlc*/64,   /*des_id*/0x100, /*updatebit_S*/471,   /*updatebit_D*/82         }
       }
   },
   {
       /*des_can*/ "ZCU_CANFD2",
       /*networktype*/ "CANFD",
       0,
       {
           0
       }
   },
   {
       /*des_can*/ "BodyExposedCAN",
       /*networktype*/ "CAN",
       4,
       {
           {   /*sigGroup_s*/"igVehSpdLgt_0",   /*sig_name*/"isVehSpdLgtCntr_0",   /*src_can*/"ChassisCANFD2",   /*src_network_type*/"CANFD",   /*src_slotid_fr*/0,   /*src_basecycle_fr*/0,  /*src_repetition_fr*/0,  /*src_startbit*/216,   /*sigG_length*/4,  /*des_slotid_fr*/0,   /*des_basecycle_fr*/0,  /*des_repetition_fr*/0,   /*des_startbit*/31,    /*src_cyc*/101,  /*src_id*/0x9f,   /*src_dlc*/64,   /*des_id*/0x3a1, /*updatebit_S*/471,   /*updatebit_D*/7         },
           {   /*sigGroup_s*/"igVehSpdLgt_0",   /*sig_name*/"isVehSpdLgtA_0",   /*src_can*/"ChassisCANFD2",   /*src_network_type*/"CANFD",   /*src_slotid_fr*/0,   /*src_basecycle_fr*/0,  /*src_repetition_fr*/0,  /*src_startbit*/207,   /*sigG_length*/15,  /*des_slotid_fr*/0,   /*des_basecycle_fr*/0,  /*des_repetition_fr*/0,   /*des_startbit*/6,    /*src_cyc*/101,  /*src_id*/0x9f,   /*src_dlc*/64,   /*des_id*/0x3a1, /*updatebit_S*/471,   /*updatebit_D*/7         },
           {   /*sigGroup_s*/"igVehSpdLgt_0",   /*sig_name*/"isVehSpdLgtQf_0",   /*src_can*/"ChassisCANFD2",   /*src_network_type*/"CANFD",   /*src_slotid_fr*/0,   /*src_basecycle_fr*/0,  /*src_repetition_fr*/0,  /*src_startbit*/228,   /*sigG_length*/2,  /*des_slotid_fr*/0,   /*des_basecycle_fr*/0,  /*des_repetition_fr*/0,   /*des_startbit*/27,    /*src_cyc*/101,  /*src_id*/0x9f,   /*src_dlc*/64,   /*des_id*/0x3a1, /*updatebit_S*/471,   /*updatebit_D*/7         },
           {   /*sigGroup_s*/"igVehSpdLgt_0",   /*sig_name*/"isVehSpdLgtChks_0",   /*src_can*/"ChassisCANFD2",   /*src_network_type*/"CANFD",   /*src_slotid_fr*/0,   /*src_basecycle_fr*/0,  /*src_repetition_fr*/0,  /*src_startbit*/208,   /*sigG_length*/8,  /*des_slotid_fr*/0,   /*des_basecycle_fr*/0,  /*des_repetition_fr*/0,   /*des_startbit*/23,    /*src_cyc*/101,  /*src_id*/0x9f,   /*src_dlc*/64,   /*des_id*/0x3a1, /*updatebit_S*/471,   /*updatebit_D*/7         }
       }
   }
};
}



void settestchannel(int num)
{
  switch(num)
  {
  case 0:

        setBusContext(getBusNameContext("ZCUD_LIN1"));
        teststep("step", "Start test on ZCUD_LIN1");
        break;
  case 1:

        setBusContext(getBusNameContext("CEM_LIN3"));
        teststep("step", "Start test on CEM_LIN3");
        break;
  case 2:

        setBusContext(getBusNameContext("CEM_LIN2"));
        teststep("step", "Start test on CEM_LIN2");
        break;
  case 3:

        setBusContext(getBusNameContext("CEM_LIN6"));
        teststep("step", "Start test on CEM_LIN6");
        break;
  case 4:

        setBusContext(getBusNameContext("CEM_LIN1"));
        teststep("step", "Start test on CEM_LIN1");
        break;
  case 5:

        setBusContext(getBusNameContext("CEM_LIN4"));
        teststep("step", "Start test on CEM_LIN4");
        break;
  case 6:

        setBusContext(getBusNameContext("ZCUD_LIN2"));
        teststep("step", "Start test on ZCUD_LIN2");
        break;
  case 7:

        setBusContext(getBusNameContext("ZCUD_LIN3"));
        teststep("step", "Start test on ZCUD_LIN3");
        break;
  case 8:

        setBusContext(getBusNameContext("CEM_LIN7"));
        teststep("step", "Start test on CEM_LIN7");
        break;
  case 9:

        setBusContext(getBusNameContext("PropulsionCAN"));
        teststep("step", "Start test on PropulsionCAN");
        break;
  case 10:

        setBusContext(getBusNameContext("ChassisCAN1"));
        teststep("step", "Start test on ChassisCAN1");
        break;
  case 11:

        setBusContext(getBusNameContext("ZCU_CANFD1"));
        teststep("step", "Start test on ZCU_CANFD1");
        break;
  case 12:

        setBusContext(getBusNameContext("ZCUD_CANFD3"));
        teststep("step", "Start test on ZCUD_CANFD3");
        break;
  case 13:

        setBusContext(getBusNameContext("ChassisCANFD2"));
        teststep("step", "Start test on ChassisCANFD2");
        break;
  case 14:

        setBusContext(getBusNameContext("ZCUD_CAN1"));
        teststep("step", "Start test on ZCUD_CAN1");
        break;
  case 15:

        setBusContext(getBusNameContext("ZCUD_CANFD4"));
        teststep("step", "Start test on ZCUD_CANFD4");
        break;
  case 16:

        setBusContext(getBusNameContext("ZCU_CANFD2"));
        teststep("step", "Start test on ZCU_CANFD2");
        break;
  case 17:

        setBusContext(getBusNameContext("BodyExposedCAN"));
        teststep("step", "Start test on BodyExposedCAN");
        break;

  Default:
        testStepFail("step", "Bus context channel number is wrong!");
  }
}



void getbusbytestchannel(char BusName[],char BusType[],int num)
{
  switch(num)
  {

    case 0:
        strncpy(BusName,"ZCUD_LIN1",elcount(BusName));
        strncpy(BusType,"LIN",elcount(BusType));
        break;
    case 1:
        strncpy(BusName,"CEM_LIN3",elcount(BusName));
        strncpy(BusType,"LIN",elcount(BusType));
        break;
    case 2:
        strncpy(BusName,"CEM_LIN2",elcount(BusName));
        strncpy(BusType,"LIN",elcount(BusType));
        break;
    case 3:
        strncpy(BusName,"CEM_LIN6",elcount(BusName));
        strncpy(BusType,"LIN",elcount(BusType));
        break;
    case 4:
        strncpy(BusName,"CEM_LIN1",elcount(BusName));
        strncpy(BusType,"LIN",elcount(BusType));
        break;
    case 5:
        strncpy(BusName,"CEM_LIN4",elcount(BusName));
        strncpy(BusType,"LIN",elcount(BusType));
        break;
    case 6:
        strncpy(BusName,"ZCUD_LIN2",elcount(BusName));
        strncpy(BusType,"LIN",elcount(BusType));
        break;
    case 7:
        strncpy(BusName,"ZCUD_LIN3",elcount(BusName));
        strncpy(BusType,"LIN",elcount(BusType));
        break;
    case 8:
        strncpy(BusName,"CEM_LIN7",elcount(BusName));
        strncpy(BusType,"LIN",elcount(BusType));
        break;
    case 9:
        strncpy(BusName,"PropulsionCAN",elcount(BusName));
        strncpy(BusType,"CAN",elcount(BusType));
        break;
    case 10:
        strncpy(BusName,"ChassisCAN1",elcount(BusName));
        strncpy(BusType,"CAN",elcount(BusType));
        break;
    case 11:
        strncpy(BusName,"ZCU_CANFD1",elcount(BusName));
        strncpy(BusType,"CAN",elcount(BusType));
        break;
    case 12:
        strncpy(BusName,"ZCUD_CANFD3",elcount(BusName));
        strncpy(BusType,"CAN",elcount(BusType));
        break;
    case 13:
        strncpy(BusName,"ChassisCANFD2",elcount(BusName));
        strncpy(BusType,"CAN",elcount(BusType));
        break;
    case 14:
        strncpy(BusName,"ZCUD_CAN1",elcount(BusName));
        strncpy(BusType,"CAN",elcount(BusType));
        break;
    case 15:
        strncpy(BusName,"ZCUD_CANFD4",elcount(BusName));
        strncpy(BusType,"CAN",elcount(BusType));
        break;
    case 16:
        strncpy(BusName,"ZCU_CANFD2",elcount(BusName));
        strncpy(BusType,"CAN",elcount(BusType));
        break;
    case 17:
        strncpy(BusName,"BodyExposedCAN",elcount(BusName));
        strncpy(BusType,"CAN",elcount(BusType));
        break;
    Default:
        testStepFail("step","Bus context channel number is wrong!");
        break;
  }
}

void CANFD_switch_HighLoad(char souce_network[])
{
    if(strstr(souce_network,"CANFD")>0)
    {
        HighPriority_Msg1.FDF=1;
        LowPriority_Msg1.FDF=1;
    }
    else
    {
        HighPriority_Msg1.FDF=0;
        LowPriority_Msg1.FDF=0;
    }
}
        
void CANFD_switch(char souce_network[])
{
    if(strncmp(souce_network,"CANFD",10)==0)
    {
        temp_message.FDF = 1;
    }
    else
    {
        temp_message.FDF = 0;
    }
}


void Loggingfilenameset(int num, char testcaseid[], char group[], char caseid[], char sub[])
{
    char name[100];
    char network[20];
    switch(num)
    {

    case 0:
        strncpy(network,"ZCUD_LIN1",20);
        break;
    
    case 1:
        strncpy(network,"CEM_LIN3",20);
        break;
    
    case 2:
        strncpy(network,"CEM_LIN2",20);
        break;
    
    case 3:
        strncpy(network,"CEM_LIN6",20);
        break;
    
    case 4:
        strncpy(network,"CEM_LIN1",20);
        break;
    
    case 5:
        strncpy(network,"CEM_LIN4",20);
        break;
    
    case 6:
        strncpy(network,"ZCUD_LIN2",20);
        break;
    
    case 7:
        strncpy(network,"ZCUD_LIN3",20);
        break;
    
    case 8:
        strncpy(network,"CEM_LIN7",20);
        break;
    
    case 9:
        strncpy(network,"PropulsionCAN",20);
        break;
    
    case 10:
        strncpy(network,"ChassisCAN1",20);
        break;
    
    case 11:
        strncpy(network,"ZCU_CANFD1",20);
        break;
    
    case 12:
        strncpy(network,"ZCUD_CANFD3",20);
        break;
    
    case 13:
        strncpy(network,"ChassisCANFD2",20);
        break;
    
    case 14:
        strncpy(network,"ZCUD_CAN1",20);
        break;
    
    case 15:
        strncpy(network,"ZCUD_CANFD4",20);
        break;
    
    case 16:
        strncpy(network,"ZCU_CANFD2",20);
        break;
    
    case 17:
        strncpy(network,"BodyExposedCAN",20);
        break;
    
  Default:
      strncpy(network,"Default",20);
      testStepFail("step","logging channel number is wrong!");
      break;
  }

    strncpy(name,"\\per_testcase\\TC_GW_xx_yy_Vzz_net",100);
    str_replace_regex(name,"TC",testcaseid);
    str_replace_regex(name,"xx",group);
    str_replace_regex(name,"yy",caseid);
    str_replace_regex(name,"zz",sub);
    str_replace_regex(name,"net",network);
    //setLogFileName(name);
    SetLogPath_sig(name, 1);
}

void LIN_Init()
{

    linConfigureResponse(des_DdsZCUD_Lin1Fr01);
    linConfigureResponse(des_AdcZcud_Lin1Fr02);
    linConfigureResponse(des_MdmZCUD_Lin1Fr01);
    linConfigureResponse(des_AdcZcud_Lin1Fr01);
    linConfigureResponse(des_MmdZCUD_Lin1Fr01);
    linConfigureResponse(des_OhcCem_Lin3Fr01);
    linConfigureResponse(des_Srm2Cem_Lin3Fr02);
    linConfigureResponse(des_SigCem_Lin3Fr01);
    linConfigureResponse(des_Srm2Cem_Lin3Fr01);
    linConfigureResponse(des_AwmCem_Lin3Fr01);
    linConfigureResponse(des_OhcCem_Lin3Fr05);
    linConfigureResponse(des_Awm2Cem_Lin3SertNrFr01);
    linConfigureResponse(des_OhcCem_Lin3Fr06);
    linConfigureResponse(des_OhcCem_Lin3Fr04);
    linConfigureResponse(des_OhcCem_Lin3Fr10);
    linConfigureResponse(des_BmsCem_Lin6Fr06);
    linConfigureResponse(des_BmsCem_Lin6Fr10);
    linConfigureResponse(des_BmsCem_Lin6Fr01);
    linConfigureResponse(des_BmsCem_Lin6Fr12);
    linConfigureResponse(des_FmdmCem_Lin6Fr01);
    linConfigureResponse(des_BmsCem_Lin6Fr13);
    linConfigureResponse(des_FdmlCem_Lin6Fr01);
    linConfigureResponse(des_BmsCem_Lin6Fr02);
    linConfigureResponse(des_BmsCem_Lin6Fr16);
    linConfigureResponse(des_BmsCem_Lin6Fr03);
    linConfigureResponse(des_BmsCem_Lin6Fr08);
    linConfigureResponse(des_BmsCem_Lin6Fr11);
    linConfigureResponse(des_BmsCem_Lin6Fr04);
    linConfigureResponse(des_BmsCem_Lin6Fr05);
    linConfigureResponse(des_BmsCem_Lin6Fr09);
    linConfigureResponse(des_BmsCem_Lin6Fr07);
    linConfigureResponse(des_BmsCem_Lin6Fr14);
    linConfigureResponse(des_BmsCem_Lin6Fr15);
    linConfigureResponse(des_BmsCem_Lin6Fr17);
    linConfigureResponse(des_RlsmCem_Lin1Fr02);
    linConfigureResponse(des_RlsmCem_Lin1Fr03);
    linConfigureResponse(des_WmmCem_Lin1Fr01);
    linConfigureResponse(des_RlsmCem_Lin1Fr01);
    linConfigureResponse(des_RlsmCem_Lin1Fr04);
    linConfigureResponse(des_IrmmCem_Lin1Fr01);
    linConfigureResponse(des_IrmmCem_Lin1Fr02);
    linConfigureResponse(des_FtksCem_Lin4Fr01);
    linConfigureResponse(des_LsmCem_Lin4Fr01);
    linConfigureResponse(des_HcmlZcud_Lin2Fr01);
    linConfigureResponse(des_HcmrZcud_Lin2Fr01);
    linConfigureResponse(des_PosmCem_Lin7Fr01);
    linConfigureResponse(des_TCSCem_Lin7Fr03);
    linConfigureResponse(des_TCSCem_Lin7Fr02);
    
}

void messageUpdate(char net_num[], int id, Byte data[])
{
    int k;
    // 按网络通道处理LIN报文数据更新
    if (0) {}  // 用于后续的else if链
    else if (strncmp(net_num, "ZCUD_LIN1", strlen(net_num)) == 0) {
        switch(id) {
            case 0x36:
                for (k = 0; k < des_DdsZCUD_Lin1Fr01.dlc; k++) {
                    des_DdsZCUD_Lin1Fr01.byte(k) = data[k];
                }
                linUpdateResponse(des_DdsZCUD_Lin1Fr01);
                break;
            case 0x39:
                for (k = 0; k < des_AdcZcud_Lin1Fr02.dlc; k++) {
                    des_AdcZcud_Lin1Fr02.byte(k) = data[k];
                }
                linUpdateResponse(des_AdcZcud_Lin1Fr02);
                break;
            case 0x13:
                for (k = 0; k < des_MdmZCUD_Lin1Fr01.dlc; k++) {
                    des_MdmZCUD_Lin1Fr01.byte(k) = data[k];
                }
                linUpdateResponse(des_MdmZCUD_Lin1Fr01);
                break;
            case 0x3b:
                for (k = 0; k < des_AdcZcud_Lin1Fr01.dlc; k++) {
                    des_AdcZcud_Lin1Fr01.byte(k) = data[k];
                }
                linUpdateResponse(des_AdcZcud_Lin1Fr01);
                break;
            case 0x1:
                for (k = 0; k < des_MmdZCUD_Lin1Fr01.dlc; k++) {
                    des_MmdZCUD_Lin1Fr01.byte(k) = data[k];
                }
                linUpdateResponse(des_MmdZCUD_Lin1Fr01);
                break;
            default:
                break;
        }
    }
    else if (strncmp(net_num, "CEM_LIN3", strlen(net_num)) == 0) {
        switch(id) {
            case 0x20:
                for (k = 0; k < des_OhcCem_Lin3Fr01.dlc; k++) {
                    des_OhcCem_Lin3Fr01.byte(k) = data[k];
                }
                linUpdateResponse(des_OhcCem_Lin3Fr01);
                break;
            case 0x23:
                for (k = 0; k < des_Srm2Cem_Lin3Fr02.dlc; k++) {
                    des_Srm2Cem_Lin3Fr02.byte(k) = data[k];
                }
                linUpdateResponse(des_Srm2Cem_Lin3Fr02);
                break;
            case 0x8:
                for (k = 0; k < des_SigCem_Lin3Fr01.dlc; k++) {
                    des_SigCem_Lin3Fr01.byte(k) = data[k];
                }
                linUpdateResponse(des_SigCem_Lin3Fr01);
                break;
            case 0x11:
                for (k = 0; k < des_Srm2Cem_Lin3Fr01.dlc; k++) {
                    des_Srm2Cem_Lin3Fr01.byte(k) = data[k];
                }
                linUpdateResponse(des_Srm2Cem_Lin3Fr01);
                break;
            case 0x1a:
                for (k = 0; k < des_AwmCem_Lin3Fr01.dlc; k++) {
                    des_AwmCem_Lin3Fr01.byte(k) = data[k];
                }
                linUpdateResponse(des_AwmCem_Lin3Fr01);
                break;
            case 0x16:
                for (k = 0; k < des_OhcCem_Lin3Fr05.dlc; k++) {
                    des_OhcCem_Lin3Fr05.byte(k) = data[k];
                }
                linUpdateResponse(des_OhcCem_Lin3Fr05);
                break;
            case 0xe:
                for (k = 0; k < des_Awm2Cem_Lin3SertNrFr01.dlc; k++) {
                    des_Awm2Cem_Lin3SertNrFr01.byte(k) = data[k];
                }
                linUpdateResponse(des_Awm2Cem_Lin3SertNrFr01);
                break;
            case 0x1c:
                for (k = 0; k < des_OhcCem_Lin3Fr06.dlc; k++) {
                    des_OhcCem_Lin3Fr06.byte(k) = data[k];
                }
                linUpdateResponse(des_OhcCem_Lin3Fr06);
                break;
            case 0x14:
                for (k = 0; k < des_OhcCem_Lin3Fr04.dlc; k++) {
                    des_OhcCem_Lin3Fr04.byte(k) = data[k];
                }
                linUpdateResponse(des_OhcCem_Lin3Fr04);
                break;
            case 0x6:
                for (k = 0; k < des_OhcCem_Lin3Fr10.dlc; k++) {
                    des_OhcCem_Lin3Fr10.byte(k) = data[k];
                }
                linUpdateResponse(des_OhcCem_Lin3Fr10);
                break;
            default:
                break;
        }
    }
    else if (strncmp(net_num, "CEM_LIN6", strlen(net_num)) == 0) {
        switch(id) {
            case 0x28:
                for (k = 0; k < des_BmsCem_Lin6Fr06.dlc; k++) {
                    des_BmsCem_Lin6Fr06.byte(k) = data[k];
                }
                linUpdateResponse(des_BmsCem_Lin6Fr06);
                break;
            case 0x20:
                for (k = 0; k < des_BmsCem_Lin6Fr10.dlc; k++) {
                    des_BmsCem_Lin6Fr10.byte(k) = data[k];
                }
                linUpdateResponse(des_BmsCem_Lin6Fr10);
                break;
            case 0x2:
                for (k = 0; k < des_BmsCem_Lin6Fr01.dlc; k++) {
                    des_BmsCem_Lin6Fr01.byte(k) = data[k];
                }
                linUpdateResponse(des_BmsCem_Lin6Fr01);
                break;
            case 0x29:
                for (k = 0; k < des_BmsCem_Lin6Fr12.dlc; k++) {
                    des_BmsCem_Lin6Fr12.byte(k) = data[k];
                }
                linUpdateResponse(des_BmsCem_Lin6Fr12);
                break;
            case 0x16:
                for (k = 0; k < des_FmdmCem_Lin6Fr01.dlc; k++) {
                    des_FmdmCem_Lin6Fr01.byte(k) = data[k];
                }
                linUpdateResponse(des_FmdmCem_Lin6Fr01);
                break;
            case 0x2a:
                for (k = 0; k < des_BmsCem_Lin6Fr13.dlc; k++) {
                    des_BmsCem_Lin6Fr13.byte(k) = data[k];
                }
                linUpdateResponse(des_BmsCem_Lin6Fr13);
                break;
            case 0x18:
                for (k = 0; k < des_FdmlCem_Lin6Fr01.dlc; k++) {
                    des_FdmlCem_Lin6Fr01.byte(k) = data[k];
                }
                linUpdateResponse(des_FdmlCem_Lin6Fr01);
                break;
            case 0x3:
                for (k = 0; k < des_BmsCem_Lin6Fr02.dlc; k++) {
                    des_BmsCem_Lin6Fr02.byte(k) = data[k];
                }
                linUpdateResponse(des_BmsCem_Lin6Fr02);
                break;
            case 0x26:
                for (k = 0; k < des_BmsCem_Lin6Fr16.dlc; k++) {
                    des_BmsCem_Lin6Fr16.byte(k) = data[k];
                }
                linUpdateResponse(des_BmsCem_Lin6Fr16);
                break;
            case 0x4:
                for (k = 0; k < des_BmsCem_Lin6Fr03.dlc; k++) {
                    des_BmsCem_Lin6Fr03.byte(k) = data[k];
                }
                linUpdateResponse(des_BmsCem_Lin6Fr03);
                break;
            case 0x7:
                for (k = 0; k < des_BmsCem_Lin6Fr08.dlc; k++) {
                    des_BmsCem_Lin6Fr08.byte(k) = data[k];
                }
                linUpdateResponse(des_BmsCem_Lin6Fr08);
                break;
            case 0x21:
                for (k = 0; k < des_BmsCem_Lin6Fr11.dlc; k++) {
                    des_BmsCem_Lin6Fr11.byte(k) = data[k];
                }
                linUpdateResponse(des_BmsCem_Lin6Fr11);
                break;
            case 0x9:
                for (k = 0; k < des_BmsCem_Lin6Fr04.dlc; k++) {
                    des_BmsCem_Lin6Fr04.byte(k) = data[k];
                }
                linUpdateResponse(des_BmsCem_Lin6Fr04);
                break;
            case 0x6:
                for (k = 0; k < des_BmsCem_Lin6Fr05.dlc; k++) {
                    des_BmsCem_Lin6Fr05.byte(k) = data[k];
                }
                linUpdateResponse(des_BmsCem_Lin6Fr05);
                break;
            case 0x10:
                for (k = 0; k < des_BmsCem_Lin6Fr09.dlc; k++) {
                    des_BmsCem_Lin6Fr09.byte(k) = data[k];
                }
                linUpdateResponse(des_BmsCem_Lin6Fr09);
                break;
            case 0x8:
                for (k = 0; k < des_BmsCem_Lin6Fr07.dlc; k++) {
                    des_BmsCem_Lin6Fr07.byte(k) = data[k];
                }
                linUpdateResponse(des_BmsCem_Lin6Fr07);
                break;
            case 0x24:
                for (k = 0; k < des_BmsCem_Lin6Fr14.dlc; k++) {
                    des_BmsCem_Lin6Fr14.byte(k) = data[k];
                }
                linUpdateResponse(des_BmsCem_Lin6Fr14);
                break;
            case 0x25:
                for (k = 0; k < des_BmsCem_Lin6Fr15.dlc; k++) {
                    des_BmsCem_Lin6Fr15.byte(k) = data[k];
                }
                linUpdateResponse(des_BmsCem_Lin6Fr15);
                break;
            case 0x27:
                for (k = 0; k < des_BmsCem_Lin6Fr17.dlc; k++) {
                    des_BmsCem_Lin6Fr17.byte(k) = data[k];
                }
                linUpdateResponse(des_BmsCem_Lin6Fr17);
                break;
            default:
                break;
        }
    }
    else if (strncmp(net_num, "CEM_LIN1", strlen(net_num)) == 0) {
        switch(id) {
            case 0x2c:
                for (k = 0; k < des_RlsmCem_Lin1Fr02.dlc; k++) {
                    des_RlsmCem_Lin1Fr02.byte(k) = data[k];
                }
                linUpdateResponse(des_RlsmCem_Lin1Fr02);
                break;
            case 0x2:
                for (k = 0; k < des_RlsmCem_Lin1Fr03.dlc; k++) {
                    des_RlsmCem_Lin1Fr03.byte(k) = data[k];
                }
                linUpdateResponse(des_RlsmCem_Lin1Fr03);
                break;
            case 0x25:
                for (k = 0; k < des_WmmCem_Lin1Fr01.dlc; k++) {
                    des_WmmCem_Lin1Fr01.byte(k) = data[k];
                }
                linUpdateResponse(des_WmmCem_Lin1Fr01);
                break;
            case 0x15:
                for (k = 0; k < des_RlsmCem_Lin1Fr01.dlc; k++) {
                    des_RlsmCem_Lin1Fr01.byte(k) = data[k];
                }
                linUpdateResponse(des_RlsmCem_Lin1Fr01);
                break;
            case 0x3:
                for (k = 0; k < des_RlsmCem_Lin1Fr04.dlc; k++) {
                    des_RlsmCem_Lin1Fr04.byte(k) = data[k];
                }
                linUpdateResponse(des_RlsmCem_Lin1Fr04);
                break;
            case 0x10:
                for (k = 0; k < des_IrmmCem_Lin1Fr01.dlc; k++) {
                    des_IrmmCem_Lin1Fr01.byte(k) = data[k];
                }
                linUpdateResponse(des_IrmmCem_Lin1Fr01);
                break;
            case 0x13:
                for (k = 0; k < des_IrmmCem_Lin1Fr02.dlc; k++) {
                    des_IrmmCem_Lin1Fr02.byte(k) = data[k];
                }
                linUpdateResponse(des_IrmmCem_Lin1Fr02);
                break;
            default:
                break;
        }
    }
    else if (strncmp(net_num, "CEM_LIN4", strlen(net_num)) == 0) {
        switch(id) {
            case 0xc:
                for (k = 0; k < des_FtksCem_Lin4Fr01.dlc; k++) {
                    des_FtksCem_Lin4Fr01.byte(k) = data[k];
                }
                linUpdateResponse(des_FtksCem_Lin4Fr01);
                break;
            case 0x20:
                for (k = 0; k < des_LsmCem_Lin4Fr01.dlc; k++) {
                    des_LsmCem_Lin4Fr01.byte(k) = data[k];
                }
                linUpdateResponse(des_LsmCem_Lin4Fr01);
                break;
            default:
                break;
        }
    }
    else if (strncmp(net_num, "ZCUD_LIN2", strlen(net_num)) == 0) {
        switch(id) {
            case 0x1:
                for (k = 0; k < des_HcmlZcud_Lin2Fr01.dlc; k++) {
                    des_HcmlZcud_Lin2Fr01.byte(k) = data[k];
                }
                linUpdateResponse(des_HcmlZcud_Lin2Fr01);
                break;
            case 0x2:
                for (k = 0; k < des_HcmrZcud_Lin2Fr01.dlc; k++) {
                    des_HcmrZcud_Lin2Fr01.byte(k) = data[k];
                }
                linUpdateResponse(des_HcmrZcud_Lin2Fr01);
                break;
            default:
                break;
        }
    }
    else if (strncmp(net_num, "CEM_LIN7", strlen(net_num)) == 0) {
        switch(id) {
            case 0x11:
                for (k = 0; k < des_PosmCem_Lin7Fr01.dlc; k++) {
                    des_PosmCem_Lin7Fr01.byte(k) = data[k];
                }
                linUpdateResponse(des_PosmCem_Lin7Fr01);
                break;
            case 0xf:
                for (k = 0; k < des_TCSCem_Lin7Fr03.dlc; k++) {
                    des_TCSCem_Lin7Fr03.byte(k) = data[k];
                }
                linUpdateResponse(des_TCSCem_Lin7Fr03);
                break;
            case 0xa:
                for (k = 0; k < des_TCSCem_Lin7Fr02.dlc; k++) {
                    des_TCSCem_Lin7Fr02.byte(k) = data[k];
                }
                linUpdateResponse(des_TCSCem_Lin7Fr02);
                break;
            default:
                break;
        }
    }
}


on timer SimHighLoadTimer_HighPriority
{
  int burst[network_quantity],busload[network_quantity],testchannel,buschannel,h;
  char busaname[20],bustype[20];
  for(testchannel=0;testchannel<network_quantity;testchannel++)
  {
    getbusbytestchannel(busaname,bustype,testchannel);
    if((strncmp(bustype,"CANFD",strlen("CANFD"))==0)||(strncmp(bustype,"CAN",strlen("CAN"))==0))
    {
      buschannel=GetBusNameContext(busaname);
      CANFD_switch_HighLoad(busaname);
      for(h=0; h<burst[testchannel] ;h++)
      { 

         HighPriority_Msg1.can=buschannel;
         output(HighPriority_Msg1);

      }
      
      busload[testchannel] = canGetBusLoad(buschannel);
      if(busload[testchannel]<80)
        burst[testchannel]++; 
    }      
  }
}

on timer SimHighLoadTimer_LowPriority
{
  int burst[network_quantity],busload[network_quantity],testchannel,buschannel,h;
  char busaname[20],bustype[20];
  for(testchannel=0;testchannel<network_quantity;testchannel++)
  {
    getbusbytestchannel(busaname,bustype,testchannel);
    if((strncmp(bustype,"CANFD",strlen("CANFD"))==0)||(strncmp(bustype,"CAN",strlen("CAN"))==0))
    {
      buschannel=GetBusNameContext(busaname);
      CANFD_switch_HighLoad(busaname);
      for(h=0; h<burst[testchannel] ;h++)
      { 

         LowPriority_Msg1.can=buschannel;
         output(LowPriority_Msg1);

      }
      
      busload[testchannel] = canGetBusLoad(buschannel);
      if(busload[testchannel]<80)
        burst[testchannel]++; 
    }      
  }
}
