
variables
{   
    //由basetech测试配置生成，非code-factory生成
    
    //本次生成选中的目标网段为：['CEM_LIN3', 'ZCUD_CANFD4', 'PropulsionCAN', 'CEM_LIN7', 'ZCUD_CAN1', 'ZCU_CANFD1', 'ChassisCAN1', 'CEM_LIN1', 'CEM_LIN4', 'ZCUD_CANFD3', 'ChassisCANFD2']
    //本次生成被过滤的源网段为：['ZCUD_LIN3', 'CEM_LIN2']
    
    const int Event = 1002;
    char NodeName[20] = "ZCUD5";
    LinFrame ZCUD_LIN1.0x36 des_DdsZCUD_Lin1Fr01={dlc=7};
    LinFrame ZCUD_LIN1.0x39 des_AdcZcud_Lin1Fr02={dlc=4};
    LinFrame ZCUD_LIN1.0x13 des_MdmZCUD_Lin1Fr01={dlc=2};
    LinFrame ZCUD_LIN1.0x3b des_AdcZcud_Lin1Fr01={dlc=8};
    LinFrame ZCUD_LIN1.0x1 des_MmdZCUD_Lin1Fr01={dlc=4};
    LinFrame CEM_LIN3.0x20 des_OhcCem_Lin3Fr01={dlc=7};
    LinFrame CEM_LIN3.0x23 des_Srm2Cem_Lin3Fr02={dlc=8};
    LinFrame CEM_LIN3.0x8 des_SigCem_Lin3Fr01={dlc=7};
    LinFrame CEM_LIN3.0x11 des_Srm2Cem_Lin3Fr01={dlc=7};
    LinFrame CEM_LIN3.0x1a des_AwmCem_Lin3Fr01={dlc=3};
    LinFrame CEM_LIN3.0x16 des_OhcCem_Lin3Fr05={dlc=2};
    LinFrame CEM_LIN3.0xe des_Awm2Cem_Lin3SertNrFr01={dlc=4};
    LinFrame CEM_LIN3.0x1c des_OhcCem_Lin3Fr06={dlc=7};
    LinFrame CEM_LIN3.0x14 des_OhcCem_Lin3Fr04={dlc=1};
    LinFrame CEM_LIN3.0x6 des_OhcCem_Lin3Fr10={dlc=7};
    LinFrame CEM_LIN6.0x28 des_BmsCem_Lin6Fr06={dlc=7};
    LinFrame CEM_LIN6.0x20 des_BmsCem_Lin6Fr10={dlc=7};
    LinFrame CEM_LIN6.0x2 des_BmsCem_Lin6Fr01={dlc=8};
    LinFrame CEM_LIN6.0x29 des_BmsCem_Lin6Fr12={dlc=8};
    LinFrame CEM_LIN6.0x16 des_FmdmCem_Lin6Fr01={dlc=1};
    LinFrame CEM_LIN6.0x2a des_BmsCem_Lin6Fr13={dlc=8};
    LinFrame CEM_LIN6.0x18 des_FdmlCem_Lin6Fr01={dlc=1};
    LinFrame CEM_LIN6.0x3 des_BmsCem_Lin6Fr02={dlc=8};
    LinFrame CEM_LIN6.0x26 des_BmsCem_Lin6Fr16={dlc=8};
    LinFrame CEM_LIN6.0x4 des_BmsCem_Lin6Fr03={dlc=7};
    LinFrame CEM_LIN6.0x7 des_BmsCem_Lin6Fr08={dlc=8};
    LinFrame CEM_LIN6.0x21 des_BmsCem_Lin6Fr11={dlc=4};
    LinFrame CEM_LIN6.0x9 des_BmsCem_Lin6Fr04={dlc=7};
    LinFrame CEM_LIN6.0x6 des_BmsCem_Lin6Fr05={dlc=7};
    LinFrame CEM_LIN6.0x10 des_BmsCem_Lin6Fr09={dlc=8};
    LinFrame CEM_LIN6.0x8 des_BmsCem_Lin6Fr07={dlc=8};
    LinFrame CEM_LIN6.0x24 des_BmsCem_Lin6Fr14={dlc=8};
    LinFrame CEM_LIN6.0x25 des_BmsCem_Lin6Fr15={dlc=8};
    LinFrame CEM_LIN6.0x27 des_BmsCem_Lin6Fr17={dlc=8};
    LinFrame CEM_LIN1.0x2c des_RlsmCem_Lin1Fr02={dlc=8};
    LinFrame CEM_LIN1.0x2 des_RlsmCem_Lin1Fr03={dlc=8};
    LinFrame CEM_LIN1.0x25 des_WmmCem_Lin1Fr01={dlc=4};
    LinFrame CEM_LIN1.0x15 des_RlsmCem_Lin1Fr01={dlc=8};
    LinFrame CEM_LIN1.0x3 des_RlsmCem_Lin1Fr04={dlc=7};
    LinFrame CEM_LIN1.0x10 des_IrmmCem_Lin1Fr01={dlc=4};
    LinFrame CEM_LIN1.0x13 des_IrmmCem_Lin1Fr02={dlc=8};
    LinFrame CEM_LIN4.0xc des_FtksCem_Lin4Fr01={dlc=8};
    LinFrame CEM_LIN4.0x20 des_LsmCem_Lin4Fr01={dlc=5};
    LinFrame ZCUD_LIN2.0x1 des_HcmlZcud_Lin2Fr01={dlc=7};
    LinFrame ZCUD_LIN2.0x2 des_HcmrZcud_Lin2Fr01={dlc=7};
    LinFrame CEM_LIN7.0x11 des_PosmCem_Lin7Fr01={dlc=8};
    LinFrame CEM_LIN7.0xf des_TCSCem_Lin7Fr03={dlc=8};
    LinFrame CEM_LIN7.0xa des_TCSCem_Lin7Fr02={dlc=8};
    Const int  Num_LIN=48;

    message 0x1 HighPriority_Msg1= {FDF=1,BRS=1,dlc = 15};
    message 0x7FE LowPriority_Msg1= {FDF=1,BRS=1,dlc = 15};
    message PropulsionCAN.0x000 des_PropulsionCAN_0x000;
    message ChassisCAN1.0x000 des_ChassisCAN1_0x000;
    message ZCU_CANFD1.0x000 des_ZCU_CANFD1_0x000;
    message ZCUD_CANFD3.0x000 des_ZCUD_CANFD3_0x000;
    message ChassisCANFD2.0x000 des_ChassisCANFD2_0x000;
    message ZCUD_CAN1.0x000 des_ZCUD_CAN1_0x000;
    message ZCUD_CANFD4.0x000 des_ZCUD_CANFD4_0x000;
    message ZCU_CANFD2.0x000 des_ZCU_CANFD2_0x000;
    message BodyExposedCAN.0x000 des_BodyExposedCAN_0x000;
    const int network_quantity=18;
    dword SignaleRoutingTime=5;
    int network_num;
    int Encoding=2;

    struct gFrame{
    char des_frame[100];
    int des_cyc;
    int des_id;   
    int des_slotid_fr;
    int des_basecycle_fr;
    int des_repetition_fr;
    int des_dlc;
  };
  
    //data for Signal routing message check
    struct Demo_signal_frame{ 
    char des_can[100];
    char networktype[20];
    int SumAll;
    struct gFrame GFrame[500];
  };
        
    struct Demo_signal_frame test_sig_frame[network_quantity]={

   {
       /*des_channels*/  "ZCUD_LIN1",
       /*networktype*/  "LIN",
       0,
       {
           0
       }
   },
   {
       /*des_channels*/  "CEM_LIN3",
       /*networktype*/  "LIN",
       1,
       {
           {/*des_frame*/"ZCUDCem_Lin3Fr01",   /*des_cyc*/1000,   /*des_id*/0,   /*des_slotid_fr*/0,   /*des_basecycle_fr*/0,   /*des_repetition_fr*/0,  /*des_dlc*/7    
           }
       }
   },
   {
       /*des_channels*/  "CEM_LIN2",
       /*networktype*/  "LIN",
       0,
       {
           0
       }
   },
   {
       /*des_channels*/  "CEM_LIN6",
       /*networktype*/  "LIN",
       0,
       {
           0
       }
   },
   {
       /*des_channels*/  "CEM_LIN1",
       /*networktype*/  "LIN",
       2,
       {
           {/*des_frame*/"CemCem_Lin1Fr08",   /*des_cyc*/1000,   /*des_id*/4,   /*des_slotid_fr*/0,   /*des_basecycle_fr*/0,   /*des_repetition_fr*/0,  /*des_dlc*/8    
           },
           {/*des_frame*/"CemCem_Lin1Fr07",   /*des_cyc*/1000,   /*des_id*/17,   /*des_slotid_fr*/0,   /*des_basecycle_fr*/0,   /*des_repetition_fr*/0,  /*des_dlc*/8    
           }
       }
   },
   {
       /*des_channels*/  "CEM_LIN4",
       /*networktype*/  "LIN",
       1,
       {
           {/*des_frame*/"ZCUDCem_Lin4Fr10",   /*des_cyc*/1000,   /*des_id*/13,   /*des_slotid_fr*/0,   /*des_basecycle_fr*/0,   /*des_repetition_fr*/0,  /*des_dlc*/8    
           }
       }
   },
   {
       /*des_channels*/  "ZCUD_LIN2",
       /*networktype*/  "LIN",
       0,
       {
           0
       }
   },
   {
       /*des_channels*/  "ZCUD_LIN3",
       /*networktype*/  "LIN",
       0,
       {
           0
       }
   },
   {
       /*des_channels*/  "CEM_LIN7",
       /*networktype*/  "LIN",
       1,
       {
           {/*des_frame*/"ZCUDCem_Lin7Fr03",   /*des_cyc*/1000,   /*des_id*/33,   /*des_slotid_fr*/0,   /*des_basecycle_fr*/0,   /*des_repetition_fr*/0,  /*des_dlc*/7    
           }
       }
   },
   {
       /*des_channels*/  "PropulsionCAN",
       /*networktype*/  "CAN",
       8,
       {
           {/*des_frame*/"ZcudPropFr23",   /*des_cyc*/200,   /*des_id*/0x285,   /*des_slotid_fr*/0,   /*des_basecycle_fr*/0,   /*des_repetition_fr*/0,  /*des_dlc*/8    
           },
           {/*des_frame*/"ZcudPropFr13",   /*des_cyc*/300,   /*des_id*/0x297,   /*des_slotid_fr*/0,   /*des_basecycle_fr*/0,   /*des_repetition_fr*/0,  /*des_dlc*/8    
           },
           {/*des_frame*/"ZcudPropFr14",   /*des_cyc*/20,   /*des_id*/0x12e,   /*des_slotid_fr*/0,   /*des_basecycle_fr*/0,   /*des_repetition_fr*/0,  /*des_dlc*/8    
           },
           {/*des_frame*/"ZcudPropFr03",   /*des_cyc*/50,   /*des_id*/0x19d,   /*des_slotid_fr*/0,   /*des_basecycle_fr*/0,   /*des_repetition_fr*/0,  /*des_dlc*/8    
           },
           {/*des_frame*/"ZcudPropFr12",   /*des_cyc*/100,   /*des_id*/0x160,   /*des_slotid_fr*/0,   /*des_basecycle_fr*/0,   /*des_repetition_fr*/0,  /*des_dlc*/8    
           },
           {/*des_frame*/"ZcudPropFr15",   /*des_cyc*/20,   /*des_id*/0x11a,   /*des_slotid_fr*/0,   /*des_basecycle_fr*/0,   /*des_repetition_fr*/0,  /*des_dlc*/8    
           },
           {/*des_frame*/"ZcudPropFr16",   /*des_cyc*/15,   /*des_id*/0x76,   /*des_slotid_fr*/0,   /*des_basecycle_fr*/0,   /*des_repetition_fr*/0,  /*des_dlc*/8    
           },
           {/*des_frame*/"ZcudPropFr26",   /*des_cyc*/50,   /*des_id*/0x198,   /*des_slotid_fr*/0,   /*des_basecycle_fr*/0,   /*des_repetition_fr*/0,  /*des_dlc*/8    
           }
       }
   },
   {
       /*des_channels*/  "ChassisCAN1",
       /*networktype*/  "CAN",
       7,
       {
           {/*des_frame*/"ZcudChas1Fr30",   /*des_cyc*/30,   /*des_id*/0x1f0,   /*des_slotid_fr*/0,   /*des_basecycle_fr*/0,   /*des_repetition_fr*/0,  /*des_dlc*/8    
           },
           {/*des_frame*/"ZcudChas1Fr23",   /*des_cyc*/170,   /*des_id*/0x310,   /*des_slotid_fr*/0,   /*des_basecycle_fr*/0,   /*des_repetition_fr*/0,  /*des_dlc*/8    
           },
           {/*des_frame*/"ZcudChas1Fr25",   /*des_cyc*/Event,   /*des_id*/0x3f7,   /*des_slotid_fr*/0,   /*des_basecycle_fr*/0,   /*des_repetition_fr*/0,  /*des_dlc*/8    
           },
           {/*des_frame*/"ZcudChas1Fr02",   /*des_cyc*/Event,   /*des_id*/0x152,   /*des_slotid_fr*/0,   /*des_basecycle_fr*/0,   /*des_repetition_fr*/0,  /*des_dlc*/8    
           },
           {/*des_frame*/"ZcudChas1Fr26",   /*des_cyc*/120,   /*des_id*/0x2ae,   /*des_slotid_fr*/0,   /*des_basecycle_fr*/0,   /*des_repetition_fr*/0,  /*des_dlc*/8    
           },
           {/*des_frame*/"ZcudChas1Fr24",   /*des_cyc*/Event,   /*des_id*/0x250,   /*des_slotid_fr*/0,   /*des_basecycle_fr*/0,   /*des_repetition_fr*/0,  /*des_dlc*/8    
           },
           {/*des_frame*/"ZcudChas1Fr28",   /*des_cyc*/80,   /*des_id*/0x360,   /*des_slotid_fr*/0,   /*des_basecycle_fr*/0,   /*des_repetition_fr*/0,  /*des_dlc*/8    
           }
       }
   },
   {
       /*des_channels*/  "ZCU_CANFD1",
       /*networktype*/  "CAN",
       11,
       {
           {/*des_frame*/"ZcudZCUCANFD1Fr03",   /*des_cyc*/150,   /*des_id*/0x353,   /*des_slotid_fr*/0,   /*des_basecycle_fr*/0,   /*des_repetition_fr*/0,  /*des_dlc*/64    
           },
           {/*des_frame*/"ZcudZCUCANFD1Fr02",   /*des_cyc*/20,   /*des_id*/0x106,   /*des_slotid_fr*/0,   /*des_basecycle_fr*/0,   /*des_repetition_fr*/0,  /*des_dlc*/64    
           },
           {/*des_frame*/"ZcudZCUCANFD1Fr07",   /*des_cyc*/40,   /*des_id*/0x1f1,   /*des_slotid_fr*/0,   /*des_basecycle_fr*/0,   /*des_repetition_fr*/0,  /*des_dlc*/64    
           },
           {/*des_frame*/"ZcudZCUCANFD1Fr13",   /*des_cyc*/1000,   /*des_id*/0x485,   /*des_slotid_fr*/0,   /*des_basecycle_fr*/0,   /*des_repetition_fr*/0,  /*des_dlc*/64    
           },
           {/*des_frame*/"ZcudZCUCANFD1Fr06",   /*des_cyc*/70,   /*des_id*/0x243,   /*des_slotid_fr*/0,   /*des_basecycle_fr*/0,   /*des_repetition_fr*/0,  /*des_dlc*/64    
           },
           {/*des_frame*/"ZcudZCUCANFD1Fr01",   /*des_cyc*/10,   /*des_id*/0x61,   /*des_slotid_fr*/0,   /*des_basecycle_fr*/0,   /*des_repetition_fr*/0,  /*des_dlc*/64    
           },
           {/*des_frame*/"ZcudZCUCANFD1Fr04",   /*des_cyc*/10,   /*des_id*/0x81,   /*des_slotid_fr*/0,   /*des_basecycle_fr*/0,   /*des_repetition_fr*/0,  /*des_dlc*/64    
           },
           {/*des_frame*/"ZcudZCUCANFD1Fr12",   /*des_cyc*/50,   /*des_id*/0x16f,   /*des_slotid_fr*/0,   /*des_basecycle_fr*/0,   /*des_repetition_fr*/0,  /*des_dlc*/64    
           },
           {/*des_frame*/"ZcudZCUCANFD1Fr05",   /*des_cyc*/100,   /*des_id*/0x221,   /*des_slotid_fr*/0,   /*des_basecycle_fr*/0,   /*des_repetition_fr*/0,  /*des_dlc*/64    
           },
           {/*des_frame*/"ZcudZCUCANFD1Fr09",   /*des_cyc*/400,   /*des_id*/0x3a3,   /*des_slotid_fr*/0,   /*des_basecycle_fr*/0,   /*des_repetition_fr*/0,  /*des_dlc*/64    
           },
           {/*des_frame*/"ZcudZCUCANFD1Fr08",   /*des_cyc*/300,   /*des_id*/0x363,   /*des_slotid_fr*/0,   /*des_basecycle_fr*/0,   /*des_repetition_fr*/0,  /*des_dlc*/64    
           }
       }
   },
   {
       /*des_channels*/  "ZCUD_CANFD3",
       /*networktype*/  "CAN",
       6,
       {
           {/*des_frame*/"ZcudZCUDCANFD3Fr05",   /*des_cyc*/1000,   /*des_id*/0x495,   /*des_slotid_fr*/0,   /*des_basecycle_fr*/0,   /*des_repetition_fr*/0,  /*des_dlc*/64    
           },
           {/*des_frame*/"ZcudZCUDCANFD3Fr12",   /*des_cyc*/150,   /*des_id*/0x2f0,   /*des_slotid_fr*/0,   /*des_basecycle_fr*/0,   /*des_repetition_fr*/0,  /*des_dlc*/64    
           },
           {/*des_frame*/"ZcudZCUDCANFD3Fr10",   /*des_cyc*/Event,   /*des_id*/0x225,   /*des_slotid_fr*/0,   /*des_basecycle_fr*/0,   /*des_repetition_fr*/0,  /*des_dlc*/64    
           },
           {/*des_frame*/"ZcudZCUDCANFD3Fr06",   /*des_cyc*/100,   /*des_id*/0x239,   /*des_slotid_fr*/0,   /*des_basecycle_fr*/0,   /*des_repetition_fr*/0,  /*des_dlc*/64    
           },
           {/*des_frame*/"ZcudZCUDCANFD3Fr01",   /*des_cyc*/10,   /*des_id*/0x55,   /*des_slotid_fr*/0,   /*des_basecycle_fr*/0,   /*des_repetition_fr*/0,  /*des_dlc*/64    
           },
           {/*des_frame*/"ZcudZCUDCANFD3Fr03",   /*des_cyc*/30,   /*des_id*/0x121,   /*des_slotid_fr*/0,   /*des_basecycle_fr*/0,   /*des_repetition_fr*/0,  /*des_dlc*/64    
           }
       }
   },
   {
       /*des_channels*/  "ChassisCANFD2",
       /*networktype*/  "CAN",
       11,
       {
           {/*des_frame*/"ZcudChassisCANFD2Fr009",   /*des_cyc*/900,   /*des_id*/0x3f5,   /*des_slotid_fr*/0,   /*des_basecycle_fr*/0,   /*des_repetition_fr*/0,  /*des_dlc*/64    
           },
           {/*des_frame*/"ZcudChassisCANFD2Fr008",   /*des_cyc*/30,   /*des_id*/0xe5,   /*des_slotid_fr*/0,   /*des_basecycle_fr*/0,   /*des_repetition_fr*/0,  /*des_dlc*/64    
           },
           {/*des_frame*/"ZcudChassisCANFD2Fr004",   /*des_cyc*/40,   /*des_id*/0x13c,   /*des_slotid_fr*/0,   /*des_basecycle_fr*/0,   /*des_repetition_fr*/0,  /*des_dlc*/64    
           },
           {/*des_frame*/"ZcudChassisCANFD2Fr003",   /*des_cyc*/20,   /*des_id*/0xdf,   /*des_slotid_fr*/0,   /*des_basecycle_fr*/0,   /*des_repetition_fr*/0,  /*des_dlc*/64    
           },
           {/*des_frame*/"ZcudChassisCANFD2Fr006",   /*des_cyc*/60,   /*des_id*/0x16f,   /*des_slotid_fr*/0,   /*des_basecycle_fr*/0,   /*des_repetition_fr*/0,  /*des_dlc*/64    
           },
           {/*des_frame*/"ZcudChassisCANFD2Fr014",   /*des_cyc*/10,   /*des_id*/0x59,   /*des_slotid_fr*/0,   /*des_basecycle_fr*/0,   /*des_repetition_fr*/0,  /*des_dlc*/64    
           },
           {/*des_frame*/"ZcudChassisCANFD2Fr001",   /*des_cyc*/10,   /*des_id*/0x86,   /*des_slotid_fr*/0,   /*des_basecycle_fr*/0,   /*des_repetition_fr*/0,  /*des_dlc*/64    
           },
           {/*des_frame*/"ZcudChassisCANFD2Fr002",   /*des_cyc*/10,   /*des_id*/0x4f,   /*des_slotid_fr*/0,   /*des_basecycle_fr*/0,   /*des_repetition_fr*/0,  /*des_dlc*/64    
           },
           {/*des_frame*/"ZcudChassisCANFD2Fr015",   /*des_cyc*/450,   /*des_id*/0x35c,   /*des_slotid_fr*/0,   /*des_basecycle_fr*/0,   /*des_repetition_fr*/0,  /*des_dlc*/64    
           },
           {/*des_frame*/"ZcudChassisCANFD2Fr018",   /*des_cyc*/450,   /*des_id*/0x335,   /*des_slotid_fr*/0,   /*des_basecycle_fr*/0,   /*des_repetition_fr*/0,  /*des_dlc*/64    
           },
           {/*des_frame*/"ZcudChassisCANFD2Fr010",   /*des_cyc*/100,   /*des_id*/0x23d,   /*des_slotid_fr*/0,   /*des_basecycle_fr*/0,   /*des_repetition_fr*/0,  /*des_dlc*/64    
           }
       }
   },
   {
       /*des_channels*/  "ZCUD_CAN1",
       /*networktype*/  "CAN",
       29,
       {
           {/*des_frame*/"ZCUDZCUDCAN1Fr29",   /*des_cyc*/40,   /*des_id*/0x83,   /*des_slotid_fr*/0,   /*des_basecycle_fr*/0,   /*des_repetition_fr*/0,  /*des_dlc*/8    
           },
           {/*des_frame*/"ZCUDZCUDCAN1Fr50",   /*des_cyc*/800,   /*des_id*/0x471,   /*des_slotid_fr*/0,   /*des_basecycle_fr*/0,   /*des_repetition_fr*/0,  /*des_dlc*/8    
           },
           {/*des_frame*/"ZCUDZCUDCAN1Fr69",   /*des_cyc*/175,   /*des_id*/0x310,   /*des_slotid_fr*/0,   /*des_basecycle_fr*/0,   /*des_repetition_fr*/0,  /*des_dlc*/8    
           },
           {/*des_frame*/"ZCUDZCUDCAN1Fr46",   /*des_cyc*/120,   /*des_id*/0x210,   /*des_slotid_fr*/0,   /*des_basecycle_fr*/0,   /*des_repetition_fr*/0,  /*des_dlc*/8    
           },
           {/*des_frame*/"ZCUDZCUDCAN1Fr27",   /*des_cyc*/10,   /*des_id*/0x54,   /*des_slotid_fr*/0,   /*des_basecycle_fr*/0,   /*des_repetition_fr*/0,  /*des_dlc*/8    
           },
           {/*des_frame*/"ZCUDZCUDCAN1Fr40",   /*des_cyc*/100,   /*des_id*/0x228,   /*des_slotid_fr*/0,   /*des_basecycle_fr*/0,   /*des_repetition_fr*/0,  /*des_dlc*/8    
           },
           {/*des_frame*/"ZCUDZCUDCAN1Fr70",   /*des_cyc*/70,   /*des_id*/0x99,   /*des_slotid_fr*/0,   /*des_basecycle_fr*/0,   /*des_repetition_fr*/0,  /*des_dlc*/8    
           },
           {/*des_frame*/"ZCUDZCUDCAN1Fr19",   /*des_cyc*/350,   /*des_id*/0x384,   /*des_slotid_fr*/0,   /*des_basecycle_fr*/0,   /*des_repetition_fr*/0,  /*des_dlc*/8    
           },
           {/*des_frame*/"ZCUDZCUDCAN1Fr52",   /*des_cyc*/30,   /*des_id*/0x121,   /*des_slotid_fr*/0,   /*des_basecycle_fr*/0,   /*des_repetition_fr*/0,  /*des_dlc*/8    
           },
           {/*des_frame*/"ZCUDZCUDCAN1Fr47",   /*des_cyc*/10,   /*des_id*/0x50,   /*des_slotid_fr*/0,   /*des_basecycle_fr*/0,   /*des_repetition_fr*/0,  /*des_dlc*/8    
           },
           {/*des_frame*/"ZCUDZCUDCAN1Fr13",   /*des_cyc*/40,   /*des_id*/0x366,   /*des_slotid_fr*/0,   /*des_basecycle_fr*/0,   /*des_repetition_fr*/0,  /*des_dlc*/8    
           },
           {/*des_frame*/"ZCUDZCUDCAN1Fr34",   /*des_cyc*/Event,   /*des_id*/0x132,   /*des_slotid_fr*/0,   /*des_basecycle_fr*/0,   /*des_repetition_fr*/0,  /*des_dlc*/8    
           },
           {/*des_frame*/"ZCUDZCUDCAN1Fr05",   /*des_cyc*/620,   /*des_id*/0x370,   /*des_slotid_fr*/0,   /*des_basecycle_fr*/0,   /*des_repetition_fr*/0,  /*des_dlc*/8    
           },
           {/*des_frame*/"ZCUDZCUDCAN1Fr36",   /*des_cyc*/90,   /*des_id*/0x80,   /*des_slotid_fr*/0,   /*des_basecycle_fr*/0,   /*des_repetition_fr*/0,  /*des_dlc*/8    
           },
           {/*des_frame*/"ZCUDZCUDCAN1Fr30",   /*des_cyc*/15,   /*des_id*/0x131,   /*des_slotid_fr*/0,   /*des_basecycle_fr*/0,   /*des_repetition_fr*/0,  /*des_dlc*/8    
           },
           {/*des_frame*/"ZCUDZCUDCAN1Fr43",   /*des_cyc*/Event,   /*des_id*/0x318,   /*des_slotid_fr*/0,   /*des_basecycle_fr*/0,   /*des_repetition_fr*/0,  /*des_dlc*/8    
           },
           {/*des_frame*/"ZCUDZCUDCAN1Fr12",   /*des_cyc*/350,   /*des_id*/0x388,   /*des_slotid_fr*/0,   /*des_basecycle_fr*/0,   /*des_repetition_fr*/0,  /*des_dlc*/8    
           },
           {/*des_frame*/"ZCUDZCUDCAN1Fr44",   /*des_cyc*/25,   /*des_id*/0x85,   /*des_slotid_fr*/0,   /*des_basecycle_fr*/0,   /*des_repetition_fr*/0,  /*des_dlc*/8    
           },
           {/*des_frame*/"ZCUDZCUDCAN1Fr49",   /*des_cyc*/20,   /*des_id*/0x314,   /*des_slotid_fr*/0,   /*des_basecycle_fr*/0,   /*des_repetition_fr*/0,  /*des_dlc*/8    
           },
           {/*des_frame*/"ZCUDZCUDCAN1Fr09",   /*des_cyc*/150,   /*des_id*/0x371,   /*des_slotid_fr*/0,   /*des_basecycle_fr*/0,   /*des_repetition_fr*/0,  /*des_dlc*/8    
           },
           {/*des_frame*/"ZCUDZCUDCAN1Fr14",   /*des_cyc*/180,   /*des_id*/0x320,   /*des_slotid_fr*/0,   /*des_basecycle_fr*/0,   /*des_repetition_fr*/0,  /*des_dlc*/8    
           },
           {/*des_frame*/"ZCUDZCUDCAN1Fr31",   /*des_cyc*/40,   /*des_id*/0x78,   /*des_slotid_fr*/0,   /*des_basecycle_fr*/0,   /*des_repetition_fr*/0,  /*des_dlc*/8    
           },
           {/*des_frame*/"ZCUDZCUDCAN1Fr24",   /*des_cyc*/100,   /*des_id*/0x206,   /*des_slotid_fr*/0,   /*des_basecycle_fr*/0,   /*des_repetition_fr*/0,  /*des_dlc*/8    
           },
           {/*des_frame*/"ZCUDZCUDCAN1Fr65",   /*des_cyc*/60,   /*des_id*/0x215,   /*des_slotid_fr*/0,   /*des_basecycle_fr*/0,   /*des_repetition_fr*/0,  /*des_dlc*/8    
           },
           {/*des_frame*/"ZCUDZCUDCAN1Fr01",   /*des_cyc*/15,   /*des_id*/0x40,   /*des_slotid_fr*/0,   /*des_basecycle_fr*/0,   /*des_repetition_fr*/0,  /*des_dlc*/8    
           },
           {/*des_frame*/"ZCUDZCUDCAN1Fr74",   /*des_cyc*/70,   /*des_id*/0x271,   /*des_slotid_fr*/0,   /*des_basecycle_fr*/0,   /*des_repetition_fr*/0,  /*des_dlc*/8    
           },
           {/*des_frame*/"ZCUDZCUDCAN1Fr33",   /*des_cyc*/Event,   /*des_id*/0x340,   /*des_slotid_fr*/0,   /*des_basecycle_fr*/0,   /*des_repetition_fr*/0,  /*des_dlc*/8    
           },
           {/*des_frame*/"ZCUDZCUDCAN1Fr26",   /*des_cyc*/85,   /*des_id*/0x32f,   /*des_slotid_fr*/0,   /*des_basecycle_fr*/0,   /*des_repetition_fr*/0,  /*des_dlc*/8    
           },
           {/*des_frame*/"ZCUDZCUDCAN1Fr53",   /*des_cyc*/60,   /*des_id*/0x490,   /*des_slotid_fr*/0,   /*des_basecycle_fr*/0,   /*des_repetition_fr*/0,  /*des_dlc*/8    
           }
       }
   },
   {
       /*des_channels*/  "ZCUD_CANFD4",
       /*networktype*/  "CAN",
       6,
       {
           {/*des_frame*/"ZcudZCUDCANFD4Fr03",   /*des_cyc*/1000,   /*des_id*/0x4c0,   /*des_slotid_fr*/0,   /*des_basecycle_fr*/0,   /*des_repetition_fr*/0,  /*des_dlc*/64    
           },
           {/*des_frame*/"ZcudZCUDCANFD4Fr02",   /*des_cyc*/50,   /*des_id*/0x1c0,   /*des_slotid_fr*/0,   /*des_basecycle_fr*/0,   /*des_repetition_fr*/0,  /*des_dlc*/64    
           },
           {/*des_frame*/"ZcudZCUDCANFD4Fr01",   /*des_cyc*/200,   /*des_id*/0x300,   /*des_slotid_fr*/0,   /*des_basecycle_fr*/0,   /*des_repetition_fr*/0,  /*des_dlc*/64    
           },
           {/*des_frame*/"ZcudZCUDCANFD4Fr08",   /*des_cyc*/Event,   /*des_id*/0x1da,   /*des_slotid_fr*/0,   /*des_basecycle_fr*/0,   /*des_repetition_fr*/0,  /*des_dlc*/64    
           },
           {/*des_frame*/"ZcudZCUDCANFD4Fr09",   /*des_cyc*/30,   /*des_id*/0x140,   /*des_slotid_fr*/0,   /*des_basecycle_fr*/0,   /*des_repetition_fr*/0,  /*des_dlc*/64    
           },
           {/*des_frame*/"ZcudZCUDCANFD4Fr06",   /*des_cyc*/20,   /*des_id*/0x100,   /*des_slotid_fr*/0,   /*des_basecycle_fr*/0,   /*des_repetition_fr*/0,  /*des_dlc*/64    
           }
       }
   },
   {
       /*des_channels*/  "ZCU_CANFD2",
       /*networktype*/  "CAN",
       0,
       {
           0
       }
   },
   {
       /*des_channels*/  "BodyExposedCAN",
       /*networktype*/  "CAN",
       0,
       {
           0
       }
   }
};//data for Signal routing test
  struct gSignal{
    char sig_name[100];
    char scr_can[100];
    char scr_network_type[100];
    int scr_slotid_fr;
    int scr_basecycle_fr;
    int scr_repetition_fr;
    int scr_startbit;
    int sig_length;
    int des_slotid_fr;
    int des_basecycle_fr;
    int des_repetition_fr;
    int des_startbit;
    int scr_cyc;
    int scr_id;
    int scr_dlc;
    int des_cyc;
    int des_id;  
    int updatebit; //source
    int des_updatebit;
    qword InitValue; 
  };
  
 //data for Signal routing test
  struct Demo_signal{ 
    char des_can[100]; 
    char des_networktype[100];
    int sum;
    struct gSignal GSignal[4000];
  };
    
  struct Demo_signal test_sig[network_quantity]={
   {
       /*des_can*/ "ZCUD_LIN1",
       /*networktype*/ "LIN",
       0,
       {
           0
       }
   },
   {
       /*des_can*/ "CEM_LIN3",
       /*networktype*/ "LIN",
       1,
       {
           {   /*sig_name*/"isAD4CameraHeatingReq_0",   /*src_can*/"ZCU_CANFD1",   /*src_network_type*/"CANFD",   /*src_slotid_fr*/0,   /*src_basecycle_fr*/0,  /*src_repetition_fr*/0,  /*src_startbit*/345,   /*sig_length*/1,  /*des_slotid_fr*/0,   /*des_basecycle_fr*/0,  /*des_repetition_fr*/0,   /*des_startbit*/3,    /*src_cyc*/101,  /*src_id*/0x241,   /*src_dlc*/64,   /*des_cyc*/1000,   /*des_id*/0, /*src_updatebit*/344,   /*des_updatebit*/1000,      /*initvalue*/0         }
       }
   },
   {
       /*des_can*/ "CEM_LIN2",
       /*networktype*/ "LIN",
       0,
       {
           0
       }
   },
   {
       /*des_can*/ "CEM_LIN6",
       /*networktype*/ "LIN",
       0,
       {
           0
       }
   },
   {
       /*des_can*/ "CEM_LIN1",
       /*networktype*/ "LIN",
       16,
       {
           {   /*sig_name*/"isVehCfgPrmExtCCPBytePosn8_0",   /*src_can*/"ZCU_CANFD1",   /*src_network_type*/"CANFD",   /*src_slotid_fr*/0,   /*src_basecycle_fr*/0,  /*src_repetition_fr*/0,  /*src_startbit*/127,   /*sig_length*/8,  /*des_slotid_fr*/0,   /*des_basecycle_fr*/0,  /*des_repetition_fr*/0,   /*des_startbit*/56,    /*src_cyc*/101,  /*src_id*/0x1f5,   /*src_dlc*/64,   /*des_cyc*/1000,   /*des_id*/4, /*src_updatebit*/198,   /*des_updatebit*/1000,      /*initvalue*/0         },
           {   /*sig_name*/"isVehCfgPrmExtCCPBytePosn6_0",   /*src_can*/"ZCU_CANFD1",   /*src_network_type*/"CANFD",   /*src_slotid_fr*/0,   /*src_basecycle_fr*/0,  /*src_repetition_fr*/0,  /*src_startbit*/111,   /*sig_length*/8,  /*des_slotid_fr*/0,   /*des_basecycle_fr*/0,  /*des_repetition_fr*/0,   /*des_startbit*/40,    /*src_cyc*/101,  /*src_id*/0x1f5,   /*src_dlc*/64,   /*des_cyc*/1000,   /*des_id*/4, /*src_updatebit*/198,   /*des_updatebit*/1000,      /*initvalue*/0         },
           {   /*sig_name*/"isVehCfgPrmExtCCPBytePosn4_0",   /*src_can*/"ZCU_CANFD1",   /*src_network_type*/"CANFD",   /*src_slotid_fr*/0,   /*src_basecycle_fr*/0,  /*src_repetition_fr*/0,  /*src_startbit*/95,   /*sig_length*/8,  /*des_slotid_fr*/0,   /*des_basecycle_fr*/0,  /*des_repetition_fr*/0,   /*des_startbit*/24,    /*src_cyc*/101,  /*src_id*/0x1f5,   /*src_dlc*/64,   /*des_cyc*/1000,   /*des_id*/4, /*src_updatebit*/198,   /*des_updatebit*/1000,      /*initvalue*/0         },
           {   /*sig_name*/"isVehCfgPrmExtCCPBytePosn3_0",   /*src_can*/"ZCU_CANFD1",   /*src_network_type*/"CANFD",   /*src_slotid_fr*/0,   /*src_basecycle_fr*/0,  /*src_repetition_fr*/0,  /*src_startbit*/87,   /*sig_length*/8,  /*des_slotid_fr*/0,   /*des_basecycle_fr*/0,  /*des_repetition_fr*/0,   /*des_startbit*/16,    /*src_cyc*/101,  /*src_id*/0x1f5,   /*src_dlc*/64,   /*des_cyc*/1000,   /*des_id*/4, /*src_updatebit*/198,   /*des_updatebit*/1000,      /*initvalue*/0         },
           {   /*sig_name*/"isVehCfgPrmExtCCPBytePosn2_0",   /*src_can*/"ZCU_CANFD1",   /*src_network_type*/"CANFD",   /*src_slotid_fr*/0,   /*src_basecycle_fr*/0,  /*src_repetition_fr*/0,  /*src_startbit*/79,   /*sig_length*/8,  /*des_slotid_fr*/0,   /*des_basecycle_fr*/0,  /*des_repetition_fr*/0,   /*des_startbit*/8,    /*src_cyc*/101,  /*src_id*/0x1f5,   /*src_dlc*/64,   /*des_cyc*/1000,   /*des_id*/4, /*src_updatebit*/198,   /*des_updatebit*/1000,      /*initvalue*/0         },
           {   /*sig_name*/"isVehCfgPrmExtBlkIDBytePosn1_0",   /*src_can*/"ZCU_CANFD1",   /*src_network_type*/"CANFD",   /*src_slotid_fr*/0,   /*src_basecycle_fr*/0,  /*src_repetition_fr*/0,  /*src_startbit*/71,   /*sig_length*/8,  /*des_slotid_fr*/0,   /*des_basecycle_fr*/0,  /*des_repetition_fr*/0,   /*des_startbit*/0,    /*src_cyc*/101,  /*src_id*/0x1f5,   /*src_dlc*/64,   /*des_cyc*/1000,   /*des_id*/4, /*src_updatebit*/198,   /*des_updatebit*/1000,      /*initvalue*/0         },
           {   /*sig_name*/"isVehCfgPrmExtCCPBytePosn5_0",   /*src_can*/"ZCU_CANFD1",   /*src_network_type*/"CANFD",   /*src_slotid_fr*/0,   /*src_basecycle_fr*/0,  /*src_repetition_fr*/0,  /*src_startbit*/103,   /*sig_length*/8,  /*des_slotid_fr*/0,   /*des_basecycle_fr*/0,  /*des_repetition_fr*/0,   /*des_startbit*/32,    /*src_cyc*/101,  /*src_id*/0x1f5,   /*src_dlc*/64,   /*des_cyc*/1000,   /*des_id*/4, /*src_updatebit*/198,   /*des_updatebit*/1000,      /*initvalue*/0         },
           {   /*sig_name*/"isVehCfgPrmExtCCPBytePosn7_0",   /*src_can*/"ZCU_CANFD1",   /*src_network_type*/"CANFD",   /*src_slotid_fr*/0,   /*src_basecycle_fr*/0,  /*src_repetition_fr*/0,  /*src_startbit*/119,   /*sig_length*/8,  /*des_slotid_fr*/0,   /*des_basecycle_fr*/0,  /*des_repetition_fr*/0,   /*des_startbit*/48,    /*src_cyc*/101,  /*src_id*/0x1f5,   /*src_dlc*/64,   /*des_cyc*/1000,   /*des_id*/4, /*src_updatebit*/198,   /*des_updatebit*/1000,      /*initvalue*/0         },
           {   /*sig_name*/"isVehCfgPrmCCPBytePosn2_0",   /*src_can*/"ZCU_CANFD1",   /*src_network_type*/"CANFD",   /*src_slotid_fr*/0,   /*src_basecycle_fr*/0,  /*src_repetition_fr*/0,  /*src_startbit*/15,   /*sig_length*/8,  /*des_slotid_fr*/0,   /*des_basecycle_fr*/0,  /*des_repetition_fr*/0,   /*des_startbit*/8,    /*src_cyc*/101,  /*src_id*/0x1f5,   /*src_dlc*/64,   /*des_cyc*/1000,   /*des_id*/17, /*src_updatebit*/199,   /*des_updatebit*/1000,      /*initvalue*/0         },
           {   /*sig_name*/"isVehCfgPrmCCPBytePosn7_0",   /*src_can*/"ZCU_CANFD1",   /*src_network_type*/"CANFD",   /*src_slotid_fr*/0,   /*src_basecycle_fr*/0,  /*src_repetition_fr*/0,  /*src_startbit*/55,   /*sig_length*/8,  /*des_slotid_fr*/0,   /*des_basecycle_fr*/0,  /*des_repetition_fr*/0,   /*des_startbit*/48,    /*src_cyc*/101,  /*src_id*/0x1f5,   /*src_dlc*/64,   /*des_cyc*/1000,   /*des_id*/17, /*src_updatebit*/199,   /*des_updatebit*/1000,      /*initvalue*/0         },
           {   /*sig_name*/"isVehCfgPrmCCPBytePosn3_0",   /*src_can*/"ZCU_CANFD1",   /*src_network_type*/"CANFD",   /*src_slotid_fr*/0,   /*src_basecycle_fr*/0,  /*src_repetition_fr*/0,  /*src_startbit*/23,   /*sig_length*/8,  /*des_slotid_fr*/0,   /*des_basecycle_fr*/0,  /*des_repetition_fr*/0,   /*des_startbit*/16,    /*src_cyc*/101,  /*src_id*/0x1f5,   /*src_dlc*/64,   /*des_cyc*/1000,   /*des_id*/17, /*src_updatebit*/199,   /*des_updatebit*/1000,      /*initvalue*/0         },
           {   /*sig_name*/"isVehCfgPrmCCPBytePosn4_0",   /*src_can*/"ZCU_CANFD1",   /*src_network_type*/"CANFD",   /*src_slotid_fr*/0,   /*src_basecycle_fr*/0,  /*src_repetition_fr*/0,  /*src_startbit*/31,   /*sig_length*/8,  /*des_slotid_fr*/0,   /*des_basecycle_fr*/0,  /*des_repetition_fr*/0,   /*des_startbit*/24,    /*src_cyc*/101,  /*src_id*/0x1f5,   /*src_dlc*/64,   /*des_cyc*/1000,   /*des_id*/17, /*src_updatebit*/199,   /*des_updatebit*/1000,      /*initvalue*/0         },
           {   /*sig_name*/"isVehCfgPrmCCPBytePosn8_0",   /*src_can*/"ZCU_CANFD1",   /*src_network_type*/"CANFD",   /*src_slotid_fr*/0,   /*src_basecycle_fr*/0,  /*src_repetition_fr*/0,  /*src_startbit*/63,   /*sig_length*/8,  /*des_slotid_fr*/0,   /*des_basecycle_fr*/0,  /*des_repetition_fr*/0,   /*des_startbit*/56,    /*src_cyc*/101,  /*src_id*/0x1f5,   /*src_dlc*/64,   /*des_cyc*/1000,   /*des_id*/17, /*src_updatebit*/199,   /*des_updatebit*/1000,      /*initvalue*/0         },
           {   /*sig_name*/"isVehCfgPrmCCPBytePosn5_0",   /*src_can*/"ZCU_CANFD1",   /*src_network_type*/"CANFD",   /*src_slotid_fr*/0,   /*src_basecycle_fr*/0,  /*src_repetition_fr*/0,  /*src_startbit*/39,   /*sig_length*/8,  /*des_slotid_fr*/0,   /*des_basecycle_fr*/0,  /*des_repetition_fr*/0,   /*des_startbit*/32,    /*src_cyc*/101,  /*src_id*/0x1f5,   /*src_dlc*/64,   /*des_cyc*/1000,   /*des_id*/17, /*src_updatebit*/199,   /*des_updatebit*/1000,      /*initvalue*/0         },
           {   /*sig_name*/"isVehCfgPrmBlkIDBytePosn1_0",   /*src_can*/"ZCU_CANFD1",   /*src_network_type*/"CANFD",   /*src_slotid_fr*/0,   /*src_basecycle_fr*/0,  /*src_repetition_fr*/0,  /*src_startbit*/7,   /*sig_length*/8,  /*des_slotid_fr*/0,   /*des_basecycle_fr*/0,  /*des_repetition_fr*/0,   /*des_startbit*/0,    /*src_cyc*/101,  /*src_id*/0x1f5,   /*src_dlc*/64,   /*des_cyc*/1000,   /*des_id*/17, /*src_updatebit*/199,   /*des_updatebit*/1000,      /*initvalue*/0         },
           {   /*sig_name*/"isVehCfgPrmCCPBytePosn6_0",   /*src_can*/"ZCU_CANFD1",   /*src_network_type*/"CANFD",   /*src_slotid_fr*/0,   /*src_basecycle_fr*/0,  /*src_repetition_fr*/0,  /*src_startbit*/47,   /*sig_length*/8,  /*des_slotid_fr*/0,   /*des_basecycle_fr*/0,  /*des_repetition_fr*/0,   /*des_startbit*/40,    /*src_cyc*/101,  /*src_id*/0x1f5,   /*src_dlc*/64,   /*des_cyc*/1000,   /*des_id*/17, /*src_updatebit*/199,   /*des_updatebit*/1000,      /*initvalue*/0         }
       }
   },
   {
       /*des_can*/ "CEM_LIN4",
       /*networktype*/ "LIN",
       1,
       {
           {   /*sig_name*/"isHmiClimaRow1Pwr_0",   /*src_can*/"ZCU_CANFD1",   /*src_network_type*/"CANFD",   /*src_slotid_fr*/0,   /*src_basecycle_fr*/0,  /*src_repetition_fr*/0,  /*src_startbit*/57,   /*sig_length*/1,  /*des_slotid_fr*/0,   /*des_basecycle_fr*/0,  /*des_repetition_fr*/0,   /*des_startbit*/8,    /*src_cyc*/101,  /*src_id*/0x307,   /*src_dlc*/64,   /*des_cyc*/1000,   /*des_id*/13, /*src_updatebit*/56,   /*des_updatebit*/1000,      /*initvalue*/0         }
       }
   },
   {
       /*des_can*/ "ZCUD_LIN2",
       /*networktype*/ "LIN",
       0,
       {
           0
       }
   },
   {
       /*des_can*/ "ZCUD_LIN3",
       /*networktype*/ "LIN",
       0,
       {
           0
       }
   },
   {
       /*des_can*/ "CEM_LIN7",
       /*networktype*/ "LIN",
       3,
       {
           {   /*sig_name*/"isCmptmtTFrntFanForCmptmtTRunng_0",   /*src_can*/"ZCU_CANFD1",   /*src_network_type*/"CANFD",   /*src_slotid_fr*/0,   /*src_basecycle_fr*/0,  /*src_repetition_fr*/0,  /*src_startbit*/50,   /*sig_length*/1,  /*des_slotid_fr*/0,   /*des_basecycle_fr*/0,  /*des_repetition_fr*/0,   /*des_startbit*/11,    /*src_cyc*/101,  /*src_id*/0x212,   /*src_dlc*/64,   /*des_cyc*/1000,   /*des_id*/33, /*src_updatebit*/49,   /*des_updatebit*/1000,      /*initvalue*/0         },
           {   /*sig_name*/"isCmptmtTFrntQf_0",   /*src_can*/"ZCU_CANFD1",   /*src_network_type*/"CANFD",   /*src_slotid_fr*/0,   /*src_basecycle_fr*/0,  /*src_repetition_fr*/0,  /*src_startbit*/52,   /*sig_length*/2,  /*des_slotid_fr*/0,   /*des_basecycle_fr*/0,  /*des_repetition_fr*/0,   /*des_startbit*/12,    /*src_cyc*/101,  /*src_id*/0x212,   /*src_dlc*/64,   /*des_cyc*/1000,   /*des_id*/33, /*src_updatebit*/49,   /*des_updatebit*/1000,      /*initvalue*/1         },
           {   /*sig_name*/"isCmptmtTFrntCmptmtTFrnt_0",   /*src_can*/"ZCU_CANFD1",   /*src_network_type*/"CANFD",   /*src_slotid_fr*/0,   /*src_basecycle_fr*/0,  /*src_repetition_fr*/0,  /*src_startbit*/47,   /*sig_length*/11,  /*des_slotid_fr*/0,   /*des_basecycle_fr*/0,  /*des_repetition_fr*/0,   /*des_startbit*/0,    /*src_cyc*/101,  /*src_id*/0x212,   /*src_dlc*/64,   /*des_cyc*/1000,   /*des_id*/33, /*src_updatebit*/49,   /*des_updatebit*/1000,      /*initvalue*/600         }
       }
   },
   {
       /*des_can*/ "PropulsionCAN",
       /*networktype*/ "CAN",
       31,
       {
           {   /*sig_name*/"isBkpOfDstTrvld_0",   /*src_can*/"ZCU_CANFD1",   /*src_network_type*/"CANFD",   /*src_slotid_fr*/0,   /*src_basecycle_fr*/0,  /*src_repetition_fr*/0,  /*src_startbit*/5,   /*sig_length*/21,  /*des_slotid_fr*/0,   /*des_basecycle_fr*/0,  /*des_repetition_fr*/0,   /*des_startbit*/20,    /*src_cyc*/101,  /*src_id*/0x160,   /*src_dlc*/64,   /*des_cyc*/200,   /*des_id*/0x285, /*src_updatebit*/16,   /*des_updatebit*/21,      /*initvalue*/0         },
           {   /*sig_name*/"isHydPmpFrntLeCurr_0",   /*src_can*/"ZCU_CANFD1",   /*src_network_type*/"CANFD",   /*src_slotid_fr*/0,   /*src_basecycle_fr*/0,  /*src_repetition_fr*/0,  /*src_startbit*/1,   /*sig_length*/10,  /*des_slotid_fr*/0,   /*des_basecycle_fr*/0,  /*des_repetition_fr*/0,   /*des_startbit*/7,    /*src_cyc*/101,  /*src_id*/0x177,   /*src_dlc*/64,   /*des_cyc*/300,   /*des_id*/0x297, /*src_updatebit*/26,   /*des_updatebit*/10,      /*initvalue*/0         },
           {   /*sig_name*/"isPtActrReModReq_0",   /*src_can*/"ZCU_CANFD1",   /*src_network_type*/"CANFD",   /*src_slotid_fr*/0,   /*src_basecycle_fr*/0,  /*src_repetition_fr*/0,  /*src_startbit*/179,   /*sig_length*/2,  /*des_slotid_fr*/0,   /*des_basecycle_fr*/0,  /*des_repetition_fr*/0,   /*des_startbit*/7,    /*src_cyc*/101,  /*src_id*/0x10a,   /*src_dlc*/64,   /*des_cyc*/20,   /*des_id*/0x12e, /*src_updatebit*/177,   /*des_updatebit*/5,      /*initvalue*/0         },
           {   /*sig_name*/"isEpbStsCntr_0",   /*src_can*/"ZCU_CANFD1",   /*src_network_type*/"CANFD",   /*src_slotid_fr*/0,   /*src_basecycle_fr*/0,  /*src_repetition_fr*/0,  /*src_startbit*/135,   /*sig_length*/4,  /*des_slotid_fr*/0,   /*des_basecycle_fr*/0,  /*des_repetition_fr*/0,   /*des_startbit*/55,    /*src_cyc*/101,  /*src_id*/0x10a,   /*src_dlc*/64,   /*des_cyc*/50,   /*des_id*/0x19d, /*src_updatebit*/273,   /*des_updatebit*/63,      /*initvalue*/0         },
           {   /*sig_name*/"isEpbStsChks_0",   /*src_can*/"ZCU_CANFD1",   /*src_network_type*/"CANFD",   /*src_slotid_fr*/0,   /*src_basecycle_fr*/0,  /*src_repetition_fr*/0,  /*src_startbit*/127,   /*sig_length*/8,  /*des_slotid_fr*/0,   /*des_basecycle_fr*/0,  /*des_repetition_fr*/0,   /*des_startbit*/47,    /*src_cyc*/101,  /*src_id*/0x10a,   /*src_dlc*/64,   /*des_cyc*/50,   /*des_id*/0x19d, /*src_updatebit*/273,   /*des_updatebit*/63,      /*initvalue*/0         },
           {   /*sig_name*/"isEpbStsEpbSts_0",   /*src_can*/"ZCU_CANFD1",   /*src_network_type*/"CANFD",   /*src_slotid_fr*/0,   /*src_basecycle_fr*/0,  /*src_repetition_fr*/0,  /*src_startbit*/131,   /*sig_length*/4,  /*des_slotid_fr*/0,   /*des_basecycle_fr*/0,  /*des_repetition_fr*/0,   /*des_startbit*/51,    /*src_cyc*/101,  /*src_id*/0x10a,   /*src_dlc*/64,   /*des_cyc*/50,   /*des_id*/0x19d, /*src_updatebit*/273,   /*des_updatebit*/63,      /*initvalue*/0         },
           {   /*sig_name*/"isHydPmpFrntRiCurr_0",   /*src_can*/"ZCU_CANFD1",   /*src_network_type*/"CANFD",   /*src_slotid_fr*/0,   /*src_basecycle_fr*/0,  /*src_repetition_fr*/0,  /*src_startbit*/25,   /*sig_length*/10,  /*des_slotid_fr*/0,   /*des_basecycle_fr*/0,  /*des_repetition_fr*/0,   /*des_startbit*/9,    /*src_cyc*/101,  /*src_id*/0x177,   /*src_dlc*/64,   /*des_cyc*/300,   /*des_id*/0x297, /*src_updatebit*/28,   /*des_updatebit*/11,      /*initvalue*/0         },
           {   /*sig_name*/"isHydPmpReLeCurr_0",   /*src_can*/"ZCU_CANFD1",   /*src_network_type*/"CANFD",   /*src_slotid_fr*/0,   /*src_basecycle_fr*/0,  /*src_repetition_fr*/0,  /*src_startbit*/49,   /*sig_length*/10,  /*des_slotid_fr*/0,   /*des_basecycle_fr*/0,  /*des_repetition_fr*/0,   /*des_startbit*/31,    /*src_cyc*/101,  /*src_id*/0x177,   /*src_dlc*/64,   /*des_cyc*/300,   /*des_id*/0x297, /*src_updatebit*/50,   /*des_updatebit*/12,      /*initvalue*/0         },
           {   /*sig_name*/"isHydPmpReRiU_0",   /*src_can*/"ZCU_CANFD1",   /*src_network_type*/"CANFD",   /*src_slotid_fr*/0,   /*src_basecycle_fr*/0,  /*src_repetition_fr*/0,  /*src_startbit*/95,   /*sig_length*/10,  /*des_slotid_fr*/0,   /*des_basecycle_fr*/0,  /*des_repetition_fr*/0,   /*des_startbit*/33,    /*src_cyc*/101,  /*src_id*/0x177,   /*src_dlc*/64,   /*des_cyc*/100,   /*des_id*/0x160, /*src_updatebit*/53,   /*des_updatebit*/13,      /*initvalue*/0         },
           {   /*sig_name*/"isStcStsToDmcFrnt_0",   /*src_can*/"ZCU_CANFD1",   /*src_network_type*/"CANFD",   /*src_slotid_fr*/0,   /*src_basecycle_fr*/0,  /*src_repetition_fr*/0,  /*src_startbit*/319,   /*sig_length*/8,  /*des_slotid_fr*/0,   /*des_basecycle_fr*/0,  /*des_repetition_fr*/0,   /*des_startbit*/55,    /*src_cyc*/101,  /*src_id*/0x82,   /*src_dlc*/64,   /*des_cyc*/20,   /*des_id*/0x11a, /*src_updatebit*/331,   /*des_updatebit*/4,      /*initvalue*/0         },
           {   /*sig_name*/"isStcStsToDmcEngRotTarSpdDMCFrnt_0",   /*src_can*/"ZCU_CANFD1",   /*src_network_type*/"CANFD",   /*src_slotid_fr*/0,   /*src_basecycle_fr*/0,  /*src_repetition_fr*/0,  /*src_startbit*/279,   /*sig_length*/16,  /*des_slotid_fr*/0,   /*des_basecycle_fr*/0,  /*des_repetition_fr*/0,   /*des_startbit*/23,    /*src_cyc*/101,  /*src_id*/0x82,   /*src_dlc*/64,   /*des_cyc*/20,   /*des_id*/0x11a, /*src_updatebit*/331,   /*des_updatebit*/4,      /*initvalue*/0         },
           {   /*sig_name*/"isStcStsToDmcEngRotTarSpdDMCRear_0",   /*src_can*/"ZCU_CANFD1",   /*src_network_type*/"CANFD",   /*src_slotid_fr*/0,   /*src_basecycle_fr*/0,  /*src_repetition_fr*/0,  /*src_startbit*/295,   /*sig_length*/16,  /*des_slotid_fr*/0,   /*des_basecycle_fr*/0,  /*des_repetition_fr*/0,   /*des_startbit*/39,    /*src_cyc*/101,  /*src_id*/0x82,   /*src_dlc*/64,   /*des_cyc*/20,   /*des_id*/0x11a, /*src_updatebit*/331,   /*des_updatebit*/4,      /*initvalue*/0         },
           {   /*sig_name*/"isStcStsToDmcCntr_0",   /*src_can*/"ZCU_CANFD1",   /*src_network_type*/"CANFD",   /*src_slotid_fr*/0,   /*src_basecycle_fr*/0,  /*src_repetition_fr*/0,  /*src_startbit*/335,   /*sig_length*/4,  /*des_slotid_fr*/0,   /*des_basecycle_fr*/0,  /*des_repetition_fr*/0,   /*des_startbit*/3,    /*src_cyc*/101,  /*src_id*/0x82,   /*src_dlc*/64,   /*des_cyc*/20,   /*des_id*/0x11a, /*src_updatebit*/331,   /*des_updatebit*/4,      /*initvalue*/0         },
           {   /*sig_name*/"isStcStsToDmcChks_0",   /*src_can*/"ZCU_CANFD1",   /*src_network_type*/"CANFD",   /*src_slotid_fr*/0,   /*src_basecycle_fr*/0,  /*src_repetition_fr*/0,  /*src_startbit*/311,   /*sig_length*/8,  /*des_slotid_fr*/0,   /*des_basecycle_fr*/0,  /*des_repetition_fr*/0,   /*des_startbit*/15,    /*src_cyc*/101,  /*src_id*/0x82,   /*src_dlc*/64,   /*des_cyc*/20,   /*des_id*/0x11a, /*src_updatebit*/331,   /*des_updatebit*/4,      /*initvalue*/0         },
           {   /*sig_name*/"isStcStsToDmcRear_0",   /*src_can*/"ZCU_CANFD1",   /*src_network_type*/"CANFD",   /*src_slotid_fr*/0,   /*src_basecycle_fr*/0,  /*src_repetition_fr*/0,  /*src_startbit*/327,   /*sig_length*/8,  /*des_slotid_fr*/0,   /*des_basecycle_fr*/0,  /*des_repetition_fr*/0,   /*des_startbit*/63,    /*src_cyc*/101,  /*src_id*/0x82,   /*src_dlc*/64,   /*des_cyc*/20,   /*des_id*/0x11a, /*src_updatebit*/331,   /*des_updatebit*/4,      /*initvalue*/0         },
           {   /*sig_name*/"isHydPmpFrntRiU_0",   /*src_can*/"ZCU_CANFD1",   /*src_network_type*/"CANFD",   /*src_slotid_fr*/0,   /*src_basecycle_fr*/0,  /*src_repetition_fr*/0,  /*src_startbit*/47,   /*sig_length*/10,  /*des_slotid_fr*/0,   /*des_basecycle_fr*/0,  /*des_repetition_fr*/0,   /*des_startbit*/9,    /*src_cyc*/101,  /*src_id*/0x177,   /*src_dlc*/64,   /*des_cyc*/100,   /*des_id*/0x160, /*src_updatebit*/29,   /*des_updatebit*/11,      /*initvalue*/0         },
           {   /*sig_name*/"isEscVariantToDmcEscVariantToDmc_0",   /*src_can*/"ZCU_CANFD1",   /*src_network_type*/"CANFD",   /*src_slotid_fr*/0,   /*src_basecycle_fr*/0,  /*src_repetition_fr*/0,  /*src_startbit*/127,   /*sig_length*/8,  /*des_slotid_fr*/0,   /*des_basecycle_fr*/0,  /*des_repetition_fr*/0,   /*des_startbit*/23,    /*src_cyc*/101,  /*src_id*/0x401,   /*src_dlc*/64,   /*des_cyc*/20,   /*des_id*/0x12e, /*src_updatebit*/131,   /*des_updatebit*/4,      /*initvalue*/0         },
           {   /*sig_name*/"isEscVariantToDmcChks_0",   /*src_can*/"ZCU_CANFD1",   /*src_network_type*/"CANFD",   /*src_slotid_fr*/0,   /*src_basecycle_fr*/0,  /*src_repetition_fr*/0,  /*src_startbit*/119,   /*sig_length*/8,  /*des_slotid_fr*/0,   /*des_basecycle_fr*/0,  /*des_repetition_fr*/0,   /*des_startbit*/15,    /*src_cyc*/101,  /*src_id*/0x401,   /*src_dlc*/64,   /*des_cyc*/20,   /*des_id*/0x12e, /*src_updatebit*/131,   /*des_updatebit*/4,      /*initvalue*/0         },
           {   /*sig_name*/"isEscVariantToDmcCntr_0",   /*src_can*/"ZCU_CANFD1",   /*src_network_type*/"CANFD",   /*src_slotid_fr*/0,   /*src_basecycle_fr*/0,  /*src_repetition_fr*/0,  /*src_startbit*/135,   /*sig_length*/4,  /*des_slotid_fr*/0,   /*des_basecycle_fr*/0,  /*des_repetition_fr*/0,   /*des_startbit*/3,    /*src_cyc*/101,  /*src_id*/0x401,   /*src_dlc*/64,   /*des_cyc*/20,   /*des_id*/0x12e, /*src_updatebit*/131,   /*des_updatebit*/4,      /*initvalue*/0         },
           {   /*sig_name*/"isHydPmpReLeU_0",   /*src_can*/"ZCU_CANFD1",   /*src_network_type*/"CANFD",   /*src_slotid_fr*/0,   /*src_basecycle_fr*/0,  /*src_repetition_fr*/0,  /*src_startbit*/71,   /*sig_length*/10,  /*des_slotid_fr*/0,   /*des_basecycle_fr*/0,  /*des_repetition_fr*/0,   /*des_startbit*/31,    /*src_cyc*/101,  /*src_id*/0x177,   /*src_dlc*/64,   /*des_cyc*/100,   /*des_id*/0x160, /*src_updatebit*/51,   /*des_updatebit*/12,      /*initvalue*/0         },
           {   /*sig_name*/"isHydPmpReRiCurr_0",   /*src_can*/"ZCU_CANFD1",   /*src_network_type*/"CANFD",   /*src_slotid_fr*/0,   /*src_basecycle_fr*/0,  /*src_repetition_fr*/0,  /*src_startbit*/73,   /*sig_length*/10,  /*des_slotid_fr*/0,   /*des_basecycle_fr*/0,  /*des_repetition_fr*/0,   /*des_startbit*/33,    /*src_cyc*/101,  /*src_id*/0x177,   /*src_dlc*/64,   /*des_cyc*/300,   /*des_id*/0x297, /*src_updatebit*/52,   /*des_updatebit*/13,      /*initvalue*/0         },
           {   /*sig_name*/"isHydPmpFrntLeU_0",   /*src_can*/"ZCU_CANFD1",   /*src_network_type*/"CANFD",   /*src_slotid_fr*/0,   /*src_basecycle_fr*/0,  /*src_repetition_fr*/0,  /*src_startbit*/23,   /*sig_length*/10,  /*des_slotid_fr*/0,   /*des_basecycle_fr*/0,  /*des_repetition_fr*/0,   /*des_startbit*/7,    /*src_cyc*/101,  /*src_id*/0x177,   /*src_dlc*/64,   /*des_cyc*/100,   /*des_id*/0x160, /*src_updatebit*/27,   /*des_updatebit*/10,      /*initvalue*/0         },
           {   /*sig_name*/"isVehMtnStCntr_0",   /*src_can*/"ZCU_CANFD1",   /*src_network_type*/"CANFD",   /*src_slotid_fr*/0,   /*src_basecycle_fr*/0,  /*src_repetition_fr*/0,  /*src_startbit*/423,   /*sig_length*/4,  /*des_slotid_fr*/0,   /*des_basecycle_fr*/0,  /*des_repetition_fr*/0,   /*des_startbit*/22,    /*src_cyc*/101,  /*src_id*/0x82,   /*src_dlc*/64,   /*des_cyc*/15,   /*des_id*/0x76, /*src_updatebit*/416,   /*des_updatebit*/57,      /*initvalue*/0         },
           {   /*sig_name*/"isVehMtnStVehMtnSt_0",   /*src_can*/"ZCU_CANFD1",   /*src_network_type*/"CANFD",   /*src_slotid_fr*/0,   /*src_basecycle_fr*/0,  /*src_repetition_fr*/0,  /*src_startbit*/419,   /*sig_length*/3,  /*des_slotid_fr*/0,   /*des_basecycle_fr*/0,  /*des_repetition_fr*/0,   /*des_startbit*/18,    /*src_cyc*/101,  /*src_id*/0x82,   /*src_dlc*/64,   /*des_cyc*/15,   /*des_id*/0x76, /*src_updatebit*/416,   /*des_updatebit*/57,      /*initvalue*/0         },
           {   /*sig_name*/"isVehMtnStChks_0",   /*src_can*/"ZCU_CANFD1",   /*src_network_type*/"CANFD",   /*src_slotid_fr*/0,   /*src_basecycle_fr*/0,  /*src_repetition_fr*/0,  /*src_startbit*/415,   /*sig_length*/8,  /*des_slotid_fr*/0,   /*des_basecycle_fr*/0,  /*des_repetition_fr*/0,   /*des_startbit*/31,    /*src_cyc*/101,  /*src_id*/0x82,   /*src_dlc*/64,   /*des_cyc*/15,   /*des_id*/0x76, /*src_updatebit*/416,   /*des_updatebit*/57,      /*initvalue*/0         },
           {   /*sig_name*/"isBrkPedlPsdBrkPedlPsd_0",   /*src_can*/"ZCU_CANFD1",   /*src_network_type*/"CANFD",   /*src_slotid_fr*/0,   /*src_basecycle_fr*/0,  /*src_repetition_fr*/0,  /*src_startbit*/168,   /*sig_length*/1,  /*des_slotid_fr*/0,   /*des_basecycle_fr*/0,  /*des_repetition_fr*/0,   /*des_startbit*/6,    /*src_cyc*/101,  /*src_id*/0x82,   /*src_dlc*/64,   /*des_cyc*/15,   /*des_id*/0x76, /*src_updatebit*/400,   /*des_updatebit*/23,      /*initvalue*/0         },
           {   /*sig_name*/"isBrkPedlPsdCntr_0",   /*src_can*/"ZCU_CANFD1",   /*src_network_type*/"CANFD",   /*src_slotid_fr*/0,   /*src_basecycle_fr*/0,  /*src_repetition_fr*/0,  /*src_startbit*/175,   /*sig_length*/4,  /*des_slotid_fr*/0,   /*des_basecycle_fr*/0,  /*des_repetition_fr*/0,   /*des_startbit*/3,    /*src_cyc*/101,  /*src_id*/0x82,   /*src_dlc*/64,   /*des_cyc*/15,   /*des_id*/0x76, /*src_updatebit*/400,   /*des_updatebit*/23,      /*initvalue*/0         },
           {   /*sig_name*/"isBrkPedlPsdChks_0",   /*src_can*/"ZCU_CANFD1",   /*src_network_type*/"CANFD",   /*src_slotid_fr*/0,   /*src_basecycle_fr*/0,  /*src_repetition_fr*/0,  /*src_startbit*/167,   /*sig_length*/8,  /*des_slotid_fr*/0,   /*des_basecycle_fr*/0,  /*des_repetition_fr*/0,   /*des_startbit*/15,    /*src_cyc*/101,  /*src_id*/0x82,   /*src_dlc*/64,   /*des_cyc*/15,   /*des_id*/0x76, /*src_updatebit*/400,   /*des_updatebit*/23,      /*initvalue*/0         },
           {   /*sig_name*/"isBrkPedlPsdQf_0",   /*src_can*/"ZCU_CANFD1",   /*src_network_type*/"CANFD",   /*src_slotid_fr*/0,   /*src_basecycle_fr*/0,  /*src_repetition_fr*/0,  /*src_startbit*/171,   /*sig_length*/2,  /*des_slotid_fr*/0,   /*des_basecycle_fr*/0,  /*des_repetition_fr*/0,   /*des_startbit*/5,    /*src_cyc*/101,  /*src_id*/0x82,   /*src_dlc*/64,   /*des_cyc*/15,   /*des_id*/0x76, /*src_updatebit*/400,   /*des_updatebit*/23,      /*initvalue*/0         },
           {   /*sig_name*/"isBrkPedlPsdBrkPedlNotPsdSafe_0",   /*src_can*/"ZCU_CANFD1",   /*src_network_type*/"CANFD",   /*src_slotid_fr*/0,   /*src_basecycle_fr*/0,  /*src_repetition_fr*/0,  /*src_startbit*/169,   /*sig_length*/1,  /*des_slotid_fr*/0,   /*des_basecycle_fr*/0,  /*des_repetition_fr*/0,   /*des_startbit*/7,    /*src_cyc*/101,  /*src_id*/0x82,   /*src_dlc*/64,   /*des_cyc*/15,   /*des_id*/0x76, /*src_updatebit*/400,   /*des_updatebit*/23,      /*initvalue*/0         },
           {   /*sig_name*/"isEscCtrlIndcn_0",   /*src_can*/"ZCU_CANFD1",   /*src_network_type*/"CANFD",   /*src_slotid_fr*/0,   /*src_basecycle_fr*/0,  /*src_repetition_fr*/0,  /*src_startbit*/115,   /*sig_length*/2,  /*des_slotid_fr*/0,   /*des_basecycle_fr*/0,  /*des_repetition_fr*/0,   /*des_startbit*/57,    /*src_cyc*/101,  /*src_id*/0x10a,   /*src_dlc*/64,   /*des_cyc*/50,   /*des_id*/0x198, /*src_updatebit*/360,   /*des_updatebit*/33,      /*initvalue*/1         }
       }
   },
   {
       /*des_can*/ "ChassisCAN1",
       /*networktype*/ "CAN",
       30,
       {
           {   /*sig_name*/"isBkpOfDstTrvld_0",   /*src_can*/"ZCU_CANFD1",   /*src_network_type*/"CANFD",   /*src_slotid_fr*/0,   /*src_basecycle_fr*/0,  /*src_repetition_fr*/0,  /*src_startbit*/5,   /*sig_length*/21,  /*des_slotid_fr*/0,   /*des_basecycle_fr*/0,  /*des_repetition_fr*/0,   /*des_startbit*/7,    /*src_cyc*/101,  /*src_id*/0x160,   /*src_dlc*/64,   /*des_cyc*/30,   /*des_id*/0x1f0, /*src_updatebit*/16,   /*des_updatebit*/53,      /*initvalue*/0         },
           {   /*sig_name*/"isCmptmtTFrntFanForCmptmtTRunng_0",   /*src_can*/"ZCU_CANFD1",   /*src_network_type*/"CANFD",   /*src_slotid_fr*/0,   /*src_basecycle_fr*/0,  /*src_repetition_fr*/0,  /*src_startbit*/50,   /*sig_length*/1,  /*des_slotid_fr*/0,   /*des_basecycle_fr*/0,  /*des_repetition_fr*/0,   /*des_startbit*/24,    /*src_cyc*/101,  /*src_id*/0x212,   /*src_dlc*/64,   /*des_cyc*/170,   /*des_id*/0x310, /*src_updatebit*/49,   /*des_updatebit*/23,      /*initvalue*/0         },
           {   /*sig_name*/"isCmptmtTFrntQf_0",   /*src_can*/"ZCU_CANFD1",   /*src_network_type*/"CANFD",   /*src_slotid_fr*/0,   /*src_basecycle_fr*/0,  /*src_repetition_fr*/0,  /*src_startbit*/52,   /*sig_length*/2,  /*des_slotid_fr*/0,   /*des_basecycle_fr*/0,  /*des_repetition_fr*/0,   /*des_startbit*/26,    /*src_cyc*/101,  /*src_id*/0x212,   /*src_dlc*/64,   /*des_cyc*/170,   /*des_id*/0x310, /*src_updatebit*/49,   /*des_updatebit*/23,      /*initvalue*/1         },
           {   /*sig_name*/"isCmptmtTFrntCmptmtTFrnt_0",   /*src_can*/"ZCU_CANFD1",   /*src_network_type*/"CANFD",   /*src_slotid_fr*/0,   /*src_basecycle_fr*/0,  /*src_repetition_fr*/0,  /*src_startbit*/47,   /*sig_length*/11,  /*des_slotid_fr*/0,   /*des_basecycle_fr*/0,  /*des_repetition_fr*/0,   /*des_startbit*/21,    /*src_cyc*/101,  /*src_id*/0x212,   /*src_dlc*/64,   /*des_cyc*/170,   /*des_id*/0x310, /*src_updatebit*/49,   /*des_updatebit*/23,      /*initvalue*/600         },
           {   /*sig_name*/"isVehCfgPrmExtCCPBytePosn8_0",   /*src_can*/"ZCU_CANFD1",   /*src_network_type*/"CANFD",   /*src_slotid_fr*/0,   /*src_basecycle_fr*/0,  /*src_repetition_fr*/0,  /*src_startbit*/127,   /*sig_length*/8,  /*des_slotid_fr*/0,   /*des_basecycle_fr*/0,  /*des_repetition_fr*/0,   /*des_startbit*/63,    /*src_cyc*/101,  /*src_id*/0x1f5,   /*src_dlc*/64,   /*des_cyc*/Event,   /*des_id*/0x3f7, /*src_updatebit*/198,   /*des_updatebit*/1000,      /*initvalue*/0         },
           {   /*sig_name*/"isVehCfgPrmExtCCPBytePosn6_0",   /*src_can*/"ZCU_CANFD1",   /*src_network_type*/"CANFD",   /*src_slotid_fr*/0,   /*src_basecycle_fr*/0,  /*src_repetition_fr*/0,  /*src_startbit*/111,   /*sig_length*/8,  /*des_slotid_fr*/0,   /*des_basecycle_fr*/0,  /*des_repetition_fr*/0,   /*des_startbit*/47,    /*src_cyc*/101,  /*src_id*/0x1f5,   /*src_dlc*/64,   /*des_cyc*/Event,   /*des_id*/0x3f7, /*src_updatebit*/198,   /*des_updatebit*/1000,      /*initvalue*/0         },
           {   /*sig_name*/"isVehCfgPrmExtCCPBytePosn4_0",   /*src_can*/"ZCU_CANFD1",   /*src_network_type*/"CANFD",   /*src_slotid_fr*/0,   /*src_basecycle_fr*/0,  /*src_repetition_fr*/0,  /*src_startbit*/95,   /*sig_length*/8,  /*des_slotid_fr*/0,   /*des_basecycle_fr*/0,  /*des_repetition_fr*/0,   /*des_startbit*/31,    /*src_cyc*/101,  /*src_id*/0x1f5,   /*src_dlc*/64,   /*des_cyc*/Event,   /*des_id*/0x3f7, /*src_updatebit*/198,   /*des_updatebit*/1000,      /*initvalue*/0         },
           {   /*sig_name*/"isVehCfgPrmExtCCPBytePosn3_0",   /*src_can*/"ZCU_CANFD1",   /*src_network_type*/"CANFD",   /*src_slotid_fr*/0,   /*src_basecycle_fr*/0,  /*src_repetition_fr*/0,  /*src_startbit*/87,   /*sig_length*/8,  /*des_slotid_fr*/0,   /*des_basecycle_fr*/0,  /*des_repetition_fr*/0,   /*des_startbit*/23,    /*src_cyc*/101,  /*src_id*/0x1f5,   /*src_dlc*/64,   /*des_cyc*/Event,   /*des_id*/0x3f7, /*src_updatebit*/198,   /*des_updatebit*/1000,      /*initvalue*/0         },
           {   /*sig_name*/"isVehCfgPrmExtCCPBytePosn2_0",   /*src_can*/"ZCU_CANFD1",   /*src_network_type*/"CANFD",   /*src_slotid_fr*/0,   /*src_basecycle_fr*/0,  /*src_repetition_fr*/0,  /*src_startbit*/79,   /*sig_length*/8,  /*des_slotid_fr*/0,   /*des_basecycle_fr*/0,  /*des_repetition_fr*/0,   /*des_startbit*/15,    /*src_cyc*/101,  /*src_id*/0x1f5,   /*src_dlc*/64,   /*des_cyc*/Event,   /*des_id*/0x3f7, /*src_updatebit*/198,   /*des_updatebit*/1000,      /*initvalue*/0         },
           {   /*sig_name*/"isVehCfgPrmExtBlkIDBytePosn1_0",   /*src_can*/"ZCU_CANFD1",   /*src_network_type*/"CANFD",   /*src_slotid_fr*/0,   /*src_basecycle_fr*/0,  /*src_repetition_fr*/0,  /*src_startbit*/71,   /*sig_length*/8,  /*des_slotid_fr*/0,   /*des_basecycle_fr*/0,  /*des_repetition_fr*/0,   /*des_startbit*/7,    /*src_cyc*/101,  /*src_id*/0x1f5,   /*src_dlc*/64,   /*des_cyc*/Event,   /*des_id*/0x3f7, /*src_updatebit*/198,   /*des_updatebit*/1000,      /*initvalue*/0         },
           {   /*sig_name*/"isVehCfgPrmExtCCPBytePosn5_0",   /*src_can*/"ZCU_CANFD1",   /*src_network_type*/"CANFD",   /*src_slotid_fr*/0,   /*src_basecycle_fr*/0,  /*src_repetition_fr*/0,  /*src_startbit*/103,   /*sig_length*/8,  /*des_slotid_fr*/0,   /*des_basecycle_fr*/0,  /*des_repetition_fr*/0,   /*des_startbit*/39,    /*src_cyc*/101,  /*src_id*/0x1f5,   /*src_dlc*/64,   /*des_cyc*/Event,   /*des_id*/0x3f7, /*src_updatebit*/198,   /*des_updatebit*/1000,      /*initvalue*/0         },
           {   /*sig_name*/"isVehCfgPrmExtCCPBytePosn7_0",   /*src_can*/"ZCU_CANFD1",   /*src_network_type*/"CANFD",   /*src_slotid_fr*/0,   /*src_basecycle_fr*/0,  /*src_repetition_fr*/0,  /*src_startbit*/119,   /*sig_length*/8,  /*des_slotid_fr*/0,   /*des_basecycle_fr*/0,  /*des_repetition_fr*/0,   /*des_startbit*/55,    /*src_cyc*/101,  /*src_id*/0x1f5,   /*src_dlc*/64,   /*des_cyc*/Event,   /*des_id*/0x3f7, /*src_updatebit*/198,   /*des_updatebit*/1000,      /*initvalue*/0         },
           {   /*sig_name*/"isVehCfgPrmExt2BlkIDBytePosn1_0",   /*src_can*/"ZCU_CANFD1",   /*src_network_type*/"CANFD",   /*src_slotid_fr*/0,   /*src_basecycle_fr*/0,  /*src_repetition_fr*/0,  /*src_startbit*/135,   /*sig_length*/8,  /*des_slotid_fr*/0,   /*des_basecycle_fr*/0,  /*des_repetition_fr*/0,   /*des_startbit*/7,    /*src_cyc*/101,  /*src_id*/0x1f5,   /*src_dlc*/64,   /*des_cyc*/Event,   /*des_id*/0x152, /*src_updatebit*/197,   /*des_updatebit*/1000,      /*initvalue*/0         },
           {   /*sig_name*/"isVehCfgPrmExt2CCPBytePosn2_0",   /*src_can*/"ZCU_CANFD1",   /*src_network_type*/"CANFD",   /*src_slotid_fr*/0,   /*src_basecycle_fr*/0,  /*src_repetition_fr*/0,  /*src_startbit*/143,   /*sig_length*/8,  /*des_slotid_fr*/0,   /*des_basecycle_fr*/0,  /*des_repetition_fr*/0,   /*des_startbit*/15,    /*src_cyc*/101,  /*src_id*/0x1f5,   /*src_dlc*/64,   /*des_cyc*/Event,   /*des_id*/0x152, /*src_updatebit*/197,   /*des_updatebit*/1000,      /*initvalue*/0         },
           {   /*sig_name*/"isVehCfgPrmExt2CCPBytePosn6_0",   /*src_can*/"ZCU_CANFD1",   /*src_network_type*/"CANFD",   /*src_slotid_fr*/0,   /*src_basecycle_fr*/0,  /*src_repetition_fr*/0,  /*src_startbit*/175,   /*sig_length*/8,  /*des_slotid_fr*/0,   /*des_basecycle_fr*/0,  /*des_repetition_fr*/0,   /*des_startbit*/47,    /*src_cyc*/101,  /*src_id*/0x1f5,   /*src_dlc*/64,   /*des_cyc*/Event,   /*des_id*/0x152, /*src_updatebit*/197,   /*des_updatebit*/1000,      /*initvalue*/0         },
           {   /*sig_name*/"isVehCfgPrmExt2CCPBytePosn4_0",   /*src_can*/"ZCU_CANFD1",   /*src_network_type*/"CANFD",   /*src_slotid_fr*/0,   /*src_basecycle_fr*/0,  /*src_repetition_fr*/0,  /*src_startbit*/159,   /*sig_length*/8,  /*des_slotid_fr*/0,   /*des_basecycle_fr*/0,  /*des_repetition_fr*/0,   /*des_startbit*/31,    /*src_cyc*/101,  /*src_id*/0x1f5,   /*src_dlc*/64,   /*des_cyc*/Event,   /*des_id*/0x152, /*src_updatebit*/197,   /*des_updatebit*/1000,      /*initvalue*/0         },
           {   /*sig_name*/"isVehCfgPrmExt2CCPBytePosn5_0",   /*src_can*/"ZCU_CANFD1",   /*src_network_type*/"CANFD",   /*src_slotid_fr*/0,   /*src_basecycle_fr*/0,  /*src_repetition_fr*/0,  /*src_startbit*/167,   /*sig_length*/8,  /*des_slotid_fr*/0,   /*des_basecycle_fr*/0,  /*des_repetition_fr*/0,   /*des_startbit*/39,    /*src_cyc*/101,  /*src_id*/0x1f5,   /*src_dlc*/64,   /*des_cyc*/Event,   /*des_id*/0x152, /*src_updatebit*/197,   /*des_updatebit*/1000,      /*initvalue*/0         },
           {   /*sig_name*/"isVehCfgPrmExt2CCPBytePosn3_0",   /*src_can*/"ZCU_CANFD1",   /*src_network_type*/"CANFD",   /*src_slotid_fr*/0,   /*src_basecycle_fr*/0,  /*src_repetition_fr*/0,  /*src_startbit*/151,   /*sig_length*/8,  /*des_slotid_fr*/0,   /*des_basecycle_fr*/0,  /*des_repetition_fr*/0,   /*des_startbit*/23,    /*src_cyc*/101,  /*src_id*/0x1f5,   /*src_dlc*/64,   /*des_cyc*/Event,   /*des_id*/0x152, /*src_updatebit*/197,   /*des_updatebit*/1000,      /*initvalue*/0         },
           {   /*sig_name*/"isVehCfgPrmExt2CCPBytePosn7_0",   /*src_can*/"ZCU_CANFD1",   /*src_network_type*/"CANFD",   /*src_slotid_fr*/0,   /*src_basecycle_fr*/0,  /*src_repetition_fr*/0,  /*src_startbit*/183,   /*sig_length*/8,  /*des_slotid_fr*/0,   /*des_basecycle_fr*/0,  /*des_repetition_fr*/0,   /*des_startbit*/55,    /*src_cyc*/101,  /*src_id*/0x1f5,   /*src_dlc*/64,   /*des_cyc*/Event,   /*des_id*/0x152, /*src_updatebit*/197,   /*des_updatebit*/1000,      /*initvalue*/0         },
           {   /*sig_name*/"isVehCfgPrmExt2CCPBytePosn8_0",   /*src_can*/"ZCU_CANFD1",   /*src_network_type*/"CANFD",   /*src_slotid_fr*/0,   /*src_basecycle_fr*/0,  /*src_repetition_fr*/0,  /*src_startbit*/191,   /*sig_length*/8,  /*des_slotid_fr*/0,   /*des_basecycle_fr*/0,  /*des_repetition_fr*/0,   /*des_startbit*/63,    /*src_cyc*/101,  /*src_id*/0x1f5,   /*src_dlc*/64,   /*des_cyc*/Event,   /*des_id*/0x152, /*src_updatebit*/197,   /*des_updatebit*/1000,      /*initvalue*/0         },
           {   /*sig_name*/"isDrvModReq_0",   /*src_can*/"ZCU_CANFD1",   /*src_network_type*/"CANFD",   /*src_slotid_fr*/0,   /*src_basecycle_fr*/0,  /*src_repetition_fr*/0,  /*src_startbit*/119,   /*sig_length*/5,  /*des_slotid_fr*/0,   /*des_basecycle_fr*/0,  /*des_repetition_fr*/0,   /*des_startbit*/61,    /*src_cyc*/101,  /*src_id*/0x105,   /*src_dlc*/64,   /*des_cyc*/120,   /*des_id*/0x2ae, /*src_updatebit*/178,   /*des_updatebit*/62,      /*initvalue*/0         },
           {   /*sig_name*/"isVehCfgPrmCCPBytePosn2_0",   /*src_can*/"ZCU_CANFD1",   /*src_network_type*/"CANFD",   /*src_slotid_fr*/0,   /*src_basecycle_fr*/0,  /*src_repetition_fr*/0,  /*src_startbit*/15,   /*sig_length*/8,  /*des_slotid_fr*/0,   /*des_basecycle_fr*/0,  /*des_repetition_fr*/0,   /*des_startbit*/15,    /*src_cyc*/101,  /*src_id*/0x1f5,   /*src_dlc*/64,   /*des_cyc*/Event,   /*des_id*/0x250, /*src_updatebit*/199,   /*des_updatebit*/1000,      /*initvalue*/0         },
           {   /*sig_name*/"isVehCfgPrmCCPBytePosn7_0",   /*src_can*/"ZCU_CANFD1",   /*src_network_type*/"CANFD",   /*src_slotid_fr*/0,   /*src_basecycle_fr*/0,  /*src_repetition_fr*/0,  /*src_startbit*/55,   /*sig_length*/8,  /*des_slotid_fr*/0,   /*des_basecycle_fr*/0,  /*des_repetition_fr*/0,   /*des_startbit*/55,    /*src_cyc*/101,  /*src_id*/0x1f5,   /*src_dlc*/64,   /*des_cyc*/Event,   /*des_id*/0x250, /*src_updatebit*/199,   /*des_updatebit*/1000,      /*initvalue*/0         },
           {   /*sig_name*/"isVehCfgPrmCCPBytePosn3_0",   /*src_can*/"ZCU_CANFD1",   /*src_network_type*/"CANFD",   /*src_slotid_fr*/0,   /*src_basecycle_fr*/0,  /*src_repetition_fr*/0,  /*src_startbit*/23,   /*sig_length*/8,  /*des_slotid_fr*/0,   /*des_basecycle_fr*/0,  /*des_repetition_fr*/0,   /*des_startbit*/23,    /*src_cyc*/101,  /*src_id*/0x1f5,   /*src_dlc*/64,   /*des_cyc*/Event,   /*des_id*/0x250, /*src_updatebit*/199,   /*des_updatebit*/1000,      /*initvalue*/0         },
           {   /*sig_name*/"isVehCfgPrmCCPBytePosn4_0",   /*src_can*/"ZCU_CANFD1",   /*src_network_type*/"CANFD",   /*src_slotid_fr*/0,   /*src_basecycle_fr*/0,  /*src_repetition_fr*/0,  /*src_startbit*/31,   /*sig_length*/8,  /*des_slotid_fr*/0,   /*des_basecycle_fr*/0,  /*des_repetition_fr*/0,   /*des_startbit*/31,    /*src_cyc*/101,  /*src_id*/0x1f5,   /*src_dlc*/64,   /*des_cyc*/Event,   /*des_id*/0x250, /*src_updatebit*/199,   /*des_updatebit*/1000,      /*initvalue*/0         },
           {   /*sig_name*/"isVehCfgPrmCCPBytePosn8_0",   /*src_can*/"ZCU_CANFD1",   /*src_network_type*/"CANFD",   /*src_slotid_fr*/0,   /*src_basecycle_fr*/0,  /*src_repetition_fr*/0,  /*src_startbit*/63,   /*sig_length*/8,  /*des_slotid_fr*/0,   /*des_basecycle_fr*/0,  /*des_repetition_fr*/0,   /*des_startbit*/63,    /*src_cyc*/101,  /*src_id*/0x1f5,   /*src_dlc*/64,   /*des_cyc*/Event,   /*des_id*/0x250, /*src_updatebit*/199,   /*des_updatebit*/1000,      /*initvalue*/0         },
           {   /*sig_name*/"isVehCfgPrmCCPBytePosn5_0",   /*src_can*/"ZCU_CANFD1",   /*src_network_type*/"CANFD",   /*src_slotid_fr*/0,   /*src_basecycle_fr*/0,  /*src_repetition_fr*/0,  /*src_startbit*/39,   /*sig_length*/8,  /*des_slotid_fr*/0,   /*des_basecycle_fr*/0,  /*des_repetition_fr*/0,   /*des_startbit*/39,    /*src_cyc*/101,  /*src_id*/0x1f5,   /*src_dlc*/64,   /*des_cyc*/Event,   /*des_id*/0x250, /*src_updatebit*/199,   /*des_updatebit*/1000,      /*initvalue*/0         },
           {   /*sig_name*/"isVehCfgPrmBlkIDBytePosn1_0",   /*src_can*/"ZCU_CANFD1",   /*src_network_type*/"CANFD",   /*src_slotid_fr*/0,   /*src_basecycle_fr*/0,  /*src_repetition_fr*/0,  /*src_startbit*/7,   /*sig_length*/8,  /*des_slotid_fr*/0,   /*des_basecycle_fr*/0,  /*des_repetition_fr*/0,   /*des_startbit*/7,    /*src_cyc*/101,  /*src_id*/0x1f5,   /*src_dlc*/64,   /*des_cyc*/Event,   /*des_id*/0x250, /*src_updatebit*/199,   /*des_updatebit*/1000,      /*initvalue*/0         },
           {   /*sig_name*/"isVehCfgPrmCCPBytePosn6_0",   /*src_can*/"ZCU_CANFD1",   /*src_network_type*/"CANFD",   /*src_slotid_fr*/0,   /*src_basecycle_fr*/0,  /*src_repetition_fr*/0,  /*src_startbit*/47,   /*sig_length*/8,  /*des_slotid_fr*/0,   /*des_basecycle_fr*/0,  /*des_repetition_fr*/0,   /*des_startbit*/47,    /*src_cyc*/101,  /*src_id*/0x1f5,   /*src_dlc*/64,   /*des_cyc*/Event,   /*des_id*/0x250, /*src_updatebit*/199,   /*des_updatebit*/1000,      /*initvalue*/0         },
           {   /*sig_name*/"isProfPenSts1_0",   /*src_can*/"ZCU_CANFD1",   /*src_network_type*/"CANFD",   /*src_slotid_fr*/0,   /*src_basecycle_fr*/0,  /*src_repetition_fr*/0,  /*src_startbit*/55,   /*sig_length*/4,  /*des_slotid_fr*/0,   /*des_basecycle_fr*/0,  /*des_repetition_fr*/0,   /*des_startbit*/63,    /*src_cyc*/101,  /*src_id*/0x1f8,   /*src_dlc*/64,   /*des_cyc*/80,   /*des_id*/0x360, /*src_updatebit*/38,   /*des_updatebit*/41,      /*initvalue*/0         }
       }
   },
   {
       /*des_can*/ "ZCU_CANFD1",
       /*networktype*/ "CANFD",
       190,
       {
           {   /*sig_name*/"isBltLockStAtRowSecRiBltLockSt1_0",   /*src_can*/"ZCUD_CAN1",   /*src_network_type*/"CAN",   /*src_slotid_fr*/0,   /*src_basecycle_fr*/0,  /*src_repetition_fr*/0,  /*src_startbit*/14,   /*sig_length*/1,  /*des_slotid_fr*/0,   /*des_basecycle_fr*/0,  /*des_repetition_fr*/0,   /*des_startbit*/11,    /*src_cyc*/101,  /*src_id*/0x70,   /*src_dlc*/8,   /*des_cyc*/150,   /*des_id*/0x353, /*src_updatebit*/12,   /*des_updatebit*/1,      /*initvalue*/0         },
           {   /*sig_name*/"isBltLockStAtRowSecRiBltLockEquid_0",   /*src_can*/"ZCUD_CAN1",   /*src_network_type*/"CAN",   /*src_slotid_fr*/0,   /*src_basecycle_fr*/0,  /*src_repetition_fr*/0,  /*src_startbit*/15,   /*sig_length*/1,  /*des_slotid_fr*/0,   /*des_basecycle_fr*/0,  /*des_repetition_fr*/0,   /*des_startbit*/12,    /*src_cyc*/101,  /*src_id*/0x70,   /*src_dlc*/8,   /*des_cyc*/150,   /*des_id*/0x353, /*src_updatebit*/12,   /*des_updatebit*/1,      /*initvalue*/1         },
           {   /*sig_name*/"isBltLockStAtRowSecRiBltLockSts_0",   /*src_can*/"ZCUD_CAN1",   /*src_network_type*/"CAN",   /*src_slotid_fr*/0,   /*src_basecycle_fr*/0,  /*src_repetition_fr*/0,  /*src_startbit*/13,   /*sig_length*/1,  /*des_slotid_fr*/0,   /*des_basecycle_fr*/0,  /*des_repetition_fr*/0,   /*des_startbit*/10,    /*src_cyc*/101,  /*src_id*/0x70,   /*src_dlc*/8,   /*des_cyc*/150,   /*des_id*/0x353, /*src_updatebit*/12,   /*des_updatebit*/1,      /*initvalue*/1         },
           {   /*sig_name*/"isReqForAsyDataStorgFromRestrntSys_0",   /*src_can*/"ZCUD_CAN1",   /*src_network_type*/"CAN",   /*src_slotid_fr*/0,   /*src_basecycle_fr*/0,  /*src_repetition_fr*/0,  /*src_startbit*/38,   /*sig_length*/1,  /*des_slotid_fr*/0,   /*des_basecycle_fr*/0,  /*des_repetition_fr*/0,   /*des_startbit*/112,    /*src_cyc*/101,  /*src_id*/0x142,   /*src_dlc*/8,   /*des_cyc*/20,   /*des_id*/0x106, /*src_updatebit*/37,   /*des_updatebit*/418,      /*initvalue*/0         },
           {   /*sig_name*/"isSwtIndcrIndcrTypExtReq_0",   /*src_can*/"ChassisCAN1",   /*src_network_type*/"CAN",   /*src_slotid_fr*/0,   /*src_basecycle_fr*/0,  /*src_repetition_fr*/0,  /*src_startbit*/15,   /*sig_length*/2,  /*des_slotid_fr*/0,   /*des_basecycle_fr*/0,  /*des_repetition_fr*/0,   /*des_startbit*/183,    /*src_cyc*/101,  /*src_id*/0x2e6,   /*src_dlc*/8,   /*des_cyc*/40,   /*des_id*/0x1f1, /*src_updatebit*/9,   /*des_updatebit*/176,      /*initvalue*/0         },
           {   /*sig_name*/"isSwtIndcrIndcrTypExtReqChks_0",   /*src_can*/"ChassisCAN1",   /*src_network_type*/"CAN",   /*src_slotid_fr*/0,   /*src_basecycle_fr*/0,  /*src_repetition_fr*/0,  /*src_startbit*/7,   /*sig_length*/8,  /*des_slotid_fr*/0,   /*des_basecycle_fr*/0,  /*des_repetition_fr*/0,   /*des_startbit*/175,    /*src_cyc*/101,  /*src_id*/0x2e6,   /*src_dlc*/8,   /*des_cyc*/40,   /*des_id*/0x1f1, /*src_updatebit*/9,   /*des_updatebit*/176,      /*initvalue*/0         },
           {   /*sig_name*/"isSwtIndcrIndcrTypExtReqCntr_0",   /*src_can*/"ChassisCAN1",   /*src_network_type*/"CAN",   /*src_slotid_fr*/0,   /*src_basecycle_fr*/0,  /*src_repetition_fr*/0,  /*src_startbit*/13,   /*sig_length*/2,  /*des_slotid_fr*/0,   /*des_basecycle_fr*/0,  /*des_repetition_fr*/0,   /*des_startbit*/181,    /*src_cyc*/101,  /*src_id*/0x2e6,   /*src_dlc*/8,   /*des_cyc*/40,   /*des_id*/0x1f1, /*src_updatebit*/9,   /*des_updatebit*/176,      /*initvalue*/0         },
           {   /*sig_name*/"isSwtIndcrIndcrTypExtReqToUpdQf_0",   /*src_can*/"ChassisCAN1",   /*src_network_type*/"CAN",   /*src_slotid_fr*/0,   /*src_basecycle_fr*/0,  /*src_repetition_fr*/0,  /*src_startbit*/11,   /*sig_length*/2,  /*des_slotid_fr*/0,   /*des_basecycle_fr*/0,  /*des_repetition_fr*/0,   /*des_startbit*/179,    /*src_cyc*/101,  /*src_id*/0x2e6,   /*src_dlc*/8,   /*des_cyc*/40,   /*des_id*/0x1f1, /*src_updatebit*/9,   /*des_updatebit*/176,      /*initvalue*/1         },
           {   /*sig_name*/"isCrsCtrlrMsg_0",   /*src_can*/"ChassisCANFD2",   /*src_network_type*/"CANFD",   /*src_slotid_fr*/0,   /*src_basecycle_fr*/0,  /*src_repetition_fr*/0,  /*src_startbit*/7,   /*sig_length*/3,  /*des_slotid_fr*/0,   /*des_basecycle_fr*/0,  /*des_repetition_fr*/0,   /*des_startbit*/95,    /*src_cyc*/101,  /*src_id*/0x11e,   /*src_dlc*/64,   /*des_cyc*/20,   /*des_id*/0x106, /*src_updatebit*/4,   /*des_updatebit*/113,      /*initvalue*/0         },
           {   /*sig_name*/"isBrkTqAtWhlsReq_0",   /*src_can*/"ChassisCANFD2",   /*src_network_type*/"CANFD",   /*src_slotid_fr*/0,   /*src_basecycle_fr*/0,  /*src_repetition_fr*/0,  /*src_startbit*/231,   /*sig_length*/12,  /*des_slotid_fr*/0,   /*des_basecycle_fr*/0,  /*des_repetition_fr*/0,   /*des_startbit*/293,    /*src_cyc*/101,  /*src_id*/0x5a,   /*src_dlc*/64,   /*des_cyc*/1000,   /*des_id*/0x485, /*src_updatebit*/498,   /*des_updatebit*/297,      /*initvalue*/0         },
           {   /*sig_name*/"isOnBdChrgrHndlSts1_0",   /*src_can*/"PropulsionCAN",   /*src_network_type*/"CAN",   /*src_slotid_fr*/0,   /*src_basecycle_fr*/0,  /*src_repetition_fr*/0,  /*src_startbit*/19,   /*sig_length*/4,  /*des_slotid_fr*/0,   /*des_basecycle_fr*/0,  /*des_repetition_fr*/0,   /*des_startbit*/7,    /*src_cyc*/101,  /*src_id*/0x218,   /*src_dlc*/8,   /*des_cyc*/70,   /*des_id*/0x243, /*src_updatebit*/20,   /*des_updatebit*/3,      /*initvalue*/8         },
           {   /*sig_name*/"isActvReSplrMotBlk_0",   /*src_can*/"CEM_LIN3",   /*src_network_type*/"LIN",   /*src_slotid_fr*/0,   /*src_basecycle_fr*/0,  /*src_repetition_fr*/0,  /*src_startbit*/4,   /*sig_length*/1,  /*des_slotid_fr*/0,   /*des_basecycle_fr*/0,  /*des_repetition_fr*/0,   /*des_startbit*/453,    /*src_cyc*/101,  /*src_id*/26,   /*src_dlc*/3,   /*des_cyc*/40,   /*des_id*/0x1f1, /*src_updatebit*/1000,   /*des_updatebit*/452,      /*initvalue*/0         },
           {   /*sig_name*/"isCrsCtrlrStbOk_0",   /*src_can*/"ChassisCANFD2",   /*src_network_type*/"CANFD",   /*src_slotid_fr*/0,   /*src_basecycle_fr*/0,  /*src_repetition_fr*/0,  /*src_startbit*/3,   /*sig_length*/1,  /*des_slotid_fr*/0,   /*des_basecycle_fr*/0,  /*des_repetition_fr*/0,   /*des_startbit*/92,    /*src_cyc*/101,  /*src_id*/0x11e,   /*src_dlc*/64,   /*des_cyc*/20,   /*des_id*/0x106, /*src_updatebit*/2,   /*des_updatebit*/114,      /*initvalue*/0         },
           {   /*sig_name*/"isCrabMovModStsChks_0",   /*src_can*/"ChassisCAN1",   /*src_network_type*/"CAN",   /*src_slotid_fr*/0,   /*src_basecycle_fr*/0,  /*src_repetition_fr*/0,  /*src_startbit*/63,   /*sig_length*/8,  /*des_slotid_fr*/0,   /*des_basecycle_fr*/0,  /*des_repetition_fr*/0,   /*des_startbit*/63,    /*src_cyc*/101,  /*src_id*/0x5b,   /*src_dlc*/8,   /*des_cyc*/10,   /*des_id*/0x61, /*src_updatebit*/55,   /*des_updatebit*/232,      /*initvalue*/0         },
           {   /*sig_name*/"isCrabMovModStsTankTurnModSts_0",   /*src_can*/"ChassisCAN1",   /*src_network_type*/"CAN",   /*src_slotid_fr*/0,   /*src_basecycle_fr*/0,  /*src_repetition_fr*/0,  /*src_startbit*/54,   /*sig_length*/3,  /*des_slotid_fr*/0,   /*des_basecycle_fr*/0,  /*des_repetition_fr*/0,   /*des_startbit*/67,    /*src_cyc*/101,  /*src_id*/0x5b,   /*src_dlc*/8,   /*des_cyc*/10,   /*des_id*/0x61, /*src_updatebit*/55,   /*des_updatebit*/232,      /*initvalue*/0         },
           {   /*sig_name*/"isCrabMovModStsCntr_0",   /*src_can*/"ChassisCAN1",   /*src_network_type*/"CAN",   /*src_slotid_fr*/0,   /*src_basecycle_fr*/0,  /*src_repetition_fr*/0,  /*src_startbit*/51,   /*sig_length*/4,  /*des_slotid_fr*/0,   /*des_basecycle_fr*/0,  /*des_repetition_fr*/0,   /*des_startbit*/71,    /*src_cyc*/101,  /*src_id*/0x5b,   /*src_dlc*/8,   /*des_cyc*/10,   /*des_id*/0x61, /*src_updatebit*/55,   /*des_updatebit*/232,      /*initvalue*/0         },
           {   /*sig_name*/"isADModCtrlInhbnADModCtrlInhbn_0",   /*src_can*/"ChassisCAN1",   /*src_network_type*/"CAN",   /*src_slotid_fr*/0,   /*src_basecycle_fr*/0,  /*src_repetition_fr*/0,  /*src_startbit*/43,   /*sig_length*/3,  /*des_slotid_fr*/0,   /*des_basecycle_fr*/0,  /*des_repetition_fr*/0,   /*des_startbit*/251,    /*src_cyc*/101,  /*src_id*/0x76,   /*src_dlc*/8,   /*des_cyc*/1000,   /*des_id*/0x485, /*src_updatebit*/40,   /*des_updatebit*/248,      /*initvalue*/0         },
           {   /*sig_name*/"isADModCtrlInhbnCntr_0",   /*src_can*/"ChassisCAN1",   /*src_network_type*/"CAN",   /*src_slotid_fr*/0,   /*src_basecycle_fr*/0,  /*src_repetition_fr*/0,  /*src_startbit*/47,   /*sig_length*/4,  /*des_slotid_fr*/0,   /*des_basecycle_fr*/0,  /*des_repetition_fr*/0,   /*des_startbit*/255,    /*src_cyc*/101,  /*src_id*/0x76,   /*src_dlc*/8,   /*des_cyc*/1000,   /*des_id*/0x485, /*src_updatebit*/40,   /*des_updatebit*/248,      /*initvalue*/0         },
           {   /*sig_name*/"isADModCtrlInhbnChks_0",   /*src_can*/"ChassisCAN1",   /*src_network_type*/"CAN",   /*src_slotid_fr*/0,   /*src_basecycle_fr*/0,  /*src_repetition_fr*/0,  /*src_startbit*/39,   /*sig_length*/8,  /*des_slotid_fr*/0,   /*des_basecycle_fr*/0,  /*des_repetition_fr*/0,   /*des_startbit*/247,    /*src_cyc*/101,  /*src_id*/0x76,   /*src_dlc*/8,   /*des_cyc*/1000,   /*des_id*/0x485, /*src_updatebit*/40,   /*des_updatebit*/248,      /*initvalue*/0         },
           {   /*sig_name*/"isHvBattSoc_0",   /*src_can*/"PropulsionCAN",   /*src_network_type*/"CAN",   /*src_slotid_fr*/0,   /*src_basecycle_fr*/0,  /*src_repetition_fr*/0,  /*src_startbit*/47,   /*sig_length*/14,  /*des_slotid_fr*/0,   /*des_basecycle_fr*/0,  /*des_repetition_fr*/0,   /*des_startbit*/15,    /*src_cyc*/101,  /*src_id*/0x187,   /*src_dlc*/8,   /*des_cyc*/70,   /*des_id*/0x243, /*src_updatebit*/49,   /*des_updatebit*/17,      /*initvalue*/0         },
           {   /*sig_name*/"isRecOfPostImpctBrkgCfmdCrashRollovr_0",   /*src_can*/"ZCUD_CAN1",   /*src_network_type*/"CAN",   /*src_slotid_fr*/0,   /*src_basecycle_fr*/0,  /*src_repetition_fr*/0,  /*src_startbit*/55,   /*sig_length*/2,  /*des_slotid_fr*/0,   /*des_basecycle_fr*/0,  /*des_repetition_fr*/0,   /*des_startbit*/289,    /*src_cyc*/101,  /*src_id*/0x148,   /*src_dlc*/8,   /*des_cyc*/20,   /*des_id*/0x106, /*src_updatebit*/30,   /*des_updatebit*/416,      /*initvalue*/1         },
           {   /*sig_name*/"isRecOfPostImpctBrkgCfmdCrashOz_0",   /*src_can*/"ZCUD_CAN1",   /*src_network_type*/"CAN",   /*src_slotid_fr*/0,   /*src_basecycle_fr*/0,  /*src_repetition_fr*/0,  /*src_startbit*/45,   /*sig_length*/2,  /*des_slotid_fr*/0,   /*des_basecycle_fr*/0,  /*des_repetition_fr*/0,   /*des_startbit*/295,    /*src_cyc*/101,  /*src_id*/0x148,   /*src_dlc*/8,   /*des_cyc*/20,   /*des_id*/0x106, /*src_updatebit*/30,   /*des_updatebit*/416,      /*initvalue*/1         },
           {   /*sig_name*/"isRecOfPostImpctBrkgCfmdCrashSideRi_0",   /*src_can*/"ZCUD_CAN1",   /*src_network_type*/"CAN",   /*src_slotid_fr*/0,   /*src_basecycle_fr*/0,  /*src_repetition_fr*/0,  /*src_startbit*/51,   /*sig_length*/2,  /*des_slotid_fr*/0,   /*des_basecycle_fr*/0,  /*des_repetition_fr*/0,   /*des_startbit*/301,    /*src_cyc*/101,  /*src_id*/0x148,   /*src_dlc*/8,   /*des_cyc*/20,   /*des_id*/0x106, /*src_updatebit*/30,   /*des_updatebit*/416,      /*initvalue*/1         },
           {   /*sig_name*/"isRecOfPostImpctBrkgCfmdCrashOffroadRTsevere_0",   /*src_can*/"ZCUD_CAN1",   /*src_network_type*/"CAN",   /*src_slotid_fr*/0,   /*src_basecycle_fr*/0,  /*src_repetition_fr*/0,  /*src_startbit*/47,   /*sig_length*/2,  /*des_slotid_fr*/0,   /*des_basecycle_fr*/0,  /*des_repetition_fr*/0,   /*des_startbit*/281,    /*src_cyc*/101,  /*src_id*/0x148,   /*src_dlc*/8,   /*des_cyc*/20,   /*des_id*/0x106, /*src_updatebit*/30,   /*des_updatebit*/416,      /*initvalue*/1         },
           {   /*sig_name*/"isRecOfPostImpctBrkgCfmdCrashFrnt_0",   /*src_can*/"ZCUD_CAN1",   /*src_network_type*/"CAN",   /*src_slotid_fr*/0,   /*src_basecycle_fr*/0,  /*src_repetition_fr*/0,  /*src_startbit*/25,   /*sig_length*/2,  /*des_slotid_fr*/0,   /*des_basecycle_fr*/0,  /*des_repetition_fr*/0,   /*des_startbit*/275,    /*src_cyc*/101,  /*src_id*/0x148,   /*src_dlc*/8,   /*des_cyc*/20,   /*des_id*/0x106, /*src_updatebit*/30,   /*des_updatebit*/416,      /*initvalue*/1         },
           {   /*sig_name*/"isRecOfPostImpctBrkgCfmdCrashSideLe_0",   /*src_can*/"ZCUD_CAN1",   /*src_network_type*/"CAN",   /*src_slotid_fr*/0,   /*src_basecycle_fr*/0,  /*src_repetition_fr*/0,  /*src_startbit*/53,   /*sig_length*/2,  /*des_slotid_fr*/0,   /*des_basecycle_fr*/0,  /*des_repetition_fr*/0,   /*des_startbit*/303,    /*src_cyc*/101,  /*src_id*/0x148,   /*src_dlc*/8,   /*des_cyc*/20,   /*des_id*/0x106, /*src_updatebit*/30,   /*des_updatebit*/416,      /*initvalue*/1         },
           {   /*sig_name*/"isRecOfPostImpctBrkgCfmdCrashLargeAnimal_0",   /*src_can*/"ZCUD_CAN1",   /*src_network_type*/"CAN",   /*src_slotid_fr*/0,   /*src_basecycle_fr*/0,  /*src_repetition_fr*/0,  /*src_startbit*/39,   /*sig_length*/2,  /*des_slotid_fr*/0,   /*des_basecycle_fr*/0,  /*des_repetition_fr*/0,   /*des_startbit*/273,    /*src_cyc*/101,  /*src_id*/0x148,   /*src_dlc*/8,   /*des_cyc*/20,   /*des_id*/0x106, /*src_updatebit*/30,   /*des_updatebit*/416,      /*initvalue*/1         },
           {   /*sig_name*/"isRecOfPostImpctBrkgCfmdCrashRe_0",   /*src_can*/"ZCUD_CAN1",   /*src_network_type*/"CAN",   /*src_slotid_fr*/0,   /*src_basecycle_fr*/0,  /*src_repetition_fr*/0,  /*src_startbit*/41,   /*sig_length*/2,  /*des_slotid_fr*/0,   /*des_basecycle_fr*/0,  /*des_repetition_fr*/0,   /*des_startbit*/291,    /*src_cyc*/101,  /*src_id*/0x148,   /*src_dlc*/8,   /*des_cyc*/20,   /*des_id*/0x106, /*src_updatebit*/30,   /*des_updatebit*/416,      /*initvalue*/1         },
           {   /*sig_name*/"isRecOfPostImpctBrkgCfmdPostImpctBrkgCfmd_0",   /*src_can*/"ZCUD_CAN1",   /*src_network_type*/"CAN",   /*src_slotid_fr*/0,   /*src_basecycle_fr*/0,  /*src_repetition_fr*/0,  /*src_startbit*/49,   /*sig_length*/2,  /*des_slotid_fr*/0,   /*des_basecycle_fr*/0,  /*des_repetition_fr*/0,   /*des_startbit*/299,    /*src_cyc*/101,  /*src_id*/0x148,   /*src_dlc*/8,   /*des_cyc*/20,   /*des_id*/0x106, /*src_updatebit*/30,   /*des_updatebit*/416,      /*initvalue*/1         },
           {   /*sig_name*/"isRecOfPostImpctBrkgCfmdCrashOffroadD_0",   /*src_can*/"ZCUD_CAN1",   /*src_network_type*/"CAN",   /*src_slotid_fr*/0,   /*src_basecycle_fr*/0,  /*src_repetition_fr*/0,  /*src_startbit*/35,   /*sig_length*/2,  /*des_slotid_fr*/0,   /*des_basecycle_fr*/0,  /*des_repetition_fr*/0,   /*des_startbit*/285,    /*src_cyc*/101,  /*src_id*/0x148,   /*src_dlc*/8,   /*des_cyc*/20,   /*des_id*/0x106, /*src_updatebit*/30,   /*des_updatebit*/416,      /*initvalue*/1         },
           {   /*sig_name*/"isRecOfPostImpctBrkgCfmdCrashOffroadA_0",   /*src_can*/"ZCUD_CAN1",   /*src_network_type*/"CAN",   /*src_slotid_fr*/0,   /*src_basecycle_fr*/0,  /*src_repetition_fr*/0,  /*src_startbit*/37,   /*sig_length*/2,  /*des_slotid_fr*/0,   /*des_basecycle_fr*/0,  /*des_repetition_fr*/0,   /*des_startbit*/287,    /*src_cyc*/101,  /*src_id*/0x148,   /*src_dlc*/8,   /*des_cyc*/20,   /*des_id*/0x106, /*src_updatebit*/30,   /*des_updatebit*/416,      /*initvalue*/1         },
           {   /*sig_name*/"isRecOfPostImpctBrkgCfmdCntr_0",   /*src_can*/"ZCUD_CAN1",   /*src_network_type*/"CAN",   /*src_slotid_fr*/0,   /*src_basecycle_fr*/0,  /*src_repetition_fr*/0,  /*src_startbit*/29,   /*sig_length*/4,  /*des_slotid_fr*/0,   /*des_basecycle_fr*/0,  /*des_repetition_fr*/0,   /*des_startbit*/279,    /*src_cyc*/101,  /*src_id*/0x148,   /*src_dlc*/8,   /*des_cyc*/20,   /*des_id*/0x106, /*src_updatebit*/30,   /*des_updatebit*/416,      /*initvalue*/0         },
           {   /*sig_name*/"isRecOfPostImpctBrkgCfmdChks_0",   /*src_can*/"ZCUD_CAN1",   /*src_network_type*/"CAN",   /*src_slotid_fr*/0,   /*src_basecycle_fr*/0,  /*src_repetition_fr*/0,  /*src_startbit*/63,   /*sig_length*/8,  /*des_slotid_fr*/0,   /*des_basecycle_fr*/0,  /*des_repetition_fr*/0,   /*des_startbit*/271,    /*src_cyc*/101,  /*src_id*/0x148,   /*src_dlc*/8,   /*des_cyc*/20,   /*des_id*/0x106, /*src_updatebit*/30,   /*des_updatebit*/416,      /*initvalue*/255         },
           {   /*sig_name*/"isRecOfPostImpctBrkgCfmdCrashOffroadRT_0",   /*src_can*/"ZCUD_CAN1",   /*src_network_type*/"CAN",   /*src_slotid_fr*/0,   /*src_basecycle_fr*/0,  /*src_repetition_fr*/0,  /*src_startbit*/33,   /*sig_length*/2,  /*des_slotid_fr*/0,   /*des_basecycle_fr*/0,  /*des_repetition_fr*/0,   /*des_startbit*/283,    /*src_cyc*/101,  /*src_id*/0x148,   /*src_dlc*/8,   /*des_cyc*/20,   /*des_id*/0x106, /*src_updatebit*/30,   /*des_updatebit*/416,      /*initvalue*/1         },
           {   /*sig_name*/"isRecOfPostImpctBrkgCfmdCrashPed_0",   /*src_can*/"ZCUD_CAN1",   /*src_network_type*/"CAN",   /*src_slotid_fr*/0,   /*src_basecycle_fr*/0,  /*src_repetition_fr*/0,  /*src_startbit*/43,   /*sig_length*/2,  /*des_slotid_fr*/0,   /*des_basecycle_fr*/0,  /*des_repetition_fr*/0,   /*des_startbit*/293,    /*src_cyc*/101,  /*src_id*/0x148,   /*src_dlc*/8,   /*des_cyc*/20,   /*des_id*/0x106, /*src_updatebit*/30,   /*des_updatebit*/416,      /*initvalue*/1         },
           {   /*sig_name*/"isDrvrGearShiftParkReqSts_0",   /*src_can*/"PropulsionCAN",   /*src_network_type*/"CAN",   /*src_slotid_fr*/0,   /*src_basecycle_fr*/0,  /*src_repetition_fr*/0,  /*src_startbit*/13,   /*sig_length*/2,  /*des_slotid_fr*/0,   /*des_basecycle_fr*/0,  /*des_repetition_fr*/0,   /*des_startbit*/235,    /*src_cyc*/101,  /*src_id*/0x135,   /*src_dlc*/8,   /*des_cyc*/10,   /*des_id*/0x61, /*src_updatebit*/15,   /*des_updatebit*/418,      /*initvalue*/0         },
           {   /*sig_name*/"isDrvrGearShiftParkReqCntr_0",   /*src_can*/"PropulsionCAN",   /*src_network_type*/"CAN",   /*src_slotid_fr*/0,   /*src_basecycle_fr*/0,  /*src_repetition_fr*/0,  /*src_startbit*/11,   /*sig_length*/4,  /*des_slotid_fr*/0,   /*des_basecycle_fr*/0,  /*des_repetition_fr*/0,   /*des_startbit*/239,    /*src_cyc*/101,  /*src_id*/0x135,   /*src_dlc*/8,   /*des_cyc*/10,   /*des_id*/0x61, /*src_updatebit*/15,   /*des_updatebit*/418,      /*initvalue*/0         },
           {   /*sig_name*/"isDrvrGearShiftParkReqChks_0",   /*src_can*/"PropulsionCAN",   /*src_network_type*/"CAN",   /*src_slotid_fr*/0,   /*src_basecycle_fr*/0,  /*src_repetition_fr*/0,  /*src_startbit*/23,   /*sig_length*/8,  /*des_slotid_fr*/0,   /*des_basecycle_fr*/0,  /*des_repetition_fr*/0,   /*des_startbit*/231,    /*src_cyc*/101,  /*src_id*/0x135,   /*src_dlc*/8,   /*des_cyc*/10,   /*des_id*/0x61, /*src_updatebit*/15,   /*des_updatebit*/418,      /*initvalue*/0         },
           {   /*sig_name*/"isDrvrGearShiftParkReq1_0",   /*src_can*/"PropulsionCAN",   /*src_network_type*/"CAN",   /*src_slotid_fr*/0,   /*src_basecycle_fr*/0,  /*src_repetition_fr*/0,  /*src_startbit*/14,   /*sig_length*/1,  /*des_slotid_fr*/0,   /*des_basecycle_fr*/0,  /*des_repetition_fr*/0,   /*des_startbit*/233,    /*src_cyc*/101,  /*src_id*/0x135,   /*src_dlc*/8,   /*des_cyc*/10,   /*des_id*/0x61, /*src_updatebit*/15,   /*des_updatebit*/418,      /*initvalue*/0         },
           {   /*sig_name*/"isBltLockStAtRowSecMidBltLockEquid_0",   /*src_can*/"ZCUD_CAN1",   /*src_network_type*/"CAN",   /*src_slotid_fr*/0,   /*src_basecycle_fr*/0,  /*src_repetition_fr*/0,  /*src_startbit*/3,   /*sig_length*/1,  /*des_slotid_fr*/0,   /*des_basecycle_fr*/0,  /*des_repetition_fr*/0,   /*des_startbit*/15,    /*src_cyc*/101,  /*src_id*/0x70,   /*src_dlc*/8,   /*des_cyc*/150,   /*des_id*/0x353, /*src_updatebit*/0,   /*des_updatebit*/0,      /*initvalue*/1         },
           {   /*sig_name*/"isBltLockStAtRowSecMidBltLockSts_0",   /*src_can*/"ZCUD_CAN1",   /*src_network_type*/"CAN",   /*src_slotid_fr*/0,   /*src_basecycle_fr*/0,  /*src_repetition_fr*/0,  /*src_startbit*/1,   /*sig_length*/1,  /*des_slotid_fr*/0,   /*des_basecycle_fr*/0,  /*des_repetition_fr*/0,   /*des_startbit*/13,    /*src_cyc*/101,  /*src_id*/0x70,   /*src_dlc*/8,   /*des_cyc*/150,   /*des_id*/0x353, /*src_updatebit*/0,   /*des_updatebit*/0,      /*initvalue*/1         },
           {   /*sig_name*/"isBltLockStAtRowSecMidBltLockSt1_0",   /*src_can*/"ZCUD_CAN1",   /*src_network_type*/"CAN",   /*src_slotid_fr*/0,   /*src_basecycle_fr*/0,  /*src_repetition_fr*/0,  /*src_startbit*/2,   /*sig_length*/1,  /*des_slotid_fr*/0,   /*des_basecycle_fr*/0,  /*des_repetition_fr*/0,   /*des_startbit*/14,    /*src_cyc*/101,  /*src_id*/0x70,   /*src_dlc*/8,   /*des_cyc*/150,   /*des_id*/0x353, /*src_updatebit*/0,   /*des_updatebit*/0,      /*initvalue*/0         },
           {   /*sig_name*/"isAdjSpdLimnFusnTrfcSgn_0",   /*src_can*/"ChassisCAN1",   /*src_network_type*/"CAN",   /*src_slotid_fr*/0,   /*src_basecycle_fr*/0,  /*src_repetition_fr*/0,  /*src_startbit*/23,   /*sig_length*/1,  /*des_slotid_fr*/0,   /*des_basecycle_fr*/0,  /*des_repetition_fr*/0,   /*des_startbit*/57,    /*src_cyc*/101,  /*src_id*/0x161,   /*src_dlc*/8,   /*des_cyc*/40,   /*des_id*/0x1f1, /*src_updatebit*/22,   /*des_updatebit*/56,      /*initvalue*/0         },
           {   /*sig_name*/"isCrsCtrlOvrdn_0",   /*src_can*/"ChassisCANFD2",   /*src_network_type*/"CANFD",   /*src_slotid_fr*/0,   /*src_basecycle_fr*/0,  /*src_repetition_fr*/0,  /*src_startbit*/11,   /*sig_length*/1,  /*des_slotid_fr*/0,   /*des_basecycle_fr*/0,  /*des_repetition_fr*/0,   /*des_startbit*/32,    /*src_cyc*/101,  /*src_id*/0x11e,   /*src_dlc*/64,   /*des_cyc*/20,   /*des_id*/0x106, /*src_updatebit*/10,   /*des_updatebit*/111,      /*initvalue*/0         },
           {   /*sig_name*/"isPtTqAtWhlReActPtTqAtWhlReLeAct_0",   /*src_can*/"ChassisCANFD2",   /*src_network_type*/"CANFD",   /*src_slotid_fr*/0,   /*src_basecycle_fr*/0,  /*src_repetition_fr*/0,  /*src_startbit*/247,   /*sig_length*/16,  /*des_slotid_fr*/0,   /*des_basecycle_fr*/0,  /*des_repetition_fr*/0,   /*des_startbit*/407,    /*src_cyc*/101,  /*src_id*/0x7c,   /*src_dlc*/64,   /*des_cyc*/40,   /*des_id*/0x1f1, /*src_updatebit*/280,   /*des_updatebit*/440,      /*initvalue*/0         },
           {   /*sig_name*/"isPtTqAtWhlReActPtTqAtWhlsReQly_0",   /*src_can*/"ChassisCANFD2",   /*src_network_type*/"CANFD",   /*src_slotid_fr*/0,   /*src_basecycle_fr*/0,  /*src_repetition_fr*/0,  /*src_startbit*/283,   /*sig_length*/3,  /*des_slotid_fr*/0,   /*des_basecycle_fr*/0,  /*des_repetition_fr*/0,   /*des_startbit*/443,    /*src_cyc*/101,  /*src_id*/0x7c,   /*src_dlc*/64,   /*des_cyc*/40,   /*des_id*/0x1f1, /*src_updatebit*/280,   /*des_updatebit*/440,      /*initvalue*/0         },
           {   /*sig_name*/"isPtTqAtWhlReActPtTqAtWhlReRiAct_0",   /*src_can*/"ChassisCANFD2",   /*src_network_type*/"CANFD",   /*src_slotid_fr*/0,   /*src_basecycle_fr*/0,  /*src_repetition_fr*/0,  /*src_startbit*/263,   /*sig_length*/16,  /*des_slotid_fr*/0,   /*des_basecycle_fr*/0,  /*des_repetition_fr*/0,   /*des_startbit*/423,    /*src_cyc*/101,  /*src_id*/0x7c,   /*src_dlc*/64,   /*des_cyc*/40,   /*des_id*/0x1f1, /*src_updatebit*/280,   /*des_updatebit*/440,      /*initvalue*/0         },
           {   /*sig_name*/"isPtTqAtWhlReActCntr_0",   /*src_can*/"ChassisCANFD2",   /*src_network_type*/"CANFD",   /*src_slotid_fr*/0,   /*src_basecycle_fr*/0,  /*src_repetition_fr*/0,  /*src_startbit*/287,   /*sig_length*/4,  /*des_slotid_fr*/0,   /*des_basecycle_fr*/0,  /*des_repetition_fr*/0,   /*des_startbit*/447,    /*src_cyc*/101,  /*src_id*/0x7c,   /*src_dlc*/64,   /*des_cyc*/40,   /*des_id*/0x1f1, /*src_updatebit*/280,   /*des_updatebit*/440,      /*initvalue*/0         },
           {   /*sig_name*/"isPtTqAtWhlReActPtTqAtAxleReAct_0",   /*src_can*/"ChassisCANFD2",   /*src_network_type*/"CANFD",   /*src_slotid_fr*/0,   /*src_basecycle_fr*/0,  /*src_repetition_fr*/0,  /*src_startbit*/231,   /*sig_length*/16,  /*des_slotid_fr*/0,   /*des_basecycle_fr*/0,  /*des_repetition_fr*/0,   /*des_startbit*/391,    /*src_cyc*/101,  /*src_id*/0x7c,   /*src_dlc*/64,   /*des_cyc*/40,   /*des_id*/0x1f1, /*src_updatebit*/280,   /*des_updatebit*/440,      /*initvalue*/0         },
           {   /*sig_name*/"isPtTqAtWhlReActChks_0",   /*src_can*/"ChassisCANFD2",   /*src_network_type*/"CANFD",   /*src_slotid_fr*/0,   /*src_basecycle_fr*/0,  /*src_repetition_fr*/0,  /*src_startbit*/279,   /*sig_length*/8,  /*des_slotid_fr*/0,   /*des_basecycle_fr*/0,  /*des_repetition_fr*/0,   /*des_startbit*/439,    /*src_cyc*/101,  /*src_id*/0x7c,   /*src_dlc*/64,   /*des_cyc*/40,   /*des_id*/0x1f1, /*src_updatebit*/280,   /*des_updatebit*/440,      /*initvalue*/0         },
           {   /*sig_name*/"isBltLockStAtRowThrdLeBltLockSt1_0",   /*src_can*/"ZCUD_CAN1",   /*src_network_type*/"CAN",   /*src_slotid_fr*/0,   /*src_basecycle_fr*/0,  /*src_repetition_fr*/0,  /*src_startbit*/10,   /*sig_length*/1,  /*des_slotid_fr*/0,   /*des_basecycle_fr*/0,  /*des_repetition_fr*/0,   /*des_startbit*/22,    /*src_cyc*/101,  /*src_id*/0x70,   /*src_dlc*/8,   /*des_cyc*/150,   /*des_id*/0x353, /*src_updatebit*/8,   /*des_updatebit*/8,      /*initvalue*/0         },
           {   /*sig_name*/"isBltLockStAtRowThrdLeBltLockEquid_0",   /*src_can*/"ZCUD_CAN1",   /*src_network_type*/"CAN",   /*src_slotid_fr*/0,   /*src_basecycle_fr*/0,  /*src_repetition_fr*/0,  /*src_startbit*/11,   /*sig_length*/1,  /*des_slotid_fr*/0,   /*des_basecycle_fr*/0,  /*des_repetition_fr*/0,   /*des_startbit*/23,    /*src_cyc*/101,  /*src_id*/0x70,   /*src_dlc*/8,   /*des_cyc*/150,   /*des_id*/0x353, /*src_updatebit*/8,   /*des_updatebit*/8,      /*initvalue*/1         },
           {   /*sig_name*/"isBltLockStAtRowThrdLeBltLockSts_0",   /*src_can*/"ZCUD_CAN1",   /*src_network_type*/"CAN",   /*src_slotid_fr*/0,   /*src_basecycle_fr*/0,  /*src_repetition_fr*/0,  /*src_startbit*/9,   /*sig_length*/1,  /*des_slotid_fr*/0,   /*des_basecycle_fr*/0,  /*des_repetition_fr*/0,   /*des_startbit*/21,    /*src_cyc*/101,  /*src_id*/0x70,   /*src_dlc*/8,   /*des_cyc*/150,   /*des_id*/0x353, /*src_updatebit*/8,   /*des_updatebit*/8,      /*initvalue*/1         },
           {   /*sig_name*/"isRecOfPostImpctBrkgSuspcChks_0",   /*src_can*/"ZCUD_CAN1",   /*src_network_type*/"CAN",   /*src_slotid_fr*/0,   /*src_basecycle_fr*/0,  /*src_repetition_fr*/0,  /*src_startbit*/39,   /*sig_length*/8,  /*des_slotid_fr*/0,   /*des_basecycle_fr*/0,  /*des_repetition_fr*/0,   /*des_startbit*/191,    /*src_cyc*/101,  /*src_id*/0x70,   /*src_dlc*/8,   /*des_cyc*/10,   /*des_id*/0x81, /*src_updatebit*/41,   /*des_updatebit*/193,      /*initvalue*/255         },
           {   /*sig_name*/"isRecOfPostImpctBrkgSuspcCntr_0",   /*src_can*/"ZCUD_CAN1",   /*src_network_type*/"CAN",   /*src_slotid_fr*/0,   /*src_basecycle_fr*/0,  /*src_repetition_fr*/0,  /*src_startbit*/47,   /*sig_length*/4,  /*des_slotid_fr*/0,   /*des_basecycle_fr*/0,  /*des_repetition_fr*/0,   /*des_startbit*/199,    /*src_cyc*/101,  /*src_id*/0x70,   /*src_dlc*/8,   /*des_cyc*/10,   /*des_id*/0x81, /*src_updatebit*/41,   /*des_updatebit*/193,      /*initvalue*/0         },
           {   /*sig_name*/"isRecOfPostImpctBrkgSuspcSuspcPostImpctBrkg_0",   /*src_can*/"ZCUD_CAN1",   /*src_network_type*/"CAN",   /*src_slotid_fr*/0,   /*src_basecycle_fr*/0,  /*src_repetition_fr*/0,  /*src_startbit*/43,   /*sig_length*/2,  /*des_slotid_fr*/0,   /*des_basecycle_fr*/0,  /*des_repetition_fr*/0,   /*des_startbit*/195,    /*src_cyc*/101,  /*src_id*/0x70,   /*src_dlc*/8,   /*des_cyc*/10,   /*des_id*/0x81, /*src_updatebit*/41,   /*des_updatebit*/193,      /*initvalue*/1         },
           {   /*sig_name*/"isEngSt1WdStsChks_0",   /*src_can*/"PropulsionCAN",   /*src_network_type*/"CAN",   /*src_slotid_fr*/0,   /*src_basecycle_fr*/0,  /*src_repetition_fr*/0,  /*src_startbit*/23,   /*sig_length*/8,  /*des_slotid_fr*/0,   /*des_basecycle_fr*/0,  /*des_repetition_fr*/0,   /*des_startbit*/263,    /*src_cyc*/101,  /*src_id*/0x4b,   /*src_dlc*/8,   /*des_cyc*/10,   /*des_id*/0x61, /*src_updatebit*/8,   /*des_updatebit*/420,      /*initvalue*/0         },
           {   /*sig_name*/"isEngSt1WdStsCntr_0",   /*src_can*/"PropulsionCAN",   /*src_network_type*/"CAN",   /*src_slotid_fr*/0,   /*src_basecycle_fr*/0,  /*src_repetition_fr*/0,  /*src_startbit*/31,   /*sig_length*/4,  /*des_slotid_fr*/0,   /*des_basecycle_fr*/0,  /*des_repetition_fr*/0,   /*des_startbit*/271,    /*src_cyc*/101,  /*src_id*/0x4b,   /*src_dlc*/8,   /*des_cyc*/10,   /*des_id*/0x61, /*src_updatebit*/8,   /*des_updatebit*/420,      /*initvalue*/0         },
           {   /*sig_name*/"isEngSt1WdStsEngSt1WdSts_0",   /*src_can*/"PropulsionCAN",   /*src_network_type*/"CAN",   /*src_slotid_fr*/0,   /*src_basecycle_fr*/0,  /*src_repetition_fr*/0,  /*src_startbit*/27,   /*sig_length*/4,  /*des_slotid_fr*/0,   /*des_basecycle_fr*/0,  /*des_repetition_fr*/0,   /*des_startbit*/267,    /*src_cyc*/101,  /*src_id*/0x4b,   /*src_dlc*/8,   /*des_cyc*/10,   /*des_id*/0x61, /*src_updatebit*/8,   /*des_updatebit*/420,      /*initvalue*/0         },
           {   /*sig_name*/"isAD4HeatingCircTestSts_0",   /*src_can*/"CEM_LIN3",   /*src_network_type*/"LIN",   /*src_slotid_fr*/0,   /*src_basecycle_fr*/0,  /*src_repetition_fr*/0,  /*src_startbit*/6,   /*sig_length*/2,  /*des_slotid_fr*/0,   /*des_basecycle_fr*/0,  /*des_repetition_fr*/0,   /*des_startbit*/7,    /*src_cyc*/101,  /*src_id*/32,   /*src_dlc*/7,   /*des_cyc*/40,   /*des_id*/0x1f1, /*src_updatebit*/1000,   /*des_updatebit*/3,      /*initvalue*/0         },
           {   /*sig_name*/"isActvnStsOfRtrctrRvsbRi_0",   /*src_can*/"ZCUD_CAN1",   /*src_network_type*/"CAN",   /*src_slotid_fr*/0,   /*src_basecycle_fr*/0,  /*src_repetition_fr*/0,  /*src_startbit*/3,   /*sig_length*/1,  /*des_slotid_fr*/0,   /*des_basecycle_fr*/0,  /*des_repetition_fr*/0,   /*des_startbit*/135,    /*src_cyc*/101,  /*src_id*/0x175,   /*src_dlc*/8,   /*des_cyc*/40,   /*des_id*/0x1f1, /*src_updatebit*/6,   /*des_updatebit*/134,      /*initvalue*/0         },
           {   /*sig_name*/"isEpbActrStSec_0",   /*src_can*/"ChassisCANFD2",   /*src_network_type*/"CANFD",   /*src_slotid_fr*/0,   /*src_basecycle_fr*/0,  /*src_repetition_fr*/0,  /*src_startbit*/26,   /*sig_length*/3,  /*des_slotid_fr*/0,   /*des_basecycle_fr*/0,  /*des_repetition_fr*/0,   /*des_startbit*/279,    /*src_cyc*/101,  /*src_id*/0x68,   /*src_dlc*/64,   /*des_cyc*/10,   /*des_id*/0x61, /*src_updatebit*/27,   /*des_updatebit*/421,      /*initvalue*/4         },
           {   /*sig_name*/"isFullElecTwbrPosn_0",   /*src_can*/"ZCUD_CAN1",   /*src_network_type*/"CAN",   /*src_slotid_fr*/0,   /*src_basecycle_fr*/0,  /*src_repetition_fr*/0,  /*src_startbit*/7,   /*sig_length*/3,  /*des_slotid_fr*/0,   /*des_basecycle_fr*/0,  /*des_repetition_fr*/0,   /*des_startbit*/52,    /*src_cyc*/101,  /*src_id*/0x159,   /*src_dlc*/8,   /*des_cyc*/150,   /*des_id*/0x353, /*src_updatebit*/4,   /*des_updatebit*/79,      /*initvalue*/0         },
           {   /*sig_name*/"isGearLvrIndcn_0",   /*src_can*/"ChassisCANFD2",   /*src_network_type*/"CANFD",   /*src_slotid_fr*/0,   /*src_basecycle_fr*/0,  /*src_repetition_fr*/0,  /*src_startbit*/71,   /*sig_length*/3,  /*des_slotid_fr*/0,   /*des_basecycle_fr*/0,  /*des_repetition_fr*/0,   /*des_startbit*/4,    /*src_cyc*/101,  /*src_id*/0x7c,   /*src_dlc*/64,   /*des_cyc*/50,   /*des_id*/0x16f, /*src_updatebit*/68,   /*des_updatebit*/1,      /*initvalue*/7         },
           {   /*sig_name*/"isEngTQf_0",   /*src_can*/"PropulsionCAN",   /*src_network_type*/"CAN",   /*src_slotid_fr*/0,   /*src_basecycle_fr*/0,  /*src_repetition_fr*/0,  /*src_startbit*/1,   /*sig_length*/2,  /*des_slotid_fr*/0,   /*des_basecycle_fr*/0,  /*des_repetition_fr*/0,   /*des_startbit*/63,    /*src_cyc*/101,  /*src_id*/0x171,   /*src_dlc*/8,   /*des_cyc*/40,   /*des_id*/0x1f1, /*src_updatebit*/2,   /*des_updatebit*/61,      /*initvalue*/0         },
           {   /*sig_name*/"isEngTEngT_0",   /*src_can*/"PropulsionCAN",   /*src_network_type*/"CAN",   /*src_slotid_fr*/0,   /*src_basecycle_fr*/0,  /*src_repetition_fr*/0,  /*src_startbit*/15,   /*sig_length*/8,  /*des_slotid_fr*/0,   /*des_basecycle_fr*/0,  /*des_repetition_fr*/0,   /*des_startbit*/55,    /*src_cyc*/101,  /*src_id*/0x171,   /*src_dlc*/8,   /*des_cyc*/40,   /*des_id*/0x1f1, /*src_updatebit*/2,   /*des_updatebit*/61,      /*initvalue*/50         },
           {   /*sig_name*/"isWhlMotSysSpdActSafeChks_0",   /*src_can*/"PropulsionCAN",   /*src_network_type*/"CAN",   /*src_slotid_fr*/0,   /*src_basecycle_fr*/0,  /*src_repetition_fr*/0,  /*src_startbit*/23,   /*sig_length*/8,  /*des_slotid_fr*/0,   /*des_basecycle_fr*/0,  /*des_repetition_fr*/0,   /*des_startbit*/447,    /*src_cyc*/101,  /*src_id*/0x105,   /*src_dlc*/8,   /*des_cyc*/10,   /*des_id*/0x61, /*src_updatebit*/25,   /*des_updatebit*/487,      /*initvalue*/0         },
           {   /*sig_name*/"isWhlMotSysSpdActSafeIsgSpdActSgn800_0",   /*src_can*/"PropulsionCAN",   /*src_network_type*/"CAN",   /*src_slotid_fr*/0,   /*src_basecycle_fr*/0,  /*src_repetition_fr*/0,  /*src_startbit*/7,   /*sig_length*/16,  /*des_slotid_fr*/0,   /*des_basecycle_fr*/0,  /*des_repetition_fr*/0,   /*des_startbit*/431,    /*src_cyc*/101,  /*src_id*/0x105,   /*src_dlc*/8,   /*des_cyc*/10,   /*des_id*/0x61, /*src_updatebit*/25,   /*des_updatebit*/487,      /*initvalue*/20000         },
           {   /*sig_name*/"isWhlMotSysSpdActSafeQF_0",   /*src_can*/"PropulsionCAN",   /*src_network_type*/"CAN",   /*src_slotid_fr*/0,   /*src_basecycle_fr*/0,  /*src_repetition_fr*/0,  /*src_startbit*/27,   /*sig_length*/2,  /*des_slotid_fr*/0,   /*des_basecycle_fr*/0,  /*des_repetition_fr*/0,   /*des_startbit*/451,    /*src_cyc*/101,  /*src_id*/0x105,   /*src_dlc*/8,   /*des_cyc*/10,   /*des_id*/0x61, /*src_updatebit*/25,   /*des_updatebit*/487,      /*initvalue*/1         },
           {   /*sig_name*/"isWhlMotSysSpdActSafeCntr_0",   /*src_can*/"PropulsionCAN",   /*src_network_type*/"CAN",   /*src_slotid_fr*/0,   /*src_basecycle_fr*/0,  /*src_repetition_fr*/0,  /*src_startbit*/31,   /*sig_length*/4,  /*des_slotid_fr*/0,   /*des_basecycle_fr*/0,  /*des_repetition_fr*/0,   /*des_startbit*/455,    /*src_cyc*/101,  /*src_id*/0x105,   /*src_dlc*/8,   /*des_cyc*/10,   /*des_id*/0x61, /*src_updatebit*/25,   /*des_updatebit*/487,      /*initvalue*/1         },
           {   /*sig_name*/"isStsForRtrctrRvsbLe_0",   /*src_can*/"ZCUD_CAN1",   /*src_network_type*/"CAN",   /*src_slotid_fr*/0,   /*src_basecycle_fr*/0,  /*src_repetition_fr*/0,  /*src_startbit*/5,   /*sig_length*/2,  /*des_slotid_fr*/0,   /*des_basecycle_fr*/0,  /*des_repetition_fr*/0,   /*des_startbit*/259,    /*src_cyc*/101,  /*src_id*/0x153,   /*src_dlc*/8,   /*des_cyc*/20,   /*des_id*/0x106, /*src_updatebit*/8,   /*des_updatebit*/257,      /*initvalue*/0         },
           {   /*sig_name*/"isSwtFogLiRe_0",   /*src_can*/"ChassisCAN1",   /*src_network_type*/"CAN",   /*src_slotid_fr*/0,   /*src_basecycle_fr*/0,  /*src_repetition_fr*/0,  /*src_startbit*/37,   /*sig_length*/1,  /*des_slotid_fr*/0,   /*des_basecycle_fr*/0,  /*des_repetition_fr*/0,   /*des_startbit*/121,    /*src_cyc*/101,  /*src_id*/0x2e6,   /*src_dlc*/8,   /*des_cyc*/40,   /*des_id*/0x1f1, /*src_updatebit*/8,   /*des_updatebit*/120,      /*initvalue*/0         },
           {   /*sig_name*/"isMsgReqForRtrctrRvsbRi_0",   /*src_can*/"ZCUD_CAN1",   /*src_network_type*/"CAN",   /*src_slotid_fr*/0,   /*src_basecycle_fr*/0,  /*src_repetition_fr*/0,  /*src_startbit*/9,   /*sig_length*/1,  /*des_slotid_fr*/0,   /*des_basecycle_fr*/0,  /*des_repetition_fr*/0,   /*des_startbit*/73,    /*src_cyc*/101,  /*src_id*/0x175,   /*src_dlc*/8,   /*des_cyc*/100,   /*des_id*/0x221, /*src_updatebit*/7,   /*des_updatebit*/87,      /*initvalue*/0         },
           {   /*sig_name*/"isGearMov_0",   /*src_can*/"ChassisCANFD2",   /*src_network_type*/"CANFD",   /*src_slotid_fr*/0,   /*src_basecycle_fr*/0,  /*src_repetition_fr*/0,  /*src_startbit*/15,   /*sig_length*/2,  /*des_slotid_fr*/0,   /*des_basecycle_fr*/0,  /*des_repetition_fr*/0,   /*des_startbit*/263,    /*src_cyc*/101,  /*src_id*/0x11e,   /*src_dlc*/64,   /*des_cyc*/20,   /*des_id*/0x106, /*src_updatebit*/13,   /*des_updatebit*/405,      /*initvalue*/2         },
           {   /*sig_name*/"isTurnIndcrSwtIndcrTypExtReqCntr_0",   /*src_can*/"CEM_LIN4",   /*src_network_type*/"LIN",   /*src_slotid_fr*/0,   /*src_basecycle_fr*/0,  /*src_repetition_fr*/0,  /*src_startbit*/24,   /*sig_length*/2,  /*des_slotid_fr*/0,   /*des_basecycle_fr*/0,  /*des_repetition_fr*/0,   /*des_startbit*/469,    /*src_cyc*/101,  /*src_id*/32,   /*src_dlc*/5,   /*des_cyc*/40,   /*des_id*/0x1f1, /*src_updatebit*/1000,   /*des_updatebit*/465,      /*initvalue*/0         },
           {   /*sig_name*/"isTurnIndcrSwtIndcrTypExtReqChks_0",   /*src_can*/"CEM_LIN4",   /*src_network_type*/"LIN",   /*src_slotid_fr*/0,   /*src_basecycle_fr*/0,  /*src_repetition_fr*/0,  /*src_startbit*/14,   /*sig_length*/8,  /*des_slotid_fr*/0,   /*des_basecycle_fr*/0,  /*des_repetition_fr*/0,   /*des_startbit*/463,    /*src_cyc*/101,  /*src_id*/32,   /*src_dlc*/5,   /*des_cyc*/40,   /*des_id*/0x1f1, /*src_updatebit*/1000,   /*des_updatebit*/465,      /*initvalue*/0         },
           {   /*sig_name*/"isTurnIndcrSwtIndcrTypExtReq_0",   /*src_can*/"CEM_LIN4",   /*src_network_type*/"LIN",   /*src_slotid_fr*/0,   /*src_basecycle_fr*/0,  /*src_repetition_fr*/0,  /*src_startbit*/22,   /*sig_length*/2,  /*des_slotid_fr*/0,   /*des_basecycle_fr*/0,  /*des_repetition_fr*/0,   /*des_startbit*/471,    /*src_cyc*/101,  /*src_id*/32,   /*src_dlc*/5,   /*des_cyc*/40,   /*des_id*/0x1f1, /*src_updatebit*/1000,   /*des_updatebit*/465,      /*initvalue*/0         },
           {   /*sig_name*/"isTurnIndcrSwtIndcrTypExtReqToUpdQf_0",   /*src_can*/"CEM_LIN4",   /*src_network_type*/"LIN",   /*src_slotid_fr*/0,   /*src_basecycle_fr*/0,  /*src_repetition_fr*/0,  /*src_startbit*/26,   /*sig_length*/2,  /*des_slotid_fr*/0,   /*des_basecycle_fr*/0,  /*des_repetition_fr*/0,   /*des_startbit*/467,    /*src_cyc*/101,  /*src_id*/32,   /*src_dlc*/5,   /*des_cyc*/40,   /*des_id*/0x1f1, /*src_updatebit*/1000,   /*des_updatebit*/465,      /*initvalue*/1         },
           {   /*sig_name*/"isCouplFltSts_0",   /*src_can*/"PropulsionCAN",   /*src_network_type*/"CAN",   /*src_slotid_fr*/0,   /*src_basecycle_fr*/0,  /*src_repetition_fr*/0,  /*src_startbit*/31,   /*sig_length*/2,  /*des_slotid_fr*/0,   /*des_basecycle_fr*/0,  /*des_repetition_fr*/0,   /*des_startbit*/49,    /*src_cyc*/101,  /*src_id*/0x71,   /*src_dlc*/8,   /*des_cyc*/20,   /*des_id*/0x106, /*src_updatebit*/29,   /*des_updatebit*/110,      /*initvalue*/0         },
           {   /*sig_name*/"isSusUpDwnCtrlReq_0",   /*src_can*/"ChassisCANFD2",   /*src_network_type*/"CANFD",   /*src_slotid_fr*/0,   /*src_basecycle_fr*/0,  /*src_repetition_fr*/0,  /*src_startbit*/337,   /*sig_length*/2,  /*des_slotid_fr*/0,   /*des_basecycle_fr*/0,  /*des_repetition_fr*/0,   /*des_startbit*/423,    /*src_cyc*/101,  /*src_id*/0xce,   /*src_dlc*/64,   /*des_cyc*/20,   /*des_id*/0x106, /*src_updatebit*/424,   /*des_updatebit*/421,      /*initvalue*/0         },
           {   /*sig_name*/"isTrsmStAxleReActr_0",   /*src_can*/"PropulsionCAN",   /*src_network_type*/"CAN",   /*src_slotid_fr*/0,   /*src_basecycle_fr*/0,  /*src_repetition_fr*/0,  /*src_startbit*/23,   /*sig_length*/2,  /*des_slotid_fr*/0,   /*des_basecycle_fr*/0,  /*des_repetition_fr*/0,   /*des_startbit*/187,    /*src_cyc*/101,  /*src_id*/0x71,   /*src_dlc*/8,   /*des_cyc*/10,   /*des_id*/0x61, /*src_updatebit*/21,   /*des_updatebit*/478,      /*initvalue*/0         },
           {   /*sig_name*/"isSBWSysDegradationStsR1DegradationSts_0",   /*src_can*/"ZCUD_CANFD3",   /*src_network_type*/"CANFD",   /*src_slotid_fr*/0,   /*src_basecycle_fr*/0,  /*src_repetition_fr*/0,  /*src_startbit*/11,   /*sig_length*/4,  /*des_slotid_fr*/0,   /*des_basecycle_fr*/0,  /*des_repetition_fr*/0,   /*des_startbit*/363,    /*src_cyc*/101,  /*src_id*/0x110,   /*src_dlc*/64,   /*des_cyc*/20,   /*des_id*/0x106, /*src_updatebit*/23,   /*des_updatebit*/315,      /*initvalue*/0         },
           {   /*sig_name*/"isSBWSysDegradationStsR1Chks_0",   /*src_can*/"ZCUD_CANFD3",   /*src_network_type*/"CANFD",   /*src_slotid_fr*/0,   /*src_basecycle_fr*/0,  /*src_repetition_fr*/0,  /*src_startbit*/7,   /*sig_length*/8,  /*des_slotid_fr*/0,   /*des_basecycle_fr*/0,  /*des_repetition_fr*/0,   /*des_startbit*/359,    /*src_cyc*/101,  /*src_id*/0x110,   /*src_dlc*/64,   /*des_cyc*/20,   /*des_id*/0x106, /*src_updatebit*/23,   /*des_updatebit*/315,      /*initvalue*/0         },
           {   /*sig_name*/"isSBWSysDegradationStsR1Cntr_0",   /*src_can*/"ZCUD_CANFD3",   /*src_network_type*/"CANFD",   /*src_slotid_fr*/0,   /*src_basecycle_fr*/0,  /*src_repetition_fr*/0,  /*src_startbit*/15,   /*sig_length*/4,  /*des_slotid_fr*/0,   /*des_basecycle_fr*/0,  /*des_repetition_fr*/0,   /*des_startbit*/367,    /*src_cyc*/101,  /*src_id*/0x110,   /*src_dlc*/64,   /*des_cyc*/20,   /*des_id*/0x106, /*src_updatebit*/23,   /*des_updatebit*/315,      /*initvalue*/0         },
           {   /*sig_name*/"isSBWSysDegradationStsH1Cntr_0",   /*src_can*/"ZCUD_CANFD3",   /*src_network_type*/"CANFD",   /*src_slotid_fr*/0,   /*src_basecycle_fr*/0,  /*src_repetition_fr*/0,  /*src_startbit*/15,   /*sig_length*/4,  /*des_slotid_fr*/0,   /*des_basecycle_fr*/0,  /*des_repetition_fr*/0,   /*des_startbit*/351,    /*src_cyc*/101,  /*src_id*/0x100,   /*src_dlc*/64,   /*des_cyc*/20,   /*des_id*/0x106, /*src_updatebit*/23,   /*des_updatebit*/420,      /*initvalue*/0         },
           {   /*sig_name*/"isSBWSysDegradationStsH1DegradationSts_0",   /*src_can*/"ZCUD_CANFD3",   /*src_network_type*/"CANFD",   /*src_slotid_fr*/0,   /*src_basecycle_fr*/0,  /*src_repetition_fr*/0,  /*src_startbit*/11,   /*sig_length*/4,  /*des_slotid_fr*/0,   /*des_basecycle_fr*/0,  /*des_repetition_fr*/0,   /*des_startbit*/347,    /*src_cyc*/101,  /*src_id*/0x100,   /*src_dlc*/64,   /*des_cyc*/20,   /*des_id*/0x106, /*src_updatebit*/23,   /*des_updatebit*/420,      /*initvalue*/0         },
           {   /*sig_name*/"isSBWSysDegradationStsH1Chks_0",   /*src_can*/"ZCUD_CANFD3",   /*src_network_type*/"CANFD",   /*src_slotid_fr*/0,   /*src_basecycle_fr*/0,  /*src_repetition_fr*/0,  /*src_startbit*/7,   /*sig_length*/8,  /*des_slotid_fr*/0,   /*des_basecycle_fr*/0,  /*des_repetition_fr*/0,   /*des_startbit*/343,    /*src_cyc*/101,  /*src_id*/0x100,   /*src_dlc*/64,   /*des_cyc*/20,   /*des_id*/0x106, /*src_updatebit*/23,   /*des_updatebit*/420,      /*initvalue*/0         },
           {   /*sig_name*/"isPinionSteerAgGroupR1PinionSteerAgSpd1Qf_0",   /*src_can*/"ZCUD_CANFD3",   /*src_network_type*/"CANFD",   /*src_slotid_fr*/0,   /*src_basecycle_fr*/0,  /*src_repetition_fr*/0,  /*src_startbit*/62,   /*sig_length*/2,  /*des_slotid_fr*/0,   /*des_basecycle_fr*/0,  /*des_repetition_fr*/0,   /*des_startbit*/94,    /*src_cyc*/101,  /*src_id*/0x50,   /*src_dlc*/64,   /*des_cyc*/10,   /*des_id*/0x81, /*src_updatebit*/58,   /*des_updatebit*/90,      /*initvalue*/1         },
           {   /*sig_name*/"isPinionSteerAgGroupR1Chks_0",   /*src_can*/"ZCUD_CANFD3",   /*src_network_type*/"CANFD",   /*src_slotid_fr*/0,   /*src_basecycle_fr*/0,  /*src_repetition_fr*/0,  /*src_startbit*/44,   /*sig_length*/8,  /*des_slotid_fr*/0,   /*des_basecycle_fr*/0,  /*des_repetition_fr*/0,   /*des_startbit*/76,    /*src_cyc*/101,  /*src_id*/0x50,   /*src_dlc*/64,   /*des_cyc*/10,   /*des_id*/0x81, /*src_updatebit*/58,   /*des_updatebit*/90,      /*initvalue*/0         },
           {   /*sig_name*/"isPinionSteerAgGroupR1Cntr_0",   /*src_can*/"ZCUD_CANFD3",   /*src_network_type*/"CANFD",   /*src_slotid_fr*/0,   /*src_basecycle_fr*/0,  /*src_repetition_fr*/0,  /*src_startbit*/52,   /*sig_length*/4,  /*des_slotid_fr*/0,   /*des_basecycle_fr*/0,  /*des_repetition_fr*/0,   /*des_startbit*/84,    /*src_cyc*/101,  /*src_id*/0x50,   /*src_dlc*/64,   /*des_cyc*/10,   /*des_id*/0x81, /*src_updatebit*/58,   /*des_updatebit*/90,      /*initvalue*/0         },
           {   /*sig_name*/"isPinionSteerAgGroupR1PinionSteerAgSpd1_0",   /*src_can*/"ZCUD_CANFD3",   /*src_network_type*/"CANFD",   /*src_slotid_fr*/0,   /*src_basecycle_fr*/0,  /*src_repetition_fr*/0,  /*src_startbit*/8,   /*sig_length*/14,  /*des_slotid_fr*/0,   /*des_basecycle_fr*/0,  /*des_repetition_fr*/0,   /*des_startbit*/40,    /*src_cyc*/101,  /*src_id*/0x50,   /*src_dlc*/64,   /*des_cyc*/10,   /*des_id*/0x81, /*src_updatebit*/58,   /*des_updatebit*/90,      /*initvalue*/0         },
           {   /*sig_name*/"isPinionSteerAgGroupR1SteerWhlTq_0",   /*src_can*/"ZCUD_CANFD3",   /*src_network_type*/"CANFD",   /*src_slotid_fr*/0,   /*src_basecycle_fr*/0,  /*src_repetition_fr*/0,  /*src_startbit*/26,   /*sig_length*/14,  /*des_slotid_fr*/0,   /*des_basecycle_fr*/0,  /*des_repetition_fr*/0,   /*des_startbit*/58,    /*src_cyc*/101,  /*src_id*/0x50,   /*src_dlc*/64,   /*des_cyc*/10,   /*des_id*/0x81, /*src_updatebit*/58,   /*des_updatebit*/90,      /*initvalue*/0         },
           {   /*sig_name*/"isPinionSteerAgGroupR1PinionSteerAg1_0",   /*src_can*/"ZCUD_CANFD3",   /*src_network_type*/"CANFD",   /*src_slotid_fr*/0,   /*src_basecycle_fr*/0,  /*src_repetition_fr*/0,  /*src_startbit*/7,   /*sig_length*/15,  /*des_slotid_fr*/0,   /*des_basecycle_fr*/0,  /*des_repetition_fr*/0,   /*des_startbit*/39,    /*src_cyc*/101,  /*src_id*/0x50,   /*src_dlc*/64,   /*des_cyc*/10,   /*des_id*/0x81, /*src_updatebit*/58,   /*des_updatebit*/90,      /*initvalue*/0         },
           {   /*sig_name*/"isPinionSteerAgGroupR1PinionSteerAg1Qf_0",   /*src_can*/"ZCUD_CANFD3",   /*src_network_type*/"CANFD",   /*src_slotid_fr*/0,   /*src_basecycle_fr*/0,  /*src_repetition_fr*/0,  /*src_startbit*/48,   /*sig_length*/2,  /*des_slotid_fr*/0,   /*des_basecycle_fr*/0,  /*des_repetition_fr*/0,   /*des_startbit*/80,    /*src_cyc*/101,  /*src_id*/0x50,   /*src_dlc*/64,   /*des_cyc*/10,   /*des_id*/0x81, /*src_updatebit*/58,   /*des_updatebit*/90,      /*initvalue*/1         },
           {   /*sig_name*/"isPinionSteerAgGroupR1SteerWhlTqQf_0",   /*src_can*/"ZCUD_CANFD3",   /*src_network_type*/"CANFD",   /*src_slotid_fr*/0,   /*src_basecycle_fr*/0,  /*src_repetition_fr*/0,  /*src_startbit*/60,   /*sig_length*/2,  /*des_slotid_fr*/0,   /*des_basecycle_fr*/0,  /*des_repetition_fr*/0,   /*des_startbit*/92,    /*src_cyc*/101,  /*src_id*/0x50,   /*src_dlc*/64,   /*des_cyc*/10,   /*des_id*/0x81, /*src_updatebit*/58,   /*des_updatebit*/90,      /*initvalue*/1         },
           {   /*sig_name*/"isSysModAvt_0",   /*src_can*/"PropulsionCAN",   /*src_network_type*/"CAN",   /*src_slotid_fr*/0,   /*src_basecycle_fr*/0,  /*src_repetition_fr*/0,  /*src_startbit*/20,   /*sig_length*/4,  /*des_slotid_fr*/0,   /*des_basecycle_fr*/0,  /*des_repetition_fr*/0,   /*des_startbit*/191,    /*src_cyc*/101,  /*src_id*/0x71,   /*src_dlc*/8,   /*des_cyc*/10,   /*des_id*/0x61, /*src_updatebit*/16,   /*des_updatebit*/476,      /*initvalue*/0         },
           {   /*sig_name*/"isDcDcActvd_0",   /*src_can*/"PropulsionCAN",   /*src_network_type*/"CAN",   /*src_slotid_fr*/0,   /*src_basecycle_fr*/0,  /*src_repetition_fr*/0,  /*src_startbit*/25,   /*sig_length*/1,  /*des_slotid_fr*/0,   /*des_basecycle_fr*/0,  /*des_repetition_fr*/0,   /*des_startbit*/29,    /*src_cyc*/101,  /*src_id*/0x14b,   /*src_dlc*/8,   /*des_cyc*/70,   /*des_id*/0x243, /*src_updatebit*/24,   /*des_updatebit*/24,      /*initvalue*/0         },
           {   /*sig_name*/"isDrvrGearShiftDirReq1DwnTipAut_0",   /*src_can*/"PropulsionCAN",   /*src_network_type*/"CAN",   /*src_slotid_fr*/0,   /*src_basecycle_fr*/0,  /*src_repetition_fr*/0,  /*src_startbit*/13,   /*sig_length*/1,  /*des_slotid_fr*/0,   /*des_basecycle_fr*/0,  /*des_repetition_fr*/0,   /*des_startbit*/204,    /*src_cyc*/101,  /*src_id*/0x136,   /*src_dlc*/8,   /*des_cyc*/10,   /*des_id*/0x61, /*src_updatebit*/1,   /*des_updatebit*/416,      /*initvalue*/0         },
           {   /*sig_name*/"isDrvrGearShiftDirReq1DwnDwnTipAut_0",   /*src_can*/"PropulsionCAN",   /*src_network_type*/"CAN",   /*src_slotid_fr*/0,   /*src_basecycle_fr*/0,  /*src_repetition_fr*/0,  /*src_startbit*/12,   /*sig_length*/1,  /*des_slotid_fr*/0,   /*des_basecycle_fr*/0,  /*des_repetition_fr*/0,   /*des_startbit*/205,    /*src_cyc*/101,  /*src_id*/0x136,   /*src_dlc*/8,   /*des_cyc*/10,   /*des_id*/0x61, /*src_updatebit*/1,   /*des_updatebit*/416,      /*initvalue*/0         },
           {   /*sig_name*/"isDrvrGearShiftDirReq1UpUpTipAut_0",   /*src_can*/"PropulsionCAN",   /*src_network_type*/"CAN",   /*src_slotid_fr*/0,   /*src_basecycle_fr*/0,  /*src_repetition_fr*/0,  /*src_startbit*/0,   /*sig_length*/1,  /*des_slotid_fr*/0,   /*des_basecycle_fr*/0,  /*des_repetition_fr*/0,   /*des_startbit*/201,    /*src_cyc*/101,  /*src_id*/0x136,   /*src_dlc*/8,   /*des_cyc*/10,   /*des_id*/0x61, /*src_updatebit*/1,   /*des_updatebit*/416,      /*initvalue*/0         },
           {   /*sig_name*/"isDrvrGearShiftDirReq1Chks_0",   /*src_can*/"PropulsionCAN",   /*src_network_type*/"CAN",   /*src_slotid_fr*/0,   /*src_basecycle_fr*/0,  /*src_repetition_fr*/0,  /*src_startbit*/23,   /*sig_length*/8,  /*des_slotid_fr*/0,   /*des_basecycle_fr*/0,  /*des_repetition_fr*/0,   /*des_startbit*/185,    /*src_cyc*/101,  /*src_id*/0x136,   /*src_dlc*/8,   /*des_cyc*/10,   /*des_id*/0x61, /*src_updatebit*/1,   /*des_updatebit*/416,      /*initvalue*/0         },
           {   /*sig_name*/"isDrvrGearShiftDirReq1Cntr_0",   /*src_can*/"PropulsionCAN",   /*src_network_type*/"CAN",   /*src_slotid_fr*/0,   /*src_basecycle_fr*/0,  /*src_repetition_fr*/0,  /*src_startbit*/11,   /*sig_length*/4,  /*des_slotid_fr*/0,   /*des_basecycle_fr*/0,  /*des_repetition_fr*/0,   /*des_startbit*/193,    /*src_cyc*/101,  /*src_id*/0x136,   /*src_dlc*/8,   /*des_cyc*/10,   /*des_id*/0x61, /*src_updatebit*/1,   /*des_updatebit*/416,      /*initvalue*/0         },
           {   /*sig_name*/"isDrvrGearShiftDirReq1UpTipAut_0",   /*src_can*/"PropulsionCAN",   /*src_network_type*/"CAN",   /*src_slotid_fr*/0,   /*src_basecycle_fr*/0,  /*src_repetition_fr*/0,  /*src_startbit*/15,   /*sig_length*/1,  /*des_slotid_fr*/0,   /*des_basecycle_fr*/0,  /*des_repetition_fr*/0,   /*des_startbit*/202,    /*src_cyc*/101,  /*src_id*/0x136,   /*src_dlc*/8,   /*des_cyc*/10,   /*des_id*/0x61, /*src_updatebit*/1,   /*des_updatebit*/416,      /*initvalue*/0         },
           {   /*sig_name*/"isDrvrGearShiftDirReq1PosnAut_0",   /*src_can*/"PropulsionCAN",   /*src_network_type*/"CAN",   /*src_slotid_fr*/0,   /*src_basecycle_fr*/0,  /*src_repetition_fr*/0,  /*src_startbit*/14,   /*sig_length*/1,  /*des_slotid_fr*/0,   /*des_basecycle_fr*/0,  /*des_repetition_fr*/0,   /*des_startbit*/203,    /*src_cyc*/101,  /*src_id*/0x136,   /*src_dlc*/8,   /*des_cyc*/10,   /*des_id*/0x61, /*src_updatebit*/1,   /*des_updatebit*/416,      /*initvalue*/0         },
           {   /*sig_name*/"isBltLockStAtDrvrBltLockSt1_0",   /*src_can*/"ZCUD_CAN1",   /*src_network_type*/"CAN",   /*src_slotid_fr*/0,   /*src_basecycle_fr*/0,  /*src_repetition_fr*/0,  /*src_startbit*/57,   /*sig_length*/1,  /*des_slotid_fr*/0,   /*des_basecycle_fr*/0,  /*des_repetition_fr*/0,   /*des_startbit*/34,    /*src_cyc*/101,  /*src_id*/0x89,   /*src_dlc*/8,   /*des_cyc*/20,   /*des_id*/0x106, /*src_updatebit*/7,   /*des_updatebit*/107,      /*initvalue*/1         },
           {   /*sig_name*/"isBltLockStAtDrvrBltLockSts_0",   /*src_can*/"ZCUD_CAN1",   /*src_network_type*/"CAN",   /*src_slotid_fr*/0,   /*src_basecycle_fr*/0,  /*src_repetition_fr*/0,  /*src_startbit*/56,   /*sig_length*/1,  /*des_slotid_fr*/0,   /*des_basecycle_fr*/0,  /*des_repetition_fr*/0,   /*des_startbit*/33,    /*src_cyc*/101,  /*src_id*/0x89,   /*src_dlc*/8,   /*des_cyc*/20,   /*des_id*/0x106, /*src_updatebit*/7,   /*des_updatebit*/107,      /*initvalue*/0         },
           {   /*sig_name*/"isTurnIndcrMonostableChks_0",   /*src_can*/"ChassisCAN1",   /*src_network_type*/"CAN",   /*src_slotid_fr*/0,   /*src_basecycle_fr*/0,  /*src_repetition_fr*/0,  /*src_startbit*/23,   /*sig_length*/8,  /*des_slotid_fr*/0,   /*des_basecycle_fr*/0,  /*des_repetition_fr*/0,   /*des_startbit*/207,    /*src_cyc*/101,  /*src_id*/0x2e6,   /*src_dlc*/8,   /*des_cyc*/40,   /*des_id*/0x1f1, /*src_updatebit*/24,   /*des_updatebit*/208,      /*initvalue*/0         },
           {   /*sig_name*/"isTurnIndcrMonostableCntr_0",   /*src_can*/"ChassisCAN1",   /*src_network_type*/"CAN",   /*src_slotid_fr*/0,   /*src_basecycle_fr*/0,  /*src_repetition_fr*/0,  /*src_startbit*/31,   /*sig_length*/2,  /*des_slotid_fr*/0,   /*des_basecycle_fr*/0,  /*des_repetition_fr*/0,   /*des_startbit*/215,    /*src_cyc*/101,  /*src_id*/0x2e6,   /*src_dlc*/8,   /*des_cyc*/40,   /*des_id*/0x1f1, /*src_updatebit*/24,   /*des_updatebit*/208,      /*initvalue*/0         },
           {   /*sig_name*/"isTurnIndcrMonostableTurnIndcrMonostable_0",   /*src_can*/"ChassisCAN1",   /*src_network_type*/"CAN",   /*src_slotid_fr*/0,   /*src_basecycle_fr*/0,  /*src_repetition_fr*/0,  /*src_startbit*/27,   /*sig_length*/3,  /*des_slotid_fr*/0,   /*des_basecycle_fr*/0,  /*des_repetition_fr*/0,   /*des_startbit*/211,    /*src_cyc*/101,  /*src_id*/0x2e6,   /*src_dlc*/8,   /*des_cyc*/40,   /*des_id*/0x1f1, /*src_updatebit*/24,   /*des_updatebit*/208,      /*initvalue*/0         },
           {   /*sig_name*/"isTurnIndcrMonostableQf_0",   /*src_can*/"ChassisCAN1",   /*src_network_type*/"CAN",   /*src_slotid_fr*/0,   /*src_basecycle_fr*/0,  /*src_repetition_fr*/0,  /*src_startbit*/29,   /*sig_length*/2,  /*des_slotid_fr*/0,   /*des_basecycle_fr*/0,  /*des_repetition_fr*/0,   /*des_startbit*/213,    /*src_cyc*/101,  /*src_id*/0x2e6,   /*src_dlc*/8,   /*des_cyc*/40,   /*des_id*/0x1f1, /*src_updatebit*/24,   /*des_updatebit*/208,      /*initvalue*/1         },
           {   /*sig_name*/"isPassAirbSts_0",   /*src_can*/"ZCUD_CAN1",   /*src_network_type*/"CAN",   /*src_slotid_fr*/0,   /*src_basecycle_fr*/0,  /*src_repetition_fr*/0,  /*src_startbit*/63,   /*sig_length*/1,  /*des_slotid_fr*/0,   /*des_basecycle_fr*/0,  /*des_repetition_fr*/0,   /*des_startbit*/7,    /*src_cyc*/101,  /*src_id*/0x360,   /*src_dlc*/8,   /*des_cyc*/400,   /*des_id*/0x3a3, /*src_updatebit*/62,   /*des_updatebit*/6,      /*initvalue*/1         },
           {   /*sig_name*/"isOnBdChrgrCooltT_0",   /*src_can*/"PropulsionCAN",   /*src_network_type*/"CAN",   /*src_slotid_fr*/0,   /*src_basecycle_fr*/0,  /*src_repetition_fr*/0,  /*src_startbit*/7,   /*sig_length*/8,  /*des_slotid_fr*/0,   /*des_basecycle_fr*/0,  /*des_repetition_fr*/0,   /*des_startbit*/79,    /*src_cyc*/101,  /*src_id*/0x411,   /*src_dlc*/8,   /*des_cyc*/300,   /*des_id*/0x363, /*src_updatebit*/27,   /*des_updatebit*/2,      /*initvalue*/40         },
           {   /*sig_name*/"isDispHvBattLvlOfChrg_0",   /*src_can*/"PropulsionCAN",   /*src_network_type*/"CAN",   /*src_slotid_fr*/0,   /*src_basecycle_fr*/0,  /*src_repetition_fr*/0,  /*src_startbit*/7,   /*sig_length*/10,  /*des_slotid_fr*/0,   /*des_basecycle_fr*/0,  /*des_repetition_fr*/0,   /*des_startbit*/55,    /*src_cyc*/101,  /*src_id*/0x211,   /*src_dlc*/8,   /*des_cyc*/400,   /*des_id*/0x3a3, /*src_updatebit*/13,   /*des_updatebit*/61,      /*initvalue*/0         },
           {   /*sig_name*/"isIsgSpdActSgn_0",   /*src_can*/"ChassisCANFD2",   /*src_network_type*/"CANFD",   /*src_slotid_fr*/0,   /*src_basecycle_fr*/0,  /*src_repetition_fr*/0,  /*src_startbit*/439,   /*sig_length*/16,  /*des_slotid_fr*/0,   /*des_basecycle_fr*/0,  /*des_repetition_fr*/0,   /*des_startbit*/175,    /*src_cyc*/101,  /*src_id*/0x7c,   /*src_dlc*/64,   /*des_cyc*/10,   /*des_id*/0x81, /*src_updatebit*/112,   /*des_updatebit*/160,      /*initvalue*/20000         },
           {   /*sig_name*/"isBrkPedlSts_0",   /*src_can*/"ZCUD_CAN1",   /*src_network_type*/"CAN",   /*src_slotid_fr*/0,   /*src_basecycle_fr*/0,  /*src_repetition_fr*/0,  /*src_startbit*/31,   /*sig_length*/1,  /*des_slotid_fr*/0,   /*des_basecycle_fr*/0,  /*des_repetition_fr*/0,   /*des_startbit*/64,    /*src_cyc*/101,  /*src_id*/0x21,   /*src_dlc*/8,   /*des_cyc*/10,   /*des_id*/0x61, /*src_updatebit*/15,   /*des_updatebit*/176,      /*initvalue*/0         },
           {   /*sig_name*/"isBltLockStSafeAtDrvrBltLockStErrSts_0",   /*src_can*/"ZCUD_CAN1",   /*src_network_type*/"CAN",   /*src_slotid_fr*/0,   /*src_basecycle_fr*/0,  /*src_repetition_fr*/0,  /*src_startbit*/12,   /*sig_length*/1,  /*des_slotid_fr*/0,   /*des_basecycle_fr*/0,  /*des_repetition_fr*/0,   /*des_startbit*/50,    /*src_cyc*/101,  /*src_id*/0x21,   /*src_dlc*/8,   /*des_cyc*/20,   /*des_id*/0x106, /*src_updatebit*/14,   /*des_updatebit*/108,      /*initvalue*/0         },
           {   /*sig_name*/"isBltLockStSafeAtDrvrCntr_0",   /*src_can*/"ZCUD_CAN1",   /*src_network_type*/"CAN",   /*src_slotid_fr*/0,   /*src_basecycle_fr*/0,  /*src_repetition_fr*/0,  /*src_startbit*/11,   /*sig_length*/4,  /*des_slotid_fr*/0,   /*des_basecycle_fr*/0,  /*des_repetition_fr*/0,   /*des_startbit*/55,    /*src_cyc*/101,  /*src_id*/0x21,   /*src_dlc*/8,   /*des_cyc*/20,   /*des_id*/0x106, /*src_updatebit*/14,   /*des_updatebit*/108,      /*initvalue*/0         },
           {   /*sig_name*/"isBltLockStSafeAtDrvrChks_0",   /*src_can*/"ZCUD_CAN1",   /*src_network_type*/"CAN",   /*src_slotid_fr*/0,   /*src_basecycle_fr*/0,  /*src_repetition_fr*/0,  /*src_startbit*/23,   /*sig_length*/8,  /*des_slotid_fr*/0,   /*des_basecycle_fr*/0,  /*des_repetition_fr*/0,   /*des_startbit*/47,    /*src_cyc*/101,  /*src_id*/0x21,   /*src_dlc*/8,   /*des_cyc*/20,   /*des_id*/0x106, /*src_updatebit*/14,   /*des_updatebit*/108,      /*initvalue*/255         },
           {   /*sig_name*/"isBltLockStSafeAtDrvrBltLockSt1_0",   /*src_can*/"ZCUD_CAN1",   /*src_network_type*/"CAN",   /*src_slotid_fr*/0,   /*src_basecycle_fr*/0,  /*src_repetition_fr*/0,  /*src_startbit*/13,   /*sig_length*/1,  /*des_slotid_fr*/0,   /*des_basecycle_fr*/0,  /*des_repetition_fr*/0,   /*des_startbit*/51,    /*src_cyc*/101,  /*src_id*/0x21,   /*src_dlc*/8,   /*des_cyc*/20,   /*des_id*/0x106, /*src_updatebit*/14,   /*des_updatebit*/108,      /*initvalue*/1         },
           {   /*sig_name*/"isPtBrkTqQf_0",   /*src_can*/"ChassisCANFD2",   /*src_network_type*/"CANFD",   /*src_slotid_fr*/0,   /*src_basecycle_fr*/0,  /*src_repetition_fr*/0,  /*src_startbit*/348,   /*sig_length*/2,  /*des_slotid_fr*/0,   /*des_basecycle_fr*/0,  /*des_repetition_fr*/0,   /*des_startbit*/345,    /*src_cyc*/101,  /*src_id*/0x7c,   /*src_dlc*/64,   /*des_cyc*/10,   /*des_id*/0x61, /*src_updatebit*/346,   /*des_updatebit*/472,      /*initvalue*/0         },
           {   /*sig_name*/"isPtBrkTqRgnAtAxleReAct_0",   /*src_can*/"ChassisCANFD2",   /*src_network_type*/"CANFD",   /*src_slotid_fr*/0,   /*src_basecycle_fr*/0,  /*src_repetition_fr*/0,  /*src_startbit*/313,   /*sig_length*/15,  /*des_slotid_fr*/0,   /*des_basecycle_fr*/0,  /*des_repetition_fr*/0,   /*des_startbit*/391,    /*src_cyc*/101,  /*src_id*/0x7c,   /*src_dlc*/64,   /*des_cyc*/10,   /*des_id*/0x61, /*src_updatebit*/346,   /*des_updatebit*/472,      /*initvalue*/0         },
           {   /*sig_name*/"isPtBrkTqActTot_0",   /*src_can*/"ChassisCANFD2",   /*src_network_type*/"CANFD",   /*src_slotid_fr*/0,   /*src_basecycle_fr*/0,  /*src_repetition_fr*/0,  /*src_startbit*/295,   /*sig_length*/15,  /*des_slotid_fr*/0,   /*des_basecycle_fr*/0,  /*des_repetition_fr*/0,   /*des_startbit*/359,    /*src_cyc*/101,  /*src_id*/0x7c,   /*src_dlc*/64,   /*des_cyc*/10,   /*des_id*/0x61, /*src_updatebit*/346,   /*des_updatebit*/472,      /*initvalue*/0         },
           {   /*sig_name*/"isPtBrkTqActTotQf_0",   /*src_can*/"ChassisCANFD2",   /*src_network_type*/"CANFD",   /*src_slotid_fr*/0,   /*src_basecycle_fr*/0,  /*src_repetition_fr*/0,  /*src_startbit*/350,   /*sig_length*/2,  /*des_slotid_fr*/0,   /*des_basecycle_fr*/0,  /*des_repetition_fr*/0,   /*des_startbit*/351,    /*src_cyc*/101,  /*src_id*/0x7c,   /*src_dlc*/64,   /*des_cyc*/10,   /*des_id*/0x61, /*src_updatebit*/346,   /*des_updatebit*/472,      /*initvalue*/0         },
           {   /*sig_name*/"isPtBrkTqChks_0",   /*src_can*/"ChassisCANFD2",   /*src_network_type*/"CANFD",   /*src_slotid_fr*/0,   /*src_basecycle_fr*/0,  /*src_repetition_fr*/0,  /*src_startbit*/330,   /*sig_length*/8,  /*des_slotid_fr*/0,   /*des_basecycle_fr*/0,  /*des_repetition_fr*/0,   /*des_startbit*/343,    /*src_cyc*/101,  /*src_id*/0x7c,   /*src_dlc*/64,   /*des_cyc*/10,   /*des_id*/0x61, /*src_updatebit*/346,   /*des_updatebit*/472,      /*initvalue*/0         },
           {   /*sig_name*/"isPtBrkTqCntr_0",   /*src_can*/"ChassisCANFD2",   /*src_network_type*/"CANFD",   /*src_slotid_fr*/0,   /*src_basecycle_fr*/0,  /*src_repetition_fr*/0,  /*src_startbit*/338,   /*sig_length*/4,  /*des_slotid_fr*/0,   /*des_basecycle_fr*/0,  /*des_repetition_fr*/0,   /*des_startbit*/349,    /*src_cyc*/101,  /*src_id*/0x7c,   /*src_dlc*/64,   /*des_cyc*/10,   /*des_id*/0x61, /*src_updatebit*/346,   /*des_updatebit*/472,      /*initvalue*/0         },
           {   /*sig_name*/"isPtBrkTqReqForBrkSys_0",   /*src_can*/"ChassisCANFD2",   /*src_network_type*/"CANFD",   /*src_slotid_fr*/0,   /*src_basecycle_fr*/0,  /*src_repetition_fr*/0,  /*src_startbit*/296,   /*sig_length*/15,  /*des_slotid_fr*/0,   /*des_basecycle_fr*/0,  /*des_repetition_fr*/0,   /*des_startbit*/375,    /*src_cyc*/101,  /*src_id*/0x7c,   /*src_dlc*/64,   /*des_cyc*/10,   /*des_id*/0x61, /*src_updatebit*/346,   /*des_updatebit*/472,      /*initvalue*/0         },
           {   /*sig_name*/"isStsForRtrctrRvsbRi_0",   /*src_can*/"ZCUD_CAN1",   /*src_network_type*/"CAN",   /*src_slotid_fr*/0,   /*src_basecycle_fr*/0,  /*src_repetition_fr*/0,  /*src_startbit*/5,   /*sig_length*/2,  /*des_slotid_fr*/0,   /*des_basecycle_fr*/0,  /*des_repetition_fr*/0,   /*des_startbit*/393,    /*src_cyc*/101,  /*src_id*/0x175,   /*src_dlc*/8,   /*des_cyc*/20,   /*des_id*/0x106, /*src_updatebit*/8,   /*des_updatebit*/407,      /*initvalue*/1         },
           {   /*sig_name*/"isRainfallAmnt_0",   /*src_can*/"CEM_LIN1",   /*src_network_type*/"LIN",   /*src_slotid_fr*/0,   /*src_basecycle_fr*/0,  /*src_repetition_fr*/0,  /*src_startbit*/8,   /*sig_length*/4,  /*des_slotid_fr*/0,   /*des_basecycle_fr*/0,  /*des_repetition_fr*/0,   /*des_startbit*/15,    /*src_cyc*/101,  /*src_id*/2,   /*src_dlc*/8,   /*des_cyc*/40,   /*des_id*/0x1f1, /*src_updatebit*/1000,   /*des_updatebit*/11,      /*initvalue*/14         },
           {   /*sig_name*/"isRWATarPinionAgR2RefPinionAg_0",   /*src_can*/"ChassisCAN1",   /*src_network_type*/"CAN",   /*src_slotid_fr*/0,   /*src_basecycle_fr*/0,  /*src_repetition_fr*/0,  /*src_startbit*/39,   /*sig_length*/15,  /*des_slotid_fr*/0,   /*des_basecycle_fr*/0,  /*des_repetition_fr*/0,   /*des_startbit*/327,    /*src_cyc*/101,  /*src_id*/0x13b,   /*src_dlc*/8,   /*des_cyc*/20,   /*des_id*/0x106, /*src_updatebit*/40,   /*des_updatebit*/419,      /*initvalue*/0         },
           {   /*sig_name*/"isRWATarPinionAgR2Qf_0",   /*src_can*/"ChassisCAN1",   /*src_network_type*/"CAN",   /*src_slotid_fr*/0,   /*src_basecycle_fr*/0,  /*src_repetition_fr*/0,  /*src_startbit*/25,   /*sig_length*/2,  /*des_slotid_fr*/0,   /*des_basecycle_fr*/0,  /*des_repetition_fr*/0,   /*des_startbit*/313,    /*src_cyc*/101,  /*src_id*/0x13b,   /*src_dlc*/8,   /*des_cyc*/20,   /*des_id*/0x106, /*src_updatebit*/40,   /*des_updatebit*/419,      /*initvalue*/1         },
           {   /*sig_name*/"isTrlrPrsnt_0",   /*src_can*/"ZCUD_CAN1",   /*src_network_type*/"CAN",   /*src_slotid_fr*/0,   /*src_basecycle_fr*/0,  /*src_repetition_fr*/0,  /*src_startbit*/13,   /*sig_length*/1,  /*des_slotid_fr*/0,   /*des_basecycle_fr*/0,  /*des_repetition_fr*/0,   /*des_startbit*/32,    /*src_cyc*/101,  /*src_id*/0xd0,   /*src_dlc*/4,   /*des_cyc*/10,   /*des_id*/0x61, /*src_updatebit*/20,   /*des_updatebit*/477,      /*initvalue*/0         },
           {   /*sig_name*/"isAbsCtrlActvCtrlSts1_0",   /*src_can*/"ChassisCAN1",   /*src_network_type*/"CAN",   /*src_slotid_fr*/0,   /*src_basecycle_fr*/0,  /*src_repetition_fr*/0,  /*src_startbit*/43,   /*sig_length*/1,  /*des_slotid_fr*/0,   /*des_basecycle_fr*/0,  /*des_repetition_fr*/0,   /*des_startbit*/395,    /*src_cyc*/101,  /*src_id*/0xb9,   /*src_dlc*/8,   /*des_cyc*/20,   /*des_id*/0x106, /*src_updatebit*/24,   /*des_updatebit*/394,      /*initvalue*/0         },
           {   /*sig_name*/"isAbsCtrlActvChks_0",   /*src_can*/"ChassisCAN1",   /*src_network_type*/"CAN",   /*src_slotid_fr*/0,   /*src_basecycle_fr*/0,  /*src_repetition_fr*/0,  /*src_startbit*/39,   /*sig_length*/8,  /*des_slotid_fr*/0,   /*des_basecycle_fr*/0,  /*des_repetition_fr*/0,   /*des_startbit*/391,    /*src_cyc*/101,  /*src_id*/0xb9,   /*src_dlc*/8,   /*des_cyc*/20,   /*des_id*/0x106, /*src_updatebit*/24,   /*des_updatebit*/394,      /*initvalue*/0         },
           {   /*sig_name*/"isAbsCtrlActvCntr_0",   /*src_can*/"ChassisCAN1",   /*src_network_type*/"CAN",   /*src_slotid_fr*/0,   /*src_basecycle_fr*/0,  /*src_repetition_fr*/0,  /*src_startbit*/47,   /*sig_length*/4,  /*des_slotid_fr*/0,   /*des_basecycle_fr*/0,  /*des_repetition_fr*/0,   /*des_startbit*/399,    /*src_cyc*/101,  /*src_id*/0xb9,   /*src_dlc*/8,   /*des_cyc*/20,   /*des_id*/0x106, /*src_updatebit*/24,   /*des_updatebit*/394,      /*initvalue*/0         },
           {   /*sig_name*/"isMsgReqForRtrctrRvsbLe_0",   /*src_can*/"ZCUD_CAN1",   /*src_network_type*/"CAN",   /*src_slotid_fr*/0,   /*src_basecycle_fr*/0,  /*src_repetition_fr*/0,  /*src_startbit*/9,   /*sig_length*/1,  /*des_slotid_fr*/0,   /*des_basecycle_fr*/0,  /*des_repetition_fr*/0,   /*des_startbit*/74,    /*src_cyc*/101,  /*src_id*/0x153,   /*src_dlc*/8,   /*des_cyc*/100,   /*des_id*/0x221, /*src_updatebit*/7,   /*des_updatebit*/72,      /*initvalue*/0         },
           {   /*sig_name*/"isBltLockStAtRowSecLeBltLockEquid_0",   /*src_can*/"ZCUD_CAN1",   /*src_network_type*/"CAN",   /*src_slotid_fr*/0,   /*src_basecycle_fr*/0,  /*src_repetition_fr*/0,  /*src_startbit*/7,   /*sig_length*/1,  /*des_slotid_fr*/0,   /*des_basecycle_fr*/0,  /*des_repetition_fr*/0,   /*des_startbit*/7,    /*src_cyc*/101,  /*src_id*/0x70,   /*src_dlc*/8,   /*des_cyc*/150,   /*des_id*/0x353, /*src_updatebit*/4,   /*des_updatebit*/2,      /*initvalue*/1         },
           {   /*sig_name*/"isBltLockStAtRowSecLeBltLockSts_0",   /*src_can*/"ZCUD_CAN1",   /*src_network_type*/"CAN",   /*src_slotid_fr*/0,   /*src_basecycle_fr*/0,  /*src_repetition_fr*/0,  /*src_startbit*/5,   /*sig_length*/1,  /*des_slotid_fr*/0,   /*des_basecycle_fr*/0,  /*des_repetition_fr*/0,   /*des_startbit*/5,    /*src_cyc*/101,  /*src_id*/0x70,   /*src_dlc*/8,   /*des_cyc*/150,   /*des_id*/0x353, /*src_updatebit*/4,   /*des_updatebit*/2,      /*initvalue*/1         },
           {   /*sig_name*/"isBltLockStAtRowSecLeBltLockSt1_0",   /*src_can*/"ZCUD_CAN1",   /*src_network_type*/"CAN",   /*src_slotid_fr*/0,   /*src_basecycle_fr*/0,  /*src_repetition_fr*/0,  /*src_startbit*/6,   /*sig_length*/1,  /*des_slotid_fr*/0,   /*des_basecycle_fr*/0,  /*des_repetition_fr*/0,   /*des_startbit*/6,    /*src_cyc*/101,  /*src_id*/0x70,   /*src_dlc*/8,   /*des_cyc*/150,   /*des_id*/0x353, /*src_updatebit*/4,   /*des_updatebit*/2,      /*initvalue*/0         },
           {   /*sig_name*/"isDrvrGearShiftDirReq2Cntr_0",   /*src_can*/"PropulsionCAN",   /*src_network_type*/"CAN",   /*src_slotid_fr*/0,   /*src_basecycle_fr*/0,  /*src_repetition_fr*/0,  /*src_startbit*/35,   /*sig_length*/4,  /*des_slotid_fr*/0,   /*des_basecycle_fr*/0,  /*des_repetition_fr*/0,   /*des_startbit*/208,    /*src_cyc*/101,  /*src_id*/0x136,   /*src_dlc*/8,   /*des_cyc*/10,   /*des_id*/0x61, /*src_updatebit*/25,   /*des_updatebit*/417,      /*initvalue*/0         },
           {   /*sig_name*/"isDrvrGearShiftDirReq2Chks_0",   /*src_can*/"PropulsionCAN",   /*src_network_type*/"CAN",   /*src_slotid_fr*/0,   /*src_basecycle_fr*/0,  /*src_repetition_fr*/0,  /*src_startbit*/47,   /*sig_length*/8,  /*des_slotid_fr*/0,   /*des_basecycle_fr*/0,  /*des_repetition_fr*/0,   /*des_startbit*/200,    /*src_cyc*/101,  /*src_id*/0x136,   /*src_dlc*/8,   /*des_cyc*/10,   /*des_id*/0x61, /*src_updatebit*/25,   /*des_updatebit*/417,      /*initvalue*/0         },
           {   /*sig_name*/"isDrvrGearShiftDirReq2UpTipAut_0",   /*src_can*/"PropulsionCAN",   /*src_network_type*/"CAN",   /*src_slotid_fr*/0,   /*src_basecycle_fr*/0,  /*src_repetition_fr*/0,  /*src_startbit*/39,   /*sig_length*/1,  /*des_slotid_fr*/0,   /*des_basecycle_fr*/0,  /*des_repetition_fr*/0,   /*des_startbit*/217,    /*src_cyc*/101,  /*src_id*/0x136,   /*src_dlc*/8,   /*des_cyc*/10,   /*des_id*/0x61, /*src_updatebit*/25,   /*des_updatebit*/417,      /*initvalue*/0         },
           {   /*sig_name*/"isDrvrGearShiftDirReq2PosnAut_0",   /*src_can*/"PropulsionCAN",   /*src_network_type*/"CAN",   /*src_slotid_fr*/0,   /*src_basecycle_fr*/0,  /*src_repetition_fr*/0,  /*src_startbit*/38,   /*sig_length*/1,  /*des_slotid_fr*/0,   /*des_basecycle_fr*/0,  /*des_repetition_fr*/0,   /*des_startbit*/218,    /*src_cyc*/101,  /*src_id*/0x136,   /*src_dlc*/8,   /*des_cyc*/10,   /*des_id*/0x61, /*src_updatebit*/25,   /*des_updatebit*/417,      /*initvalue*/0         },
           {   /*sig_name*/"isDrvrGearShiftDirReq2DwnDwnTipAut_0",   /*src_can*/"PropulsionCAN",   /*src_network_type*/"CAN",   /*src_slotid_fr*/0,   /*src_basecycle_fr*/0,  /*src_repetition_fr*/0,  /*src_startbit*/36,   /*sig_length*/1,  /*des_slotid_fr*/0,   /*des_basecycle_fr*/0,  /*des_repetition_fr*/0,   /*des_startbit*/220,    /*src_cyc*/101,  /*src_id*/0x136,   /*src_dlc*/8,   /*des_cyc*/10,   /*des_id*/0x61, /*src_updatebit*/25,   /*des_updatebit*/417,      /*initvalue*/0         },
           {   /*sig_name*/"isDrvrGearShiftDirReq2UpUpTipAut_0",   /*src_can*/"PropulsionCAN",   /*src_network_type*/"CAN",   /*src_slotid_fr*/0,   /*src_basecycle_fr*/0,  /*src_repetition_fr*/0,  /*src_startbit*/24,   /*sig_length*/1,  /*des_slotid_fr*/0,   /*des_basecycle_fr*/0,  /*des_repetition_fr*/0,   /*des_startbit*/216,    /*src_cyc*/101,  /*src_id*/0x136,   /*src_dlc*/8,   /*des_cyc*/10,   /*des_id*/0x61, /*src_updatebit*/25,   /*des_updatebit*/417,      /*initvalue*/0         },
           {   /*sig_name*/"isDrvrGearShiftDirReq2DwnTipAut_0",   /*src_can*/"PropulsionCAN",   /*src_network_type*/"CAN",   /*src_slotid_fr*/0,   /*src_basecycle_fr*/0,  /*src_repetition_fr*/0,  /*src_startbit*/37,   /*sig_length*/1,  /*des_slotid_fr*/0,   /*des_basecycle_fr*/0,  /*des_repetition_fr*/0,   /*des_startbit*/219,    /*src_cyc*/101,  /*src_id*/0x136,   /*src_dlc*/8,   /*des_cyc*/10,   /*des_id*/0x61, /*src_updatebit*/25,   /*des_updatebit*/417,      /*initvalue*/0         },
           {   /*sig_name*/"isHvBattTMax_0",   /*src_can*/"PropulsionCAN",   /*src_network_type*/"CAN",   /*src_slotid_fr*/0,   /*src_basecycle_fr*/0,  /*src_repetition_fr*/0,  /*src_startbit*/10,   /*sig_length*/13,  /*des_slotid_fr*/0,   /*des_basecycle_fr*/0,  /*des_repetition_fr*/0,   /*des_startbit*/162,    /*src_cyc*/101,  /*src_id*/0x187,   /*src_dlc*/8,   /*des_cyc*/100,   /*des_id*/0x221, /*src_updatebit*/32,   /*des_updatebit*/184,      /*initvalue*/0         },
           {   /*sig_name*/"isHvBattTAvg_0",   /*src_can*/"PropulsionCAN",   /*src_network_type*/"CAN",   /*src_slotid_fr*/0,   /*src_basecycle_fr*/0,  /*src_repetition_fr*/0,  /*src_startbit*/7,   /*sig_length*/13,  /*des_slotid_fr*/0,   /*des_basecycle_fr*/0,  /*des_repetition_fr*/0,   /*des_startbit*/159,    /*src_cyc*/101,  /*src_id*/0x187,   /*src_dlc*/8,   /*des_cyc*/100,   /*des_id*/0x221, /*src_updatebit*/32,   /*des_updatebit*/184,      /*initvalue*/0         },
           {   /*sig_name*/"isHvBattTMin_0",   /*src_can*/"PropulsionCAN",   /*src_network_type*/"CAN",   /*src_slotid_fr*/0,   /*src_basecycle_fr*/0,  /*src_repetition_fr*/0,  /*src_startbit*/29,   /*sig_length*/13,  /*des_slotid_fr*/0,   /*des_basecycle_fr*/0,  /*des_repetition_fr*/0,   /*des_startbit*/181,    /*src_cyc*/101,  /*src_id*/0x187,   /*src_dlc*/8,   /*des_cyc*/100,   /*des_id*/0x221, /*src_updatebit*/32,   /*des_updatebit*/184,      /*initvalue*/0         },
           {   /*sig_name*/"isAMBStsQF_0",   /*src_can*/"CEM_LIN1",   /*src_network_type*/"LIN",   /*src_slotid_fr*/0,   /*src_basecycle_fr*/0,  /*src_repetition_fr*/0,  /*src_startbit*/56,   /*sig_length*/2,  /*des_slotid_fr*/0,   /*des_basecycle_fr*/0,  /*des_repetition_fr*/0,   /*des_startbit*/127,    /*src_cyc*/101,  /*src_id*/2,   /*src_dlc*/8,   /*des_cyc*/100,   /*des_id*/0x221, /*src_updatebit*/1000,   /*des_updatebit*/5,      /*initvalue*/1         },
           {   /*sig_name*/"isAMBStsFWLiIllmn_0",   /*src_can*/"CEM_LIN1",   /*src_network_type*/"LIN",   /*src_slotid_fr*/0,   /*src_basecycle_fr*/0,  /*src_repetition_fr*/0,  /*src_startbit*/44,   /*sig_length*/12,  /*des_slotid_fr*/0,   /*des_basecycle_fr*/0,  /*des_repetition_fr*/0,   /*des_startbit*/107,    /*src_cyc*/101,  /*src_id*/2,   /*src_dlc*/8,   /*des_cyc*/100,   /*des_id*/0x221, /*src_updatebit*/1000,   /*des_updatebit*/5,      /*initvalue*/0         },
           {   /*sig_name*/"isAMBStsAMBLiIllmn_0",   /*src_can*/"CEM_LIN1",   /*src_network_type*/"LIN",   /*src_slotid_fr*/0,   /*src_basecycle_fr*/0,  /*src_repetition_fr*/0,  /*src_startbit*/32,   /*sig_length*/12,  /*des_slotid_fr*/0,   /*des_basecycle_fr*/0,  /*des_repetition_fr*/0,   /*des_startbit*/103,    /*src_cyc*/101,  /*src_id*/2,   /*src_dlc*/8,   /*des_cyc*/100,   /*des_id*/0x221, /*src_updatebit*/1000,   /*des_updatebit*/5,      /*initvalue*/0         },
           {   /*sig_name*/"isTDcDcCoolt_0",   /*src_can*/"PropulsionCAN",   /*src_network_type*/"CAN",   /*src_slotid_fr*/0,   /*src_basecycle_fr*/0,  /*src_repetition_fr*/0,  /*src_startbit*/31,   /*sig_length*/8,  /*des_slotid_fr*/0,   /*des_basecycle_fr*/0,  /*des_repetition_fr*/0,   /*des_startbit*/95,    /*src_cyc*/101,  /*src_id*/0x455,   /*src_dlc*/8,   /*des_cyc*/100,   /*des_id*/0x221, /*src_updatebit*/16,   /*des_updatebit*/80,      /*initvalue*/40         },
           {   /*sig_name*/"isActvnStsOfRtrctrRvsbLe_0",   /*src_can*/"ZCUD_CAN1",   /*src_network_type*/"CAN",   /*src_slotid_fr*/0,   /*src_basecycle_fr*/0,  /*src_repetition_fr*/0,  /*src_startbit*/3,   /*sig_length*/1,  /*des_slotid_fr*/0,   /*des_basecycle_fr*/0,  /*des_repetition_fr*/0,   /*des_startbit*/20,    /*src_cyc*/101,  /*src_id*/0x153,   /*src_dlc*/8,   /*des_cyc*/40,   /*des_id*/0x1f1, /*src_updatebit*/6,   /*des_updatebit*/19,      /*initvalue*/0         },
           {   /*sig_name*/"isBltLockStAtPassBltLockSt1_0",   /*src_can*/"ZCUD_CAN1",   /*src_network_type*/"CAN",   /*src_slotid_fr*/0,   /*src_basecycle_fr*/0,  /*src_repetition_fr*/0,  /*src_startbit*/63,   /*sig_length*/1,  /*des_slotid_fr*/0,   /*des_basecycle_fr*/0,  /*des_repetition_fr*/0,   /*des_startbit*/4,    /*src_cyc*/101,  /*src_id*/0x89,   /*src_dlc*/8,   /*des_cyc*/100,   /*des_id*/0x221, /*src_updatebit*/6,   /*des_updatebit*/2,      /*initvalue*/1         },
           {   /*sig_name*/"isBltLockStAtPassBltLockSts_0",   /*src_can*/"ZCUD_CAN1",   /*src_network_type*/"CAN",   /*src_slotid_fr*/0,   /*src_basecycle_fr*/0,  /*src_repetition_fr*/0,  /*src_startbit*/62,   /*sig_length*/1,  /*des_slotid_fr*/0,   /*des_basecycle_fr*/0,  /*des_repetition_fr*/0,   /*des_startbit*/3,    /*src_cyc*/101,  /*src_id*/0x89,   /*src_dlc*/8,   /*des_cyc*/100,   /*des_id*/0x221, /*src_updatebit*/6,   /*des_updatebit*/2,      /*initvalue*/0         },
           {   /*sig_name*/"isPinionSteerAgGroupPinionSteerAg1Qf_0",   /*src_can*/"ChassisCAN1",   /*src_network_type*/"CAN",   /*src_slotid_fr*/0,   /*src_basecycle_fr*/0,  /*src_repetition_fr*/0,  /*src_startbit*/15,   /*sig_length*/2,  /*des_slotid_fr*/0,   /*des_basecycle_fr*/0,  /*des_repetition_fr*/0,   /*des_startbit*/333,    /*src_cyc*/101,  /*src_id*/0x4e,   /*src_dlc*/8,   /*des_cyc*/10,   /*des_id*/0x61, /*src_updatebit*/57,   /*des_updatebit*/448,      /*initvalue*/1         },
           {   /*sig_name*/"isPinionSteerAgGroupCntr_0",   /*src_can*/"ChassisCAN1",   /*src_network_type*/"CAN",   /*src_slotid_fr*/0,   /*src_basecycle_fr*/0,  /*src_repetition_fr*/0,  /*src_startbit*/63,   /*sig_length*/4,  /*des_slotid_fr*/0,   /*des_basecycle_fr*/0,  /*des_repetition_fr*/0,   /*des_startbit*/321,    /*src_cyc*/101,  /*src_id*/0x4e,   /*src_dlc*/8,   /*des_cyc*/10,   /*des_id*/0x61, /*src_updatebit*/57,   /*des_updatebit*/448,      /*initvalue*/0         },
           {   /*sig_name*/"isPinionSteerAgGroupSteerWhlTq_0",   /*src_can*/"ChassisCAN1",   /*src_network_type*/"CAN",   /*src_slotid_fr*/0,   /*src_basecycle_fr*/0,  /*src_repetition_fr*/0,  /*src_startbit*/29,   /*sig_length*/14,  /*des_slotid_fr*/0,   /*des_basecycle_fr*/0,  /*des_repetition_fr*/0,   /*des_startbit*/311,    /*src_cyc*/101,  /*src_id*/0x4e,   /*src_dlc*/8,   /*des_cyc*/10,   /*des_id*/0x61, /*src_updatebit*/57,   /*des_updatebit*/448,      /*initvalue*/0         },
           {   /*sig_name*/"isPinionSteerAgGroupPinionSteerAg1_0",   /*src_can*/"ChassisCAN1",   /*src_network_type*/"CAN",   /*src_slotid_fr*/0,   /*src_basecycle_fr*/0,  /*src_repetition_fr*/0,  /*src_startbit*/46,   /*sig_length*/15,  /*des_slotid_fr*/0,   /*des_basecycle_fr*/0,  /*des_repetition_fr*/0,   /*des_startbit*/276,    /*src_cyc*/101,  /*src_id*/0x4e,   /*src_dlc*/8,   /*des_cyc*/10,   /*des_id*/0x61, /*src_updatebit*/57,   /*des_updatebit*/448,      /*initvalue*/0         },
           {   /*sig_name*/"isPinionSteerAgGroupPinionSteerAgSpd1_0",   /*src_can*/"ChassisCAN1",   /*src_network_type*/"CAN",   /*src_slotid_fr*/0,   /*src_basecycle_fr*/0,  /*src_repetition_fr*/0,  /*src_startbit*/13,   /*sig_length*/14,  /*des_slotid_fr*/0,   /*des_basecycle_fr*/0,  /*des_repetition_fr*/0,   /*des_startbit*/293,    /*src_cyc*/101,  /*src_id*/0x4e,   /*src_dlc*/8,   /*des_cyc*/10,   /*des_id*/0x61, /*src_updatebit*/57,   /*des_updatebit*/448,      /*initvalue*/0         },
           {   /*sig_name*/"isPinionSteerAgGroupSteerWhlTqQf_0",   /*src_can*/"ChassisCAN1",   /*src_network_type*/"CAN",   /*src_slotid_fr*/0,   /*src_basecycle_fr*/0,  /*src_repetition_fr*/0,  /*src_startbit*/59,   /*sig_length*/2,  /*des_slotid_fr*/0,   /*des_basecycle_fr*/0,  /*des_repetition_fr*/0,   /*des_startbit*/329,    /*src_cyc*/101,  /*src_id*/0x4e,   /*src_dlc*/8,   /*des_cyc*/10,   /*des_id*/0x61, /*src_updatebit*/57,   /*des_updatebit*/448,      /*initvalue*/1         },
           {   /*sig_name*/"isPinionSteerAgGroupPinionSteerAgSpd1Qf_0",   /*src_can*/"ChassisCAN1",   /*src_network_type*/"CAN",   /*src_slotid_fr*/0,   /*src_basecycle_fr*/0,  /*src_repetition_fr*/0,  /*src_startbit*/31,   /*sig_length*/2,  /*des_slotid_fr*/0,   /*des_basecycle_fr*/0,  /*des_repetition_fr*/0,   /*des_startbit*/331,    /*src_cyc*/101,  /*src_id*/0x4e,   /*src_dlc*/8,   /*des_cyc*/10,   /*des_id*/0x61, /*src_updatebit*/57,   /*des_updatebit*/448,      /*initvalue*/1         },
           {   /*sig_name*/"isPinionSteerAgGroupChks_0",   /*src_can*/"ChassisCAN1",   /*src_network_type*/"CAN",   /*src_slotid_fr*/0,   /*src_basecycle_fr*/0,  /*src_repetition_fr*/0,  /*src_startbit*/7,   /*sig_length*/8,  /*des_slotid_fr*/0,   /*des_basecycle_fr*/0,  /*des_repetition_fr*/0,   /*des_startbit*/313,    /*src_cyc*/101,  /*src_id*/0x4e,   /*src_dlc*/8,   /*des_cyc*/10,   /*des_id*/0x61, /*src_updatebit*/57,   /*des_updatebit*/448,      /*initvalue*/0         },
           {   /*sig_name*/"isActvReSplrPosn_0",   /*src_can*/"CEM_LIN3",   /*src_network_type*/"LIN",   /*src_slotid_fr*/0,   /*src_basecycle_fr*/0,  /*src_repetition_fr*/0,  /*src_startbit*/0,   /*sig_length*/3,  /*des_slotid_fr*/0,   /*des_basecycle_fr*/0,  /*des_repetition_fr*/0,   /*des_startbit*/451,    /*src_cyc*/101,  /*src_id*/26,   /*src_dlc*/3,   /*des_cyc*/40,   /*des_id*/0x1f1, /*src_updatebit*/1000,   /*des_updatebit*/448,      /*initvalue*/0         },
           {   /*sig_name*/"isBltLockStAtRowThrdRiBltLockSts_0",   /*src_can*/"ZCUD_CAN1",   /*src_network_type*/"CAN",   /*src_slotid_fr*/0,   /*src_basecycle_fr*/0,  /*src_repetition_fr*/0,  /*src_startbit*/21,   /*sig_length*/1,  /*des_slotid_fr*/0,   /*des_basecycle_fr*/0,  /*des_repetition_fr*/0,   /*des_startbit*/18,    /*src_cyc*/101,  /*src_id*/0x70,   /*src_dlc*/8,   /*des_cyc*/150,   /*des_id*/0x353, /*src_updatebit*/20,   /*des_updatebit*/9,      /*initvalue*/1         },
           {   /*sig_name*/"isBltLockStAtRowThrdRiBltLockEquid_0",   /*src_can*/"ZCUD_CAN1",   /*src_network_type*/"CAN",   /*src_slotid_fr*/0,   /*src_basecycle_fr*/0,  /*src_repetition_fr*/0,  /*src_startbit*/23,   /*sig_length*/1,  /*des_slotid_fr*/0,   /*des_basecycle_fr*/0,  /*des_repetition_fr*/0,   /*des_startbit*/20,    /*src_cyc*/101,  /*src_id*/0x70,   /*src_dlc*/8,   /*des_cyc*/150,   /*des_id*/0x353, /*src_updatebit*/20,   /*des_updatebit*/9,      /*initvalue*/1         },
           {   /*sig_name*/"isBltLockStAtRowThrdRiBltLockSt1_0",   /*src_can*/"ZCUD_CAN1",   /*src_network_type*/"CAN",   /*src_slotid_fr*/0,   /*src_basecycle_fr*/0,  /*src_repetition_fr*/0,  /*src_startbit*/22,   /*sig_length*/1,  /*des_slotid_fr*/0,   /*des_basecycle_fr*/0,  /*des_repetition_fr*/0,   /*des_startbit*/19,    /*src_cyc*/101,  /*src_id*/0x70,   /*src_dlc*/8,   /*des_cyc*/150,   /*des_id*/0x353, /*src_updatebit*/20,   /*des_updatebit*/9,      /*initvalue*/0         },
           {   /*sig_name*/"isTwliBriRawQf_0",   /*src_can*/"CEM_LIN1",   /*src_network_type*/"LIN",   /*src_slotid_fr*/0,   /*src_basecycle_fr*/0,  /*src_repetition_fr*/0,  /*src_startbit*/24,   /*sig_length*/2,  /*des_slotid_fr*/0,   /*des_basecycle_fr*/0,  /*des_repetition_fr*/0,   /*des_startbit*/223,    /*src_cyc*/101,  /*src_id*/21,   /*src_dlc*/8,   /*des_cyc*/40,   /*des_id*/0x1f1, /*src_updatebit*/1000,   /*des_updatebit*/233,      /*initvalue*/1         },
           {   /*sig_name*/"isTwliBriRawTwliBriRaw_0",   /*src_can*/"CEM_LIN1",   /*src_network_type*/"LIN",   /*src_slotid_fr*/0,   /*src_basecycle_fr*/0,  /*src_repetition_fr*/0,  /*src_startbit*/26,   /*sig_length*/14,  /*des_slotid_fr*/0,   /*des_basecycle_fr*/0,  /*des_repetition_fr*/0,   /*des_startbit*/221,    /*src_cyc*/101,  /*src_id*/21,   /*src_dlc*/8,   /*des_cyc*/40,   /*des_id*/0x1f1, /*src_updatebit*/1000,   /*des_updatebit*/233,      /*initvalue*/0         },
           {   /*sig_name*/"isAccrPedlRatCntr_0",   /*src_can*/"ChassisCANFD2",   /*src_network_type*/"CANFD",   /*src_slotid_fr*/0,   /*src_basecycle_fr*/0,  /*src_repetition_fr*/0,  /*src_startbit*/115,   /*sig_length*/4,  /*des_slotid_fr*/0,   /*des_basecycle_fr*/0,  /*des_repetition_fr*/0,   /*des_startbit*/16,    /*src_cyc*/101,  /*src_id*/0xde,   /*src_dlc*/64,   /*des_cyc*/20,   /*des_id*/0x106, /*src_updatebit*/168,   /*des_updatebit*/105,      /*initvalue*/0         },
           {   /*sig_name*/"isAccrPedlRatChks_0",   /*src_can*/"ChassisCANFD2",   /*src_network_type*/"CANFD",   /*src_slotid_fr*/0,   /*src_basecycle_fr*/0,  /*src_repetition_fr*/0,  /*src_startbit*/107,   /*sig_length*/8,  /*des_slotid_fr*/0,   /*des_basecycle_fr*/0,  /*des_repetition_fr*/0,   /*des_startbit*/8,    /*src_cyc*/101,  /*src_id*/0xde,   /*src_dlc*/64,   /*des_cyc*/20,   /*des_id*/0x106, /*src_updatebit*/168,   /*des_updatebit*/105,      /*initvalue*/0         },
           {   /*sig_name*/"isAccrPedlRatAccrPedlRat_0",   /*src_can*/"ChassisCANFD2",   /*src_network_type*/"CANFD",   /*src_slotid_fr*/0,   /*src_basecycle_fr*/0,  /*src_repetition_fr*/0,  /*src_startbit*/90,   /*sig_length*/15,  /*des_slotid_fr*/0,   /*des_basecycle_fr*/0,  /*des_repetition_fr*/0,   /*des_startbit*/7,    /*src_cyc*/101,  /*src_id*/0xde,   /*src_dlc*/64,   /*des_cyc*/20,   /*des_id*/0x106, /*src_updatebit*/168,   /*des_updatebit*/105,      /*initvalue*/0         },
           {   /*sig_name*/"isDCChrgnHndlSts_0",   /*src_can*/"PropulsionCAN",   /*src_network_type*/"CAN",   /*src_slotid_fr*/0,   /*src_basecycle_fr*/0,  /*src_repetition_fr*/0,  /*src_startbit*/3,   /*sig_length*/3,  /*des_slotid_fr*/0,   /*des_basecycle_fr*/0,  /*des_repetition_fr*/0,   /*des_startbit*/55,    /*src_cyc*/101,  /*src_id*/0x141,   /*src_dlc*/8,   /*des_cyc*/150,   /*des_id*/0x353, /*src_updatebit*/0,   /*des_updatebit*/16,      /*initvalue*/4         },
           {   /*sig_name*/"isJIDByte3_0",   /*src_can*/"ZCUD_CAN1",   /*src_network_type*/"CAN",   /*src_slotid_fr*/0,   /*src_basecycle_fr*/0,  /*src_repetition_fr*/0,  /*src_startbit*/31,   /*sig_length*/8,  /*des_slotid_fr*/0,   /*des_basecycle_fr*/0,  /*des_repetition_fr*/0,   /*des_startbit*/39,    /*src_cyc*/101,  /*src_id*/0x22a,   /*src_dlc*/8,   /*des_cyc*/300,   /*des_id*/0x363, /*src_updatebit*/1000,   /*des_updatebit*/3,      /*initvalue*/255         },
           {   /*sig_name*/"isJIDByte0_0",   /*src_can*/"ZCUD_CAN1",   /*src_network_type*/"CAN",   /*src_slotid_fr*/0,   /*src_basecycle_fr*/0,  /*src_repetition_fr*/0,  /*src_startbit*/7,   /*sig_length*/8,  /*des_slotid_fr*/0,   /*des_basecycle_fr*/0,  /*des_repetition_fr*/0,   /*des_startbit*/15,    /*src_cyc*/101,  /*src_id*/0x22a,   /*src_dlc*/8,   /*des_cyc*/300,   /*des_id*/0x363, /*src_updatebit*/1000,   /*des_updatebit*/3,      /*initvalue*/255         },
           {   /*sig_name*/"isJIDByte7_0",   /*src_can*/"ZCUD_CAN1",   /*src_network_type*/"CAN",   /*src_slotid_fr*/0,   /*src_basecycle_fr*/0,  /*src_repetition_fr*/0,  /*src_startbit*/63,   /*sig_length*/8,  /*des_slotid_fr*/0,   /*des_basecycle_fr*/0,  /*des_repetition_fr*/0,   /*des_startbit*/71,    /*src_cyc*/101,  /*src_id*/0x22a,   /*src_dlc*/8,   /*des_cyc*/300,   /*des_id*/0x363, /*src_updatebit*/1000,   /*des_updatebit*/3,      /*initvalue*/255         },
           {   /*sig_name*/"isJIDByte2_0",   /*src_can*/"ZCUD_CAN1",   /*src_network_type*/"CAN",   /*src_slotid_fr*/0,   /*src_basecycle_fr*/0,  /*src_repetition_fr*/0,  /*src_startbit*/23,   /*sig_length*/8,  /*des_slotid_fr*/0,   /*des_basecycle_fr*/0,  /*des_repetition_fr*/0,   /*des_startbit*/31,    /*src_cyc*/101,  /*src_id*/0x22a,   /*src_dlc*/8,   /*des_cyc*/300,   /*des_id*/0x363, /*src_updatebit*/1000,   /*des_updatebit*/3,      /*initvalue*/255         },
           {   /*sig_name*/"isJIDByte6_0",   /*src_can*/"ZCUD_CAN1",   /*src_network_type*/"CAN",   /*src_slotid_fr*/0,   /*src_basecycle_fr*/0,  /*src_repetition_fr*/0,  /*src_startbit*/55,   /*sig_length*/8,  /*des_slotid_fr*/0,   /*des_basecycle_fr*/0,  /*des_repetition_fr*/0,   /*des_startbit*/63,    /*src_cyc*/101,  /*src_id*/0x22a,   /*src_dlc*/8,   /*des_cyc*/300,   /*des_id*/0x363, /*src_updatebit*/1000,   /*des_updatebit*/3,      /*initvalue*/255         },
           {   /*sig_name*/"isJIDByte4_0",   /*src_can*/"ZCUD_CAN1",   /*src_network_type*/"CAN",   /*src_slotid_fr*/0,   /*src_basecycle_fr*/0,  /*src_repetition_fr*/0,  /*src_startbit*/39,   /*sig_length*/8,  /*des_slotid_fr*/0,   /*des_basecycle_fr*/0,  /*des_repetition_fr*/0,   /*des_startbit*/47,    /*src_cyc*/101,  /*src_id*/0x22a,   /*src_dlc*/8,   /*des_cyc*/300,   /*des_id*/0x363, /*src_updatebit*/1000,   /*des_updatebit*/3,      /*initvalue*/255         },
           {   /*sig_name*/"isJIDByte5_0",   /*src_can*/"ZCUD_CAN1",   /*src_network_type*/"CAN",   /*src_slotid_fr*/0,   /*src_basecycle_fr*/0,  /*src_repetition_fr*/0,  /*src_startbit*/47,   /*sig_length*/8,  /*des_slotid_fr*/0,   /*des_basecycle_fr*/0,  /*des_repetition_fr*/0,   /*des_startbit*/55,    /*src_cyc*/101,  /*src_id*/0x22a,   /*src_dlc*/8,   /*des_cyc*/300,   /*des_id*/0x363, /*src_updatebit*/1000,   /*des_updatebit*/3,      /*initvalue*/255         },
           {   /*sig_name*/"isJIDByte1_0",   /*src_can*/"ZCUD_CAN1",   /*src_network_type*/"CAN",   /*src_slotid_fr*/0,   /*src_basecycle_fr*/0,  /*src_repetition_fr*/0,  /*src_startbit*/15,   /*sig_length*/8,  /*des_slotid_fr*/0,   /*des_basecycle_fr*/0,  /*des_repetition_fr*/0,   /*des_startbit*/23,    /*src_cyc*/101,  /*src_id*/0x22a,   /*src_dlc*/8,   /*des_cyc*/300,   /*des_id*/0x363, /*src_updatebit*/1000,   /*des_updatebit*/3,      /*initvalue*/255         },
           {   /*sig_name*/"isDrvrDesDirDrvrDesDir_0",   /*src_can*/"ChassisCAN1",   /*src_network_type*/"CAN",   /*src_slotid_fr*/0,   /*src_basecycle_fr*/0,  /*src_repetition_fr*/0,  /*src_startbit*/27,   /*sig_length*/3,  /*des_slotid_fr*/0,   /*des_basecycle_fr*/0,  /*des_repetition_fr*/0,   /*des_startbit*/155,    /*src_cyc*/101,  /*src_id*/0x76,   /*src_dlc*/8,   /*des_cyc*/70,   /*des_id*/0x243, /*src_updatebit*/24,   /*des_updatebit*/152,      /*initvalue*/0         },
           {   /*sig_name*/"isDrvrDesDirChks_0",   /*src_can*/"ChassisCAN1",   /*src_network_type*/"CAN",   /*src_slotid_fr*/0,   /*src_basecycle_fr*/0,  /*src_repetition_fr*/0,  /*src_startbit*/23,   /*sig_length*/8,  /*des_slotid_fr*/0,   /*des_basecycle_fr*/0,  /*des_repetition_fr*/0,   /*des_startbit*/151,    /*src_cyc*/101,  /*src_id*/0x76,   /*src_dlc*/8,   /*des_cyc*/70,   /*des_id*/0x243, /*src_updatebit*/24,   /*des_updatebit*/152,      /*initvalue*/0         },
           {   /*sig_name*/"isDrvrDesDirCntr_0",   /*src_can*/"ChassisCAN1",   /*src_network_type*/"CAN",   /*src_slotid_fr*/0,   /*src_basecycle_fr*/0,  /*src_repetition_fr*/0,  /*src_startbit*/31,   /*sig_length*/4,  /*des_slotid_fr*/0,   /*des_basecycle_fr*/0,  /*des_repetition_fr*/0,   /*des_startbit*/159,    /*src_cyc*/101,  /*src_id*/0x76,   /*src_dlc*/8,   /*des_cyc*/70,   /*des_id*/0x243, /*src_updatebit*/24,   /*des_updatebit*/152,      /*initvalue*/0         },
           {   /*sig_name*/"isActvReSplrIceBreakFaild_0",   /*src_can*/"CEM_LIN3",   /*src_network_type*/"LIN",   /*src_slotid_fr*/0,   /*src_basecycle_fr*/0,  /*src_repetition_fr*/0,  /*src_startbit*/5,   /*sig_length*/1,  /*des_slotid_fr*/0,   /*des_basecycle_fr*/0,  /*des_repetition_fr*/0,   /*des_startbit*/455,    /*src_cyc*/101,  /*src_id*/26,   /*src_dlc*/3,   /*des_cyc*/40,   /*des_id*/0x1f1, /*src_updatebit*/1000,   /*des_updatebit*/454,      /*initvalue*/0         },
           {   /*sig_name*/"isEngTiOn_0",   /*src_can*/"PropulsionCAN",   /*src_network_type*/"CAN",   /*src_slotid_fr*/0,   /*src_basecycle_fr*/0,  /*src_repetition_fr*/0,  /*src_startbit*/7,   /*sig_length*/16,  /*des_slotid_fr*/0,   /*des_basecycle_fr*/0,  /*des_repetition_fr*/0,   /*des_startbit*/39,    /*src_cyc*/101,  /*src_id*/0x2a5,   /*src_dlc*/8,   /*des_cyc*/400,   /*des_id*/0x3a3, /*src_updatebit*/20,   /*des_updatebit*/5,      /*initvalue*/0         },
           {   /*sig_name*/"isTwbrLockdPosn_0",   /*src_can*/"ZCUD_CAN1",   /*src_network_type*/"CAN",   /*src_slotid_fr*/0,   /*src_basecycle_fr*/0,  /*src_repetition_fr*/0,  /*src_startbit*/10,   /*sig_length*/2,  /*des_slotid_fr*/0,   /*des_basecycle_fr*/0,  /*des_repetition_fr*/0,   /*des_startbit*/4,    /*src_cyc*/101,  /*src_id*/0x91,   /*src_dlc*/8,   /*des_cyc*/150,   /*des_id*/0x353, /*src_updatebit*/8,   /*des_updatebit*/64,      /*initvalue*/0         },
           {   /*sig_name*/"isRWATarPinionAgR1RefPinionAg_0",   /*src_can*/"ZCUD_CANFD3",   /*src_network_type*/"CANFD",   /*src_slotid_fr*/0,   /*src_basecycle_fr*/0,  /*src_repetition_fr*/0,  /*src_startbit*/20,   /*sig_length*/15,  /*des_slotid_fr*/0,   /*des_basecycle_fr*/0,  /*des_repetition_fr*/0,   /*des_startbit*/407,    /*src_cyc*/101,  /*src_id*/0x110,   /*src_dlc*/64,   /*des_cyc*/10,   /*des_id*/0x61, /*src_updatebit*/35,   /*des_updatebit*/474,      /*initvalue*/0         },
           {   /*sig_name*/"isRWATarPinionAgR1Qf_0",   /*src_can*/"ZCUD_CANFD3",   /*src_network_type*/"CANFD",   /*src_slotid_fr*/0,   /*src_basecycle_fr*/0,  /*src_repetition_fr*/0,  /*src_startbit*/37,   /*sig_length*/2,  /*des_slotid_fr*/0,   /*des_basecycle_fr*/0,  /*des_repetition_fr*/0,   /*des_startbit*/423,    /*src_cyc*/101,  /*src_id*/0x110,   /*src_dlc*/64,   /*des_cyc*/10,   /*des_id*/0x61, /*src_updatebit*/35,   /*des_updatebit*/474,      /*initvalue*/1         },
           {   /*sig_name*/"isSwtFogLiFr_0",   /*src_can*/"ChassisCAN1",   /*src_network_type*/"CAN",   /*src_slotid_fr*/0,   /*src_basecycle_fr*/0,  /*src_repetition_fr*/0,  /*src_startbit*/39,   /*sig_length*/1,  /*des_slotid_fr*/0,   /*des_basecycle_fr*/0,  /*des_repetition_fr*/0,   /*des_startbit*/123,    /*src_cyc*/101,  /*src_id*/0x2e6,   /*src_dlc*/8,   /*des_cyc*/40,   /*des_id*/0x1f1, /*src_updatebit*/38,   /*des_updatebit*/122,      /*initvalue*/0         }
       }
   },
   {
       /*des_can*/ "ZCUD_CANFD3",
       /*networktype*/ "CANFD",
       40,
       {
           {   /*sig_name*/"isBkpOfDstTrvld_0",   /*src_can*/"ZCU_CANFD1",   /*src_network_type*/"CANFD",   /*src_slotid_fr*/0,   /*src_basecycle_fr*/0,  /*src_repetition_fr*/0,  /*src_startbit*/5,   /*sig_length*/21,  /*des_slotid_fr*/0,   /*des_basecycle_fr*/0,  /*des_repetition_fr*/0,   /*des_startbit*/63,    /*src_cyc*/101,  /*src_id*/0x160,   /*src_dlc*/64,   /*des_cyc*/1000,   /*des_id*/0x495, /*src_updatebit*/16,   /*des_updatebit*/74,      /*initvalue*/0         },
           {   /*sig_name*/"isCmptmtTFrntFanForCmptmtTRunng_0",   /*src_can*/"ZCU_CANFD1",   /*src_network_type*/"CANFD",   /*src_slotid_fr*/0,   /*src_basecycle_fr*/0,  /*src_repetition_fr*/0,  /*src_startbit*/50,   /*sig_length*/1,  /*des_slotid_fr*/0,   /*des_basecycle_fr*/0,  /*des_repetition_fr*/0,   /*des_startbit*/10,    /*src_cyc*/101,  /*src_id*/0x212,   /*src_dlc*/64,   /*des_cyc*/150,   /*des_id*/0x2f0, /*src_updatebit*/49,   /*des_updatebit*/9,      /*initvalue*/0         },
           {   /*sig_name*/"isCmptmtTFrntQf_0",   /*src_can*/"ZCU_CANFD1",   /*src_network_type*/"CANFD",   /*src_slotid_fr*/0,   /*src_basecycle_fr*/0,  /*src_repetition_fr*/0,  /*src_startbit*/52,   /*sig_length*/2,  /*des_slotid_fr*/0,   /*des_basecycle_fr*/0,  /*des_repetition_fr*/0,   /*des_startbit*/12,    /*src_cyc*/101,  /*src_id*/0x212,   /*src_dlc*/64,   /*des_cyc*/150,   /*des_id*/0x2f0, /*src_updatebit*/49,   /*des_updatebit*/9,      /*initvalue*/1         },
           {   /*sig_name*/"isCmptmtTFrntCmptmtTFrnt_0",   /*src_can*/"ZCU_CANFD1",   /*src_network_type*/"CANFD",   /*src_slotid_fr*/0,   /*src_basecycle_fr*/0,  /*src_repetition_fr*/0,  /*src_startbit*/47,   /*sig_length*/11,  /*des_slotid_fr*/0,   /*des_basecycle_fr*/0,  /*des_repetition_fr*/0,   /*des_startbit*/7,    /*src_cyc*/101,  /*src_id*/0x212,   /*src_dlc*/64,   /*des_cyc*/150,   /*des_id*/0x2f0, /*src_updatebit*/49,   /*des_updatebit*/9,      /*initvalue*/600         },
           {   /*sig_name*/"isVehCfgPrmExtCCPBytePosn8_0",   /*src_can*/"ZCU_CANFD1",   /*src_network_type*/"CANFD",   /*src_slotid_fr*/0,   /*src_basecycle_fr*/0,  /*src_repetition_fr*/0,  /*src_startbit*/127,   /*sig_length*/8,  /*des_slotid_fr*/0,   /*des_basecycle_fr*/0,  /*des_repetition_fr*/0,   /*des_startbit*/127,    /*src_cyc*/101,  /*src_id*/0x1f5,   /*src_dlc*/64,   /*des_cyc*/Event,   /*des_id*/0x225, /*src_updatebit*/198,   /*des_updatebit*/362,      /*initvalue*/0         },
           {   /*sig_name*/"isVehCfgPrmExtCCPBytePosn6_0",   /*src_can*/"ZCU_CANFD1",   /*src_network_type*/"CANFD",   /*src_slotid_fr*/0,   /*src_basecycle_fr*/0,  /*src_repetition_fr*/0,  /*src_startbit*/111,   /*sig_length*/8,  /*des_slotid_fr*/0,   /*des_basecycle_fr*/0,  /*des_repetition_fr*/0,   /*des_startbit*/111,    /*src_cyc*/101,  /*src_id*/0x1f5,   /*src_dlc*/64,   /*des_cyc*/Event,   /*des_id*/0x225, /*src_updatebit*/198,   /*des_updatebit*/362,      /*initvalue*/0         },
           {   /*sig_name*/"isVehCfgPrmExtCCPBytePosn4_0",   /*src_can*/"ZCU_CANFD1",   /*src_network_type*/"CANFD",   /*src_slotid_fr*/0,   /*src_basecycle_fr*/0,  /*src_repetition_fr*/0,  /*src_startbit*/95,   /*sig_length*/8,  /*des_slotid_fr*/0,   /*des_basecycle_fr*/0,  /*des_repetition_fr*/0,   /*des_startbit*/95,    /*src_cyc*/101,  /*src_id*/0x1f5,   /*src_dlc*/64,   /*des_cyc*/Event,   /*des_id*/0x225, /*src_updatebit*/198,   /*des_updatebit*/362,      /*initvalue*/0         },
           {   /*sig_name*/"isVehCfgPrmExtCCPBytePosn3_0",   /*src_can*/"ZCU_CANFD1",   /*src_network_type*/"CANFD",   /*src_slotid_fr*/0,   /*src_basecycle_fr*/0,  /*src_repetition_fr*/0,  /*src_startbit*/87,   /*sig_length*/8,  /*des_slotid_fr*/0,   /*des_basecycle_fr*/0,  /*des_repetition_fr*/0,   /*des_startbit*/87,    /*src_cyc*/101,  /*src_id*/0x1f5,   /*src_dlc*/64,   /*des_cyc*/Event,   /*des_id*/0x225, /*src_updatebit*/198,   /*des_updatebit*/362,      /*initvalue*/0         },
           {   /*sig_name*/"isVehCfgPrmExtCCPBytePosn2_0",   /*src_can*/"ZCU_CANFD1",   /*src_network_type*/"CANFD",   /*src_slotid_fr*/0,   /*src_basecycle_fr*/0,  /*src_repetition_fr*/0,  /*src_startbit*/79,   /*sig_length*/8,  /*des_slotid_fr*/0,   /*des_basecycle_fr*/0,  /*des_repetition_fr*/0,   /*des_startbit*/79,    /*src_cyc*/101,  /*src_id*/0x1f5,   /*src_dlc*/64,   /*des_cyc*/Event,   /*des_id*/0x225, /*src_updatebit*/198,   /*des_updatebit*/362,      /*initvalue*/0         },
           {   /*sig_name*/"isVehCfgPrmExtBlkIDBytePosn1_0",   /*src_can*/"ZCU_CANFD1",   /*src_network_type*/"CANFD",   /*src_slotid_fr*/0,   /*src_basecycle_fr*/0,  /*src_repetition_fr*/0,  /*src_startbit*/71,   /*sig_length*/8,  /*des_slotid_fr*/0,   /*des_basecycle_fr*/0,  /*des_repetition_fr*/0,   /*des_startbit*/71,    /*src_cyc*/101,  /*src_id*/0x1f5,   /*src_dlc*/64,   /*des_cyc*/Event,   /*des_id*/0x225, /*src_updatebit*/198,   /*des_updatebit*/362,      /*initvalue*/0         },
           {   /*sig_name*/"isVehCfgPrmExtCCPBytePosn5_0",   /*src_can*/"ZCU_CANFD1",   /*src_network_type*/"CANFD",   /*src_slotid_fr*/0,   /*src_basecycle_fr*/0,  /*src_repetition_fr*/0,  /*src_startbit*/103,   /*sig_length*/8,  /*des_slotid_fr*/0,   /*des_basecycle_fr*/0,  /*des_repetition_fr*/0,   /*des_startbit*/103,    /*src_cyc*/101,  /*src_id*/0x1f5,   /*src_dlc*/64,   /*des_cyc*/Event,   /*des_id*/0x225, /*src_updatebit*/198,   /*des_updatebit*/362,      /*initvalue*/0         },
           {   /*sig_name*/"isVehCfgPrmExtCCPBytePosn7_0",   /*src_can*/"ZCU_CANFD1",   /*src_network_type*/"CANFD",   /*src_slotid_fr*/0,   /*src_basecycle_fr*/0,  /*src_repetition_fr*/0,  /*src_startbit*/119,   /*sig_length*/8,  /*des_slotid_fr*/0,   /*des_basecycle_fr*/0,  /*des_repetition_fr*/0,   /*des_startbit*/119,    /*src_cyc*/101,  /*src_id*/0x1f5,   /*src_dlc*/64,   /*des_cyc*/Event,   /*des_id*/0x225, /*src_updatebit*/198,   /*des_updatebit*/362,      /*initvalue*/0         },
           {   /*sig_name*/"isVehCfgPrmExt2BlkIDBytePosn1_0",   /*src_can*/"ZCU_CANFD1",   /*src_network_type*/"CANFD",   /*src_slotid_fr*/0,   /*src_basecycle_fr*/0,  /*src_repetition_fr*/0,  /*src_startbit*/135,   /*sig_length*/8,  /*des_slotid_fr*/0,   /*des_basecycle_fr*/0,  /*des_repetition_fr*/0,   /*des_startbit*/135,    /*src_cyc*/101,  /*src_id*/0x1f5,   /*src_dlc*/64,   /*des_cyc*/Event,   /*des_id*/0x225, /*src_updatebit*/197,   /*des_updatebit*/361,      /*initvalue*/0         },
           {   /*sig_name*/"isVehCfgPrmExt2CCPBytePosn2_0",   /*src_can*/"ZCU_CANFD1",   /*src_network_type*/"CANFD",   /*src_slotid_fr*/0,   /*src_basecycle_fr*/0,  /*src_repetition_fr*/0,  /*src_startbit*/143,   /*sig_length*/8,  /*des_slotid_fr*/0,   /*des_basecycle_fr*/0,  /*des_repetition_fr*/0,   /*des_startbit*/143,    /*src_cyc*/101,  /*src_id*/0x1f5,   /*src_dlc*/64,   /*des_cyc*/Event,   /*des_id*/0x225, /*src_updatebit*/197,   /*des_updatebit*/361,      /*initvalue*/0         },
           {   /*sig_name*/"isVehCfgPrmExt2CCPBytePosn6_0",   /*src_can*/"ZCU_CANFD1",   /*src_network_type*/"CANFD",   /*src_slotid_fr*/0,   /*src_basecycle_fr*/0,  /*src_repetition_fr*/0,  /*src_startbit*/175,   /*sig_length*/8,  /*des_slotid_fr*/0,   /*des_basecycle_fr*/0,  /*des_repetition_fr*/0,   /*des_startbit*/175,    /*src_cyc*/101,  /*src_id*/0x1f5,   /*src_dlc*/64,   /*des_cyc*/Event,   /*des_id*/0x225, /*src_updatebit*/197,   /*des_updatebit*/361,      /*initvalue*/0         },
           {   /*sig_name*/"isVehCfgPrmExt2CCPBytePosn4_0",   /*src_can*/"ZCU_CANFD1",   /*src_network_type*/"CANFD",   /*src_slotid_fr*/0,   /*src_basecycle_fr*/0,  /*src_repetition_fr*/0,  /*src_startbit*/159,   /*sig_length*/8,  /*des_slotid_fr*/0,   /*des_basecycle_fr*/0,  /*des_repetition_fr*/0,   /*des_startbit*/159,    /*src_cyc*/101,  /*src_id*/0x1f5,   /*src_dlc*/64,   /*des_cyc*/Event,   /*des_id*/0x225, /*src_updatebit*/197,   /*des_updatebit*/361,      /*initvalue*/0         },
           {   /*sig_name*/"isVehCfgPrmExt2CCPBytePosn5_0",   /*src_can*/"ZCU_CANFD1",   /*src_network_type*/"CANFD",   /*src_slotid_fr*/0,   /*src_basecycle_fr*/0,  /*src_repetition_fr*/0,  /*src_startbit*/167,   /*sig_length*/8,  /*des_slotid_fr*/0,   /*des_basecycle_fr*/0,  /*des_repetition_fr*/0,   /*des_startbit*/167,    /*src_cyc*/101,  /*src_id*/0x1f5,   /*src_dlc*/64,   /*des_cyc*/Event,   /*des_id*/0x225, /*src_updatebit*/197,   /*des_updatebit*/361,      /*initvalue*/0         },
           {   /*sig_name*/"isVehCfgPrmExt2CCPBytePosn3_0",   /*src_can*/"ZCU_CANFD1",   /*src_network_type*/"CANFD",   /*src_slotid_fr*/0,   /*src_basecycle_fr*/0,  /*src_repetition_fr*/0,  /*src_startbit*/151,   /*sig_length*/8,  /*des_slotid_fr*/0,   /*des_basecycle_fr*/0,  /*des_repetition_fr*/0,   /*des_startbit*/151,    /*src_cyc*/101,  /*src_id*/0x1f5,   /*src_dlc*/64,   /*des_cyc*/Event,   /*des_id*/0x225, /*src_updatebit*/197,   /*des_updatebit*/361,      /*initvalue*/0         },
           {   /*sig_name*/"isVehCfgPrmExt2CCPBytePosn7_0",   /*src_can*/"ZCU_CANFD1",   /*src_network_type*/"CANFD",   /*src_slotid_fr*/0,   /*src_basecycle_fr*/0,  /*src_repetition_fr*/0,  /*src_startbit*/183,   /*sig_length*/8,  /*des_slotid_fr*/0,   /*des_basecycle_fr*/0,  /*des_repetition_fr*/0,   /*des_startbit*/183,    /*src_cyc*/101,  /*src_id*/0x1f5,   /*src_dlc*/64,   /*des_cyc*/Event,   /*des_id*/0x225, /*src_updatebit*/197,   /*des_updatebit*/361,      /*initvalue*/0         },
           {   /*sig_name*/"isVehCfgPrmExt2CCPBytePosn8_0",   /*src_can*/"ZCU_CANFD1",   /*src_network_type*/"CANFD",   /*src_slotid_fr*/0,   /*src_basecycle_fr*/0,  /*src_repetition_fr*/0,  /*src_startbit*/191,   /*sig_length*/8,  /*des_slotid_fr*/0,   /*des_basecycle_fr*/0,  /*des_repetition_fr*/0,   /*des_startbit*/191,    /*src_cyc*/101,  /*src_id*/0x1f5,   /*src_dlc*/64,   /*des_cyc*/Event,   /*des_id*/0x225, /*src_updatebit*/197,   /*des_updatebit*/361,      /*initvalue*/0         },
           {   /*sig_name*/"isDrvModReq_0",   /*src_can*/"ZCU_CANFD1",   /*src_network_type*/"CANFD",   /*src_slotid_fr*/0,   /*src_basecycle_fr*/0,  /*src_repetition_fr*/0,  /*src_startbit*/119,   /*sig_length*/5,  /*des_slotid_fr*/0,   /*des_basecycle_fr*/0,  /*des_repetition_fr*/0,   /*des_startbit*/127,    /*src_cyc*/101,  /*src_id*/0x105,   /*src_dlc*/64,   /*des_cyc*/100,   /*des_id*/0x239, /*src_updatebit*/178,   /*des_updatebit*/122,      /*initvalue*/0         },
           {   /*sig_name*/"isVehMtnStCntr_0",   /*src_can*/"ZCU_CANFD1",   /*src_network_type*/"CANFD",   /*src_slotid_fr*/0,   /*src_basecycle_fr*/0,  /*src_repetition_fr*/0,  /*src_startbit*/423,   /*sig_length*/4,  /*des_slotid_fr*/0,   /*des_basecycle_fr*/0,  /*des_repetition_fr*/0,   /*des_startbit*/215,    /*src_cyc*/101,  /*src_id*/0x82,   /*src_dlc*/64,   /*des_cyc*/10,   /*des_id*/0x55, /*src_updatebit*/416,   /*des_updatebit*/208,      /*initvalue*/0         },
           {   /*sig_name*/"isVehMtnStVehMtnSt_0",   /*src_can*/"ZCU_CANFD1",   /*src_network_type*/"CANFD",   /*src_slotid_fr*/0,   /*src_basecycle_fr*/0,  /*src_repetition_fr*/0,  /*src_startbit*/419,   /*sig_length*/3,  /*des_slotid_fr*/0,   /*des_basecycle_fr*/0,  /*des_repetition_fr*/0,   /*des_startbit*/211,    /*src_cyc*/101,  /*src_id*/0x82,   /*src_dlc*/64,   /*des_cyc*/10,   /*des_id*/0x55, /*src_updatebit*/416,   /*des_updatebit*/208,      /*initvalue*/0         },
           {   /*sig_name*/"isVehMtnStChks_0",   /*src_can*/"ZCU_CANFD1",   /*src_network_type*/"CANFD",   /*src_slotid_fr*/0,   /*src_basecycle_fr*/0,  /*src_repetition_fr*/0,  /*src_startbit*/415,   /*sig_length*/8,  /*des_slotid_fr*/0,   /*des_basecycle_fr*/0,  /*des_repetition_fr*/0,   /*des_startbit*/207,    /*src_cyc*/101,  /*src_id*/0x82,   /*src_dlc*/64,   /*des_cyc*/10,   /*des_id*/0x55, /*src_updatebit*/416,   /*des_updatebit*/208,      /*initvalue*/0         },
           {   /*sig_name*/"isVehCfgPrmCCPBytePosn2_0",   /*src_can*/"ZCU_CANFD1",   /*src_network_type*/"CANFD",   /*src_slotid_fr*/0,   /*src_basecycle_fr*/0,  /*src_repetition_fr*/0,  /*src_startbit*/15,   /*sig_length*/8,  /*des_slotid_fr*/0,   /*des_basecycle_fr*/0,  /*des_repetition_fr*/0,   /*des_startbit*/15,    /*src_cyc*/101,  /*src_id*/0x1f5,   /*src_dlc*/64,   /*des_cyc*/Event,   /*des_id*/0x225, /*src_updatebit*/199,   /*des_updatebit*/363,      /*initvalue*/0         },
           {   /*sig_name*/"isVehCfgPrmCCPBytePosn7_0",   /*src_can*/"ZCU_CANFD1",   /*src_network_type*/"CANFD",   /*src_slotid_fr*/0,   /*src_basecycle_fr*/0,  /*src_repetition_fr*/0,  /*src_startbit*/55,   /*sig_length*/8,  /*des_slotid_fr*/0,   /*des_basecycle_fr*/0,  /*des_repetition_fr*/0,   /*des_startbit*/55,    /*src_cyc*/101,  /*src_id*/0x1f5,   /*src_dlc*/64,   /*des_cyc*/Event,   /*des_id*/0x225, /*src_updatebit*/199,   /*des_updatebit*/363,      /*initvalue*/0         },
           {   /*sig_name*/"isVehCfgPrmCCPBytePosn3_0",   /*src_can*/"ZCU_CANFD1",   /*src_network_type*/"CANFD",   /*src_slotid_fr*/0,   /*src_basecycle_fr*/0,  /*src_repetition_fr*/0,  /*src_startbit*/23,   /*sig_length*/8,  /*des_slotid_fr*/0,   /*des_basecycle_fr*/0,  /*des_repetition_fr*/0,   /*des_startbit*/23,    /*src_cyc*/101,  /*src_id*/0x1f5,   /*src_dlc*/64,   /*des_cyc*/Event,   /*des_id*/0x225, /*src_updatebit*/199,   /*des_updatebit*/363,      /*initvalue*/0         },
           {   /*sig_name*/"isVehCfgPrmCCPBytePosn4_0",   /*src_can*/"ZCU_CANFD1",   /*src_network_type*/"CANFD",   /*src_slotid_fr*/0,   /*src_basecycle_fr*/0,  /*src_repetition_fr*/0,  /*src_startbit*/31,   /*sig_length*/8,  /*des_slotid_fr*/0,   /*des_basecycle_fr*/0,  /*des_repetition_fr*/0,   /*des_startbit*/31,    /*src_cyc*/101,  /*src_id*/0x1f5,   /*src_dlc*/64,   /*des_cyc*/Event,   /*des_id*/0x225, /*src_updatebit*/199,   /*des_updatebit*/363,      /*initvalue*/0         },
           {   /*sig_name*/"isVehCfgPrmCCPBytePosn8_0",   /*src_can*/"ZCU_CANFD1",   /*src_network_type*/"CANFD",   /*src_slotid_fr*/0,   /*src_basecycle_fr*/0,  /*src_repetition_fr*/0,  /*src_startbit*/63,   /*sig_length*/8,  /*des_slotid_fr*/0,   /*des_basecycle_fr*/0,  /*des_repetition_fr*/0,   /*des_startbit*/63,    /*src_cyc*/101,  /*src_id*/0x1f5,   /*src_dlc*/64,   /*des_cyc*/Event,   /*des_id*/0x225, /*src_updatebit*/199,   /*des_updatebit*/363,      /*initvalue*/0         },
           {   /*sig_name*/"isVehCfgPrmCCPBytePosn5_0",   /*src_can*/"ZCU_CANFD1",   /*src_network_type*/"CANFD",   /*src_slotid_fr*/0,   /*src_basecycle_fr*/0,  /*src_repetition_fr*/0,  /*src_startbit*/39,   /*sig_length*/8,  /*des_slotid_fr*/0,   /*des_basecycle_fr*/0,  /*des_repetition_fr*/0,   /*des_startbit*/39,    /*src_cyc*/101,  /*src_id*/0x1f5,   /*src_dlc*/64,   /*des_cyc*/Event,   /*des_id*/0x225, /*src_updatebit*/199,   /*des_updatebit*/363,      /*initvalue*/0         },
           {   /*sig_name*/"isVehCfgPrmBlkIDBytePosn1_0",   /*src_can*/"ZCU_CANFD1",   /*src_network_type*/"CANFD",   /*src_slotid_fr*/0,   /*src_basecycle_fr*/0,  /*src_repetition_fr*/0,  /*src_startbit*/7,   /*sig_length*/8,  /*des_slotid_fr*/0,   /*des_basecycle_fr*/0,  /*des_repetition_fr*/0,   /*des_startbit*/7,    /*src_cyc*/101,  /*src_id*/0x1f5,   /*src_dlc*/64,   /*des_cyc*/Event,   /*des_id*/0x225, /*src_updatebit*/199,   /*des_updatebit*/363,      /*initvalue*/0         },
           {   /*sig_name*/"isVehCfgPrmCCPBytePosn6_0",   /*src_can*/"ZCU_CANFD1",   /*src_network_type*/"CANFD",   /*src_slotid_fr*/0,   /*src_basecycle_fr*/0,  /*src_repetition_fr*/0,  /*src_startbit*/47,   /*sig_length*/8,  /*des_slotid_fr*/0,   /*des_basecycle_fr*/0,  /*des_repetition_fr*/0,   /*des_startbit*/47,    /*src_cyc*/101,  /*src_id*/0x1f5,   /*src_dlc*/64,   /*des_cyc*/Event,   /*des_id*/0x225, /*src_updatebit*/199,   /*des_updatebit*/363,      /*initvalue*/0         },
           {   /*sig_name*/"isEscStChks_0",   /*src_can*/"ZCU_CANFD1",   /*src_network_type*/"CANFD",   /*src_slotid_fr*/0,   /*src_basecycle_fr*/0,  /*src_repetition_fr*/0,  /*src_startbit*/343,   /*sig_length*/8,  /*des_slotid_fr*/0,   /*des_basecycle_fr*/0,  /*des_repetition_fr*/0,   /*des_startbit*/191,    /*src_cyc*/101,  /*src_id*/0x82,   /*src_dlc*/64,   /*des_cyc*/10,   /*des_id*/0x55, /*src_updatebit*/344,   /*des_updatebit*/192,      /*initvalue*/0         },
           {   /*sig_name*/"isEscStEscSt_0",   /*src_can*/"ZCU_CANFD1",   /*src_network_type*/"CANFD",   /*src_slotid_fr*/0,   /*src_basecycle_fr*/0,  /*src_repetition_fr*/0,  /*src_startbit*/347,   /*sig_length*/3,  /*des_slotid_fr*/0,   /*des_basecycle_fr*/0,  /*des_repetition_fr*/0,   /*des_startbit*/195,    /*src_cyc*/101,  /*src_id*/0x82,   /*src_dlc*/64,   /*des_cyc*/10,   /*des_id*/0x55, /*src_updatebit*/344,   /*des_updatebit*/192,      /*initvalue*/1         },
           {   /*sig_name*/"isEscStCntr_0",   /*src_can*/"ZCU_CANFD1",   /*src_network_type*/"CANFD",   /*src_slotid_fr*/0,   /*src_basecycle_fr*/0,  /*src_repetition_fr*/0,  /*src_startbit*/351,   /*sig_length*/4,  /*des_slotid_fr*/0,   /*des_basecycle_fr*/0,  /*des_repetition_fr*/0,   /*des_startbit*/199,    /*src_cyc*/101,  /*src_id*/0x82,   /*src_dlc*/64,   /*des_cyc*/10,   /*des_id*/0x55, /*src_updatebit*/344,   /*des_updatebit*/192,      /*initvalue*/0         },
           {   /*sig_name*/"isBrkPedlPsdBrkPedlPsd_0",   /*src_can*/"ZCU_CANFD1",   /*src_network_type*/"CANFD",   /*src_slotid_fr*/0,   /*src_basecycle_fr*/0,  /*src_repetition_fr*/0,  /*src_startbit*/168,   /*sig_length*/1,  /*des_slotid_fr*/0,   /*des_basecycle_fr*/0,  /*des_repetition_fr*/0,   /*des_startbit*/48,    /*src_cyc*/101,  /*src_id*/0x82,   /*src_dlc*/64,   /*des_cyc*/30,   /*des_id*/0x121, /*src_updatebit*/400,   /*des_updatebit*/68,      /*initvalue*/0         },
           {   /*sig_name*/"isBrkPedlPsdCntr_0",   /*src_can*/"ZCU_CANFD1",   /*src_network_type*/"CANFD",   /*src_slotid_fr*/0,   /*src_basecycle_fr*/0,  /*src_repetition_fr*/0,  /*src_startbit*/175,   /*sig_length*/4,  /*des_slotid_fr*/0,   /*des_basecycle_fr*/0,  /*des_repetition_fr*/0,   /*des_startbit*/55,    /*src_cyc*/101,  /*src_id*/0x82,   /*src_dlc*/64,   /*des_cyc*/30,   /*des_id*/0x121, /*src_updatebit*/400,   /*des_updatebit*/68,      /*initvalue*/0         },
           {   /*sig_name*/"isBrkPedlPsdChks_0",   /*src_can*/"ZCU_CANFD1",   /*src_network_type*/"CANFD",   /*src_slotid_fr*/0,   /*src_basecycle_fr*/0,  /*src_repetition_fr*/0,  /*src_startbit*/167,   /*sig_length*/8,  /*des_slotid_fr*/0,   /*des_basecycle_fr*/0,  /*des_repetition_fr*/0,   /*des_startbit*/47,    /*src_cyc*/101,  /*src_id*/0x82,   /*src_dlc*/64,   /*des_cyc*/30,   /*des_id*/0x121, /*src_updatebit*/400,   /*des_updatebit*/68,      /*initvalue*/0         },
           {   /*sig_name*/"isBrkPedlPsdQf_0",   /*src_can*/"ZCU_CANFD1",   /*src_network_type*/"CANFD",   /*src_slotid_fr*/0,   /*src_basecycle_fr*/0,  /*src_repetition_fr*/0,  /*src_startbit*/171,   /*sig_length*/2,  /*des_slotid_fr*/0,   /*des_basecycle_fr*/0,  /*des_repetition_fr*/0,   /*des_startbit*/51,    /*src_cyc*/101,  /*src_id*/0x82,   /*src_dlc*/64,   /*des_cyc*/30,   /*des_id*/0x121, /*src_updatebit*/400,   /*des_updatebit*/68,      /*initvalue*/0         },
           {   /*sig_name*/"isBrkPedlPsdBrkPedlNotPsdSafe_0",   /*src_can*/"ZCU_CANFD1",   /*src_network_type*/"CANFD",   /*src_slotid_fr*/0,   /*src_basecycle_fr*/0,  /*src_repetition_fr*/0,  /*src_startbit*/169,   /*sig_length*/1,  /*des_slotid_fr*/0,   /*des_basecycle_fr*/0,  /*des_repetition_fr*/0,   /*des_startbit*/49,    /*src_cyc*/101,  /*src_id*/0x82,   /*src_dlc*/64,   /*des_cyc*/30,   /*des_id*/0x121, /*src_updatebit*/400,   /*des_updatebit*/68,      /*initvalue*/0         }
       }
   },
   {
       /*des_can*/ "ChassisCANFD2",
       /*networktype*/ "CANFD",
       116,
       {
           {   /*sig_name*/"isBkpOfDstTrvld_0",   /*src_can*/"ZCU_CANFD1",   /*src_network_type*/"CANFD",   /*src_slotid_fr*/0,   /*src_basecycle_fr*/0,  /*src_repetition_fr*/0,  /*src_startbit*/5,   /*sig_length*/21,  /*des_slotid_fr*/0,   /*des_basecycle_fr*/0,  /*des_repetition_fr*/0,   /*des_startbit*/151,    /*src_cyc*/101,  /*src_id*/0x160,   /*src_dlc*/64,   /*des_cyc*/900,   /*des_id*/0x3f5, /*src_updatebit*/16,   /*des_updatebit*/162,      /*initvalue*/0         },
           {   /*sig_name*/"isEpbSoftSwtCtrlSt_0",   /*src_can*/"ZCU_CANFD1",   /*src_network_type*/"CANFD",   /*src_slotid_fr*/0,   /*src_basecycle_fr*/0,  /*src_repetition_fr*/0,  /*src_startbit*/141,   /*sig_length*/3,  /*des_slotid_fr*/0,   /*des_basecycle_fr*/0,  /*des_repetition_fr*/0,   /*des_startbit*/428,    /*src_cyc*/101,  /*src_id*/0x160,   /*src_dlc*/64,   /*des_cyc*/30,   /*des_id*/0xe5, /*src_updatebit*/104,   /*des_updatebit*/425,      /*initvalue*/0         },
           {   /*sig_name*/"isHmiMovgObj1HdDirOfMovgObj_0",   /*src_can*/"ZCU_CANFD1",   /*src_network_type*/"CANFD",   /*src_slotid_fr*/0,   /*src_basecycle_fr*/0,  /*src_repetition_fr*/0,  /*src_startbit*/3,   /*sig_length*/12,  /*des_slotid_fr*/0,   /*des_basecycle_fr*/0,  /*des_repetition_fr*/0,   /*des_startbit*/39,    /*src_cyc*/101,  /*src_id*/0x1b5,   /*src_dlc*/64,   /*des_cyc*/40,   /*des_id*/0x13c, /*src_updatebit*/35,   /*des_updatebit*/67,      /*initvalue*/0         },
           {   /*sig_name*/"isHmiMovgObj1DstLatOfMovgObj_0",   /*src_can*/"ZCU_CANFD1",   /*src_network_type*/"CANFD",   /*src_slotid_fr*/0,   /*src_basecycle_fr*/0,  /*src_repetition_fr*/0,  /*src_startbit*/31,   /*sig_length*/9,  /*des_slotid_fr*/0,   /*des_basecycle_fr*/0,  /*des_repetition_fr*/0,   /*des_startbit*/43,    /*src_cyc*/101,  /*src_id*/0x1b5,   /*src_dlc*/64,   /*des_cyc*/40,   /*des_id*/0x13c, /*src_updatebit*/35,   /*des_updatebit*/67,      /*initvalue*/250         },
           {   /*sig_name*/"isHmiMovgObj1DstLgtOfMovgobj_0",   /*src_can*/"ZCU_CANFD1",   /*src_network_type*/"CANFD",   /*src_slotid_fr*/0,   /*src_basecycle_fr*/0,  /*src_repetition_fr*/0,  /*src_startbit*/23,   /*sig_length*/8,  /*des_slotid_fr*/0,   /*des_basecycle_fr*/0,  /*des_repetition_fr*/0,   /*des_startbit*/50,    /*src_cyc*/101,  /*src_id*/0x1b5,   /*src_dlc*/64,   /*des_cyc*/40,   /*des_id*/0x13c, /*src_updatebit*/35,   /*des_updatebit*/67,      /*initvalue*/30         },
           {   /*sig_name*/"isHmiMovgObj1HmiMovgObjTyp_0",   /*src_can*/"ZCU_CANFD1",   /*src_network_type*/"CANFD",   /*src_slotid_fr*/0,   /*src_basecycle_fr*/0,  /*src_repetition_fr*/0,  /*src_startbit*/7,   /*sig_length*/4,  /*des_slotid_fr*/0,   /*des_basecycle_fr*/0,  /*des_repetition_fr*/0,   /*des_startbit*/58,    /*src_cyc*/101,  /*src_id*/0x1b5,   /*src_dlc*/64,   /*des_cyc*/40,   /*des_id*/0x13c, /*src_updatebit*/35,   /*des_updatebit*/67,      /*initvalue*/0         },
           {   /*sig_name*/"isHmiMovgObj1ColorOfHmiMovgObj_0",   /*src_can*/"ZCU_CANFD1",   /*src_network_type*/"CANFD",   /*src_slotid_fr*/0,   /*src_basecycle_fr*/0,  /*src_repetition_fr*/0,  /*src_startbit*/38,   /*sig_length*/3,  /*des_slotid_fr*/0,   /*des_basecycle_fr*/0,  /*des_repetition_fr*/0,   /*des_startbit*/70,    /*src_cyc*/101,  /*src_id*/0x1b5,   /*src_dlc*/64,   /*des_cyc*/40,   /*des_id*/0x13c, /*src_updatebit*/35,   /*des_updatebit*/67,      /*initvalue*/0         },
           {   /*sig_name*/"isPtDrvrSetg_0",   /*src_can*/"ZCU_CANFD1",   /*src_network_type*/"CANFD",   /*src_slotid_fr*/0,   /*src_basecycle_fr*/0,  /*src_repetition_fr*/0,  /*src_startbit*/51,   /*sig_length*/4,  /*des_slotid_fr*/0,   /*des_basecycle_fr*/0,  /*des_repetition_fr*/0,   /*des_startbit*/175,    /*src_cyc*/101,  /*src_id*/0x1f8,   /*src_dlc*/64,   /*des_cyc*/900,   /*des_id*/0x3f5, /*src_updatebit*/37,   /*des_updatebit*/171,      /*initvalue*/0         },
           {   /*sig_name*/"isSetLimReq_0",   /*src_can*/"ZCU_CANFD1",   /*src_network_type*/"CANFD",   /*src_slotid_fr*/0,   /*src_basecycle_fr*/0,  /*src_repetition_fr*/0,  /*src_startbit*/162,   /*sig_length*/2,  /*des_slotid_fr*/0,   /*des_basecycle_fr*/0,  /*des_repetition_fr*/0,   /*des_startbit*/209,    /*src_cyc*/101,  /*src_id*/0x2ef,   /*src_dlc*/64,   /*des_cyc*/40,   /*des_id*/0x13c, /*src_updatebit*/160,   /*des_updatebit*/241,      /*initvalue*/1         },
           {   /*sig_name*/"isSpdLimOfRoad_0",   /*src_can*/"ZCU_CANFD1",   /*src_network_type*/"CANFD",   /*src_slotid_fr*/0,   /*src_basecycle_fr*/0,  /*src_repetition_fr*/0,  /*src_startbit*/119,   /*sig_length*/8,  /*des_slotid_fr*/0,   /*des_basecycle_fr*/0,  /*des_repetition_fr*/0,   /*des_startbit*/183,    /*src_cyc*/101,  /*src_id*/0x160,   /*src_dlc*/64,   /*des_cyc*/20,   /*des_id*/0xdf, /*src_updatebit*/80,   /*des_updatebit*/17,      /*initvalue*/0         },
           {   /*sig_name*/"isVehCfgPrmExtCCPBytePosn8_0",   /*src_can*/"ZCU_CANFD1",   /*src_network_type*/"CANFD",   /*src_slotid_fr*/0,   /*src_basecycle_fr*/0,  /*src_repetition_fr*/0,  /*src_startbit*/127,   /*sig_length*/8,  /*des_slotid_fr*/0,   /*des_basecycle_fr*/0,  /*des_repetition_fr*/0,   /*des_startbit*/407,    /*src_cyc*/101,  /*src_id*/0x1f5,   /*src_dlc*/64,   /*des_cyc*/60,   /*des_id*/0x16f, /*src_updatebit*/198,   /*des_updatebit*/232,      /*initvalue*/0         },
           {   /*sig_name*/"isVehCfgPrmExtCCPBytePosn6_0",   /*src_can*/"ZCU_CANFD1",   /*src_network_type*/"CANFD",   /*src_slotid_fr*/0,   /*src_basecycle_fr*/0,  /*src_repetition_fr*/0,  /*src_startbit*/111,   /*sig_length*/8,  /*des_slotid_fr*/0,   /*des_basecycle_fr*/0,  /*des_repetition_fr*/0,   /*des_startbit*/391,    /*src_cyc*/101,  /*src_id*/0x1f5,   /*src_dlc*/64,   /*des_cyc*/60,   /*des_id*/0x16f, /*src_updatebit*/198,   /*des_updatebit*/232,      /*initvalue*/0         },
           {   /*sig_name*/"isVehCfgPrmExtCCPBytePosn4_0",   /*src_can*/"ZCU_CANFD1",   /*src_network_type*/"CANFD",   /*src_slotid_fr*/0,   /*src_basecycle_fr*/0,  /*src_repetition_fr*/0,  /*src_startbit*/95,   /*sig_length*/8,  /*des_slotid_fr*/0,   /*des_basecycle_fr*/0,  /*des_repetition_fr*/0,   /*des_startbit*/375,    /*src_cyc*/101,  /*src_id*/0x1f5,   /*src_dlc*/64,   /*des_cyc*/60,   /*des_id*/0x16f, /*src_updatebit*/198,   /*des_updatebit*/232,      /*initvalue*/0         },
           {   /*sig_name*/"isVehCfgPrmExtCCPBytePosn3_0",   /*src_can*/"ZCU_CANFD1",   /*src_network_type*/"CANFD",   /*src_slotid_fr*/0,   /*src_basecycle_fr*/0,  /*src_repetition_fr*/0,  /*src_startbit*/87,   /*sig_length*/8,  /*des_slotid_fr*/0,   /*des_basecycle_fr*/0,  /*des_repetition_fr*/0,   /*des_startbit*/367,    /*src_cyc*/101,  /*src_id*/0x1f5,   /*src_dlc*/64,   /*des_cyc*/60,   /*des_id*/0x16f, /*src_updatebit*/198,   /*des_updatebit*/232,      /*initvalue*/0         },
           {   /*sig_name*/"isVehCfgPrmExtCCPBytePosn2_0",   /*src_can*/"ZCU_CANFD1",   /*src_network_type*/"CANFD",   /*src_slotid_fr*/0,   /*src_basecycle_fr*/0,  /*src_repetition_fr*/0,  /*src_startbit*/79,   /*sig_length*/8,  /*des_slotid_fr*/0,   /*des_basecycle_fr*/0,  /*des_repetition_fr*/0,   /*des_startbit*/359,    /*src_cyc*/101,  /*src_id*/0x1f5,   /*src_dlc*/64,   /*des_cyc*/60,   /*des_id*/0x16f, /*src_updatebit*/198,   /*des_updatebit*/232,      /*initvalue*/0         },
           {   /*sig_name*/"isVehCfgPrmExtBlkIDBytePosn1_0",   /*src_can*/"ZCU_CANFD1",   /*src_network_type*/"CANFD",   /*src_slotid_fr*/0,   /*src_basecycle_fr*/0,  /*src_repetition_fr*/0,  /*src_startbit*/71,   /*sig_length*/8,  /*des_slotid_fr*/0,   /*des_basecycle_fr*/0,  /*des_repetition_fr*/0,   /*des_startbit*/351,    /*src_cyc*/101,  /*src_id*/0x1f5,   /*src_dlc*/64,   /*des_cyc*/60,   /*des_id*/0x16f, /*src_updatebit*/198,   /*des_updatebit*/232,      /*initvalue*/0         },
           {   /*sig_name*/"isVehCfgPrmExtCCPBytePosn5_0",   /*src_can*/"ZCU_CANFD1",   /*src_network_type*/"CANFD",   /*src_slotid_fr*/0,   /*src_basecycle_fr*/0,  /*src_repetition_fr*/0,  /*src_startbit*/103,   /*sig_length*/8,  /*des_slotid_fr*/0,   /*des_basecycle_fr*/0,  /*des_repetition_fr*/0,   /*des_startbit*/383,    /*src_cyc*/101,  /*src_id*/0x1f5,   /*src_dlc*/64,   /*des_cyc*/60,   /*des_id*/0x16f, /*src_updatebit*/198,   /*des_updatebit*/232,      /*initvalue*/0         },
           {   /*sig_name*/"isVehCfgPrmExtCCPBytePosn7_0",   /*src_can*/"ZCU_CANFD1",   /*src_network_type*/"CANFD",   /*src_slotid_fr*/0,   /*src_basecycle_fr*/0,  /*src_repetition_fr*/0,  /*src_startbit*/119,   /*sig_length*/8,  /*des_slotid_fr*/0,   /*des_basecycle_fr*/0,  /*des_repetition_fr*/0,   /*des_startbit*/399,    /*src_cyc*/101,  /*src_id*/0x1f5,   /*src_dlc*/64,   /*des_cyc*/60,   /*des_id*/0x16f, /*src_updatebit*/198,   /*des_updatebit*/232,      /*initvalue*/0         },
           {   /*sig_name*/"isPosnFromSatltUTCForHr_0",   /*src_can*/"ZCU_CANFD1",   /*src_network_type*/"CANFD",   /*src_slotid_fr*/0,   /*src_basecycle_fr*/0,  /*src_repetition_fr*/0,  /*src_startbit*/296,   /*sig_length*/5,  /*des_slotid_fr*/0,   /*des_basecycle_fr*/0,  /*des_repetition_fr*/0,   /*des_startbit*/184,    /*src_cyc*/101,  /*src_id*/0x56,   /*src_dlc*/64,   /*des_cyc*/10,   /*des_id*/0x59, /*src_updatebit*/352,   /*des_updatebit*/204,      /*initvalue*/0         },
           {   /*sig_name*/"isPosnFromSatltPosnSpd_0",   /*src_can*/"ZCU_CANFD1",   /*src_network_type*/"CANFD",   /*src_slotid_fr*/0,   /*src_basecycle_fr*/0,  /*src_repetition_fr*/0,  /*src_startbit*/184,   /*sig_length*/17,  /*des_slotid_fr*/0,   /*des_basecycle_fr*/0,  /*des_repetition_fr*/0,   /*des_startbit*/72,    /*src_cyc*/101,  /*src_id*/0x56,   /*src_dlc*/64,   /*des_cyc*/10,   /*des_id*/0x59, /*src_updatebit*/352,   /*des_updatebit*/204,      /*initvalue*/0         },
           {   /*sig_name*/"isPosnFromSatltPosnAlti_0",   /*src_can*/"ZCU_CANFD1",   /*src_network_type*/"CANFD",   /*src_slotid_fr*/0,   /*src_basecycle_fr*/0,  /*src_repetition_fr*/0,  /*src_startbit*/230,   /*sig_length*/16,  /*des_slotid_fr*/0,   /*des_basecycle_fr*/0,  /*des_repetition_fr*/0,   /*des_startbit*/118,    /*src_cyc*/101,  /*src_id*/0x56,   /*src_dlc*/64,   /*des_cyc*/10,   /*des_id*/0x59, /*src_updatebit*/352,   /*des_updatebit*/204,      /*initvalue*/1000         },
           {   /*sig_name*/"isPosnFromSatltTiForSec_0",   /*src_can*/"ZCU_CANFD1",   /*src_network_type*/"CANFD",   /*src_slotid_fr*/0,   /*src_basecycle_fr*/0,  /*src_repetition_fr*/0,  /*src_startbit*/287,   /*sig_length*/6,  /*des_slotid_fr*/0,   /*des_basecycle_fr*/0,  /*des_repetition_fr*/0,   /*des_startbit*/175,    /*src_cyc*/101,  /*src_id*/0x56,   /*src_dlc*/64,   /*des_cyc*/10,   /*des_id*/0x59, /*src_updatebit*/352,   /*des_updatebit*/204,      /*initvalue*/0         },
           {   /*sig_name*/"isPosnFromSatltTiForMsec_0",   /*src_can*/"ZCU_CANFD1",   /*src_network_type*/"CANFD",   /*src_slotid_fr*/0,   /*src_basecycle_fr*/0,  /*src_repetition_fr*/0,  /*src_startbit*/262,   /*sig_length*/10,  /*des_slotid_fr*/0,   /*des_basecycle_fr*/0,  /*des_repetition_fr*/0,   /*des_startbit*/150,    /*src_cyc*/101,  /*src_id*/0x56,   /*src_dlc*/64,   /*des_cyc*/10,   /*des_id*/0x59, /*src_updatebit*/352,   /*des_updatebit*/204,      /*initvalue*/0         },
           {   /*sig_name*/"isPosnFromSatltUTCForDay_0",   /*src_can*/"ZCU_CANFD1",   /*src_network_type*/"CANFD",   /*src_slotid_fr*/0,   /*src_basecycle_fr*/0,  /*src_repetition_fr*/0,  /*src_startbit*/301,   /*sig_length*/5,  /*des_slotid_fr*/0,   /*des_basecycle_fr*/0,  /*des_repetition_fr*/0,   /*des_startbit*/189,    /*src_cyc*/101,  /*src_id*/0x56,   /*src_dlc*/64,   /*des_cyc*/10,   /*des_id*/0x59, /*src_updatebit*/352,   /*des_updatebit*/204,      /*initvalue*/1         },
           {   /*sig_name*/"isPosnFromSatltPosnVVert_0",   /*src_can*/"ZCU_CANFD1",   /*src_network_type*/"CANFD",   /*src_slotid_fr*/0,   /*src_basecycle_fr*/0,  /*src_repetition_fr*/0,  /*src_startbit*/170,   /*sig_length*/18,  /*des_slotid_fr*/0,   /*des_basecycle_fr*/0,  /*des_repetition_fr*/0,   /*des_startbit*/58,    /*src_cyc*/101,  /*src_id*/0x56,   /*src_dlc*/64,   /*des_cyc*/10,   /*des_id*/0x59, /*src_updatebit*/352,   /*des_updatebit*/204,      /*initvalue*/0         },
           {   /*sig_name*/"isPosnFromSatltPosnLat_0",   /*src_can*/"ZCU_CANFD1",   /*src_network_type*/"CANFD",   /*src_slotid_fr*/0,   /*src_basecycle_fr*/0,  /*src_repetition_fr*/0,  /*src_startbit*/136,   /*sig_length*/30,  /*des_slotid_fr*/0,   /*des_basecycle_fr*/0,  /*des_repetition_fr*/0,   /*des_startbit*/24,    /*src_cyc*/101,  /*src_id*/0x56,   /*src_dlc*/64,   /*des_cyc*/10,   /*des_id*/0x59, /*src_updatebit*/352,   /*des_updatebit*/204,      /*initvalue*/90         },
           {   /*sig_name*/"isPosnFromSatltPosnVHozl_0",   /*src_can*/"ZCU_CANFD1",   /*src_network_type*/"CANFD",   /*src_slotid_fr*/0,   /*src_basecycle_fr*/0,  /*src_repetition_fr*/0,  /*src_startbit*/215,   /*sig_length*/17,  /*des_slotid_fr*/0,   /*des_basecycle_fr*/0,  /*des_repetition_fr*/0,   /*des_startbit*/103,    /*src_cyc*/101,  /*src_id*/0x56,   /*src_dlc*/64,   /*des_cyc*/10,   /*des_id*/0x59, /*src_updatebit*/352,   /*des_updatebit*/204,      /*initvalue*/0         },
           {   /*sig_name*/"isPosnFromSatltPosnDir_0",   /*src_can*/"ZCU_CANFD1",   /*src_network_type*/"CANFD",   /*src_slotid_fr*/0,   /*src_basecycle_fr*/0,  /*src_repetition_fr*/0,  /*src_startbit*/246,   /*sig_length*/16,  /*des_slotid_fr*/0,   /*des_basecycle_fr*/0,  /*des_repetition_fr*/0,   /*des_startbit*/134,    /*src_cyc*/101,  /*src_id*/0x56,   /*src_dlc*/64,   /*des_cyc*/10,   /*des_id*/0x59, /*src_updatebit*/352,   /*des_updatebit*/204,      /*initvalue*/0         },
           {   /*sig_name*/"isPosnFromSatltUTCForMth_0",   /*src_can*/"ZCU_CANFD1",   /*src_network_type*/"CANFD",   /*src_slotid_fr*/0,   /*src_basecycle_fr*/0,  /*src_repetition_fr*/0,  /*src_startbit*/307,   /*sig_length*/4,  /*des_slotid_fr*/0,   /*des_basecycle_fr*/0,  /*des_repetition_fr*/0,   /*des_startbit*/195,    /*src_cyc*/101,  /*src_id*/0x56,   /*src_dlc*/64,   /*des_cyc*/10,   /*des_id*/0x59, /*src_updatebit*/352,   /*des_updatebit*/204,      /*initvalue*/1         },
           {   /*sig_name*/"isPosnFromSatltTiForMins_0",   /*src_can*/"ZCU_CANFD1",   /*src_network_type*/"CANFD",   /*src_slotid_fr*/0,   /*src_basecycle_fr*/0,  /*src_repetition_fr*/0,  /*src_startbit*/277,   /*sig_length*/6,  /*des_slotid_fr*/0,   /*des_basecycle_fr*/0,  /*des_repetition_fr*/0,   /*des_startbit*/165,    /*src_cyc*/101,  /*src_id*/0x56,   /*src_dlc*/64,   /*des_cyc*/10,   /*des_id*/0x59, /*src_updatebit*/352,   /*des_updatebit*/204,      /*initvalue*/0         },
           {   /*sig_name*/"isPosnFromSatltCntr_0",   /*src_can*/"ZCU_CANFD1",   /*src_network_type*/"CANFD",   /*src_slotid_fr*/0,   /*src_basecycle_fr*/0,  /*src_repetition_fr*/0,  /*src_startbit*/319,   /*sig_length*/3,  /*des_slotid_fr*/0,   /*des_basecycle_fr*/0,  /*des_repetition_fr*/0,   /*des_startbit*/207,    /*src_cyc*/101,  /*src_id*/0x56,   /*src_dlc*/64,   /*des_cyc*/10,   /*des_id*/0x59, /*src_updatebit*/352,   /*des_updatebit*/204,      /*initvalue*/0         },
           {   /*sig_name*/"isPosnFromSatltUTCForSec_0",   /*src_can*/"ZCU_CANFD1",   /*src_network_type*/"CANFD",   /*src_slotid_fr*/0,   /*src_basecycle_fr*/0,  /*src_repetition_fr*/0,  /*src_startbit*/291,   /*sig_length*/6,  /*des_slotid_fr*/0,   /*des_basecycle_fr*/0,  /*des_repetition_fr*/0,   /*des_startbit*/179,    /*src_cyc*/101,  /*src_id*/0x56,   /*src_dlc*/64,   /*des_cyc*/10,   /*des_id*/0x59, /*src_updatebit*/352,   /*des_updatebit*/204,      /*initvalue*/0         },
           {   /*sig_name*/"isPosnFromSatltUTCForMins_0",   /*src_can*/"ZCU_CANFD1",   /*src_network_type*/"CANFD",   /*src_slotid_fr*/0,   /*src_basecycle_fr*/0,  /*src_repetition_fr*/0,  /*src_startbit*/281,   /*sig_length*/6,  /*des_slotid_fr*/0,   /*des_basecycle_fr*/0,  /*des_repetition_fr*/0,   /*des_startbit*/169,    /*src_cyc*/101,  /*src_id*/0x56,   /*src_dlc*/64,   /*des_cyc*/10,   /*des_id*/0x59, /*src_updatebit*/352,   /*des_updatebit*/204,      /*initvalue*/0         },
           {   /*sig_name*/"isPosnFromSatltPosnLgt_0",   /*src_can*/"ZCU_CANFD1",   /*src_network_type*/"CANFD",   /*src_slotid_fr*/0,   /*src_basecycle_fr*/0,  /*src_repetition_fr*/0,  /*src_startbit*/119,   /*sig_length*/31,  /*des_slotid_fr*/0,   /*des_basecycle_fr*/0,  /*des_repetition_fr*/0,   /*des_startbit*/7,    /*src_cyc*/101,  /*src_id*/0x56,   /*src_dlc*/64,   /*des_cyc*/10,   /*des_id*/0x59, /*src_updatebit*/352,   /*des_updatebit*/204,      /*initvalue*/180         },
           {   /*sig_name*/"isPosnFromSatltUTCForYr_0",   /*src_can*/"ZCU_CANFD1",   /*src_network_type*/"CANFD",   /*src_slotid_fr*/0,   /*src_basecycle_fr*/0,  /*src_repetition_fr*/0,  /*src_startbit*/268,   /*sig_length*/7,  /*des_slotid_fr*/0,   /*des_basecycle_fr*/0,  /*des_repetition_fr*/0,   /*des_startbit*/156,    /*src_cyc*/101,  /*src_id*/0x56,   /*src_dlc*/64,   /*des_cyc*/10,   /*des_id*/0x59, /*src_updatebit*/352,   /*des_updatebit*/204,      /*initvalue*/0         },
           {   /*sig_name*/"isVehCfgPrmExt2BlkIDBytePosn1_0",   /*src_can*/"ZCU_CANFD1",   /*src_network_type*/"CANFD",   /*src_slotid_fr*/0,   /*src_basecycle_fr*/0,  /*src_repetition_fr*/0,  /*src_startbit*/135,   /*sig_length*/8,  /*des_slotid_fr*/0,   /*des_basecycle_fr*/0,  /*des_repetition_fr*/0,   /*des_startbit*/415,    /*src_cyc*/101,  /*src_id*/0x1f5,   /*src_dlc*/64,   /*des_cyc*/60,   /*des_id*/0x16f, /*src_updatebit*/197,   /*des_updatebit*/233,      /*initvalue*/0         },
           {   /*sig_name*/"isVehCfgPrmExt2CCPBytePosn2_0",   /*src_can*/"ZCU_CANFD1",   /*src_network_type*/"CANFD",   /*src_slotid_fr*/0,   /*src_basecycle_fr*/0,  /*src_repetition_fr*/0,  /*src_startbit*/143,   /*sig_length*/8,  /*des_slotid_fr*/0,   /*des_basecycle_fr*/0,  /*des_repetition_fr*/0,   /*des_startbit*/423,    /*src_cyc*/101,  /*src_id*/0x1f5,   /*src_dlc*/64,   /*des_cyc*/60,   /*des_id*/0x16f, /*src_updatebit*/197,   /*des_updatebit*/233,      /*initvalue*/0         },
           {   /*sig_name*/"isVehCfgPrmExt2CCPBytePosn6_0",   /*src_can*/"ZCU_CANFD1",   /*src_network_type*/"CANFD",   /*src_slotid_fr*/0,   /*src_basecycle_fr*/0,  /*src_repetition_fr*/0,  /*src_startbit*/175,   /*sig_length*/8,  /*des_slotid_fr*/0,   /*des_basecycle_fr*/0,  /*des_repetition_fr*/0,   /*des_startbit*/455,    /*src_cyc*/101,  /*src_id*/0x1f5,   /*src_dlc*/64,   /*des_cyc*/60,   /*des_id*/0x16f, /*src_updatebit*/197,   /*des_updatebit*/233,      /*initvalue*/0         },
           {   /*sig_name*/"isVehCfgPrmExt2CCPBytePosn4_0",   /*src_can*/"ZCU_CANFD1",   /*src_network_type*/"CANFD",   /*src_slotid_fr*/0,   /*src_basecycle_fr*/0,  /*src_repetition_fr*/0,  /*src_startbit*/159,   /*sig_length*/8,  /*des_slotid_fr*/0,   /*des_basecycle_fr*/0,  /*des_repetition_fr*/0,   /*des_startbit*/439,    /*src_cyc*/101,  /*src_id*/0x1f5,   /*src_dlc*/64,   /*des_cyc*/60,   /*des_id*/0x16f, /*src_updatebit*/197,   /*des_updatebit*/233,      /*initvalue*/0         },
           {   /*sig_name*/"isVehCfgPrmExt2CCPBytePosn5_0",   /*src_can*/"ZCU_CANFD1",   /*src_network_type*/"CANFD",   /*src_slotid_fr*/0,   /*src_basecycle_fr*/0,  /*src_repetition_fr*/0,  /*src_startbit*/167,   /*sig_length*/8,  /*des_slotid_fr*/0,   /*des_basecycle_fr*/0,  /*des_repetition_fr*/0,   /*des_startbit*/447,    /*src_cyc*/101,  /*src_id*/0x1f5,   /*src_dlc*/64,   /*des_cyc*/60,   /*des_id*/0x16f, /*src_updatebit*/197,   /*des_updatebit*/233,      /*initvalue*/0         },
           {   /*sig_name*/"isVehCfgPrmExt2CCPBytePosn3_0",   /*src_can*/"ZCU_CANFD1",   /*src_network_type*/"CANFD",   /*src_slotid_fr*/0,   /*src_basecycle_fr*/0,  /*src_repetition_fr*/0,  /*src_startbit*/151,   /*sig_length*/8,  /*des_slotid_fr*/0,   /*des_basecycle_fr*/0,  /*des_repetition_fr*/0,   /*des_startbit*/431,    /*src_cyc*/101,  /*src_id*/0x1f5,   /*src_dlc*/64,   /*des_cyc*/60,   /*des_id*/0x16f, /*src_updatebit*/197,   /*des_updatebit*/233,      /*initvalue*/0         },
           {   /*sig_name*/"isVehCfgPrmExt2CCPBytePosn7_0",   /*src_can*/"ZCU_CANFD1",   /*src_network_type*/"CANFD",   /*src_slotid_fr*/0,   /*src_basecycle_fr*/0,  /*src_repetition_fr*/0,  /*src_startbit*/183,   /*sig_length*/8,  /*des_slotid_fr*/0,   /*des_basecycle_fr*/0,  /*des_repetition_fr*/0,   /*des_startbit*/463,    /*src_cyc*/101,  /*src_id*/0x1f5,   /*src_dlc*/64,   /*des_cyc*/60,   /*des_id*/0x16f, /*src_updatebit*/197,   /*des_updatebit*/233,      /*initvalue*/0         },
           {   /*sig_name*/"isVehCfgPrmExt2CCPBytePosn8_0",   /*src_can*/"ZCU_CANFD1",   /*src_network_type*/"CANFD",   /*src_slotid_fr*/0,   /*src_basecycle_fr*/0,  /*src_repetition_fr*/0,  /*src_startbit*/191,   /*sig_length*/8,  /*des_slotid_fr*/0,   /*des_basecycle_fr*/0,  /*des_repetition_fr*/0,   /*des_startbit*/471,    /*src_cyc*/101,  /*src_id*/0x1f5,   /*src_dlc*/64,   /*des_cyc*/60,   /*des_id*/0x16f, /*src_updatebit*/197,   /*des_updatebit*/233,      /*initvalue*/0         },
           {   /*sig_name*/"isPassSeatSts2_0",   /*src_can*/"ZCU_CANFD1",   /*src_network_type*/"CANFD",   /*src_slotid_fr*/0,   /*src_basecycle_fr*/0,  /*src_repetition_fr*/0,  /*src_startbit*/29,   /*sig_length*/2,  /*des_slotid_fr*/0,   /*des_basecycle_fr*/0,  /*des_repetition_fr*/0,   /*des_startbit*/431,    /*src_cyc*/101,  /*src_id*/0x212,   /*src_dlc*/64,   /*des_cyc*/30,   /*des_id*/0xe5, /*src_updatebit*/26,   /*des_updatebit*/429,      /*initvalue*/1         },
           {   /*sig_name*/"isHznProfShoUpdate_0",   /*src_can*/"ZCU_CANFD1",   /*src_network_type*/"CANFD",   /*src_slotid_fr*/0,   /*src_basecycle_fr*/0,  /*src_repetition_fr*/0,  /*src_startbit*/186,   /*sig_length*/1,  /*des_slotid_fr*/0,   /*des_basecycle_fr*/0,  /*des_repetition_fr*/0,   /*des_startbit*/368,    /*src_cyc*/101,  /*src_id*/0x338,   /*src_dlc*/64,   /*des_cyc*/40,   /*des_id*/0x13c, /*src_updatebit*/128,   /*des_updatebit*/232,      /*initvalue*/0         },
           {   /*sig_name*/"isHznProfShoProfileType_0",   /*src_can*/"ZCU_CANFD1",   /*src_network_type*/"CANFD",   /*src_slotid_fr*/0,   /*src_basecycle_fr*/0,  /*src_repetition_fr*/0,  /*src_startbit*/191,   /*sig_length*/5,  /*des_slotid_fr*/0,   /*des_basecycle_fr*/0,  /*des_repetition_fr*/0,   /*des_startbit*/366,    /*src_cyc*/101,  /*src_id*/0x338,   /*src_dlc*/64,   /*des_cyc*/40,   /*des_id*/0x13c, /*src_updatebit*/128,   /*des_updatebit*/232,      /*initvalue*/0         },
           {   /*sig_name*/"isHznProfShoDistance1_0",   /*src_can*/"ZCU_CANFD1",   /*src_network_type*/"CANFD",   /*src_slotid_fr*/0,   /*src_basecycle_fr*/0,  /*src_repetition_fr*/0,  /*src_startbit*/137,   /*sig_length*/10,  /*des_slotid_fr*/0,   /*des_basecycle_fr*/0,  /*des_repetition_fr*/0,   /*des_startbit*/322,    /*src_cyc*/101,  /*src_id*/0x338,   /*src_dlc*/64,   /*des_cyc*/40,   /*des_id*/0x13c, /*src_updatebit*/128,   /*des_updatebit*/232,      /*initvalue*/0         },
           {   /*sig_name*/"isHznProfShoAccuracy_0",   /*src_can*/"ZCU_CANFD1",   /*src_network_type*/"CANFD",   /*src_slotid_fr*/0,   /*src_basecycle_fr*/0,  /*src_repetition_fr*/0,  /*src_startbit*/143,   /*sig_length*/2,  /*des_slotid_fr*/0,   /*des_basecycle_fr*/0,  /*des_repetition_fr*/0,   /*des_startbit*/374,    /*src_cyc*/101,  /*src_id*/0x338,   /*src_dlc*/64,   /*des_cyc*/40,   /*des_id*/0x13c, /*src_updatebit*/128,   /*des_updatebit*/232,      /*initvalue*/3         },
           {   /*sig_name*/"isHznProfShoRetransmission_0",   /*src_can*/"ZCU_CANFD1",   /*src_network_type*/"CANFD",   /*src_slotid_fr*/0,   /*src_basecycle_fr*/0,  /*src_repetition_fr*/0,  /*src_startbit*/138,   /*sig_length*/1,  /*des_slotid_fr*/0,   /*des_basecycle_fr*/0,  /*des_repetition_fr*/0,   /*des_startbit*/369,    /*src_cyc*/101,  /*src_id*/0x338,   /*src_dlc*/64,   /*des_cyc*/40,   /*des_id*/0x13c, /*src_updatebit*/128,   /*des_updatebit*/232,      /*initvalue*/0         },
           {   /*sig_name*/"isHznProfShoCyclicCounter_0",   /*src_can*/"ZCU_CANFD1",   /*src_network_type*/"CANFD",   /*src_slotid_fr*/0,   /*src_basecycle_fr*/0,  /*src_repetition_fr*/0,  /*src_startbit*/140,   /*sig_length*/2,  /*des_slotid_fr*/0,   /*des_basecycle_fr*/0,  /*des_repetition_fr*/0,   /*des_startbit*/372,    /*src_cyc*/101,  /*src_id*/0x338,   /*src_dlc*/64,   /*des_cyc*/40,   /*des_id*/0x13c, /*src_updatebit*/128,   /*des_updatebit*/232,      /*initvalue*/0         },
           {   /*sig_name*/"isHznProfShoPathIndex_0",   /*src_can*/"ZCU_CANFD1",   /*src_network_type*/"CANFD",   /*src_slotid_fr*/0,   /*src_basecycle_fr*/0,  /*src_repetition_fr*/0,  /*src_startbit*/175,   /*sig_length*/6,  /*des_slotid_fr*/0,   /*des_basecycle_fr*/0,  /*des_repetition_fr*/0,   /*des_startbit*/356,    /*src_cyc*/101,  /*src_id*/0x338,   /*src_dlc*/64,   /*des_cyc*/40,   /*des_id*/0x13c, /*src_updatebit*/128,   /*des_updatebit*/232,      /*initvalue*/0         },
           {   /*sig_name*/"isHznProfShoValue0_0",   /*src_can*/"ZCU_CANFD1",   /*src_network_type*/"CANFD",   /*src_slotid_fr*/0,   /*src_basecycle_fr*/0,  /*src_repetition_fr*/0,  /*src_startbit*/169,   /*sig_length*/10,  /*des_slotid_fr*/0,   /*des_basecycle_fr*/0,  /*des_repetition_fr*/0,   /*des_startbit*/328,    /*src_cyc*/101,  /*src_id*/0x338,   /*src_dlc*/64,   /*des_cyc*/40,   /*des_id*/0x13c, /*src_updatebit*/128,   /*des_updatebit*/232,      /*initvalue*/0         },
           {   /*sig_name*/"isHznProfShoValue1_0",   /*src_can*/"ZCU_CANFD1",   /*src_network_type*/"CANFD",   /*src_slotid_fr*/0,   /*src_basecycle_fr*/0,  /*src_repetition_fr*/0,  /*src_startbit*/185,   /*sig_length*/10,  /*des_slotid_fr*/0,   /*des_basecycle_fr*/0,  /*des_repetition_fr*/0,   /*des_startbit*/350,    /*src_cyc*/101,  /*src_id*/0x338,   /*src_dlc*/64,   /*des_cyc*/40,   /*des_id*/0x13c, /*src_updatebit*/128,   /*des_updatebit*/232,      /*initvalue*/0         },
           {   /*sig_name*/"isHznProfShoControlPoint_0",   /*src_can*/"ZCU_CANFD1",   /*src_network_type*/"CANFD",   /*src_slotid_fr*/0,   /*src_basecycle_fr*/0,  /*src_repetition_fr*/0,  /*src_startbit*/141,   /*sig_length*/1,  /*des_slotid_fr*/0,   /*des_basecycle_fr*/0,  /*des_repetition_fr*/0,   /*des_startbit*/370,    /*src_cyc*/101,  /*src_id*/0x338,   /*src_dlc*/64,   /*des_cyc*/40,   /*des_id*/0x13c, /*src_updatebit*/128,   /*des_updatebit*/232,      /*initvalue*/0         },
           {   /*sig_name*/"isHznProfShoMessageType_0",   /*src_can*/"ZCU_CANFD1",   /*src_network_type*/"CANFD",   /*src_slotid_fr*/0,   /*src_basecycle_fr*/0,  /*src_repetition_fr*/0,  /*src_startbit*/159,   /*sig_length*/3,  /*des_slotid_fr*/0,   /*des_basecycle_fr*/0,  /*des_repetition_fr*/0,   /*des_startbit*/361,    /*src_cyc*/101,  /*src_id*/0x338,   /*src_dlc*/64,   /*des_cyc*/40,   /*des_id*/0x13c, /*src_updatebit*/128,   /*des_updatebit*/232,      /*initvalue*/4         },
           {   /*sig_name*/"isHznProfShoOffset_0",   /*src_can*/"ZCU_CANFD1",   /*src_network_type*/"CANFD",   /*src_slotid_fr*/0,   /*src_basecycle_fr*/0,  /*src_repetition_fr*/0,  /*src_startbit*/156,   /*sig_length*/13,  /*des_slotid_fr*/0,   /*des_basecycle_fr*/0,  /*des_repetition_fr*/0,   /*des_startbit*/319,    /*src_cyc*/101,  /*src_id*/0x338,   /*src_dlc*/64,   /*des_cyc*/40,   /*des_id*/0x13c, /*src_updatebit*/128,   /*des_updatebit*/232,      /*initvalue*/0         },
           {   /*sig_name*/"isTrlrModSwtReq_0",   /*src_can*/"ZCU_CANFD1",   /*src_network_type*/"CANFD",   /*src_slotid_fr*/0,   /*src_basecycle_fr*/0,  /*src_repetition_fr*/0,  /*src_startbit*/44,   /*sig_length*/1,  /*des_slotid_fr*/0,   /*des_basecycle_fr*/0,  /*des_repetition_fr*/0,   /*des_startbit*/211,    /*src_cyc*/101,  /*src_id*/0x318,   /*src_dlc*/64,   /*des_cyc*/40,   /*des_id*/0x13c, /*src_updatebit*/43,   /*des_updatebit*/210,      /*initvalue*/0         },
           {   /*sig_name*/"isDrvModReq_0",   /*src_can*/"ZCU_CANFD1",   /*src_network_type*/"CANFD",   /*src_slotid_fr*/0,   /*src_basecycle_fr*/0,  /*src_repetition_fr*/0,  /*src_startbit*/119,   /*sig_length*/5,  /*des_slotid_fr*/0,   /*des_basecycle_fr*/0,  /*des_repetition_fr*/0,   /*des_startbit*/220,    /*src_cyc*/101,  /*src_id*/0x105,   /*src_dlc*/64,   /*des_cyc*/10,   /*des_id*/0x86, /*src_updatebit*/178,   /*des_updatebit*/231,      /*initvalue*/0         },
           {   /*sig_name*/"isEpbApplyAutSetg_0",   /*src_can*/"ZCU_CANFD1",   /*src_network_type*/"CANFD",   /*src_slotid_fr*/0,   /*src_basecycle_fr*/0,  /*src_repetition_fr*/0,  /*src_startbit*/148,   /*sig_length*/1,  /*des_slotid_fr*/0,   /*des_basecycle_fr*/0,  /*des_repetition_fr*/0,   /*des_startbit*/401,    /*src_cyc*/101,  /*src_id*/0x160,   /*src_dlc*/64,   /*des_cyc*/30,   /*des_id*/0xe5, /*src_updatebit*/147,   /*des_updatebit*/400,      /*initvalue*/0         },
           {   /*sig_name*/"isVehSpdIndcdVeSpdIndcdUnit_0",   /*src_can*/"ZCU_CANFD1",   /*src_network_type*/"CANFD",   /*src_slotid_fr*/0,   /*src_basecycle_fr*/0,  /*src_repetition_fr*/0,  /*src_startbit*/134,   /*sig_length*/2,  /*des_slotid_fr*/0,   /*des_basecycle_fr*/0,  /*des_repetition_fr*/0,   /*des_startbit*/214,    /*src_cyc*/101,  /*src_id*/0x160,   /*src_dlc*/64,   /*des_cyc*/20,   /*des_id*/0xdf, /*src_updatebit*/132,   /*des_updatebit*/212,      /*initvalue*/0         },
           {   /*sig_name*/"isVehSpdIndcdVehSpdIndcd_0",   /*src_can*/"ZCU_CANFD1",   /*src_network_type*/"CANFD",   /*src_slotid_fr*/0,   /*src_basecycle_fr*/0,  /*src_repetition_fr*/0,  /*src_startbit*/127,   /*sig_length*/9,  /*des_slotid_fr*/0,   /*des_basecycle_fr*/0,  /*des_repetition_fr*/0,   /*des_startbit*/207,    /*src_cyc*/101,  /*src_id*/0x160,   /*src_dlc*/64,   /*des_cyc*/20,   /*des_id*/0xdf, /*src_updatebit*/132,   /*des_updatebit*/212,      /*initvalue*/0         },
           {   /*sig_name*/"isHznEdgeCyclicCounter_0",   /*src_can*/"ZCU_CANFD1",   /*src_network_type*/"CANFD",   /*src_slotid_fr*/0,   /*src_basecycle_fr*/0,  /*src_repetition_fr*/0,  /*src_startbit*/5,   /*sig_length*/2,  /*des_slotid_fr*/0,   /*des_basecycle_fr*/0,  /*des_repetition_fr*/0,   /*des_startbit*/298,    /*src_cyc*/101,  /*src_id*/0x338,   /*src_dlc*/64,   /*des_cyc*/40,   /*des_id*/0x13c, /*src_updatebit*/66,   /*des_updatebit*/224,      /*initvalue*/0         },
           {   /*sig_name*/"isHznEdgeRelativeProbability_0",   /*src_can*/"ZCU_CANFD1",   /*src_network_type*/"CANFD",   /*src_slotid_fr*/0,   /*src_basecycle_fr*/0,  /*src_repetition_fr*/0,  /*src_startbit*/71,   /*sig_length*/5,  /*des_slotid_fr*/0,   /*des_basecycle_fr*/0,  /*des_repetition_fr*/0,   /*des_startbit*/286,    /*src_cyc*/101,  /*src_id*/0x338,   /*src_dlc*/64,   /*des_cyc*/40,   /*des_id*/0x13c, /*src_updatebit*/66,   /*des_updatebit*/224,      /*initvalue*/0         },
           {   /*sig_name*/"isHznEdgeComplexIntersection_0",   /*src_can*/"ZCU_CANFD1",   /*src_network_type*/"CANFD",   /*src_slotid_fr*/0,   /*src_basecycle_fr*/0,  /*src_repetition_fr*/0,  /*src_startbit*/7,   /*sig_length*/2,  /*des_slotid_fr*/0,   /*des_basecycle_fr*/0,  /*des_repetition_fr*/0,   /*des_startbit*/300,    /*src_cyc*/101,  /*src_id*/0x338,   /*src_dlc*/64,   /*des_cyc*/40,   /*des_id*/0x13c, /*src_updatebit*/66,   /*des_updatebit*/224,      /*initvalue*/0         },
           {   /*sig_name*/"isHznEdgeNumberOfLanesInOppositeDirection_0",   /*src_can*/"ZCU_CANFD1",   /*src_network_type*/"CANFD",   /*src_slotid_fr*/0,   /*src_basecycle_fr*/0,  /*src_repetition_fr*/0,  /*src_startbit*/39,   /*sig_length*/2,  /*des_slotid_fr*/0,   /*des_basecycle_fr*/0,  /*des_repetition_fr*/0,   /*des_startbit*/296,    /*src_cyc*/101,  /*src_id*/0x338,   /*src_dlc*/64,   /*des_cyc*/40,   /*des_id*/0x13c, /*src_updatebit*/66,   /*des_updatebit*/224,      /*initvalue*/0         },
           {   /*sig_name*/"isHznEdgeLastStubAtOffset_0",   /*src_can*/"ZCU_CANFD1",   /*src_network_type*/"CANFD",   /*src_slotid_fr*/0,   /*src_basecycle_fr*/0,  /*src_repetition_fr*/0,  /*src_startbit*/12,   /*sig_length*/1,  /*des_slotid_fr*/0,   /*des_basecycle_fr*/0,  /*des_repetition_fr*/0,   /*des_startbit*/306,    /*src_cyc*/101,  /*src_id*/0x338,   /*src_dlc*/64,   /*des_cyc*/40,   /*des_id*/0x13c, /*src_updatebit*/66,   /*des_updatebit*/224,      /*initvalue*/0         },
           {   /*sig_name*/"isHznEdgeSubPathIndex_0",   /*src_can*/"ZCU_CANFD1",   /*src_network_type*/"CANFD",   /*src_slotid_fr*/0,   /*src_basecycle_fr*/0,  /*src_repetition_fr*/0,  /*src_startbit*/63,   /*sig_length*/6,  /*des_slotid_fr*/0,   /*des_basecycle_fr*/0,  /*des_repetition_fr*/0,   /*des_startbit*/276,    /*src_cyc*/101,  /*src_id*/0x338,   /*src_dlc*/64,   /*des_cyc*/40,   /*des_id*/0x13c, /*src_updatebit*/66,   /*des_updatebit*/224,      /*initvalue*/5         },
           {   /*sig_name*/"isHznEdgeTurnAngle_0",   /*src_can*/"ZCU_CANFD1",   /*src_network_type*/"CANFD",   /*src_slotid_fr*/0,   /*src_basecycle_fr*/0,  /*src_repetition_fr*/0,  /*src_startbit*/55,   /*sig_length*/8,  /*des_slotid_fr*/0,   /*des_basecycle_fr*/0,  /*des_repetition_fr*/0,   /*des_startbit*/258,    /*src_cyc*/101,  /*src_id*/0x338,   /*src_dlc*/64,   /*des_cyc*/40,   /*des_id*/0x13c, /*src_updatebit*/66,   /*des_updatebit*/224,      /*initvalue*/0         },
           {   /*sig_name*/"isHznEdgeOffset_0",   /*src_can*/"ZCU_CANFD1",   /*src_network_type*/"CANFD",   /*src_slotid_fr*/0,   /*src_basecycle_fr*/0,  /*src_repetition_fr*/0,  /*src_startbit*/20,   /*sig_length*/13,  /*des_slotid_fr*/0,   /*des_basecycle_fr*/0,  /*des_repetition_fr*/0,   /*des_startbit*/255,    /*src_cyc*/101,  /*src_id*/0x338,   /*src_dlc*/64,   /*des_cyc*/40,   /*des_id*/0x13c, /*src_updatebit*/66,   /*des_updatebit*/224,      /*initvalue*/0         },
           {   /*sig_name*/"isHznEdgeRetransmission_0",   /*src_can*/"ZCU_CANFD1",   /*src_network_type*/"CANFD",   /*src_slotid_fr*/0,   /*src_basecycle_fr*/0,  /*src_repetition_fr*/0,  /*src_startbit*/8,   /*sig_length*/1,  /*des_slotid_fr*/0,   /*des_basecycle_fr*/0,  /*des_repetition_fr*/0,   /*des_startbit*/305,    /*src_cyc*/101,  /*src_id*/0x338,   /*src_dlc*/64,   /*des_cyc*/40,   /*des_id*/0x13c, /*src_updatebit*/66,   /*des_updatebit*/224,      /*initvalue*/0         },
           {   /*sig_name*/"isHznEdgePartOfCalculatedRoute_0",   /*src_can*/"ZCU_CANFD1",   /*src_network_type*/"CANFD",   /*src_slotid_fr*/0,   /*src_basecycle_fr*/0,  /*src_repetition_fr*/0,  /*src_startbit*/37,   /*sig_length*/2,  /*des_slotid_fr*/0,   /*des_basecycle_fr*/0,  /*des_repetition_fr*/0,   /*des_startbit*/310,    /*src_cyc*/101,  /*src_id*/0x338,   /*src_dlc*/64,   /*des_cyc*/40,   /*des_id*/0x13c, /*src_updatebit*/66,   /*des_updatebit*/224,      /*initvalue*/0         },
           {   /*sig_name*/"isHznEdgeFormOfWay_0",   /*src_can*/"ZCU_CANFD1",   /*src_network_type*/"CANFD",   /*src_slotid_fr*/0,   /*src_basecycle_fr*/0,  /*src_repetition_fr*/0,  /*src_startbit*/3,   /*sig_length*/4,  /*des_slotid_fr*/0,   /*des_basecycle_fr*/0,  /*des_repetition_fr*/0,   /*des_startbit*/281,    /*src_cyc*/101,  /*src_id*/0x338,   /*src_dlc*/64,   /*des_cyc*/40,   /*des_id*/0x13c, /*src_updatebit*/66,   /*des_updatebit*/224,      /*initvalue*/0         },
           {   /*sig_name*/"isHznEdgeUpdate_0",   /*src_can*/"ZCU_CANFD1",   /*src_network_type*/"CANFD",   /*src_slotid_fr*/0,   /*src_basecycle_fr*/0,  /*src_repetition_fr*/0,  /*src_startbit*/33,   /*sig_length*/1,  /*des_slotid_fr*/0,   /*des_basecycle_fr*/0,  /*des_repetition_fr*/0,   /*des_startbit*/304,    /*src_cyc*/101,  /*src_id*/0x338,   /*src_dlc*/64,   /*des_cyc*/40,   /*des_id*/0x13c, /*src_updatebit*/66,   /*des_updatebit*/224,      /*initvalue*/0         },
           {   /*sig_name*/"isHznEdgePathIndex_0",   /*src_can*/"ZCU_CANFD1",   /*src_network_type*/"CANFD",   /*src_slotid_fr*/0,   /*src_basecycle_fr*/0,  /*src_repetition_fr*/0,  /*src_startbit*/47,   /*sig_length*/6,  /*des_slotid_fr*/0,   /*des_basecycle_fr*/0,  /*des_repetition_fr*/0,   /*des_startbit*/266,    /*src_cyc*/101,  /*src_id*/0x338,   /*src_dlc*/64,   /*des_cyc*/40,   /*des_id*/0x13c, /*src_updatebit*/66,   /*des_updatebit*/224,      /*initvalue*/0         },
           {   /*sig_name*/"isHznEdgeFunctionalRoadClass_0",   /*src_can*/"ZCU_CANFD1",   /*src_network_type*/"CANFD",   /*src_slotid_fr*/0,   /*src_basecycle_fr*/0,  /*src_repetition_fr*/0,  /*src_startbit*/15,   /*sig_length*/3,  /*des_slotid_fr*/0,   /*des_basecycle_fr*/0,  /*des_repetition_fr*/0,   /*des_startbit*/293,    /*src_cyc*/101,  /*src_id*/0x338,   /*src_dlc*/64,   /*des_cyc*/40,   /*des_id*/0x13c, /*src_updatebit*/66,   /*des_updatebit*/224,      /*initvalue*/0         },
           {   /*sig_name*/"isHznEdgeRightofWay_0",   /*src_can*/"ZCU_CANFD1",   /*src_network_type*/"CANFD",   /*src_slotid_fr*/0,   /*src_basecycle_fr*/0,  /*src_repetition_fr*/0,  /*src_startbit*/35,   /*sig_length*/2,  /*des_slotid_fr*/0,   /*des_basecycle_fr*/0,  /*des_repetition_fr*/0,   /*des_startbit*/308,    /*src_cyc*/101,  /*src_id*/0x338,   /*src_dlc*/64,   /*des_cyc*/40,   /*des_id*/0x13c, /*src_updatebit*/66,   /*des_updatebit*/224,      /*initvalue*/2         },
           {   /*sig_name*/"isHznEdgeMessageType_0",   /*src_can*/"ZCU_CANFD1",   /*src_network_type*/"CANFD",   /*src_slotid_fr*/0,   /*src_basecycle_fr*/0,  /*src_repetition_fr*/0,  /*src_startbit*/11,   /*sig_length*/3,  /*des_slotid_fr*/0,   /*des_basecycle_fr*/0,  /*des_repetition_fr*/0,   /*des_startbit*/290,    /*src_cyc*/101,  /*src_id*/0x338,   /*src_dlc*/64,   /*des_cyc*/40,   /*des_id*/0x13c, /*src_updatebit*/66,   /*des_updatebit*/224,      /*initvalue*/3         },
           {   /*sig_name*/"isHznEdgeNumberOfLanesInDrivingDirection_0",   /*src_can*/"ZCU_CANFD1",   /*src_network_type*/"CANFD",   /*src_slotid_fr*/0,   /*src_basecycle_fr*/0,  /*src_repetition_fr*/0,  /*src_startbit*/23,   /*sig_length*/3,  /*des_slotid_fr*/0,   /*des_basecycle_fr*/0,  /*des_repetition_fr*/0,   /*des_startbit*/303,    /*src_cyc*/101,  /*src_id*/0x338,   /*src_dlc*/64,   /*des_cyc*/40,   /*des_id*/0x13c, /*src_updatebit*/66,   /*des_updatebit*/224,      /*initvalue*/0         },
           {   /*sig_name*/"isGearPrkgAssiReqGroupGearPrkgAssiReq1_0",   /*src_can*/"ZCU_CANFD1",   /*src_network_type*/"CANFD",   /*src_slotid_fr*/0,   /*src_basecycle_fr*/0,  /*src_repetition_fr*/0,  /*src_startbit*/11,   /*sig_length*/2,  /*des_slotid_fr*/0,   /*des_basecycle_fr*/0,  /*des_repetition_fr*/0,   /*des_startbit*/371,    /*src_cyc*/101,  /*src_id*/0x60,   /*src_dlc*/64,   /*des_cyc*/10,   /*des_id*/0x4f, /*src_updatebit*/8,   /*des_updatebit*/369,      /*initvalue*/0         },
           {   /*sig_name*/"isGearPrkgAssiReqGroupCntr_0",   /*src_can*/"ZCU_CANFD1",   /*src_network_type*/"CANFD",   /*src_slotid_fr*/0,   /*src_basecycle_fr*/0,  /*src_repetition_fr*/0,  /*src_startbit*/15,   /*sig_length*/4,  /*des_slotid_fr*/0,   /*des_basecycle_fr*/0,  /*des_repetition_fr*/0,   /*des_startbit*/375,    /*src_cyc*/101,  /*src_id*/0x60,   /*src_dlc*/64,   /*des_cyc*/10,   /*des_id*/0x4f, /*src_updatebit*/8,   /*des_updatebit*/369,      /*initvalue*/0         },
           {   /*sig_name*/"isGearPrkgAssiReqGroupChks_0",   /*src_can*/"ZCU_CANFD1",   /*src_network_type*/"CANFD",   /*src_slotid_fr*/0,   /*src_basecycle_fr*/0,  /*src_repetition_fr*/0,  /*src_startbit*/7,   /*sig_length*/8,  /*des_slotid_fr*/0,   /*des_basecycle_fr*/0,  /*des_repetition_fr*/0,   /*des_startbit*/367,    /*src_cyc*/101,  /*src_id*/0x60,   /*src_dlc*/64,   /*des_cyc*/10,   /*des_id*/0x4f, /*src_updatebit*/8,   /*des_updatebit*/369,      /*initvalue*/0         },
           {   /*sig_name*/"isMAIAccInhitReqMAIAccInhitReq_0",   /*src_can*/"ZCU_CANFD1",   /*src_network_type*/"CANFD",   /*src_slotid_fr*/0,   /*src_basecycle_fr*/0,  /*src_repetition_fr*/0,  /*src_startbit*/67,   /*sig_length*/1,  /*des_slotid_fr*/0,   /*des_basecycle_fr*/0,  /*des_repetition_fr*/0,   /*des_startbit*/235,    /*src_cyc*/101,  /*src_id*/0x71,   /*src_dlc*/64,   /*des_cyc*/10,   /*des_id*/0x59, /*src_updatebit*/168,   /*des_updatebit*/217,      /*initvalue*/0         },
           {   /*sig_name*/"isMAIAccInhitReqChks_0",   /*src_can*/"ZCU_CANFD1",   /*src_network_type*/"CANFD",   /*src_slotid_fr*/0,   /*src_basecycle_fr*/0,  /*src_repetition_fr*/0,  /*src_startbit*/63,   /*sig_length*/8,  /*des_slotid_fr*/0,   /*des_basecycle_fr*/0,  /*des_repetition_fr*/0,   /*des_startbit*/231,    /*src_cyc*/101,  /*src_id*/0x71,   /*src_dlc*/64,   /*des_cyc*/10,   /*des_id*/0x59, /*src_updatebit*/168,   /*des_updatebit*/217,      /*initvalue*/0         },
           {   /*sig_name*/"isMAIAccInhitReqCntr_0",   /*src_can*/"ZCU_CANFD1",   /*src_network_type*/"CANFD",   /*src_slotid_fr*/0,   /*src_basecycle_fr*/0,  /*src_repetition_fr*/0,  /*src_startbit*/71,   /*sig_length*/4,  /*des_slotid_fr*/0,   /*des_basecycle_fr*/0,  /*des_repetition_fr*/0,   /*des_startbit*/239,    /*src_cyc*/101,  /*src_id*/0x71,   /*src_dlc*/64,   /*des_cyc*/10,   /*des_id*/0x59, /*src_updatebit*/168,   /*des_updatebit*/217,      /*initvalue*/0         },
           {   /*sig_name*/"isListOfNodAv7_0",   /*src_can*/"ZCU_CANFD1",   /*src_network_type*/"CANFD",   /*src_slotid_fr*/0,   /*src_basecycle_fr*/0,  /*src_repetition_fr*/0,  /*src_startbit*/215,   /*sig_length*/32,  /*des_slotid_fr*/0,   /*des_basecycle_fr*/0,  /*des_repetition_fr*/0,   /*des_startbit*/255,    /*src_cyc*/101,  /*src_id*/0x379,   /*src_dlc*/64,   /*des_cyc*/450,   /*des_id*/0x35c, /*src_updatebit*/15,   /*des_updatebit*/48,      /*initvalue*/0         },
           {   /*sig_name*/"isListOfNodAv8_0",   /*src_can*/"ZCU_CANFD1",   /*src_network_type*/"CANFD",   /*src_slotid_fr*/0,   /*src_basecycle_fr*/0,  /*src_repetition_fr*/0,  /*src_startbit*/247,   /*sig_length*/32,  /*des_slotid_fr*/0,   /*des_basecycle_fr*/0,  /*des_repetition_fr*/0,   /*des_startbit*/287,    /*src_cyc*/101,  /*src_id*/0x379,   /*src_dlc*/64,   /*des_cyc*/450,   /*des_id*/0x35c, /*src_updatebit*/15,   /*des_updatebit*/48,      /*initvalue*/0         },
           {   /*sig_name*/"isListOfNodAv5_0",   /*src_can*/"ZCU_CANFD1",   /*src_network_type*/"CANFD",   /*src_slotid_fr*/0,   /*src_basecycle_fr*/0,  /*src_repetition_fr*/0,  /*src_startbit*/151,   /*sig_length*/32,  /*des_slotid_fr*/0,   /*des_basecycle_fr*/0,  /*des_repetition_fr*/0,   /*des_startbit*/191,    /*src_cyc*/101,  /*src_id*/0x379,   /*src_dlc*/64,   /*des_cyc*/450,   /*des_id*/0x35c, /*src_updatebit*/15,   /*des_updatebit*/48,      /*initvalue*/0         },
           {   /*sig_name*/"isListOfNodAv3_0",   /*src_can*/"ZCU_CANFD1",   /*src_network_type*/"CANFD",   /*src_slotid_fr*/0,   /*src_basecycle_fr*/0,  /*src_repetition_fr*/0,  /*src_startbit*/87,   /*sig_length*/32,  /*des_slotid_fr*/0,   /*des_basecycle_fr*/0,  /*des_repetition_fr*/0,   /*des_startbit*/127,    /*src_cyc*/101,  /*src_id*/0x379,   /*src_dlc*/64,   /*des_cyc*/450,   /*des_id*/0x35c, /*src_updatebit*/15,   /*des_updatebit*/48,      /*initvalue*/0         },
           {   /*sig_name*/"isListOfNodAv4_0",   /*src_can*/"ZCU_CANFD1",   /*src_network_type*/"CANFD",   /*src_slotid_fr*/0,   /*src_basecycle_fr*/0,  /*src_repetition_fr*/0,  /*src_startbit*/119,   /*sig_length*/32,  /*des_slotid_fr*/0,   /*des_basecycle_fr*/0,  /*des_repetition_fr*/0,   /*des_startbit*/159,    /*src_cyc*/101,  /*src_id*/0x379,   /*src_dlc*/64,   /*des_cyc*/450,   /*des_id*/0x35c, /*src_updatebit*/15,   /*des_updatebit*/48,      /*initvalue*/0         },
           {   /*sig_name*/"isListOfNodAv1_0",   /*src_can*/"ZCU_CANFD1",   /*src_network_type*/"CANFD",   /*src_slotid_fr*/0,   /*src_basecycle_fr*/0,  /*src_repetition_fr*/0,  /*src_startbit*/23,   /*sig_length*/32,  /*des_slotid_fr*/0,   /*des_basecycle_fr*/0,  /*des_repetition_fr*/0,   /*des_startbit*/63,    /*src_cyc*/101,  /*src_id*/0x379,   /*src_dlc*/64,   /*des_cyc*/450,   /*des_id*/0x35c, /*src_updatebit*/15,   /*des_updatebit*/48,      /*initvalue*/0         },
           {   /*sig_name*/"isListOfNodAv2_0",   /*src_can*/"ZCU_CANFD1",   /*src_network_type*/"CANFD",   /*src_slotid_fr*/0,   /*src_basecycle_fr*/0,  /*src_repetition_fr*/0,  /*src_startbit*/55,   /*sig_length*/32,  /*des_slotid_fr*/0,   /*des_basecycle_fr*/0,  /*des_repetition_fr*/0,   /*des_startbit*/95,    /*src_cyc*/101,  /*src_id*/0x379,   /*src_dlc*/64,   /*des_cyc*/450,   /*des_id*/0x35c, /*src_updatebit*/15,   /*des_updatebit*/48,      /*initvalue*/0         },
           {   /*sig_name*/"isListOfNodAv6_0",   /*src_can*/"ZCU_CANFD1",   /*src_network_type*/"CANFD",   /*src_slotid_fr*/0,   /*src_basecycle_fr*/0,  /*src_repetition_fr*/0,  /*src_startbit*/183,   /*sig_length*/32,  /*des_slotid_fr*/0,   /*des_basecycle_fr*/0,  /*des_repetition_fr*/0,   /*des_startbit*/223,    /*src_cyc*/101,  /*src_id*/0x379,   /*src_dlc*/64,   /*des_cyc*/450,   /*des_id*/0x35c, /*src_updatebit*/15,   /*des_updatebit*/48,      /*initvalue*/0         },
           {   /*sig_name*/"isDrvrPfmncAlrmReqFromDHU_0",   /*src_can*/"ZCU_CANFD1",   /*src_network_type*/"CANFD",   /*src_slotid_fr*/0,   /*src_basecycle_fr*/0,  /*src_repetition_fr*/0,  /*src_startbit*/59,   /*sig_length*/3,  /*des_slotid_fr*/0,   /*des_basecycle_fr*/0,  /*des_repetition_fr*/0,   /*des_startbit*/95,    /*src_cyc*/101,  /*src_id*/0x1e8,   /*src_dlc*/64,   /*des_cyc*/40,   /*des_id*/0x13c, /*src_updatebit*/506,   /*des_updatebit*/92,      /*initvalue*/0         },
           {   /*sig_name*/"isHMIAutoShowModSet_0",   /*src_can*/"ZCU_CANFD1",   /*src_network_type*/"CANFD",   /*src_slotid_fr*/0,   /*src_basecycle_fr*/0,  /*src_repetition_fr*/0,  /*src_startbit*/7,   /*sig_length*/1,  /*des_slotid_fr*/0,   /*des_basecycle_fr*/0,  /*des_repetition_fr*/0,   /*des_startbit*/50,    /*src_cyc*/101,  /*src_id*/0x1e8,   /*src_dlc*/64,   /*des_cyc*/450,   /*des_id*/0x35c, /*src_updatebit*/6,   /*des_updatebit*/49,      /*initvalue*/0         },
           {   /*sig_name*/"isVehCfgPrmCCPBytePosn2_0",   /*src_can*/"ZCU_CANFD1",   /*src_network_type*/"CANFD",   /*src_slotid_fr*/0,   /*src_basecycle_fr*/0,  /*src_repetition_fr*/0,  /*src_startbit*/15,   /*sig_length*/8,  /*des_slotid_fr*/0,   /*des_basecycle_fr*/0,  /*des_repetition_fr*/0,   /*des_startbit*/295,    /*src_cyc*/101,  /*src_id*/0x1f5,   /*src_dlc*/64,   /*des_cyc*/60,   /*des_id*/0x16f, /*src_updatebit*/199,   /*des_updatebit*/216,      /*initvalue*/0         },
           {   /*sig_name*/"isVehCfgPrmCCPBytePosn7_0",   /*src_can*/"ZCU_CANFD1",   /*src_network_type*/"CANFD",   /*src_slotid_fr*/0,   /*src_basecycle_fr*/0,  /*src_repetition_fr*/0,  /*src_startbit*/55,   /*sig_length*/8,  /*des_slotid_fr*/0,   /*des_basecycle_fr*/0,  /*des_repetition_fr*/0,   /*des_startbit*/335,    /*src_cyc*/101,  /*src_id*/0x1f5,   /*src_dlc*/64,   /*des_cyc*/60,   /*des_id*/0x16f, /*src_updatebit*/199,   /*des_updatebit*/216,      /*initvalue*/0         },
           {   /*sig_name*/"isVehCfgPrmCCPBytePosn3_0",   /*src_can*/"ZCU_CANFD1",   /*src_network_type*/"CANFD",   /*src_slotid_fr*/0,   /*src_basecycle_fr*/0,  /*src_repetition_fr*/0,  /*src_startbit*/23,   /*sig_length*/8,  /*des_slotid_fr*/0,   /*des_basecycle_fr*/0,  /*des_repetition_fr*/0,   /*des_startbit*/303,    /*src_cyc*/101,  /*src_id*/0x1f5,   /*src_dlc*/64,   /*des_cyc*/60,   /*des_id*/0x16f, /*src_updatebit*/199,   /*des_updatebit*/216,      /*initvalue*/0         },
           {   /*sig_name*/"isVehCfgPrmCCPBytePosn4_0",   /*src_can*/"ZCU_CANFD1",   /*src_network_type*/"CANFD",   /*src_slotid_fr*/0,   /*src_basecycle_fr*/0,  /*src_repetition_fr*/0,  /*src_startbit*/31,   /*sig_length*/8,  /*des_slotid_fr*/0,   /*des_basecycle_fr*/0,  /*des_repetition_fr*/0,   /*des_startbit*/311,    /*src_cyc*/101,  /*src_id*/0x1f5,   /*src_dlc*/64,   /*des_cyc*/60,   /*des_id*/0x16f, /*src_updatebit*/199,   /*des_updatebit*/216,      /*initvalue*/0         },
           {   /*sig_name*/"isVehCfgPrmCCPBytePosn8_0",   /*src_can*/"ZCU_CANFD1",   /*src_network_type*/"CANFD",   /*src_slotid_fr*/0,   /*src_basecycle_fr*/0,  /*src_repetition_fr*/0,  /*src_startbit*/63,   /*sig_length*/8,  /*des_slotid_fr*/0,   /*des_basecycle_fr*/0,  /*des_repetition_fr*/0,   /*des_startbit*/343,    /*src_cyc*/101,  /*src_id*/0x1f5,   /*src_dlc*/64,   /*des_cyc*/60,   /*des_id*/0x16f, /*src_updatebit*/199,   /*des_updatebit*/216,      /*initvalue*/0         },
           {   /*sig_name*/"isVehCfgPrmCCPBytePosn5_0",   /*src_can*/"ZCU_CANFD1",   /*src_network_type*/"CANFD",   /*src_slotid_fr*/0,   /*src_basecycle_fr*/0,  /*src_repetition_fr*/0,  /*src_startbit*/39,   /*sig_length*/8,  /*des_slotid_fr*/0,   /*des_basecycle_fr*/0,  /*des_repetition_fr*/0,   /*des_startbit*/319,    /*src_cyc*/101,  /*src_id*/0x1f5,   /*src_dlc*/64,   /*des_cyc*/60,   /*des_id*/0x16f, /*src_updatebit*/199,   /*des_updatebit*/216,      /*initvalue*/0         },
           {   /*sig_name*/"isVehCfgPrmBlkIDBytePosn1_0",   /*src_can*/"ZCU_CANFD1",   /*src_network_type*/"CANFD",   /*src_slotid_fr*/0,   /*src_basecycle_fr*/0,  /*src_repetition_fr*/0,  /*src_startbit*/7,   /*sig_length*/8,  /*des_slotid_fr*/0,   /*des_basecycle_fr*/0,  /*des_repetition_fr*/0,   /*des_startbit*/287,    /*src_cyc*/101,  /*src_id*/0x1f5,   /*src_dlc*/64,   /*des_cyc*/60,   /*des_id*/0x16f, /*src_updatebit*/199,   /*des_updatebit*/216,      /*initvalue*/0         },
           {   /*sig_name*/"isVehCfgPrmCCPBytePosn6_0",   /*src_can*/"ZCU_CANFD1",   /*src_network_type*/"CANFD",   /*src_slotid_fr*/0,   /*src_basecycle_fr*/0,  /*src_repetition_fr*/0,  /*src_startbit*/47,   /*sig_length*/8,  /*des_slotid_fr*/0,   /*des_basecycle_fr*/0,  /*des_repetition_fr*/0,   /*des_startbit*/327,    /*src_cyc*/101,  /*src_id*/0x1f5,   /*src_dlc*/64,   /*des_cyc*/60,   /*des_id*/0x16f, /*src_updatebit*/199,   /*des_updatebit*/216,      /*initvalue*/0         },
           {   /*sig_name*/"isPinionSteerAgGroupForBkpChks_0",   /*src_can*/"ZCU_CANFD1",   /*src_network_type*/"CANFD",   /*src_slotid_fr*/0,   /*src_basecycle_fr*/0,  /*src_repetition_fr*/0,  /*src_startbit*/111,   /*sig_length*/8,  /*des_slotid_fr*/0,   /*des_basecycle_fr*/0,  /*des_repetition_fr*/0,   /*des_startbit*/87,    /*src_cyc*/101,  /*src_id*/0x71,   /*src_dlc*/64,   /*des_cyc*/450,   /*des_id*/0x335, /*src_updatebit*/182,   /*des_updatebit*/71,      /*initvalue*/0         },
           {   /*sig_name*/"isPinionSteerAgGroupForBkpCntr_0",   /*src_can*/"ZCU_CANFD1",   /*src_network_type*/"CANFD",   /*src_slotid_fr*/0,   /*src_basecycle_fr*/0,  /*src_repetition_fr*/0,  /*src_startbit*/119,   /*sig_length*/4,  /*des_slotid_fr*/0,   /*des_basecycle_fr*/0,  /*des_repetition_fr*/0,   /*des_startbit*/127,    /*src_cyc*/101,  /*src_id*/0x71,   /*src_dlc*/64,   /*des_cyc*/450,   /*des_id*/0x335, /*src_updatebit*/182,   /*des_updatebit*/71,      /*initvalue*/0         },
           {   /*sig_name*/"isPinionSteerAgGroupForBkpSteerWhlTqQfForBkp_0",   /*src_can*/"ZCU_CANFD1",   /*src_network_type*/"CANFD",   /*src_slotid_fr*/0,   /*src_basecycle_fr*/0,  /*src_repetition_fr*/0,  /*src_startbit*/113,   /*sig_length*/2,  /*des_slotid_fr*/0,   /*des_basecycle_fr*/0,  /*des_repetition_fr*/0,   /*des_startbit*/123,    /*src_cyc*/101,  /*src_id*/0x71,   /*src_dlc*/64,   /*des_cyc*/450,   /*des_id*/0x335, /*src_updatebit*/182,   /*des_updatebit*/71,      /*initvalue*/1         },
           {   /*sig_name*/"isPinionSteerAgGroupForBkpPinionSteerAgQfForBkp_0",   /*src_can*/"ZCU_CANFD1",   /*src_network_type*/"CANFD",   /*src_slotid_fr*/0,   /*src_basecycle_fr*/0,  /*src_repetition_fr*/0,  /*src_startbit*/97,   /*sig_length*/2,  /*des_slotid_fr*/0,   /*des_basecycle_fr*/0,  /*des_repetition_fr*/0,   /*des_startbit*/95,    /*src_cyc*/101,  /*src_id*/0x71,   /*src_dlc*/64,   /*des_cyc*/450,   /*des_id*/0x335, /*src_updatebit*/182,   /*des_updatebit*/71,      /*initvalue*/1         },
           {   /*sig_name*/"isPinionSteerAgGroupForBkpPinionSteerAgSpdQfForBkp_0",   /*src_can*/"ZCU_CANFD1",   /*src_network_type*/"CANFD",   /*src_slotid_fr*/0,   /*src_basecycle_fr*/0,  /*src_repetition_fr*/0,  /*src_startbit*/115,   /*sig_length*/2,  /*des_slotid_fr*/0,   /*des_basecycle_fr*/0,  /*des_repetition_fr*/0,   /*des_startbit*/111,    /*src_cyc*/101,  /*src_id*/0x71,   /*src_dlc*/64,   /*des_cyc*/450,   /*des_id*/0x335, /*src_updatebit*/182,   /*des_updatebit*/71,      /*initvalue*/1         },
           {   /*sig_name*/"isPinionSteerAgGroupForBkpSteerWhlTqForBkp_0",   /*src_can*/"ZCU_CANFD1",   /*src_network_type*/"CANFD",   /*src_slotid_fr*/0,   /*src_basecycle_fr*/0,  /*src_repetition_fr*/0,  /*src_startbit*/95,   /*sig_length*/14,  /*des_slotid_fr*/0,   /*des_basecycle_fr*/0,  /*des_repetition_fr*/0,   /*des_startbit*/109,    /*src_cyc*/101,  /*src_id*/0x71,   /*src_dlc*/64,   /*des_cyc*/450,   /*des_id*/0x335, /*src_updatebit*/182,   /*des_updatebit*/71,      /*initvalue*/0         },
           {   /*sig_name*/"isPinionSteerAgGroupForBkpPinionSteerAgForBkp_0",   /*src_can*/"ZCU_CANFD1",   /*src_network_type*/"CANFD",   /*src_slotid_fr*/0,   /*src_basecycle_fr*/0,  /*src_repetition_fr*/0,  /*src_startbit*/79,   /*sig_length*/15,  /*des_slotid_fr*/0,   /*des_basecycle_fr*/0,  /*des_repetition_fr*/0,   /*des_startbit*/70,    /*src_cyc*/101,  /*src_id*/0x71,   /*src_dlc*/64,   /*des_cyc*/450,   /*des_id*/0x335, /*src_updatebit*/182,   /*des_updatebit*/71,      /*initvalue*/0         },
           {   /*sig_name*/"isPinionSteerAgGroupForBkpPinionSteerAgSpdForBkp_0",   /*src_can*/"ZCU_CANFD1",   /*src_network_type*/"CANFD",   /*src_slotid_fr*/0,   /*src_basecycle_fr*/0,  /*src_repetition_fr*/0,  /*src_startbit*/127,   /*sig_length*/14,  /*des_slotid_fr*/0,   /*des_basecycle_fr*/0,  /*des_repetition_fr*/0,   /*des_startbit*/93,    /*src_cyc*/101,  /*src_id*/0x71,   /*src_dlc*/64,   /*des_cyc*/450,   /*des_id*/0x335, /*src_updatebit*/182,   /*des_updatebit*/71,      /*initvalue*/0         },
           {   /*sig_name*/"isHmiAirDistbnRow1_0",   /*src_can*/"ZCU_CANFD1",   /*src_network_type*/"CANFD",   /*src_slotid_fr*/0,   /*src_basecycle_fr*/0,  /*src_repetition_fr*/0,  /*src_startbit*/47,   /*sig_length*/3,  /*des_slotid_fr*/0,   /*des_basecycle_fr*/0,  /*des_repetition_fr*/0,   /*des_startbit*/268,    /*src_cyc*/101,  /*src_id*/0x307,   /*src_dlc*/64,   /*des_cyc*/100,   /*des_id*/0x23d, /*src_updatebit*/44,   /*des_updatebit*/265,      /*initvalue*/0         },
           {   /*sig_name*/"isProfPenSts1_0",   /*src_can*/"ZCU_CANFD1",   /*src_network_type*/"CANFD",   /*src_slotid_fr*/0,   /*src_basecycle_fr*/0,  /*src_repetition_fr*/0,  /*src_startbit*/55,   /*sig_length*/4,  /*des_slotid_fr*/0,   /*des_basecycle_fr*/0,  /*des_repetition_fr*/0,   /*des_startbit*/247,    /*src_cyc*/101,  /*src_id*/0x1f8,   /*src_dlc*/64,   /*des_cyc*/40,   /*des_id*/0x13c, /*src_updatebit*/38,   /*des_updatebit*/243,      /*initvalue*/0         },
           {   /*sig_name*/"isSetSpdForCrsCtrlFct_0",   /*src_can*/"ZCU_CANFD1",   /*src_network_type*/"CANFD",   /*src_slotid_fr*/0,   /*src_basecycle_fr*/0,  /*src_repetition_fr*/0,  /*src_startbit*/263,   /*sig_length*/12,  /*des_slotid_fr*/0,   /*des_basecycle_fr*/0,  /*des_repetition_fr*/0,   /*des_startbit*/167,    /*src_cyc*/101,  /*src_id*/0x160,   /*src_dlc*/64,   /*des_cyc*/20,   /*des_id*/0xdf, /*src_updatebit*/267,   /*des_updatebit*/171,      /*initvalue*/0         },
           {   /*sig_name*/"isPlannedPahDe_0",   /*src_can*/"ZCU_CANFD1",   /*src_network_type*/"CANFD",   /*src_slotid_fr*/0,   /*src_basecycle_fr*/0,  /*src_repetition_fr*/0,  /*src_startbit*/266,   /*sig_length*/2,  /*des_slotid_fr*/0,   /*des_basecycle_fr*/0,  /*des_repetition_fr*/0,   /*des_startbit*/247,    /*src_cyc*/101,  /*src_id*/0x160,   /*src_dlc*/64,   /*des_cyc*/60,   /*des_id*/0x16f, /*src_updatebit*/264,   /*des_updatebit*/245,      /*initvalue*/0         },
           {   /*sig_name*/"isSpdLimUnit_0",   /*src_can*/"ZCU_CANFD1",   /*src_network_type*/"CANFD",   /*src_slotid_fr*/0,   /*src_basecycle_fr*/0,  /*src_repetition_fr*/0,  /*src_startbit*/177,   /*sig_length*/1,  /*des_slotid_fr*/0,   /*des_basecycle_fr*/0,  /*des_repetition_fr*/0,   /*des_startbit*/216,    /*src_cyc*/101,  /*src_id*/0x2f0,   /*src_dlc*/64,   /*des_cyc*/40,   /*des_id*/0x13c, /*src_updatebit*/176,   /*des_updatebit*/407,      /*initvalue*/0         },
           {   /*sig_name*/"isHmiMaxEvMod_0",   /*src_can*/"ZCU_CANFD1",   /*src_network_type*/"CANFD",   /*src_slotid_fr*/0,   /*src_basecycle_fr*/0,  /*src_repetition_fr*/0,  /*src_startbit*/295,   /*sig_length*/1,  /*des_slotid_fr*/0,   /*des_basecycle_fr*/0,  /*des_repetition_fr*/0,   /*des_startbit*/420,    /*src_cyc*/101,  /*src_id*/0x160,   /*src_dlc*/64,   /*des_cyc*/30,   /*des_id*/0xe5, /*src_updatebit*/294,   /*des_updatebit*/419,      /*initvalue*/0         }
       }
   },
   {
       /*des_can*/ "ZCUD_CAN1",
       /*networktype*/ "CAN",
       135,
       {
           {   /*sig_name*/"isCllsnThreat_0",   /*src_can*/"ZCU_CANFD1",   /*src_network_type*/"CANFD",   /*src_slotid_fr*/0,   /*src_basecycle_fr*/0,  /*src_repetition_fr*/0,  /*src_startbit*/109,   /*sig_length*/2,  /*des_slotid_fr*/0,   /*des_basecycle_fr*/0,  /*des_repetition_fr*/0,   /*des_startbit*/23,    /*src_cyc*/101,  /*src_id*/0x1f0,   /*src_dlc*/64,   /*des_cyc*/40,   /*des_id*/0x83, /*src_updatebit*/107,   /*des_updatebit*/21,      /*initvalue*/0         },
           {   /*sig_name*/"isVehHomePrkgSysSts_0",   /*src_can*/"ZCU_CANFD1",   /*src_network_type*/"CANFD",   /*src_slotid_fr*/0,   /*src_basecycle_fr*/0,  /*src_repetition_fr*/0,  /*src_startbit*/23,   /*sig_length*/5,  /*des_slotid_fr*/0,   /*des_basecycle_fr*/0,  /*des_repetition_fr*/0,   /*des_startbit*/63,    /*src_cyc*/101,  /*src_id*/0x112,   /*src_dlc*/64,   /*des_cyc*/800,   /*des_id*/0x471, /*src_updatebit*/18,   /*des_updatebit*/58,      /*initvalue*/0         },
           {   /*sig_name*/"isSftyDecelGroupSafeCntr_0",   /*src_can*/"ZCU_CANFD1",   /*src_network_type*/"CANFD",   /*src_slotid_fr*/0,   /*src_basecycle_fr*/0,  /*src_repetition_fr*/0,  /*src_startbit*/207,   /*sig_length*/4,  /*des_slotid_fr*/0,   /*des_basecycle_fr*/0,  /*des_repetition_fr*/0,   /*des_startbit*/43,    /*src_cyc*/101,  /*src_id*/0x71,   /*src_dlc*/64,   /*des_cyc*/40,   /*des_id*/0x83, /*src_updatebit*/202,   /*des_updatebit*/51,      /*initvalue*/0         },
           {   /*sig_name*/"isSftyDecelGroupSafeAsySftyDecelReq_0",   /*src_can*/"ZCU_CANFD1",   /*src_network_type*/"CANFD",   /*src_slotid_fr*/0,   /*src_basecycle_fr*/0,  /*src_repetition_fr*/0,  /*src_startbit*/191,   /*sig_length*/8,  /*des_slotid_fr*/0,   /*des_basecycle_fr*/0,  /*des_repetition_fr*/0,   /*des_startbit*/31,    /*src_cyc*/101,  /*src_id*/0x71,   /*src_dlc*/64,   /*des_cyc*/40,   /*des_id*/0x83, /*src_updatebit*/202,   /*des_updatebit*/51,      /*initvalue*/0         },
           {   /*sig_name*/"isSftyDecelGroupSafeAsySftyEnaDecel_0",   /*src_can*/"ZCU_CANFD1",   /*src_network_type*/"CANFD",   /*src_slotid_fr*/0,   /*src_basecycle_fr*/0,  /*src_repetition_fr*/0,  /*src_startbit*/203,   /*sig_length*/1,  /*des_slotid_fr*/0,   /*des_basecycle_fr*/0,  /*des_repetition_fr*/0,   /*des_startbit*/44,    /*src_cyc*/101,  /*src_id*/0x71,   /*src_dlc*/64,   /*des_cyc*/40,   /*des_id*/0x83, /*src_updatebit*/202,   /*des_updatebit*/51,      /*initvalue*/0         },
           {   /*sig_name*/"isSftyDecelGroupSafeChks_0",   /*src_can*/"ZCU_CANFD1",   /*src_network_type*/"CANFD",   /*src_slotid_fr*/0,   /*src_basecycle_fr*/0,  /*src_repetition_fr*/0,  /*src_startbit*/199,   /*sig_length*/8,  /*des_slotid_fr*/0,   /*des_basecycle_fr*/0,  /*des_repetition_fr*/0,   /*des_startbit*/39,    /*src_cyc*/101,  /*src_id*/0x71,   /*src_dlc*/64,   /*des_cyc*/40,   /*des_id*/0x83, /*src_updatebit*/202,   /*des_updatebit*/51,      /*initvalue*/0         },
           {   /*sig_name*/"isBkpOfDstTrvld_0",   /*src_can*/"ZCU_CANFD1",   /*src_network_type*/"CANFD",   /*src_slotid_fr*/0,   /*src_basecycle_fr*/0,  /*src_repetition_fr*/0,  /*src_startbit*/5,   /*sig_length*/21,  /*des_slotid_fr*/0,   /*des_basecycle_fr*/0,  /*des_repetition_fr*/0,   /*des_startbit*/4,    /*src_cyc*/101,  /*src_id*/0x160,   /*src_dlc*/64,   /*des_cyc*/175,   /*des_id*/0x310, /*src_updatebit*/16,   /*des_updatebit*/5,      /*initvalue*/0         },
           {   /*sig_name*/"isAsySftyFctStsToEDRACSFCFctSts_0",   /*src_can*/"ZCU_CANFD1",   /*src_network_type*/"CANFD",   /*src_slotid_fr*/0,   /*src_basecycle_fr*/0,  /*src_repetition_fr*/0,  /*src_startbit*/230,   /*sig_length*/3,  /*des_slotid_fr*/0,   /*des_basecycle_fr*/0,  /*des_repetition_fr*/0,   /*des_startbit*/28,    /*src_cyc*/101,  /*src_id*/0x265,   /*src_dlc*/64,   /*des_cyc*/120,   /*des_id*/0x210, /*src_updatebit*/241,   /*des_updatebit*/49,      /*initvalue*/0         },
           {   /*sig_name*/"isAsySftyFctStsToEDRACSFB1FctSts_0",   /*src_can*/"ZCU_CANFD1",   /*src_network_type*/"CANFD",   /*src_slotid_fr*/0,   /*src_basecycle_fr*/0,  /*src_repetition_fr*/0,  /*src_startbit*/220,   /*sig_length*/3,  /*des_slotid_fr*/0,   /*des_basecycle_fr*/0,  /*des_repetition_fr*/0,   /*des_startbit*/18,    /*src_cyc*/101,  /*src_id*/0x265,   /*src_dlc*/64,   /*des_cyc*/120,   /*des_id*/0x210, /*src_updatebit*/241,   /*des_updatebit*/49,      /*initvalue*/0         },
           {   /*sig_name*/"isAsySftyFctStsToEDRCSFFctSts_0",   /*src_can*/"ZCU_CANFD1",   /*src_network_type*/"CANFD",   /*src_slotid_fr*/0,   /*src_basecycle_fr*/0,  /*src_repetition_fr*/0,  /*src_startbit*/234,   /*sig_length*/3,  /*des_slotid_fr*/0,   /*des_basecycle_fr*/0,  /*des_repetition_fr*/0,   /*des_startbit*/44,    /*src_cyc*/101,  /*src_id*/0x265,   /*src_dlc*/64,   /*des_cyc*/120,   /*des_id*/0x210, /*src_updatebit*/241,   /*des_updatebit*/49,      /*initvalue*/0         },
           {   /*sig_name*/"isAsySftyFctStsToEDRACSFB2FctSts_0",   /*src_can*/"ZCU_CANFD1",   /*src_network_type*/"CANFD",   /*src_slotid_fr*/0,   /*src_basecycle_fr*/0,  /*src_repetition_fr*/0,  /*src_startbit*/217,   /*sig_length*/3,  /*des_slotid_fr*/0,   /*des_basecycle_fr*/0,  /*des_repetition_fr*/0,   /*des_startbit*/31,    /*src_cyc*/101,  /*src_id*/0x265,   /*src_dlc*/64,   /*des_cyc*/120,   /*des_id*/0x210, /*src_updatebit*/241,   /*des_updatebit*/49,      /*initvalue*/0         },
           {   /*sig_name*/"isAsySftyFctStsToEDRACSFEFctSts_0",   /*src_can*/"ZCU_CANFD1",   /*src_network_type*/"CANFD",   /*src_slotid_fr*/0,   /*src_basecycle_fr*/0,  /*src_repetition_fr*/0,  /*src_startbit*/224,   /*sig_length*/3,  /*des_slotid_fr*/0,   /*des_basecycle_fr*/0,  /*des_repetition_fr*/0,   /*des_startbit*/36,    /*src_cyc*/101,  /*src_id*/0x265,   /*src_dlc*/64,   /*des_cyc*/120,   /*des_id*/0x210, /*src_updatebit*/241,   /*des_updatebit*/49,      /*initvalue*/0         },
           {   /*sig_name*/"isAsySftyFctStsToEDRLDWSFctSts_0",   /*src_can*/"ZCU_CANFD1",   /*src_network_type*/"CANFD",   /*src_slotid_fr*/0,   /*src_basecycle_fr*/0,  /*src_repetition_fr*/0,  /*src_startbit*/244,   /*sig_length*/3,  /*des_slotid_fr*/0,   /*des_basecycle_fr*/0,  /*des_repetition_fr*/0,   /*des_startbit*/52,    /*src_cyc*/101,  /*src_id*/0x265,   /*src_dlc*/64,   /*des_cyc*/120,   /*des_id*/0x210, /*src_updatebit*/241,   /*des_updatebit*/49,      /*initvalue*/0         },
           {   /*sig_name*/"isAsySftyFctStsToEDRACCFctSTs_0",   /*src_can*/"ZCU_CANFD1",   /*src_network_type*/"CANFD",   /*src_slotid_fr*/0,   /*src_basecycle_fr*/0,  /*src_repetition_fr*/0,  /*src_startbit*/223,   /*sig_length*/3,  /*des_slotid_fr*/0,   /*des_basecycle_fr*/0,  /*des_repetition_fr*/0,   /*des_startbit*/21,    /*src_cyc*/101,  /*src_id*/0x265,   /*src_dlc*/64,   /*des_cyc*/120,   /*des_id*/0x210, /*src_updatebit*/241,   /*des_updatebit*/49,      /*initvalue*/0         },
           {   /*sig_name*/"isAsySftyFctStsToEDRESFFctSts_0",   /*src_can*/"ZCU_CANFD1",   /*src_network_type*/"CANFD",   /*src_slotid_fr*/0,   /*src_basecycle_fr*/0,  /*src_repetition_fr*/0,  /*src_startbit*/247,   /*sig_length*/3,  /*des_slotid_fr*/0,   /*des_basecycle_fr*/0,  /*des_repetition_fr*/0,   /*des_startbit*/55,    /*src_cyc*/101,  /*src_id*/0x265,   /*src_dlc*/64,   /*des_cyc*/120,   /*des_id*/0x210, /*src_updatebit*/241,   /*des_updatebit*/49,      /*initvalue*/0         },
           {   /*sig_name*/"isAsySftyFctStsToEDRAEBSFctSts_0",   /*src_can*/"ZCU_CANFD1",   /*src_network_type*/"CANFD",   /*src_slotid_fr*/0,   /*src_basecycle_fr*/0,  /*src_repetition_fr*/0,  /*src_startbit*/237,   /*sig_length*/3,  /*des_slotid_fr*/0,   /*des_basecycle_fr*/0,  /*des_repetition_fr*/0,   /*des_startbit*/47,    /*src_cyc*/101,  /*src_id*/0x265,   /*src_dlc*/64,   /*des_cyc*/120,   /*des_id*/0x210, /*src_updatebit*/241,   /*des_updatebit*/49,      /*initvalue*/0         },
           {   /*sig_name*/"isAsySftyFctStsToEDRACSFDFctSts_0",   /*src_can*/"ZCU_CANFD1",   /*src_network_type*/"CANFD",   /*src_slotid_fr*/0,   /*src_basecycle_fr*/0,  /*src_repetition_fr*/0,  /*src_startbit*/227,   /*sig_length*/3,  /*des_slotid_fr*/0,   /*des_basecycle_fr*/0,  /*des_repetition_fr*/0,   /*des_startbit*/39,    /*src_cyc*/101,  /*src_id*/0x265,   /*src_dlc*/64,   /*des_cyc*/120,   /*des_id*/0x210, /*src_updatebit*/241,   /*des_updatebit*/49,      /*initvalue*/0         },
           {   /*sig_name*/"isDoorOpenwarnRiIndcn_0",   /*src_can*/"ZCU_CANFD1",   /*src_network_type*/"CANFD",   /*src_slotid_fr*/0,   /*src_basecycle_fr*/0,  /*src_repetition_fr*/0,  /*src_startbit*/475,   /*sig_length*/2,  /*des_slotid_fr*/0,   /*des_basecycle_fr*/0,  /*des_repetition_fr*/0,   /*des_startbit*/50,    /*src_cyc*/101,  /*src_id*/0x109,   /*src_dlc*/64,   /*des_cyc*/10,   /*des_id*/0x54, /*src_updatebit*/473,   /*des_updatebit*/48,      /*initvalue*/0         },
           {   /*sig_name*/"isPrkgStsToEDRHPATo_0",   /*src_can*/"ZCU_CANFD1",   /*src_network_type*/"CANFD",   /*src_slotid_fr*/0,   /*src_basecycle_fr*/0,  /*src_repetition_fr*/0,  /*src_startbit*/4,   /*sig_length*/3,  /*des_slotid_fr*/0,   /*des_basecycle_fr*/0,  /*des_repetition_fr*/0,   /*des_startbit*/36,    /*src_cyc*/101,  /*src_id*/0x211,   /*src_dlc*/64,   /*des_cyc*/100,   /*des_id*/0x228, /*src_updatebit*/18,   /*des_updatebit*/50,      /*initvalue*/0         },
           {   /*sig_name*/"isPrkgStsToEDRAPATo_0",   /*src_can*/"ZCU_CANFD1",   /*src_network_type*/"CANFD",   /*src_slotid_fr*/0,   /*src_basecycle_fr*/0,  /*src_repetition_fr*/0,  /*src_startbit*/7,   /*sig_length*/3,  /*des_slotid_fr*/0,   /*des_basecycle_fr*/0,  /*des_repetition_fr*/0,   /*des_startbit*/39,    /*src_cyc*/101,  /*src_id*/0x211,   /*src_dlc*/64,   /*des_cyc*/100,   /*des_id*/0x228, /*src_updatebit*/18,   /*des_updatebit*/50,      /*initvalue*/0         },
           {   /*sig_name*/"isPrkgStsToEDRreserved3_0",   /*src_can*/"ZCU_CANFD1",   /*src_network_type*/"CANFD",   /*src_slotid_fr*/0,   /*src_basecycle_fr*/0,  /*src_repetition_fr*/0,  /*src_startbit*/8,   /*sig_length*/3,  /*des_slotid_fr*/0,   /*des_basecycle_fr*/0,  /*des_repetition_fr*/0,   /*des_startbit*/40,    /*src_cyc*/101,  /*src_id*/0x211,   /*src_dlc*/64,   /*des_cyc*/100,   /*des_id*/0x228, /*src_updatebit*/18,   /*des_updatebit*/50,      /*initvalue*/0         },
           {   /*sig_name*/"isPrkgStsToEDRRPATo_0",   /*src_can*/"ZCU_CANFD1",   /*src_network_type*/"CANFD",   /*src_slotid_fr*/0,   /*src_basecycle_fr*/0,  /*src_repetition_fr*/0,  /*src_startbit*/21,   /*sig_length*/3,  /*des_slotid_fr*/0,   /*des_basecycle_fr*/0,  /*des_repetition_fr*/0,   /*des_startbit*/53,    /*src_cyc*/101,  /*src_id*/0x211,   /*src_dlc*/64,   /*des_cyc*/100,   /*des_id*/0x228, /*src_updatebit*/18,   /*des_updatebit*/50,      /*initvalue*/0         },
           {   /*sig_name*/"isPrkgStsToEDRreserved1_0",   /*src_can*/"ZCU_CANFD1",   /*src_network_type*/"CANFD",   /*src_slotid_fr*/0,   /*src_basecycle_fr*/0,  /*src_repetition_fr*/0,  /*src_startbit*/14,   /*sig_length*/3,  /*des_slotid_fr*/0,   /*des_basecycle_fr*/0,  /*des_repetition_fr*/0,   /*des_startbit*/46,    /*src_cyc*/101,  /*src_id*/0x211,   /*src_dlc*/64,   /*des_cyc*/100,   /*des_id*/0x228, /*src_updatebit*/18,   /*des_updatebit*/50,      /*initvalue*/0         },
           {   /*sig_name*/"isPrkgStsToEDRLSDAandTBATo_0",   /*src_can*/"ZCU_CANFD1",   /*src_network_type*/"CANFD",   /*src_slotid_fr*/0,   /*src_basecycle_fr*/0,  /*src_repetition_fr*/0,  /*src_startbit*/1,   /*sig_length*/3,  /*des_slotid_fr*/0,   /*des_basecycle_fr*/0,  /*des_repetition_fr*/0,   /*des_startbit*/33,    /*src_cyc*/101,  /*src_id*/0x211,   /*src_dlc*/64,   /*des_cyc*/100,   /*des_id*/0x228, /*src_updatebit*/18,   /*des_updatebit*/50,      /*initvalue*/0         },
           {   /*sig_name*/"isPrkgStsToEDRreserved2_0",   /*src_can*/"ZCU_CANFD1",   /*src_network_type*/"CANFD",   /*src_slotid_fr*/0,   /*src_basecycle_fr*/0,  /*src_repetition_fr*/0,  /*src_startbit*/11,   /*sig_length*/3,  /*des_slotid_fr*/0,   /*des_basecycle_fr*/0,  /*des_repetition_fr*/0,   /*des_startbit*/43,    /*src_cyc*/101,  /*src_id*/0x211,   /*src_dlc*/64,   /*des_cyc*/100,   /*des_id*/0x228, /*src_updatebit*/18,   /*des_updatebit*/50,      /*initvalue*/0         },
           {   /*sig_name*/"isADTakeoverReqGroupChks_0",   /*src_can*/"ZCU_CANFD1",   /*src_network_type*/"CANFD",   /*src_slotid_fr*/0,   /*src_basecycle_fr*/0,  /*src_repetition_fr*/0,  /*src_startbit*/271,   /*sig_length*/8,  /*des_slotid_fr*/0,   /*des_basecycle_fr*/0,  /*des_repetition_fr*/0,   /*des_startbit*/15,    /*src_cyc*/101,  /*src_id*/0x241,   /*src_dlc*/64,   /*des_cyc*/120,   /*des_id*/0x210, /*src_updatebit*/286,   /*des_updatebit*/7,      /*initvalue*/0         },
           {   /*sig_name*/"isADTakeoverReqGroupADTakeoverMsg_0",   /*src_can*/"ZCU_CANFD1",   /*src_network_type*/"CANFD",   /*src_slotid_fr*/0,   /*src_basecycle_fr*/0,  /*src_repetition_fr*/0,  /*src_startbit*/275,   /*sig_length*/3,  /*des_slotid_fr*/0,   /*des_basecycle_fr*/0,  /*des_repetition_fr*/0,   /*des_startbit*/6,    /*src_cyc*/101,  /*src_id*/0x241,   /*src_dlc*/64,   /*des_cyc*/120,   /*des_id*/0x210, /*src_updatebit*/286,   /*des_updatebit*/7,      /*initvalue*/0         },
           {   /*sig_name*/"isADTakeoverReqGroupADTakeoverAudio_0",   /*src_can*/"ZCU_CANFD1",   /*src_network_type*/"CANFD",   /*src_slotid_fr*/0,   /*src_basecycle_fr*/0,  /*src_repetition_fr*/0,  /*src_startbit*/272,   /*sig_length*/2,  /*des_slotid_fr*/0,   /*des_basecycle_fr*/0,  /*des_repetition_fr*/0,   /*des_startbit*/23,    /*src_cyc*/101,  /*src_id*/0x241,   /*src_dlc*/64,   /*des_cyc*/120,   /*des_id*/0x210, /*src_updatebit*/286,   /*des_updatebit*/7,      /*initvalue*/0         },
           {   /*sig_name*/"isADTakeoverReqGroupCntr_0",   /*src_can*/"ZCU_CANFD1",   /*src_network_type*/"CANFD",   /*src_slotid_fr*/0,   /*src_basecycle_fr*/0,  /*src_repetition_fr*/0,  /*src_startbit*/279,   /*sig_length*/4,  /*des_slotid_fr*/0,   /*des_basecycle_fr*/0,  /*des_repetition_fr*/0,   /*des_startbit*/3,    /*src_cyc*/101,  /*src_id*/0x241,   /*src_dlc*/64,   /*des_cyc*/120,   /*des_id*/0x210, /*src_updatebit*/286,   /*des_updatebit*/7,      /*initvalue*/0         },
           {   /*sig_name*/"isWinPosnStsAtReRi_0",   /*src_can*/"ZCU_CANFD1",   /*src_network_type*/"CANFD",   /*src_slotid_fr*/0,   /*src_basecycle_fr*/0,  /*src_repetition_fr*/0,  /*src_startbit*/23,   /*sig_length*/5,  /*des_slotid_fr*/0,   /*des_basecycle_fr*/0,  /*des_repetition_fr*/0,   /*des_startbit*/61,    /*src_cyc*/101,  /*src_id*/0x212,   /*src_dlc*/64,   /*des_cyc*/70,   /*des_id*/0x99, /*src_updatebit*/30,   /*des_updatebit*/56,      /*initvalue*/0         },
           {   /*sig_name*/"isCllsnMtgtnFctSts_0",   /*src_can*/"ZCU_CANFD1",   /*src_network_type*/"CANFD",   /*src_slotid_fr*/0,   /*src_basecycle_fr*/0,  /*src_repetition_fr*/0,  /*src_startbit*/135,   /*sig_length*/3,  /*des_slotid_fr*/0,   /*des_basecycle_fr*/0,  /*des_repetition_fr*/0,   /*des_startbit*/19,    /*src_cyc*/101,  /*src_id*/0x2f0,   /*src_dlc*/64,   /*des_cyc*/350,   /*des_id*/0x384, /*src_updatebit*/132,   /*des_updatebit*/16,      /*initvalue*/2         },
           {   /*sig_name*/"isBrkSysCylPMstChks_0",   /*src_can*/"ZCU_CANFD1",   /*src_network_type*/"CANFD",   /*src_slotid_fr*/0,   /*src_basecycle_fr*/0,  /*src_repetition_fr*/0,  /*src_startbit*/249,   /*sig_length*/8,  /*des_slotid_fr*/0,   /*des_basecycle_fr*/0,  /*des_repetition_fr*/0,   /*des_startbit*/15,    /*src_cyc*/101,  /*src_id*/0x82,   /*src_dlc*/64,   /*des_cyc*/10,   /*des_id*/0x54, /*src_updatebit*/431,   /*des_updatebit*/6,      /*initvalue*/0         },
           {   /*sig_name*/"isBrkSysCylPMstCntr_0",   /*src_can*/"ZCU_CANFD1",   /*src_network_type*/"CANFD",   /*src_slotid_fr*/0,   /*src_basecycle_fr*/0,  /*src_repetition_fr*/0,  /*src_startbit*/257,   /*sig_length*/4,  /*des_slotid_fr*/0,   /*des_basecycle_fr*/0,  /*des_repetition_fr*/0,   /*des_startbit*/3,    /*src_cyc*/101,  /*src_id*/0x82,   /*src_dlc*/64,   /*des_cyc*/10,   /*des_id*/0x54, /*src_updatebit*/431,   /*des_updatebit*/6,      /*initvalue*/0         },
           {   /*sig_name*/"isBrkSysCylPMstAct_0",   /*src_can*/"ZCU_CANFD1",   /*src_network_type*/"CANFD",   /*src_slotid_fr*/0,   /*src_basecycle_fr*/0,  /*src_repetition_fr*/0,  /*src_startbit*/231,   /*sig_length*/10,  /*des_slotid_fr*/0,   /*des_basecycle_fr*/0,  /*des_repetition_fr*/0,   /*des_startbit*/23,    /*src_cyc*/101,  /*src_id*/0x82,   /*src_dlc*/64,   /*des_cyc*/10,   /*des_id*/0x54, /*src_updatebit*/431,   /*des_updatebit*/6,      /*initvalue*/100         },
           {   /*sig_name*/"isBrkSysCylPMstTar_0",   /*src_can*/"ZCU_CANFD1",   /*src_network_type*/"CANFD",   /*src_slotid_fr*/0,   /*src_basecycle_fr*/0,  /*src_repetition_fr*/0,  /*src_startbit*/237,   /*sig_length*/10,  /*des_slotid_fr*/0,   /*des_basecycle_fr*/0,  /*des_repetition_fr*/0,   /*des_startbit*/29,    /*src_cyc*/101,  /*src_id*/0x82,   /*src_dlc*/64,   /*des_cyc*/10,   /*des_id*/0x54, /*src_updatebit*/431,   /*des_updatebit*/6,      /*initvalue*/0         },
           {   /*sig_name*/"isBrkSysCylPMstActQf_0",   /*src_can*/"ZCU_CANFD1",   /*src_network_type*/"CANFD",   /*src_slotid_fr*/0,   /*src_basecycle_fr*/0,  /*src_repetition_fr*/0,  /*src_startbit*/269,   /*sig_length*/2,  /*des_slotid_fr*/0,   /*des_basecycle_fr*/0,  /*des_repetition_fr*/0,   /*des_startbit*/5,    /*src_cyc*/101,  /*src_id*/0x82,   /*src_dlc*/64,   /*des_cyc*/10,   /*des_id*/0x54, /*src_updatebit*/431,   /*des_updatebit*/6,      /*initvalue*/1         },
           {   /*sig_name*/"isBrkSysCylPMstVirt_0",   /*src_can*/"ZCU_CANFD1",   /*src_network_type*/"CANFD",   /*src_slotid_fr*/0,   /*src_basecycle_fr*/0,  /*src_repetition_fr*/0,  /*src_startbit*/243,   /*sig_length*/10,  /*des_slotid_fr*/0,   /*des_basecycle_fr*/0,  /*des_repetition_fr*/0,   /*des_startbit*/35,    /*src_cyc*/101,  /*src_id*/0x82,   /*src_dlc*/64,   /*des_cyc*/10,   /*des_id*/0x54, /*src_updatebit*/431,   /*des_updatebit*/6,      /*initvalue*/0         },
           {   /*sig_name*/"isBrkSysCylPMstVirtQf_0",   /*src_can*/"ZCU_CANFD1",   /*src_network_type*/"CANFD",   /*src_slotid_fr*/0,   /*src_basecycle_fr*/0,  /*src_repetition_fr*/0,  /*src_startbit*/267,   /*sig_length*/2,  /*des_slotid_fr*/0,   /*des_basecycle_fr*/0,  /*des_repetition_fr*/0,   /*des_startbit*/41,    /*src_cyc*/101,  /*src_id*/0x82,   /*src_dlc*/64,   /*des_cyc*/10,   /*des_id*/0x54, /*src_updatebit*/431,   /*des_updatebit*/6,      /*initvalue*/1         },
           {   /*sig_name*/"isCmptmtTFrntFanForCmptmtTRunng_0",   /*src_can*/"ZCU_CANFD1",   /*src_network_type*/"CANFD",   /*src_slotid_fr*/0,   /*src_basecycle_fr*/0,  /*src_repetition_fr*/0,  /*src_startbit*/50,   /*sig_length*/1,  /*des_slotid_fr*/0,   /*des_basecycle_fr*/0,  /*des_repetition_fr*/0,   /*des_startbit*/35,    /*src_cyc*/101,  /*src_id*/0x212,   /*src_dlc*/64,   /*des_cyc*/30,   /*des_id*/0x121, /*src_updatebit*/49,   /*des_updatebit*/38,      /*initvalue*/0         },
           {   /*sig_name*/"isCmptmtTFrntQf_0",   /*src_can*/"ZCU_CANFD1",   /*src_network_type*/"CANFD",   /*src_slotid_fr*/0,   /*src_basecycle_fr*/0,  /*src_repetition_fr*/0,  /*src_startbit*/52,   /*sig_length*/2,  /*des_slotid_fr*/0,   /*des_basecycle_fr*/0,  /*des_repetition_fr*/0,   /*des_startbit*/37,    /*src_cyc*/101,  /*src_id*/0x212,   /*src_dlc*/64,   /*des_cyc*/30,   /*des_id*/0x121, /*src_updatebit*/49,   /*des_updatebit*/38,      /*initvalue*/1         },
           {   /*sig_name*/"isCmptmtTFrntCmptmtTFrnt_0",   /*src_can*/"ZCU_CANFD1",   /*src_network_type*/"CANFD",   /*src_slotid_fr*/0,   /*src_basecycle_fr*/0,  /*src_repetition_fr*/0,  /*src_startbit*/47,   /*sig_length*/11,  /*des_slotid_fr*/0,   /*des_basecycle_fr*/0,  /*des_repetition_fr*/0,   /*des_startbit*/34,    /*src_cyc*/101,  /*src_id*/0x212,   /*src_dlc*/64,   /*des_cyc*/30,   /*des_id*/0x121, /*src_updatebit*/49,   /*des_updatebit*/38,      /*initvalue*/600         },
           {   /*sig_name*/"isDoorOpenwarnLeIndcn_0",   /*src_can*/"ZCU_CANFD1",   /*src_network_type*/"CANFD",   /*src_slotid_fr*/0,   /*src_basecycle_fr*/0,  /*src_repetition_fr*/0,  /*src_startbit*/466,   /*sig_length*/2,  /*des_slotid_fr*/0,   /*des_basecycle_fr*/0,  /*des_repetition_fr*/0,   /*des_startbit*/53,    /*src_cyc*/101,  /*src_id*/0x109,   /*src_dlc*/64,   /*des_cyc*/10,   /*des_id*/0x54, /*src_updatebit*/464,   /*des_updatebit*/51,      /*initvalue*/0         },
           {   /*sig_name*/"isPreCrashFrontDataCntr_0",   /*src_can*/"ZCU_CANFD1",   /*src_network_type*/"CANFD",   /*src_slotid_fr*/0,   /*src_basecycle_fr*/0,  /*src_repetition_fr*/0,  /*src_startbit*/223,   /*sig_length*/4,  /*des_slotid_fr*/0,   /*des_basecycle_fr*/0,  /*des_repetition_fr*/0,   /*des_startbit*/47,    /*src_cyc*/101,  /*src_id*/0x190,   /*src_dlc*/64,   /*des_cyc*/10,   /*des_id*/0x50, /*src_updatebit*/216,   /*des_updatebit*/40,      /*initvalue*/0         },
           {   /*sig_name*/"isPreCrashFrontDataClosingVelocity_0",   /*src_can*/"ZCU_CANFD1",   /*src_network_type*/"CANFD",   /*src_slotid_fr*/0,   /*src_basecycle_fr*/0,  /*src_repetition_fr*/0,  /*src_startbit*/199,   /*sig_length*/8,  /*des_slotid_fr*/0,   /*des_basecycle_fr*/0,  /*des_repetition_fr*/0,   /*des_startbit*/31,    /*src_cyc*/101,  /*src_id*/0x190,   /*src_dlc*/64,   /*des_cyc*/10,   /*des_id*/0x50, /*src_updatebit*/216,   /*des_updatebit*/40,      /*initvalue*/0         },
           {   /*sig_name*/"isPreCrashFrontDataOverLap_0",   /*src_can*/"ZCU_CANFD1",   /*src_network_type*/"CANFD",   /*src_slotid_fr*/0,   /*src_basecycle_fr*/0,  /*src_repetition_fr*/0,  /*src_startbit*/207,   /*sig_length*/8,  /*des_slotid_fr*/0,   /*des_basecycle_fr*/0,  /*des_repetition_fr*/0,   /*des_startbit*/15,    /*src_cyc*/101,  /*src_id*/0x190,   /*src_dlc*/64,   /*des_cyc*/10,   /*des_id*/0x50, /*src_updatebit*/216,   /*des_updatebit*/40,      /*initvalue*/100         },
           {   /*sig_name*/"isPreCrashFrontDataTimeToImpact_0",   /*src_can*/"ZCU_CANFD1",   /*src_network_type*/"CANFD",   /*src_slotid_fr*/0,   /*src_basecycle_fr*/0,  /*src_repetition_fr*/0,  /*src_startbit*/215,   /*sig_length*/8,  /*des_slotid_fr*/0,   /*des_basecycle_fr*/0,  /*des_repetition_fr*/0,   /*des_startbit*/39,    /*src_cyc*/101,  /*src_id*/0x190,   /*src_dlc*/64,   /*des_cyc*/10,   /*des_id*/0x50, /*src_updatebit*/216,   /*des_updatebit*/40,      /*initvalue*/250         },
           {   /*sig_name*/"isPreCrashFrontDataChks_0",   /*src_can*/"ZCU_CANFD1",   /*src_network_type*/"CANFD",   /*src_slotid_fr*/0,   /*src_basecycle_fr*/0,  /*src_repetition_fr*/0,  /*src_startbit*/191,   /*sig_length*/8,  /*des_slotid_fr*/0,   /*des_basecycle_fr*/0,  /*des_repetition_fr*/0,   /*des_startbit*/23,    /*src_cyc*/101,  /*src_id*/0x190,   /*src_dlc*/64,   /*des_cyc*/10,   /*des_id*/0x50, /*src_updatebit*/216,   /*des_updatebit*/40,      /*initvalue*/0         },
           {   /*sig_name*/"isPreCrashFrontDataObjectClass_0",   /*src_can*/"ZCU_CANFD1",   /*src_network_type*/"CANFD",   /*src_slotid_fr*/0,   /*src_basecycle_fr*/0,  /*src_repetition_fr*/0,  /*src_startbit*/219,   /*sig_length*/3,  /*des_slotid_fr*/0,   /*des_basecycle_fr*/0,  /*des_repetition_fr*/0,   /*des_startbit*/43,    /*src_cyc*/101,  /*src_id*/0x190,   /*src_dlc*/64,   /*des_cyc*/10,   /*des_id*/0x50, /*src_updatebit*/216,   /*des_updatebit*/40,      /*initvalue*/0         },
           {   /*sig_name*/"isDrvgAstOnSysSts_0",   /*src_can*/"ZCU_CANFD1",   /*src_network_type*/"CANFD",   /*src_slotid_fr*/0,   /*src_basecycle_fr*/0,  /*src_repetition_fr*/0,  /*src_startbit*/459,   /*sig_length*/4,  /*des_slotid_fr*/0,   /*des_basecycle_fr*/0,  /*des_repetition_fr*/0,   /*des_startbit*/36,    /*src_cyc*/101,  /*src_id*/0x1ca,   /*src_dlc*/64,   /*des_cyc*/40,   /*des_id*/0x366, /*src_updatebit*/393,   /*des_updatebit*/32,      /*initvalue*/0         },
           {   /*sig_name*/"isVehCfgPrmExtCCPBytePosn8_0",   /*src_can*/"ZCU_CANFD1",   /*src_network_type*/"CANFD",   /*src_slotid_fr*/0,   /*src_basecycle_fr*/0,  /*src_repetition_fr*/0,  /*src_startbit*/127,   /*sig_length*/8,  /*des_slotid_fr*/0,   /*des_basecycle_fr*/0,  /*des_repetition_fr*/0,   /*des_startbit*/63,    /*src_cyc*/101,  /*src_id*/0x1f5,   /*src_dlc*/64,   /*des_cyc*/Event,   /*des_id*/0x132, /*src_updatebit*/198,   /*des_updatebit*/1000,      /*initvalue*/0         },
           {   /*sig_name*/"isVehCfgPrmExtCCPBytePosn6_0",   /*src_can*/"ZCU_CANFD1",   /*src_network_type*/"CANFD",   /*src_slotid_fr*/0,   /*src_basecycle_fr*/0,  /*src_repetition_fr*/0,  /*src_startbit*/111,   /*sig_length*/8,  /*des_slotid_fr*/0,   /*des_basecycle_fr*/0,  /*des_repetition_fr*/0,   /*des_startbit*/47,    /*src_cyc*/101,  /*src_id*/0x1f5,   /*src_dlc*/64,   /*des_cyc*/Event,   /*des_id*/0x132, /*src_updatebit*/198,   /*des_updatebit*/1000,      /*initvalue*/0         },
           {   /*sig_name*/"isVehCfgPrmExtCCPBytePosn4_0",   /*src_can*/"ZCU_CANFD1",   /*src_network_type*/"CANFD",   /*src_slotid_fr*/0,   /*src_basecycle_fr*/0,  /*src_repetition_fr*/0,  /*src_startbit*/95,   /*sig_length*/8,  /*des_slotid_fr*/0,   /*des_basecycle_fr*/0,  /*des_repetition_fr*/0,   /*des_startbit*/31,    /*src_cyc*/101,  /*src_id*/0x1f5,   /*src_dlc*/64,   /*des_cyc*/Event,   /*des_id*/0x132, /*src_updatebit*/198,   /*des_updatebit*/1000,      /*initvalue*/0         },
           {   /*sig_name*/"isVehCfgPrmExtCCPBytePosn3_0",   /*src_can*/"ZCU_CANFD1",   /*src_network_type*/"CANFD",   /*src_slotid_fr*/0,   /*src_basecycle_fr*/0,  /*src_repetition_fr*/0,  /*src_startbit*/87,   /*sig_length*/8,  /*des_slotid_fr*/0,   /*des_basecycle_fr*/0,  /*des_repetition_fr*/0,   /*des_startbit*/23,    /*src_cyc*/101,  /*src_id*/0x1f5,   /*src_dlc*/64,   /*des_cyc*/Event,   /*des_id*/0x132, /*src_updatebit*/198,   /*des_updatebit*/1000,      /*initvalue*/0         },
           {   /*sig_name*/"isVehCfgPrmExtCCPBytePosn2_0",   /*src_can*/"ZCU_CANFD1",   /*src_network_type*/"CANFD",   /*src_slotid_fr*/0,   /*src_basecycle_fr*/0,  /*src_repetition_fr*/0,  /*src_startbit*/79,   /*sig_length*/8,  /*des_slotid_fr*/0,   /*des_basecycle_fr*/0,  /*des_repetition_fr*/0,   /*des_startbit*/15,    /*src_cyc*/101,  /*src_id*/0x1f5,   /*src_dlc*/64,   /*des_cyc*/Event,   /*des_id*/0x132, /*src_updatebit*/198,   /*des_updatebit*/1000,      /*initvalue*/0         },
           {   /*sig_name*/"isVehCfgPrmExtBlkIDBytePosn1_0",   /*src_can*/"ZCU_CANFD1",   /*src_network_type*/"CANFD",   /*src_slotid_fr*/0,   /*src_basecycle_fr*/0,  /*src_repetition_fr*/0,  /*src_startbit*/71,   /*sig_length*/8,  /*des_slotid_fr*/0,   /*des_basecycle_fr*/0,  /*des_repetition_fr*/0,   /*des_startbit*/7,    /*src_cyc*/101,  /*src_id*/0x1f5,   /*src_dlc*/64,   /*des_cyc*/Event,   /*des_id*/0x132, /*src_updatebit*/198,   /*des_updatebit*/1000,      /*initvalue*/0         },
           {   /*sig_name*/"isVehCfgPrmExtCCPBytePosn5_0",   /*src_can*/"ZCU_CANFD1",   /*src_network_type*/"CANFD",   /*src_slotid_fr*/0,   /*src_basecycle_fr*/0,  /*src_repetition_fr*/0,  /*src_startbit*/103,   /*sig_length*/8,  /*des_slotid_fr*/0,   /*des_basecycle_fr*/0,  /*des_repetition_fr*/0,   /*des_startbit*/39,    /*src_cyc*/101,  /*src_id*/0x1f5,   /*src_dlc*/64,   /*des_cyc*/Event,   /*des_id*/0x132, /*src_updatebit*/198,   /*des_updatebit*/1000,      /*initvalue*/0         },
           {   /*sig_name*/"isVehCfgPrmExtCCPBytePosn7_0",   /*src_can*/"ZCU_CANFD1",   /*src_network_type*/"CANFD",   /*src_slotid_fr*/0,   /*src_basecycle_fr*/0,  /*src_repetition_fr*/0,  /*src_startbit*/119,   /*sig_length*/8,  /*des_slotid_fr*/0,   /*des_basecycle_fr*/0,  /*des_repetition_fr*/0,   /*des_startbit*/55,    /*src_cyc*/101,  /*src_id*/0x1f5,   /*src_dlc*/64,   /*des_cyc*/Event,   /*des_id*/0x132, /*src_updatebit*/198,   /*des_updatebit*/1000,      /*initvalue*/0         },
           {   /*sig_name*/"isAD4DrvrBeltWarnForBkp_0",   /*src_can*/"ZCU_CANFD1",   /*src_network_type*/"CANFD",   /*src_slotid_fr*/0,   /*src_basecycle_fr*/0,  /*src_repetition_fr*/0,  /*src_startbit*/371,   /*sig_length*/3,  /*des_slotid_fr*/0,   /*des_basecycle_fr*/0,  /*des_repetition_fr*/0,   /*des_startbit*/2,    /*src_cyc*/101,  /*src_id*/0x241,   /*src_dlc*/64,   /*des_cyc*/620,   /*des_id*/0x370, /*src_updatebit*/368,   /*des_updatebit*/3,      /*initvalue*/0         },
           {   /*sig_name*/"isVinBlockNr_0",   /*src_can*/"ZCU_CANFD1",   /*src_network_type*/"CANFD",   /*src_slotid_fr*/0,   /*src_basecycle_fr*/0,  /*src_repetition_fr*/0,  /*src_startbit*/15,   /*sig_length*/8,  /*des_slotid_fr*/0,   /*des_basecycle_fr*/0,  /*des_repetition_fr*/0,   /*des_startbit*/7,    /*src_cyc*/101,  /*src_id*/0x340,   /*src_dlc*/64,   /*des_cyc*/90,   /*des_id*/0x80, /*src_updatebit*/79,   /*des_updatebit*/1000,      /*initvalue*/0         },
           {   /*sig_name*/"isVinVINSignalPos4_0",   /*src_can*/"ZCU_CANFD1",   /*src_network_type*/"CANFD",   /*src_slotid_fr*/0,   /*src_basecycle_fr*/0,  /*src_repetition_fr*/0,  /*src_startbit*/47,   /*sig_length*/8,  /*des_slotid_fr*/0,   /*des_basecycle_fr*/0,  /*des_repetition_fr*/0,   /*des_startbit*/39,    /*src_cyc*/101,  /*src_id*/0x340,   /*src_dlc*/64,   /*des_cyc*/90,   /*des_id*/0x80, /*src_updatebit*/79,   /*des_updatebit*/1000,      /*initvalue*/0         },
           {   /*sig_name*/"isVinVINSignalPos1_0",   /*src_can*/"ZCU_CANFD1",   /*src_network_type*/"CANFD",   /*src_slotid_fr*/0,   /*src_basecycle_fr*/0,  /*src_repetition_fr*/0,  /*src_startbit*/23,   /*sig_length*/8,  /*des_slotid_fr*/0,   /*des_basecycle_fr*/0,  /*des_repetition_fr*/0,   /*des_startbit*/15,    /*src_cyc*/101,  /*src_id*/0x340,   /*src_dlc*/64,   /*des_cyc*/90,   /*des_id*/0x80, /*src_updatebit*/79,   /*des_updatebit*/1000,      /*initvalue*/0         },
           {   /*sig_name*/"isVinVINSignalPos3_0",   /*src_can*/"ZCU_CANFD1",   /*src_network_type*/"CANFD",   /*src_slotid_fr*/0,   /*src_basecycle_fr*/0,  /*src_repetition_fr*/0,  /*src_startbit*/39,   /*sig_length*/8,  /*des_slotid_fr*/0,   /*des_basecycle_fr*/0,  /*des_repetition_fr*/0,   /*des_startbit*/31,    /*src_cyc*/101,  /*src_id*/0x340,   /*src_dlc*/64,   /*des_cyc*/90,   /*des_id*/0x80, /*src_updatebit*/79,   /*des_updatebit*/1000,      /*initvalue*/0         },
           {   /*sig_name*/"isVinVINSignalPos7_0",   /*src_can*/"ZCU_CANFD1",   /*src_network_type*/"CANFD",   /*src_slotid_fr*/0,   /*src_basecycle_fr*/0,  /*src_repetition_fr*/0,  /*src_startbit*/71,   /*sig_length*/8,  /*des_slotid_fr*/0,   /*des_basecycle_fr*/0,  /*des_repetition_fr*/0,   /*des_startbit*/63,    /*src_cyc*/101,  /*src_id*/0x340,   /*src_dlc*/64,   /*des_cyc*/90,   /*des_id*/0x80, /*src_updatebit*/79,   /*des_updatebit*/1000,      /*initvalue*/0         },
           {   /*sig_name*/"isVinVINSignalPos6_0",   /*src_can*/"ZCU_CANFD1",   /*src_network_type*/"CANFD",   /*src_slotid_fr*/0,   /*src_basecycle_fr*/0,  /*src_repetition_fr*/0,  /*src_startbit*/63,   /*sig_length*/8,  /*des_slotid_fr*/0,   /*des_basecycle_fr*/0,  /*des_repetition_fr*/0,   /*des_startbit*/55,    /*src_cyc*/101,  /*src_id*/0x340,   /*src_dlc*/64,   /*des_cyc*/90,   /*des_id*/0x80, /*src_updatebit*/79,   /*des_updatebit*/1000,      /*initvalue*/0         },
           {   /*sig_name*/"isVinVINSignalPos5_0",   /*src_can*/"ZCU_CANFD1",   /*src_network_type*/"CANFD",   /*src_slotid_fr*/0,   /*src_basecycle_fr*/0,  /*src_repetition_fr*/0,  /*src_startbit*/55,   /*sig_length*/8,  /*des_slotid_fr*/0,   /*des_basecycle_fr*/0,  /*des_repetition_fr*/0,   /*des_startbit*/47,    /*src_cyc*/101,  /*src_id*/0x340,   /*src_dlc*/64,   /*des_cyc*/90,   /*des_id*/0x80, /*src_updatebit*/79,   /*des_updatebit*/1000,      /*initvalue*/0         },
           {   /*sig_name*/"isVinVINSignalPos2_0",   /*src_can*/"ZCU_CANFD1",   /*src_network_type*/"CANFD",   /*src_slotid_fr*/0,   /*src_basecycle_fr*/0,  /*src_repetition_fr*/0,  /*src_startbit*/31,   /*sig_length*/8,  /*des_slotid_fr*/0,   /*des_basecycle_fr*/0,  /*des_repetition_fr*/0,   /*des_startbit*/23,    /*src_cyc*/101,  /*src_id*/0x340,   /*src_dlc*/64,   /*des_cyc*/90,   /*des_id*/0x80, /*src_updatebit*/79,   /*des_updatebit*/1000,      /*initvalue*/0         },
           {   /*sig_name*/"isBrkPedlrRatPerc_0",   /*src_can*/"ZCU_CANFD1",   /*src_network_type*/"CANFD",   /*src_slotid_fr*/0,   /*src_basecycle_fr*/0,  /*src_repetition_fr*/0,  /*src_startbit*/6,   /*sig_length*/15,  /*des_slotid_fr*/0,   /*des_basecycle_fr*/0,  /*des_repetition_fr*/0,   /*des_startbit*/6,    /*src_cyc*/101,  /*src_id*/0x1e3,   /*src_dlc*/64,   /*des_cyc*/350,   /*des_id*/0x384, /*src_updatebit*/7,   /*des_updatebit*/7,      /*initvalue*/0         },
           {   /*sig_name*/"isBrkPedlrRatQf_0",   /*src_can*/"ZCU_CANFD1",   /*src_network_type*/"CANFD",   /*src_slotid_fr*/0,   /*src_basecycle_fr*/0,  /*src_repetition_fr*/0,  /*src_startbit*/23,   /*sig_length*/2,  /*des_slotid_fr*/0,   /*des_basecycle_fr*/0,  /*des_repetition_fr*/0,   /*des_startbit*/23,    /*src_cyc*/101,  /*src_id*/0x1e3,   /*src_dlc*/64,   /*des_cyc*/350,   /*des_id*/0x384, /*src_updatebit*/7,   /*des_updatebit*/7,      /*initvalue*/0         },
           {   /*sig_name*/"isEpbStsCntr_0",   /*src_can*/"ZCU_CANFD1",   /*src_network_type*/"CANFD",   /*src_slotid_fr*/0,   /*src_basecycle_fr*/0,  /*src_repetition_fr*/0,  /*src_startbit*/135,   /*sig_length*/4,  /*des_slotid_fr*/0,   /*des_basecycle_fr*/0,  /*des_repetition_fr*/0,   /*des_startbit*/11,    /*src_cyc*/101,  /*src_id*/0x10a,   /*src_dlc*/64,   /*des_cyc*/15,   /*des_id*/0x131, /*src_updatebit*/273,   /*des_updatebit*/50,      /*initvalue*/0         },
           {   /*sig_name*/"isEpbStsChks_0",   /*src_can*/"ZCU_CANFD1",   /*src_network_type*/"CANFD",   /*src_slotid_fr*/0,   /*src_basecycle_fr*/0,  /*src_repetition_fr*/0,  /*src_startbit*/127,   /*sig_length*/8,  /*des_slotid_fr*/0,   /*des_basecycle_fr*/0,  /*des_repetition_fr*/0,   /*des_startbit*/7,    /*src_cyc*/101,  /*src_id*/0x10a,   /*src_dlc*/64,   /*des_cyc*/15,   /*des_id*/0x131, /*src_updatebit*/273,   /*des_updatebit*/50,      /*initvalue*/0         },
           {   /*sig_name*/"isEpbStsEpbSts_0",   /*src_can*/"ZCU_CANFD1",   /*src_network_type*/"CANFD",   /*src_slotid_fr*/0,   /*src_basecycle_fr*/0,  /*src_repetition_fr*/0,  /*src_startbit*/131,   /*sig_length*/4,  /*des_slotid_fr*/0,   /*des_basecycle_fr*/0,  /*des_repetition_fr*/0,   /*des_startbit*/15,    /*src_cyc*/101,  /*src_id*/0x10a,   /*src_dlc*/64,   /*des_cyc*/15,   /*des_id*/0x131, /*src_updatebit*/273,   /*des_updatebit*/50,      /*initvalue*/0         },
           {   /*sig_name*/"isFctaIndcnRi_0",   /*src_can*/"ZCU_CANFD1",   /*src_network_type*/"CANFD",   /*src_slotid_fr*/0,   /*src_basecycle_fr*/0,  /*src_repetition_fr*/0,  /*src_startbit*/39,   /*sig_length*/2,  /*des_slotid_fr*/0,   /*des_basecycle_fr*/0,  /*des_repetition_fr*/0,   /*des_startbit*/17,    /*src_cyc*/101,  /*src_id*/0x1f0,   /*src_dlc*/64,   /*des_cyc*/40,   /*des_id*/0x83, /*src_updatebit*/37,   /*des_updatebit*/18,      /*initvalue*/0         },
           {   /*sig_name*/"isVehCfgPrmExt2BlkIDBytePosn1_0",   /*src_can*/"ZCU_CANFD1",   /*src_network_type*/"CANFD",   /*src_slotid_fr*/0,   /*src_basecycle_fr*/0,  /*src_repetition_fr*/0,  /*src_startbit*/135,   /*sig_length*/8,  /*des_slotid_fr*/0,   /*des_basecycle_fr*/0,  /*des_repetition_fr*/0,   /*des_startbit*/7,    /*src_cyc*/101,  /*src_id*/0x1f5,   /*src_dlc*/64,   /*des_cyc*/Event,   /*des_id*/0x318, /*src_updatebit*/197,   /*des_updatebit*/1000,      /*initvalue*/0         },
           {   /*sig_name*/"isVehCfgPrmExt2CCPBytePosn2_0",   /*src_can*/"ZCU_CANFD1",   /*src_network_type*/"CANFD",   /*src_slotid_fr*/0,   /*src_basecycle_fr*/0,  /*src_repetition_fr*/0,  /*src_startbit*/143,   /*sig_length*/8,  /*des_slotid_fr*/0,   /*des_basecycle_fr*/0,  /*des_repetition_fr*/0,   /*des_startbit*/15,    /*src_cyc*/101,  /*src_id*/0x1f5,   /*src_dlc*/64,   /*des_cyc*/Event,   /*des_id*/0x318, /*src_updatebit*/197,   /*des_updatebit*/1000,      /*initvalue*/0         },
           {   /*sig_name*/"isVehCfgPrmExt2CCPBytePosn6_0",   /*src_can*/"ZCU_CANFD1",   /*src_network_type*/"CANFD",   /*src_slotid_fr*/0,   /*src_basecycle_fr*/0,  /*src_repetition_fr*/0,  /*src_startbit*/175,   /*sig_length*/8,  /*des_slotid_fr*/0,   /*des_basecycle_fr*/0,  /*des_repetition_fr*/0,   /*des_startbit*/47,    /*src_cyc*/101,  /*src_id*/0x1f5,   /*src_dlc*/64,   /*des_cyc*/Event,   /*des_id*/0x318, /*src_updatebit*/197,   /*des_updatebit*/1000,      /*initvalue*/0         },
           {   /*sig_name*/"isVehCfgPrmExt2CCPBytePosn4_0",   /*src_can*/"ZCU_CANFD1",   /*src_network_type*/"CANFD",   /*src_slotid_fr*/0,   /*src_basecycle_fr*/0,  /*src_repetition_fr*/0,  /*src_startbit*/159,   /*sig_length*/8,  /*des_slotid_fr*/0,   /*des_basecycle_fr*/0,  /*des_repetition_fr*/0,   /*des_startbit*/31,    /*src_cyc*/101,  /*src_id*/0x1f5,   /*src_dlc*/64,   /*des_cyc*/Event,   /*des_id*/0x318, /*src_updatebit*/197,   /*des_updatebit*/1000,      /*initvalue*/0         },
           {   /*sig_name*/"isVehCfgPrmExt2CCPBytePosn5_0",   /*src_can*/"ZCU_CANFD1",   /*src_network_type*/"CANFD",   /*src_slotid_fr*/0,   /*src_basecycle_fr*/0,  /*src_repetition_fr*/0,  /*src_startbit*/167,   /*sig_length*/8,  /*des_slotid_fr*/0,   /*des_basecycle_fr*/0,  /*des_repetition_fr*/0,   /*des_startbit*/39,    /*src_cyc*/101,  /*src_id*/0x1f5,   /*src_dlc*/64,   /*des_cyc*/Event,   /*des_id*/0x318, /*src_updatebit*/197,   /*des_updatebit*/1000,      /*initvalue*/0         },
           {   /*sig_name*/"isVehCfgPrmExt2CCPBytePosn3_0",   /*src_can*/"ZCU_CANFD1",   /*src_network_type*/"CANFD",   /*src_slotid_fr*/0,   /*src_basecycle_fr*/0,  /*src_repetition_fr*/0,  /*src_startbit*/151,   /*sig_length*/8,  /*des_slotid_fr*/0,   /*des_basecycle_fr*/0,  /*des_repetition_fr*/0,   /*des_startbit*/23,    /*src_cyc*/101,  /*src_id*/0x1f5,   /*src_dlc*/64,   /*des_cyc*/Event,   /*des_id*/0x318, /*src_updatebit*/197,   /*des_updatebit*/1000,      /*initvalue*/0         },
           {   /*sig_name*/"isVehCfgPrmExt2CCPBytePosn7_0",   /*src_can*/"ZCU_CANFD1",   /*src_network_type*/"CANFD",   /*src_slotid_fr*/0,   /*src_basecycle_fr*/0,  /*src_repetition_fr*/0,  /*src_startbit*/183,   /*sig_length*/8,  /*des_slotid_fr*/0,   /*des_basecycle_fr*/0,  /*des_repetition_fr*/0,   /*des_startbit*/55,    /*src_cyc*/101,  /*src_id*/0x1f5,   /*src_dlc*/64,   /*des_cyc*/Event,   /*des_id*/0x318, /*src_updatebit*/197,   /*des_updatebit*/1000,      /*initvalue*/0         },
           {   /*sig_name*/"isVehCfgPrmExt2CCPBytePosn8_0",   /*src_can*/"ZCU_CANFD1",   /*src_network_type*/"CANFD",   /*src_slotid_fr*/0,   /*src_basecycle_fr*/0,  /*src_repetition_fr*/0,  /*src_startbit*/191,   /*sig_length*/8,  /*des_slotid_fr*/0,   /*des_basecycle_fr*/0,  /*des_repetition_fr*/0,   /*des_startbit*/63,    /*src_cyc*/101,  /*src_id*/0x1f5,   /*src_dlc*/64,   /*des_cyc*/Event,   /*des_id*/0x318, /*src_updatebit*/197,   /*des_updatebit*/1000,      /*initvalue*/0         },
           {   /*sig_name*/"isBrkAndAbsWarnIndcnReqCntr_0",   /*src_can*/"ZCU_CANFD1",   /*src_network_type*/"CANFD",   /*src_slotid_fr*/0,   /*src_basecycle_fr*/0,  /*src_repetition_fr*/0,  /*src_startbit*/111,   /*sig_length*/4,  /*des_slotid_fr*/0,   /*des_basecycle_fr*/0,  /*des_repetition_fr*/0,   /*des_startbit*/31,    /*src_cyc*/101,  /*src_id*/0x240,   /*src_dlc*/64,   /*des_cyc*/350,   /*des_id*/0x388, /*src_updatebit*/104,   /*des_updatebit*/24,      /*initvalue*/0         },
           {   /*sig_name*/"isBrkAndAbsWarnIndcnReqBrkWarnIndcnReq_0",   /*src_can*/"ZCU_CANFD1",   /*src_network_type*/"CANFD",   /*src_slotid_fr*/0,   /*src_basecycle_fr*/0,  /*src_repetition_fr*/0,  /*src_startbit*/105,   /*sig_length*/1,  /*des_slotid_fr*/0,   /*des_basecycle_fr*/0,  /*des_repetition_fr*/0,   /*des_startbit*/25,    /*src_cyc*/101,  /*src_id*/0x240,   /*src_dlc*/64,   /*des_cyc*/350,   /*des_id*/0x388, /*src_updatebit*/104,   /*des_updatebit*/24,      /*initvalue*/1         },
           {   /*sig_name*/"isBrkAndAbsWarnIndcnReqAbsWarnIndcnReq_0",   /*src_can*/"ZCU_CANFD1",   /*src_network_type*/"CANFD",   /*src_slotid_fr*/0,   /*src_basecycle_fr*/0,  /*src_repetition_fr*/0,  /*src_startbit*/107,   /*sig_length*/2,  /*des_slotid_fr*/0,   /*des_basecycle_fr*/0,  /*des_repetition_fr*/0,   /*des_startbit*/27,    /*src_cyc*/101,  /*src_id*/0x240,   /*src_dlc*/64,   /*des_cyc*/350,   /*des_id*/0x388, /*src_updatebit*/104,   /*des_updatebit*/24,      /*initvalue*/3         },
           {   /*sig_name*/"isBrkAndAbsWarnIndcnReqChks_0",   /*src_can*/"ZCU_CANFD1",   /*src_network_type*/"CANFD",   /*src_slotid_fr*/0,   /*src_basecycle_fr*/0,  /*src_repetition_fr*/0,  /*src_startbit*/103,   /*sig_length*/8,  /*des_slotid_fr*/0,   /*des_basecycle_fr*/0,  /*des_repetition_fr*/0,   /*des_startbit*/23,    /*src_cyc*/101,  /*src_id*/0x240,   /*src_dlc*/64,   /*des_cyc*/350,   /*des_id*/0x388, /*src_updatebit*/104,   /*des_updatebit*/24,      /*initvalue*/0         },
           {   /*sig_name*/"isCllsnWarnReIndcn_0",   /*src_can*/"ZCU_CANFD1",   /*src_network_type*/"CANFD",   /*src_slotid_fr*/0,   /*src_basecycle_fr*/0,  /*src_repetition_fr*/0,  /*src_startbit*/95,   /*sig_length*/2,  /*des_slotid_fr*/0,   /*des_basecycle_fr*/0,  /*des_repetition_fr*/0,   /*des_startbit*/47,    /*src_cyc*/101,  /*src_id*/0x280,   /*src_dlc*/64,   /*des_cyc*/25,   /*des_id*/0x85, /*src_updatebit*/93,   /*des_updatebit*/45,      /*initvalue*/0         },
           {   /*sig_name*/"isRctaIndcnLe_0",   /*src_can*/"ZCU_CANFD1",   /*src_network_type*/"CANFD",   /*src_slotid_fr*/0,   /*src_basecycle_fr*/0,  /*src_repetition_fr*/0,  /*src_startbit*/484,   /*sig_length*/2,  /*des_slotid_fr*/0,   /*des_basecycle_fr*/0,  /*des_repetition_fr*/0,   /*des_startbit*/41,    /*src_cyc*/101,  /*src_id*/0x109,   /*src_dlc*/64,   /*des_cyc*/25,   /*des_id*/0x85, /*src_updatebit*/482,   /*des_updatebit*/42,      /*initvalue*/0         },
           {   /*sig_name*/"isVehSpdIndcdVeSpdIndcdUnit_0",   /*src_can*/"ZCU_CANFD1",   /*src_network_type*/"CANFD",   /*src_slotid_fr*/0,   /*src_basecycle_fr*/0,  /*src_repetition_fr*/0,  /*src_startbit*/134,   /*sig_length*/2,  /*des_slotid_fr*/0,   /*des_basecycle_fr*/0,  /*des_repetition_fr*/0,   /*des_startbit*/18,    /*src_cyc*/101,  /*src_id*/0x160,   /*src_dlc*/64,   /*des_cyc*/15,   /*des_id*/0x131, /*src_updatebit*/132,   /*des_updatebit*/19,      /*initvalue*/0         },
           {   /*sig_name*/"isVehSpdIndcdVehSpdIndcd_0",   /*src_can*/"ZCU_CANFD1",   /*src_network_type*/"CANFD",   /*src_slotid_fr*/0,   /*src_basecycle_fr*/0,  /*src_repetition_fr*/0,  /*src_startbit*/127,   /*sig_length*/9,  /*des_slotid_fr*/0,   /*des_basecycle_fr*/0,  /*des_repetition_fr*/0,   /*des_startbit*/16,    /*src_cyc*/101,  /*src_id*/0x160,   /*src_dlc*/64,   /*des_cyc*/15,   /*des_id*/0x131, /*src_updatebit*/132,   /*des_updatebit*/19,      /*initvalue*/0         },
           {   /*sig_name*/"isOverlap_0",   /*src_can*/"ZCU_CANFD1",   /*src_network_type*/"CANFD",   /*src_slotid_fr*/0,   /*src_basecycle_fr*/0,  /*src_repetition_fr*/0,  /*src_startbit*/39,   /*sig_length*/8,  /*des_slotid_fr*/0,   /*des_basecycle_fr*/0,  /*des_repetition_fr*/0,   /*des_startbit*/47,    /*src_cyc*/101,  /*src_id*/0x190,   /*src_dlc*/64,   /*des_cyc*/20,   /*des_id*/0x314, /*src_updatebit*/152,   /*des_updatebit*/28,      /*initvalue*/100         },
           {   /*sig_name*/"isAD4DrvrBeltWarn_0",   /*src_can*/"ZCU_CANFD1",   /*src_network_type*/"CANFD",   /*src_slotid_fr*/0,   /*src_basecycle_fr*/0,  /*src_repetition_fr*/0,  /*src_startbit*/375,   /*sig_length*/3,  /*des_slotid_fr*/0,   /*des_basecycle_fr*/0,  /*des_repetition_fr*/0,   /*des_startbit*/2,    /*src_cyc*/101,  /*src_id*/0x241,   /*src_dlc*/64,   /*des_cyc*/150,   /*des_id*/0x371, /*src_updatebit*/372,   /*des_updatebit*/3,      /*initvalue*/0         },
           {   /*sig_name*/"isDoorPassLockSts_0",   /*src_can*/"ZCU_CANFD1",   /*src_network_type*/"CANFD",   /*src_slotid_fr*/0,   /*src_basecycle_fr*/0,  /*src_repetition_fr*/0,  /*src_startbit*/18,   /*sig_length*/2,  /*des_slotid_fr*/0,   /*des_basecycle_fr*/0,  /*des_repetition_fr*/0,   /*des_startbit*/23,    /*src_cyc*/101,  /*src_id*/0x212,   /*src_dlc*/64,   /*des_cyc*/180,   /*des_id*/0x320, /*src_updatebit*/3,   /*des_updatebit*/60,      /*initvalue*/0         },
           {   /*sig_name*/"isFctaIndcnLe_0",   /*src_can*/"ZCU_CANFD1",   /*src_network_type*/"CANFD",   /*src_slotid_fr*/0,   /*src_basecycle_fr*/0,  /*src_repetition_fr*/0,  /*src_startbit*/27,   /*sig_length*/2,  /*des_slotid_fr*/0,   /*des_basecycle_fr*/0,  /*des_repetition_fr*/0,   /*des_startbit*/59,    /*src_cyc*/101,  /*src_id*/0x1f0,   /*src_dlc*/64,   /*des_cyc*/40,   /*des_id*/0x83, /*src_updatebit*/25,   /*des_updatebit*/50,      /*initvalue*/0         },
           {   /*sig_name*/"isCllsnFwdWarn_0",   /*src_can*/"ZCU_CANFD1",   /*src_network_type*/"CANFD",   /*src_slotid_fr*/0,   /*src_basecycle_fr*/0,  /*src_repetition_fr*/0,  /*src_startbit*/123,   /*sig_length*/3,  /*des_slotid_fr*/0,   /*des_basecycle_fr*/0,  /*des_repetition_fr*/0,   /*des_startbit*/15,    /*src_cyc*/101,  /*src_id*/0x2f0,   /*src_dlc*/64,   /*des_cyc*/40,   /*des_id*/0x83, /*src_updatebit*/120,   /*des_updatebit*/12,      /*initvalue*/0         },
           {   /*sig_name*/"isRctaIndcnRi_0",   /*src_can*/"ZCU_CANFD1",   /*src_network_type*/"CANFD",   /*src_slotid_fr*/0,   /*src_basecycle_fr*/0,  /*src_repetition_fr*/0,  /*src_startbit*/495,   /*sig_length*/2,  /*des_slotid_fr*/0,   /*des_basecycle_fr*/0,  /*des_repetition_fr*/0,   /*des_startbit*/55,    /*src_cyc*/101,  /*src_id*/0x109,   /*src_dlc*/64,   /*des_cyc*/25,   /*des_id*/0x85, /*src_updatebit*/493,   /*des_updatebit*/53,      /*initvalue*/0         },
           {   /*sig_name*/"isDoorRiReLockSts_0",   /*src_can*/"ZCU_CANFD1",   /*src_network_type*/"CANFD",   /*src_slotid_fr*/0,   /*src_basecycle_fr*/0,  /*src_repetition_fr*/0,  /*src_startbit*/7,   /*sig_length*/2,  /*des_slotid_fr*/0,   /*des_basecycle_fr*/0,  /*des_repetition_fr*/0,   /*des_startbit*/25,    /*src_cyc*/101,  /*src_id*/0x212,   /*src_dlc*/64,   /*des_cyc*/180,   /*des_id*/0x320, /*src_updatebit*/16,   /*des_updatebit*/61,      /*initvalue*/0         },
           {   /*sig_name*/"isSeatOccptAtRowSecPasSide2_0",   /*src_can*/"ZCU_CANFD1",   /*src_network_type*/"CANFD",   /*src_slotid_fr*/0,   /*src_basecycle_fr*/0,  /*src_repetition_fr*/0,  /*src_startbit*/38,   /*sig_length*/2,  /*des_slotid_fr*/0,   /*des_basecycle_fr*/0,  /*des_repetition_fr*/0,   /*des_startbit*/43,    /*src_cyc*/101,  /*src_id*/0x212,   /*src_dlc*/64,   /*des_cyc*/40,   /*des_id*/0x78, /*src_updatebit*/36,   /*des_updatebit*/41,      /*initvalue*/1         },
           {   /*sig_name*/"isCllsnAidPost_0",   /*src_can*/"ZCU_CANFD1",   /*src_network_type*/"CANFD",   /*src_slotid_fr*/0,   /*src_basecycle_fr*/0,  /*src_repetition_fr*/0,  /*src_startbit*/111,   /*sig_length*/1,  /*des_slotid_fr*/0,   /*des_basecycle_fr*/0,  /*des_repetition_fr*/0,   /*des_startbit*/44,    /*src_cyc*/101,  /*src_id*/0x1f0,   /*src_dlc*/64,   /*des_cyc*/100,   /*des_id*/0x206, /*src_updatebit*/110,   /*des_updatebit*/45,      /*initvalue*/0         },
           {   /*sig_name*/"isDrvrPfmncAlrmReqFromDHU_0",   /*src_can*/"ZCU_CANFD1",   /*src_network_type*/"CANFD",   /*src_slotid_fr*/0,   /*src_basecycle_fr*/0,  /*src_repetition_fr*/0,  /*src_startbit*/59,   /*sig_length*/3,  /*des_slotid_fr*/0,   /*des_basecycle_fr*/0,  /*des_repetition_fr*/0,   /*des_startbit*/15,    /*src_cyc*/101,  /*src_id*/0x1e8,   /*src_dlc*/64,   /*des_cyc*/60,   /*des_id*/0x215, /*src_updatebit*/506,   /*des_updatebit*/12,      /*initvalue*/0         },
           {   /*sig_name*/"isVehMtnStCntr_0",   /*src_can*/"ZCU_CANFD1",   /*src_network_type*/"CANFD",   /*src_slotid_fr*/0,   /*src_basecycle_fr*/0,  /*src_repetition_fr*/0,  /*src_startbit*/423,   /*sig_length*/4,  /*des_slotid_fr*/0,   /*des_basecycle_fr*/0,  /*des_repetition_fr*/0,   /*des_startbit*/6,    /*src_cyc*/101,  /*src_id*/0x82,   /*src_dlc*/64,   /*des_cyc*/15,   /*des_id*/0x40, /*src_updatebit*/416,   /*des_updatebit*/7,      /*initvalue*/0         },
           {   /*sig_name*/"isVehMtnStVehMtnSt_0",   /*src_can*/"ZCU_CANFD1",   /*src_network_type*/"CANFD",   /*src_slotid_fr*/0,   /*src_basecycle_fr*/0,  /*src_repetition_fr*/0,  /*src_startbit*/419,   /*sig_length*/3,  /*des_slotid_fr*/0,   /*des_basecycle_fr*/0,  /*des_repetition_fr*/0,   /*des_startbit*/2,    /*src_cyc*/101,  /*src_id*/0x82,   /*src_dlc*/64,   /*des_cyc*/15,   /*des_id*/0x40, /*src_updatebit*/416,   /*des_updatebit*/7,      /*initvalue*/0         },
           {   /*sig_name*/"isVehMtnStChks_0",   /*src_can*/"ZCU_CANFD1",   /*src_network_type*/"CANFD",   /*src_slotid_fr*/0,   /*src_basecycle_fr*/0,  /*src_repetition_fr*/0,  /*src_startbit*/415,   /*sig_length*/8,  /*des_slotid_fr*/0,   /*des_basecycle_fr*/0,  /*des_repetition_fr*/0,   /*des_startbit*/15,    /*src_cyc*/101,  /*src_id*/0x82,   /*src_dlc*/64,   /*des_cyc*/15,   /*des_id*/0x40, /*src_updatebit*/416,   /*des_updatebit*/7,      /*initvalue*/0         },
           {   /*sig_name*/"isWinPosnStsAtPass_0",   /*src_can*/"ZCU_CANFD1",   /*src_network_type*/"CANFD",   /*src_slotid_fr*/0,   /*src_basecycle_fr*/0,  /*src_repetition_fr*/0,  /*src_startbit*/14,   /*sig_length*/5,  /*des_slotid_fr*/0,   /*des_basecycle_fr*/0,  /*des_repetition_fr*/0,   /*des_startbit*/55,    /*src_cyc*/101,  /*src_id*/0x212,   /*src_dlc*/64,   /*des_cyc*/70,   /*des_id*/0x271, /*src_updatebit*/31,   /*des_updatebit*/40,      /*initvalue*/0         },
           {   /*sig_name*/"isVehCfgPrmCCPBytePosn2_0",   /*src_can*/"ZCU_CANFD1",   /*src_network_type*/"CANFD",   /*src_slotid_fr*/0,   /*src_basecycle_fr*/0,  /*src_repetition_fr*/0,  /*src_startbit*/15,   /*sig_length*/8,  /*des_slotid_fr*/0,   /*des_basecycle_fr*/0,  /*des_repetition_fr*/0,   /*des_startbit*/15,    /*src_cyc*/101,  /*src_id*/0x1f5,   /*src_dlc*/64,   /*des_cyc*/Event,   /*des_id*/0x340, /*src_updatebit*/199,   /*des_updatebit*/1000,      /*initvalue*/0         },
           {   /*sig_name*/"isVehCfgPrmCCPBytePosn7_0",   /*src_can*/"ZCU_CANFD1",   /*src_network_type*/"CANFD",   /*src_slotid_fr*/0,   /*src_basecycle_fr*/0,  /*src_repetition_fr*/0,  /*src_startbit*/55,   /*sig_length*/8,  /*des_slotid_fr*/0,   /*des_basecycle_fr*/0,  /*des_repetition_fr*/0,   /*des_startbit*/55,    /*src_cyc*/101,  /*src_id*/0x1f5,   /*src_dlc*/64,   /*des_cyc*/Event,   /*des_id*/0x340, /*src_updatebit*/199,   /*des_updatebit*/1000,      /*initvalue*/0         },
           {   /*sig_name*/"isVehCfgPrmCCPBytePosn3_0",   /*src_can*/"ZCU_CANFD1",   /*src_network_type*/"CANFD",   /*src_slotid_fr*/0,   /*src_basecycle_fr*/0,  /*src_repetition_fr*/0,  /*src_startbit*/23,   /*sig_length*/8,  /*des_slotid_fr*/0,   /*des_basecycle_fr*/0,  /*des_repetition_fr*/0,   /*des_startbit*/23,    /*src_cyc*/101,  /*src_id*/0x1f5,   /*src_dlc*/64,   /*des_cyc*/Event,   /*des_id*/0x340, /*src_updatebit*/199,   /*des_updatebit*/1000,      /*initvalue*/0         },
           {   /*sig_name*/"isVehCfgPrmCCPBytePosn4_0",   /*src_can*/"ZCU_CANFD1",   /*src_network_type*/"CANFD",   /*src_slotid_fr*/0,   /*src_basecycle_fr*/0,  /*src_repetition_fr*/0,  /*src_startbit*/31,   /*sig_length*/8,  /*des_slotid_fr*/0,   /*des_basecycle_fr*/0,  /*des_repetition_fr*/0,   /*des_startbit*/31,    /*src_cyc*/101,  /*src_id*/0x1f5,   /*src_dlc*/64,   /*des_cyc*/Event,   /*des_id*/0x340, /*src_updatebit*/199,   /*des_updatebit*/1000,      /*initvalue*/0         },
           {   /*sig_name*/"isVehCfgPrmCCPBytePosn8_0",   /*src_can*/"ZCU_CANFD1",   /*src_network_type*/"CANFD",   /*src_slotid_fr*/0,   /*src_basecycle_fr*/0,  /*src_repetition_fr*/0,  /*src_startbit*/63,   /*sig_length*/8,  /*des_slotid_fr*/0,   /*des_basecycle_fr*/0,  /*des_repetition_fr*/0,   /*des_startbit*/63,    /*src_cyc*/101,  /*src_id*/0x1f5,   /*src_dlc*/64,   /*des_cyc*/Event,   /*des_id*/0x340, /*src_updatebit*/199,   /*des_updatebit*/1000,      /*initvalue*/0         },
           {   /*sig_name*/"isVehCfgPrmCCPBytePosn5_0",   /*src_can*/"ZCU_CANFD1",   /*src_network_type*/"CANFD",   /*src_slotid_fr*/0,   /*src_basecycle_fr*/0,  /*src_repetition_fr*/0,  /*src_startbit*/39,   /*sig_length*/8,  /*des_slotid_fr*/0,   /*des_basecycle_fr*/0,  /*des_repetition_fr*/0,   /*des_startbit*/39,    /*src_cyc*/101,  /*src_id*/0x1f5,   /*src_dlc*/64,   /*des_cyc*/Event,   /*des_id*/0x340, /*src_updatebit*/199,   /*des_updatebit*/1000,      /*initvalue*/0         },
           {   /*sig_name*/"isVehCfgPrmBlkIDBytePosn1_0",   /*src_can*/"ZCU_CANFD1",   /*src_network_type*/"CANFD",   /*src_slotid_fr*/0,   /*src_basecycle_fr*/0,  /*src_repetition_fr*/0,  /*src_startbit*/7,   /*sig_length*/8,  /*des_slotid_fr*/0,   /*des_basecycle_fr*/0,  /*des_repetition_fr*/0,   /*des_startbit*/7,    /*src_cyc*/101,  /*src_id*/0x1f5,   /*src_dlc*/64,   /*des_cyc*/Event,   /*des_id*/0x340, /*src_updatebit*/199,   /*des_updatebit*/1000,      /*initvalue*/0         },
           {   /*sig_name*/"isVehCfgPrmCCPBytePosn6_0",   /*src_can*/"ZCU_CANFD1",   /*src_network_type*/"CANFD",   /*src_slotid_fr*/0,   /*src_basecycle_fr*/0,  /*src_repetition_fr*/0,  /*src_startbit*/47,   /*sig_length*/8,  /*des_slotid_fr*/0,   /*des_basecycle_fr*/0,  /*des_repetition_fr*/0,   /*des_startbit*/47,    /*src_cyc*/101,  /*src_id*/0x1f5,   /*src_dlc*/64,   /*des_cyc*/Event,   /*des_id*/0x340, /*src_updatebit*/199,   /*des_updatebit*/1000,      /*initvalue*/0         },
           {   /*sig_name*/"isEscStChks_0",   /*src_can*/"ZCU_CANFD1",   /*src_network_type*/"CANFD",   /*src_slotid_fr*/0,   /*src_basecycle_fr*/0,  /*src_repetition_fr*/0,  /*src_startbit*/343,   /*sig_length*/8,  /*des_slotid_fr*/0,   /*des_basecycle_fr*/0,  /*des_repetition_fr*/0,   /*des_startbit*/47,    /*src_cyc*/101,  /*src_id*/0x82,   /*src_dlc*/64,   /*des_cyc*/350,   /*des_id*/0x384, /*src_updatebit*/344,   /*des_updatebit*/39,      /*initvalue*/0         },
           {   /*sig_name*/"isEscStEscSt_0",   /*src_can*/"ZCU_CANFD1",   /*src_network_type*/"CANFD",   /*src_slotid_fr*/0,   /*src_basecycle_fr*/0,  /*src_repetition_fr*/0,  /*src_startbit*/347,   /*sig_length*/3,  /*des_slotid_fr*/0,   /*des_basecycle_fr*/0,  /*des_repetition_fr*/0,   /*des_startbit*/38,    /*src_cyc*/101,  /*src_id*/0x82,   /*src_dlc*/64,   /*des_cyc*/350,   /*des_id*/0x384, /*src_updatebit*/344,   /*des_updatebit*/39,      /*initvalue*/1         },
           {   /*sig_name*/"isEscStCntr_0",   /*src_can*/"ZCU_CANFD1",   /*src_network_type*/"CANFD",   /*src_slotid_fr*/0,   /*src_basecycle_fr*/0,  /*src_repetition_fr*/0,  /*src_startbit*/351,   /*sig_length*/4,  /*des_slotid_fr*/0,   /*des_basecycle_fr*/0,  /*des_repetition_fr*/0,   /*des_startbit*/35,    /*src_cyc*/101,  /*src_id*/0x82,   /*src_dlc*/64,   /*des_cyc*/350,   /*des_id*/0x384, /*src_updatebit*/344,   /*des_updatebit*/39,      /*initvalue*/0         },
           {   /*sig_name*/"isRcwmBeltReq_0",   /*src_can*/"ZCU_CANFD1",   /*src_network_type*/"CANFD",   /*src_slotid_fr*/0,   /*src_basecycle_fr*/0,  /*src_repetition_fr*/0,  /*src_startbit*/396,   /*sig_length*/2,  /*des_slotid_fr*/0,   /*des_basecycle_fr*/0,  /*des_repetition_fr*/0,   /*des_startbit*/50,    /*src_cyc*/101,  /*src_id*/0x241,   /*src_dlc*/64,   /*des_cyc*/70,   /*des_id*/0x271, /*src_updatebit*/394,   /*des_updatebit*/48,      /*initvalue*/0         },
           {   /*sig_name*/"isPostImpctBrkgRdy_0",   /*src_can*/"ZCU_CANFD1",   /*src_network_type*/"CANFD",   /*src_slotid_fr*/0,   /*src_basecycle_fr*/0,  /*src_repetition_fr*/0,  /*src_startbit*/47,   /*sig_length*/2,  /*des_slotid_fr*/0,   /*des_basecycle_fr*/0,  /*des_repetition_fr*/0,   /*des_startbit*/29,    /*src_cyc*/101,  /*src_id*/0x455,   /*src_dlc*/64,   /*des_cyc*/150,   /*des_id*/0x371, /*src_updatebit*/45,   /*des_updatebit*/30,      /*initvalue*/0         },
           {   /*sig_name*/"isBrkPedlPsdBrkPedlPsd_0",   /*src_can*/"ZCU_CANFD1",   /*src_network_type*/"CANFD",   /*src_slotid_fr*/0,   /*src_basecycle_fr*/0,  /*src_repetition_fr*/0,  /*src_startbit*/168,   /*sig_length*/1,  /*des_slotid_fr*/0,   /*des_basecycle_fr*/0,  /*des_repetition_fr*/0,   /*des_startbit*/6,    /*src_cyc*/101,  /*src_id*/0x82,   /*src_dlc*/64,   /*des_cyc*/85,   /*des_id*/0x32f, /*src_updatebit*/400,   /*des_updatebit*/23,      /*initvalue*/0         },
           {   /*sig_name*/"isBrkPedlPsdCntr_0",   /*src_can*/"ZCU_CANFD1",   /*src_network_type*/"CANFD",   /*src_slotid_fr*/0,   /*src_basecycle_fr*/0,  /*src_repetition_fr*/0,  /*src_startbit*/175,   /*sig_length*/4,  /*des_slotid_fr*/0,   /*des_basecycle_fr*/0,  /*des_repetition_fr*/0,   /*des_startbit*/3,    /*src_cyc*/101,  /*src_id*/0x82,   /*src_dlc*/64,   /*des_cyc*/85,   /*des_id*/0x32f, /*src_updatebit*/400,   /*des_updatebit*/23,      /*initvalue*/0         },
           {   /*sig_name*/"isBrkPedlPsdChks_0",   /*src_can*/"ZCU_CANFD1",   /*src_network_type*/"CANFD",   /*src_slotid_fr*/0,   /*src_basecycle_fr*/0,  /*src_repetition_fr*/0,  /*src_startbit*/167,   /*sig_length*/8,  /*des_slotid_fr*/0,   /*des_basecycle_fr*/0,  /*des_repetition_fr*/0,   /*des_startbit*/15,    /*src_cyc*/101,  /*src_id*/0x82,   /*src_dlc*/64,   /*des_cyc*/85,   /*des_id*/0x32f, /*src_updatebit*/400,   /*des_updatebit*/23,      /*initvalue*/0         },
           {   /*sig_name*/"isBrkPedlPsdQf_0",   /*src_can*/"ZCU_CANFD1",   /*src_network_type*/"CANFD",   /*src_slotid_fr*/0,   /*src_basecycle_fr*/0,  /*src_repetition_fr*/0,  /*src_startbit*/171,   /*sig_length*/2,  /*des_slotid_fr*/0,   /*des_basecycle_fr*/0,  /*des_repetition_fr*/0,   /*des_startbit*/5,    /*src_cyc*/101,  /*src_id*/0x82,   /*src_dlc*/64,   /*des_cyc*/85,   /*des_id*/0x32f, /*src_updatebit*/400,   /*des_updatebit*/23,      /*initvalue*/0         },
           {   /*sig_name*/"isBrkPedlPsdBrkPedlNotPsdSafe_0",   /*src_can*/"ZCU_CANFD1",   /*src_network_type*/"CANFD",   /*src_slotid_fr*/0,   /*src_basecycle_fr*/0,  /*src_repetition_fr*/0,  /*src_startbit*/169,   /*sig_length*/1,  /*des_slotid_fr*/0,   /*des_basecycle_fr*/0,  /*des_repetition_fr*/0,   /*des_startbit*/7,    /*src_cyc*/101,  /*src_id*/0x82,   /*src_dlc*/64,   /*des_cyc*/85,   /*des_id*/0x32f, /*src_updatebit*/400,   /*des_updatebit*/23,      /*initvalue*/0         },
           {   /*sig_name*/"isAsyALgtStsAsyALgtSts_0",   /*src_can*/"ZCU_CANFD1",   /*src_network_type*/"CANFD",   /*src_slotid_fr*/0,   /*src_basecycle_fr*/0,  /*src_repetition_fr*/0,  /*src_startbit*/311,   /*sig_length*/4,  /*des_slotid_fr*/0,   /*des_basecycle_fr*/0,  /*des_repetition_fr*/0,   /*des_startbit*/43,    /*src_cyc*/101,  /*src_id*/0x109,   /*src_dlc*/64,   /*des_cyc*/180,   /*des_id*/0x320, /*src_updatebit*/352,   /*des_updatebit*/63,      /*initvalue*/0         },
           {   /*sig_name*/"isAsyALgtStsCntr_0",   /*src_can*/"ZCU_CANFD1",   /*src_network_type*/"CANFD",   /*src_slotid_fr*/0,   /*src_basecycle_fr*/0,  /*src_repetition_fr*/0,  /*src_startbit*/307,   /*sig_length*/4,  /*des_slotid_fr*/0,   /*des_basecycle_fr*/0,  /*des_repetition_fr*/0,   /*des_startbit*/47,    /*src_cyc*/101,  /*src_id*/0x109,   /*src_dlc*/64,   /*des_cyc*/180,   /*des_id*/0x320, /*src_updatebit*/352,   /*des_updatebit*/63,      /*initvalue*/0         },
           {   /*sig_name*/"isAsyALgtStsChks_0",   /*src_can*/"ZCU_CANFD1",   /*src_network_type*/"CANFD",   /*src_slotid_fr*/0,   /*src_basecycle_fr*/0,  /*src_repetition_fr*/0,  /*src_startbit*/303,   /*sig_length*/8,  /*des_slotid_fr*/0,   /*des_basecycle_fr*/0,  /*des_repetition_fr*/0,   /*des_startbit*/39,    /*src_cyc*/101,  /*src_id*/0x109,   /*src_dlc*/64,   /*des_cyc*/180,   /*des_id*/0x320, /*src_updatebit*/352,   /*des_updatebit*/63,      /*initvalue*/0         },
           {   /*sig_name*/"isAsyNoaBltFastn_0",   /*src_can*/"ZCU_CANFD1",   /*src_network_type*/"CANFD",   /*src_slotid_fr*/0,   /*src_basecycle_fr*/0,  /*src_repetition_fr*/0,  /*src_startbit*/362,   /*sig_length*/2,  /*des_slotid_fr*/0,   /*des_basecycle_fr*/0,  /*des_repetition_fr*/0,   /*des_startbit*/58,    /*src_cyc*/101,  /*src_id*/0x241,   /*src_dlc*/64,   /*des_cyc*/60,   /*des_id*/0x490, /*src_updatebit*/360,   /*des_updatebit*/56,      /*initvalue*/0         },
           {   /*sig_name*/"isAsyAutDrvCtrlTyp_0",   /*src_can*/"ZCU_CANFD1",   /*src_network_type*/"CANFD",   /*src_slotid_fr*/0,   /*src_basecycle_fr*/0,  /*src_repetition_fr*/0,  /*src_startbit*/11,   /*sig_length*/3,  /*des_slotid_fr*/0,   /*des_basecycle_fr*/0,  /*des_repetition_fr*/0,   /*des_startbit*/14,    /*src_cyc*/101,  /*src_id*/0x1c6,   /*src_dlc*/64,   /*des_cyc*/350,   /*des_id*/0x388, /*src_updatebit*/30,   /*des_updatebit*/11,      /*initvalue*/0         },
           {   /*sig_name*/"isEscCtrlIndcn_0",   /*src_can*/"ZCU_CANFD1",   /*src_network_type*/"CANFD",   /*src_slotid_fr*/0,   /*src_basecycle_fr*/0,  /*src_repetition_fr*/0,  /*src_startbit*/115,   /*sig_length*/2,  /*des_slotid_fr*/0,   /*des_basecycle_fr*/0,  /*des_repetition_fr*/0,   /*des_startbit*/3,    /*src_cyc*/101,  /*src_id*/0x10a,   /*src_dlc*/64,   /*des_cyc*/350,   /*des_id*/0x388, /*src_updatebit*/360,   /*des_updatebit*/1,      /*initvalue*/1         },
           {   /*sig_name*/"isDrvrMonrAlrmReqFromDHU_0",   /*src_can*/"ZCU_CANFD1",   /*src_network_type*/"CANFD",   /*src_slotid_fr*/0,   /*src_basecycle_fr*/0,  /*src_repetition_fr*/0,  /*src_startbit*/55,   /*sig_length*/4,  /*des_slotid_fr*/0,   /*des_basecycle_fr*/0,  /*des_repetition_fr*/0,   /*des_startbit*/22,    /*src_cyc*/101,  /*src_id*/0x318,   /*src_dlc*/64,   /*des_cyc*/85,   /*des_id*/0x32f, /*src_updatebit*/51,   /*des_updatebit*/18,      /*initvalue*/0         },
           {   /*sig_name*/"isOccupyMonStsDrvrSts_0",   /*src_can*/"ZCU_CANFD1",   /*src_network_type*/"CANFD",   /*src_slotid_fr*/0,   /*src_basecycle_fr*/0,  /*src_repetition_fr*/0,  /*src_startbit*/143,   /*sig_length*/2,  /*des_slotid_fr*/0,   /*des_basecycle_fr*/0,  /*des_repetition_fr*/0,   /*des_startbit*/27,    /*src_cyc*/101,  /*src_id*/0x105,   /*src_dlc*/64,   /*des_cyc*/40,   /*des_id*/0x78, /*src_updatebit*/112,   /*des_updatebit*/28,      /*initvalue*/0         },
           {   /*sig_name*/"isOccupyMonStsSecMidSts_0",   /*src_can*/"ZCU_CANFD1",   /*src_network_type*/"CANFD",   /*src_slotid_fr*/0,   /*src_basecycle_fr*/0,  /*src_repetition_fr*/0,  /*src_startbit*/137,   /*sig_length*/2,  /*des_slotid_fr*/0,   /*des_basecycle_fr*/0,  /*des_repetition_fr*/0,   /*des_startbit*/37,    /*src_cyc*/101,  /*src_id*/0x105,   /*src_dlc*/64,   /*des_cyc*/40,   /*des_id*/0x78, /*src_updatebit*/112,   /*des_updatebit*/28,      /*initvalue*/0         },
           {   /*sig_name*/"isOccupyMonStsThrdLeSts_0",   /*src_can*/"ZCU_CANFD1",   /*src_network_type*/"CANFD",   /*src_slotid_fr*/0,   /*src_basecycle_fr*/0,  /*src_repetition_fr*/0,  /*src_startbit*/149,   /*sig_length*/2,  /*des_slotid_fr*/0,   /*des_basecycle_fr*/0,  /*des_repetition_fr*/0,   /*des_startbit*/33,    /*src_cyc*/101,  /*src_id*/0x105,   /*src_dlc*/64,   /*des_cyc*/40,   /*des_id*/0x78, /*src_updatebit*/112,   /*des_updatebit*/28,      /*initvalue*/0         },
           {   /*sig_name*/"isOccupyMonStsSeccLeSts_0",   /*src_can*/"ZCU_CANFD1",   /*src_network_type*/"CANFD",   /*src_slotid_fr*/0,   /*src_basecycle_fr*/0,  /*src_repetition_fr*/0,  /*src_startbit*/139,   /*sig_length*/2,  /*des_slotid_fr*/0,   /*des_basecycle_fr*/0,  /*des_repetition_fr*/0,   /*des_startbit*/39,    /*src_cyc*/101,  /*src_id*/0x105,   /*src_dlc*/64,   /*des_cyc*/40,   /*des_id*/0x78, /*src_updatebit*/112,   /*des_updatebit*/28,      /*initvalue*/0         },
           {   /*sig_name*/"isOccupyMonStsSecRiSts_0",   /*src_can*/"ZCU_CANFD1",   /*src_network_type*/"CANFD",   /*src_slotid_fr*/0,   /*src_basecycle_fr*/0,  /*src_repetition_fr*/0,  /*src_startbit*/151,   /*sig_length*/2,  /*des_slotid_fr*/0,   /*des_basecycle_fr*/0,  /*des_repetition_fr*/0,   /*des_startbit*/35,    /*src_cyc*/101,  /*src_id*/0x105,   /*src_dlc*/64,   /*des_cyc*/40,   /*des_id*/0x78, /*src_updatebit*/112,   /*des_updatebit*/28,      /*initvalue*/0         },
           {   /*sig_name*/"isOccupyMonStsPassSts_0",   /*src_can*/"ZCU_CANFD1",   /*src_network_type*/"CANFD",   /*src_slotid_fr*/0,   /*src_basecycle_fr*/0,  /*src_repetition_fr*/0,  /*src_startbit*/141,   /*sig_length*/2,  /*des_slotid_fr*/0,   /*des_basecycle_fr*/0,  /*des_repetition_fr*/0,   /*des_startbit*/25,    /*src_cyc*/101,  /*src_id*/0x105,   /*src_dlc*/64,   /*des_cyc*/40,   /*des_id*/0x78, /*src_updatebit*/112,   /*des_updatebit*/28,      /*initvalue*/0         },
           {   /*sig_name*/"isOccupyMonStsThrdMidSts_0",   /*src_can*/"ZCU_CANFD1",   /*src_network_type*/"CANFD",   /*src_slotid_fr*/0,   /*src_basecycle_fr*/0,  /*src_repetition_fr*/0,  /*src_startbit*/147,   /*sig_length*/2,  /*des_slotid_fr*/0,   /*des_basecycle_fr*/0,  /*des_repetition_fr*/0,   /*des_startbit*/47,    /*src_cyc*/101,  /*src_id*/0x105,   /*src_dlc*/64,   /*des_cyc*/40,   /*des_id*/0x78, /*src_updatebit*/112,   /*des_updatebit*/28,      /*initvalue*/0         },
           {   /*sig_name*/"isOccupyMonStsThrdRiSts_0",   /*src_can*/"ZCU_CANFD1",   /*src_network_type*/"CANFD",   /*src_slotid_fr*/0,   /*src_basecycle_fr*/0,  /*src_repetition_fr*/0,  /*src_startbit*/145,   /*sig_length*/2,  /*des_slotid_fr*/0,   /*des_basecycle_fr*/0,  /*des_repetition_fr*/0,   /*des_startbit*/45,    /*src_cyc*/101,  /*src_id*/0x105,   /*src_dlc*/64,   /*des_cyc*/40,   /*des_id*/0x78, /*src_updatebit*/112,   /*des_updatebit*/28,      /*initvalue*/0         }
       }
   },
   {
       /*des_can*/ "ZCUD_CANFD4",
       /*networktype*/ "CANFD",
       33,
       {
           {   /*sig_name*/"isBkpOfDstTrvld_0",   /*src_can*/"ZCU_CANFD1",   /*src_network_type*/"CANFD",   /*src_slotid_fr*/0,   /*src_basecycle_fr*/0,  /*src_repetition_fr*/0,  /*src_startbit*/5,   /*sig_length*/21,  /*des_slotid_fr*/0,   /*des_basecycle_fr*/0,  /*des_repetition_fr*/0,   /*des_startbit*/7,    /*src_cyc*/101,  /*src_id*/0x160,   /*src_dlc*/64,   /*des_cyc*/1000,   /*des_id*/0x4c0, /*src_updatebit*/16,   /*des_updatebit*/18,      /*initvalue*/0         },
           {   /*sig_name*/"isDoorOpenwarnRiIndcn_0",   /*src_can*/"ZCU_CANFD1",   /*src_network_type*/"CANFD",   /*src_slotid_fr*/0,   /*src_basecycle_fr*/0,  /*src_repetition_fr*/0,  /*src_startbit*/475,   /*sig_length*/2,  /*des_slotid_fr*/0,   /*des_basecycle_fr*/0,  /*des_repetition_fr*/0,   /*des_startbit*/10,    /*src_cyc*/101,  /*src_id*/0x109,   /*src_dlc*/64,   /*des_cyc*/50,   /*des_id*/0x1c0, /*src_updatebit*/473,   /*des_updatebit*/8,      /*initvalue*/0         },
           {   /*sig_name*/"isWinPosnStsAtReRi_0",   /*src_can*/"ZCU_CANFD1",   /*src_network_type*/"CANFD",   /*src_slotid_fr*/0,   /*src_basecycle_fr*/0,  /*src_repetition_fr*/0,  /*src_startbit*/23,   /*sig_length*/5,  /*des_slotid_fr*/0,   /*des_basecycle_fr*/0,  /*des_repetition_fr*/0,   /*des_startbit*/47,    /*src_cyc*/101,  /*src_id*/0x212,   /*src_dlc*/64,   /*des_cyc*/200,   /*des_id*/0x300, /*src_updatebit*/30,   /*des_updatebit*/42,      /*initvalue*/0         },
           {   /*sig_name*/"isDoorOpenwarnLeIndcn_0",   /*src_can*/"ZCU_CANFD1",   /*src_network_type*/"CANFD",   /*src_slotid_fr*/0,   /*src_basecycle_fr*/0,  /*src_repetition_fr*/0,  /*src_startbit*/466,   /*sig_length*/2,  /*des_slotid_fr*/0,   /*des_basecycle_fr*/0,  /*des_repetition_fr*/0,   /*des_startbit*/13,    /*src_cyc*/101,  /*src_id*/0x109,   /*src_dlc*/64,   /*des_cyc*/50,   /*des_id*/0x1c0, /*src_updatebit*/464,   /*des_updatebit*/11,      /*initvalue*/0         },
           {   /*sig_name*/"isVehCfgPrmExtCCPBytePosn8_0",   /*src_can*/"ZCU_CANFD1",   /*src_network_type*/"CANFD",   /*src_slotid_fr*/0,   /*src_basecycle_fr*/0,  /*src_repetition_fr*/0,  /*src_startbit*/127,   /*sig_length*/8,  /*des_slotid_fr*/0,   /*des_basecycle_fr*/0,  /*des_repetition_fr*/0,   /*des_startbit*/135,    /*src_cyc*/101,  /*src_id*/0x1f5,   /*src_dlc*/64,   /*des_cyc*/Event,   /*des_id*/0x1da, /*src_updatebit*/198,   /*des_updatebit*/70,      /*initvalue*/0         },
           {   /*sig_name*/"isVehCfgPrmExtCCPBytePosn6_0",   /*src_can*/"ZCU_CANFD1",   /*src_network_type*/"CANFD",   /*src_slotid_fr*/0,   /*src_basecycle_fr*/0,  /*src_repetition_fr*/0,  /*src_startbit*/111,   /*sig_length*/8,  /*des_slotid_fr*/0,   /*des_basecycle_fr*/0,  /*des_repetition_fr*/0,   /*des_startbit*/119,    /*src_cyc*/101,  /*src_id*/0x1f5,   /*src_dlc*/64,   /*des_cyc*/Event,   /*des_id*/0x1da, /*src_updatebit*/198,   /*des_updatebit*/70,      /*initvalue*/0         },
           {   /*sig_name*/"isVehCfgPrmExtCCPBytePosn4_0",   /*src_can*/"ZCU_CANFD1",   /*src_network_type*/"CANFD",   /*src_slotid_fr*/0,   /*src_basecycle_fr*/0,  /*src_repetition_fr*/0,  /*src_startbit*/95,   /*sig_length*/8,  /*des_slotid_fr*/0,   /*des_basecycle_fr*/0,  /*des_repetition_fr*/0,   /*des_startbit*/103,    /*src_cyc*/101,  /*src_id*/0x1f5,   /*src_dlc*/64,   /*des_cyc*/Event,   /*des_id*/0x1da, /*src_updatebit*/198,   /*des_updatebit*/70,      /*initvalue*/0         },
           {   /*sig_name*/"isVehCfgPrmExtCCPBytePosn3_0",   /*src_can*/"ZCU_CANFD1",   /*src_network_type*/"CANFD",   /*src_slotid_fr*/0,   /*src_basecycle_fr*/0,  /*src_repetition_fr*/0,  /*src_startbit*/87,   /*sig_length*/8,  /*des_slotid_fr*/0,   /*des_basecycle_fr*/0,  /*des_repetition_fr*/0,   /*des_startbit*/95,    /*src_cyc*/101,  /*src_id*/0x1f5,   /*src_dlc*/64,   /*des_cyc*/Event,   /*des_id*/0x1da, /*src_updatebit*/198,   /*des_updatebit*/70,      /*initvalue*/0         },
           {   /*sig_name*/"isVehCfgPrmExtCCPBytePosn2_0",   /*src_can*/"ZCU_CANFD1",   /*src_network_type*/"CANFD",   /*src_slotid_fr*/0,   /*src_basecycle_fr*/0,  /*src_repetition_fr*/0,  /*src_startbit*/79,   /*sig_length*/8,  /*des_slotid_fr*/0,   /*des_basecycle_fr*/0,  /*des_repetition_fr*/0,   /*des_startbit*/87,    /*src_cyc*/101,  /*src_id*/0x1f5,   /*src_dlc*/64,   /*des_cyc*/Event,   /*des_id*/0x1da, /*src_updatebit*/198,   /*des_updatebit*/70,      /*initvalue*/0         },
           {   /*sig_name*/"isVehCfgPrmExtBlkIDBytePosn1_0",   /*src_can*/"ZCU_CANFD1",   /*src_network_type*/"CANFD",   /*src_slotid_fr*/0,   /*src_basecycle_fr*/0,  /*src_repetition_fr*/0,  /*src_startbit*/71,   /*sig_length*/8,  /*des_slotid_fr*/0,   /*des_basecycle_fr*/0,  /*des_repetition_fr*/0,   /*des_startbit*/79,    /*src_cyc*/101,  /*src_id*/0x1f5,   /*src_dlc*/64,   /*des_cyc*/Event,   /*des_id*/0x1da, /*src_updatebit*/198,   /*des_updatebit*/70,      /*initvalue*/0         },
           {   /*sig_name*/"isVehCfgPrmExtCCPBytePosn5_0",   /*src_can*/"ZCU_CANFD1",   /*src_network_type*/"CANFD",   /*src_slotid_fr*/0,   /*src_basecycle_fr*/0,  /*src_repetition_fr*/0,  /*src_startbit*/103,   /*sig_length*/8,  /*des_slotid_fr*/0,   /*des_basecycle_fr*/0,  /*des_repetition_fr*/0,   /*des_startbit*/111,    /*src_cyc*/101,  /*src_id*/0x1f5,   /*src_dlc*/64,   /*des_cyc*/Event,   /*des_id*/0x1da, /*src_updatebit*/198,   /*des_updatebit*/70,      /*initvalue*/0         },
           {   /*sig_name*/"isVehCfgPrmExtCCPBytePosn7_0",   /*src_can*/"ZCU_CANFD1",   /*src_network_type*/"CANFD",   /*src_slotid_fr*/0,   /*src_basecycle_fr*/0,  /*src_repetition_fr*/0,  /*src_startbit*/119,   /*sig_length*/8,  /*des_slotid_fr*/0,   /*des_basecycle_fr*/0,  /*des_repetition_fr*/0,   /*des_startbit*/127,    /*src_cyc*/101,  /*src_id*/0x1f5,   /*src_dlc*/64,   /*des_cyc*/Event,   /*des_id*/0x1da, /*src_updatebit*/198,   /*des_updatebit*/70,      /*initvalue*/0         },
           {   /*sig_name*/"isVehCfgPrmExt2BlkIDBytePosn1_0",   /*src_can*/"ZCU_CANFD1",   /*src_network_type*/"CANFD",   /*src_slotid_fr*/0,   /*src_basecycle_fr*/0,  /*src_repetition_fr*/0,  /*src_startbit*/135,   /*sig_length*/8,  /*des_slotid_fr*/0,   /*des_basecycle_fr*/0,  /*des_repetition_fr*/0,   /*des_startbit*/143,    /*src_cyc*/101,  /*src_id*/0x1f5,   /*src_dlc*/64,   /*des_cyc*/Event,   /*des_id*/0x1da, /*src_updatebit*/197,   /*des_updatebit*/69,      /*initvalue*/0         },
           {   /*sig_name*/"isVehCfgPrmExt2CCPBytePosn2_0",   /*src_can*/"ZCU_CANFD1",   /*src_network_type*/"CANFD",   /*src_slotid_fr*/0,   /*src_basecycle_fr*/0,  /*src_repetition_fr*/0,  /*src_startbit*/143,   /*sig_length*/8,  /*des_slotid_fr*/0,   /*des_basecycle_fr*/0,  /*des_repetition_fr*/0,   /*des_startbit*/151,    /*src_cyc*/101,  /*src_id*/0x1f5,   /*src_dlc*/64,   /*des_cyc*/Event,   /*des_id*/0x1da, /*src_updatebit*/197,   /*des_updatebit*/69,      /*initvalue*/0         },
           {   /*sig_name*/"isVehCfgPrmExt2CCPBytePosn6_0",   /*src_can*/"ZCU_CANFD1",   /*src_network_type*/"CANFD",   /*src_slotid_fr*/0,   /*src_basecycle_fr*/0,  /*src_repetition_fr*/0,  /*src_startbit*/175,   /*sig_length*/8,  /*des_slotid_fr*/0,   /*des_basecycle_fr*/0,  /*des_repetition_fr*/0,   /*des_startbit*/183,    /*src_cyc*/101,  /*src_id*/0x1f5,   /*src_dlc*/64,   /*des_cyc*/Event,   /*des_id*/0x1da, /*src_updatebit*/197,   /*des_updatebit*/69,      /*initvalue*/0         },
           {   /*sig_name*/"isVehCfgPrmExt2CCPBytePosn4_0",   /*src_can*/"ZCU_CANFD1",   /*src_network_type*/"CANFD",   /*src_slotid_fr*/0,   /*src_basecycle_fr*/0,  /*src_repetition_fr*/0,  /*src_startbit*/159,   /*sig_length*/8,  /*des_slotid_fr*/0,   /*des_basecycle_fr*/0,  /*des_repetition_fr*/0,   /*des_startbit*/167,    /*src_cyc*/101,  /*src_id*/0x1f5,   /*src_dlc*/64,   /*des_cyc*/Event,   /*des_id*/0x1da, /*src_updatebit*/197,   /*des_updatebit*/69,      /*initvalue*/0         },
           {   /*sig_name*/"isVehCfgPrmExt2CCPBytePosn5_0",   /*src_can*/"ZCU_CANFD1",   /*src_network_type*/"CANFD",   /*src_slotid_fr*/0,   /*src_basecycle_fr*/0,  /*src_repetition_fr*/0,  /*src_startbit*/167,   /*sig_length*/8,  /*des_slotid_fr*/0,   /*des_basecycle_fr*/0,  /*des_repetition_fr*/0,   /*des_startbit*/175,    /*src_cyc*/101,  /*src_id*/0x1f5,   /*src_dlc*/64,   /*des_cyc*/Event,   /*des_id*/0x1da, /*src_updatebit*/197,   /*des_updatebit*/69,      /*initvalue*/0         },
           {   /*sig_name*/"isVehCfgPrmExt2CCPBytePosn3_0",   /*src_can*/"ZCU_CANFD1",   /*src_network_type*/"CANFD",   /*src_slotid_fr*/0,   /*src_basecycle_fr*/0,  /*src_repetition_fr*/0,  /*src_startbit*/151,   /*sig_length*/8,  /*des_slotid_fr*/0,   /*des_basecycle_fr*/0,  /*des_repetition_fr*/0,   /*des_startbit*/159,    /*src_cyc*/101,  /*src_id*/0x1f5,   /*src_dlc*/64,   /*des_cyc*/Event,   /*des_id*/0x1da, /*src_updatebit*/197,   /*des_updatebit*/69,      /*initvalue*/0         },
           {   /*sig_name*/"isVehCfgPrmExt2CCPBytePosn7_0",   /*src_can*/"ZCU_CANFD1",   /*src_network_type*/"CANFD",   /*src_slotid_fr*/0,   /*src_basecycle_fr*/0,  /*src_repetition_fr*/0,  /*src_startbit*/183,   /*sig_length*/8,  /*des_slotid_fr*/0,   /*des_basecycle_fr*/0,  /*des_repetition_fr*/0,   /*des_startbit*/191,    /*src_cyc*/101,  /*src_id*/0x1f5,   /*src_dlc*/64,   /*des_cyc*/Event,   /*des_id*/0x1da, /*src_updatebit*/197,   /*des_updatebit*/69,      /*initvalue*/0         },
           {   /*sig_name*/"isVehCfgPrmExt2CCPBytePosn8_0",   /*src_can*/"ZCU_CANFD1",   /*src_network_type*/"CANFD",   /*src_slotid_fr*/0,   /*src_basecycle_fr*/0,  /*src_repetition_fr*/0,  /*src_startbit*/191,   /*sig_length*/8,  /*des_slotid_fr*/0,   /*des_basecycle_fr*/0,  /*des_repetition_fr*/0,   /*des_startbit*/199,    /*src_cyc*/101,  /*src_id*/0x1f5,   /*src_dlc*/64,   /*des_cyc*/Event,   /*des_id*/0x1da, /*src_updatebit*/197,   /*des_updatebit*/69,      /*initvalue*/0         },
           {   /*sig_name*/"isDoorOpenwarnOn1_0",   /*src_can*/"ZCU_CANFD1",   /*src_network_type*/"CANFD",   /*src_slotid_fr*/0,   /*src_basecycle_fr*/0,  /*src_repetition_fr*/0,  /*src_startbit*/26,   /*sig_length*/2,  /*des_slotid_fr*/0,   /*des_basecycle_fr*/0,  /*des_repetition_fr*/0,   /*des_startbit*/23,    /*src_cyc*/101,  /*src_id*/0x1c6,   /*src_dlc*/64,   /*des_cyc*/30,   /*des_id*/0x140, /*src_updatebit*/24,   /*des_updatebit*/21,      /*initvalue*/0         },
           {   /*sig_name*/"isVehMtnStCntr_0",   /*src_can*/"ZCU_CANFD1",   /*src_network_type*/"CANFD",   /*src_slotid_fr*/0,   /*src_basecycle_fr*/0,  /*src_repetition_fr*/0,  /*src_startbit*/423,   /*sig_length*/4,  /*des_slotid_fr*/0,   /*des_basecycle_fr*/0,  /*des_repetition_fr*/0,   /*des_startbit*/55,    /*src_cyc*/101,  /*src_id*/0x82,   /*src_dlc*/64,   /*des_cyc*/20,   /*des_id*/0x100, /*src_updatebit*/416,   /*des_updatebit*/48,      /*initvalue*/0         },
           {   /*sig_name*/"isVehMtnStVehMtnSt_0",   /*src_can*/"ZCU_CANFD1",   /*src_network_type*/"CANFD",   /*src_slotid_fr*/0,   /*src_basecycle_fr*/0,  /*src_repetition_fr*/0,  /*src_startbit*/419,   /*sig_length*/3,  /*des_slotid_fr*/0,   /*des_basecycle_fr*/0,  /*des_repetition_fr*/0,   /*des_startbit*/51,    /*src_cyc*/101,  /*src_id*/0x82,   /*src_dlc*/64,   /*des_cyc*/20,   /*des_id*/0x100, /*src_updatebit*/416,   /*des_updatebit*/48,      /*initvalue*/0         },
           {   /*sig_name*/"isVehMtnStChks_0",   /*src_can*/"ZCU_CANFD1",   /*src_network_type*/"CANFD",   /*src_slotid_fr*/0,   /*src_basecycle_fr*/0,  /*src_repetition_fr*/0,  /*src_startbit*/415,   /*sig_length*/8,  /*des_slotid_fr*/0,   /*des_basecycle_fr*/0,  /*des_repetition_fr*/0,   /*des_startbit*/47,    /*src_cyc*/101,  /*src_id*/0x82,   /*src_dlc*/64,   /*des_cyc*/20,   /*des_id*/0x100, /*src_updatebit*/416,   /*des_updatebit*/48,      /*initvalue*/0         },
           {   /*sig_name*/"isWinPosnStsAtPass_0",   /*src_can*/"ZCU_CANFD1",   /*src_network_type*/"CANFD",   /*src_slotid_fr*/0,   /*src_basecycle_fr*/0,  /*src_repetition_fr*/0,  /*src_startbit*/14,   /*sig_length*/5,  /*des_slotid_fr*/0,   /*des_basecycle_fr*/0,  /*des_repetition_fr*/0,   /*des_startbit*/31,    /*src_cyc*/101,  /*src_id*/0x212,   /*src_dlc*/64,   /*des_cyc*/200,   /*des_id*/0x300, /*src_updatebit*/31,   /*des_updatebit*/26,      /*initvalue*/0         },
           {   /*sig_name*/"isVehCfgPrmCCPBytePosn2_0",   /*src_can*/"ZCU_CANFD1",   /*src_network_type*/"CANFD",   /*src_slotid_fr*/0,   /*src_basecycle_fr*/0,  /*src_repetition_fr*/0,  /*src_startbit*/15,   /*sig_length*/8,  /*des_slotid_fr*/0,   /*des_basecycle_fr*/0,  /*des_repetition_fr*/0,   /*des_startbit*/15,    /*src_cyc*/101,  /*src_id*/0x1f5,   /*src_dlc*/64,   /*des_cyc*/Event,   /*des_id*/0x1da, /*src_updatebit*/199,   /*des_updatebit*/71,      /*initvalue*/0         },
           {   /*sig_name*/"isVehCfgPrmCCPBytePosn7_0",   /*src_can*/"ZCU_CANFD1",   /*src_network_type*/"CANFD",   /*src_slotid_fr*/0,   /*src_basecycle_fr*/0,  /*src_repetition_fr*/0,  /*src_startbit*/55,   /*sig_length*/8,  /*des_slotid_fr*/0,   /*des_basecycle_fr*/0,  /*des_repetition_fr*/0,   /*des_startbit*/55,    /*src_cyc*/101,  /*src_id*/0x1f5,   /*src_dlc*/64,   /*des_cyc*/Event,   /*des_id*/0x1da, /*src_updatebit*/199,   /*des_updatebit*/71,      /*initvalue*/0         },
           {   /*sig_name*/"isVehCfgPrmCCPBytePosn3_0",   /*src_can*/"ZCU_CANFD1",   /*src_network_type*/"CANFD",   /*src_slotid_fr*/0,   /*src_basecycle_fr*/0,  /*src_repetition_fr*/0,  /*src_startbit*/23,   /*sig_length*/8,  /*des_slotid_fr*/0,   /*des_basecycle_fr*/0,  /*des_repetition_fr*/0,   /*des_startbit*/23,    /*src_cyc*/101,  /*src_id*/0x1f5,   /*src_dlc*/64,   /*des_cyc*/Event,   /*des_id*/0x1da, /*src_updatebit*/199,   /*des_updatebit*/71,      /*initvalue*/0         },
           {   /*sig_name*/"isVehCfgPrmCCPBytePosn4_0",   /*src_can*/"ZCU_CANFD1",   /*src_network_type*/"CANFD",   /*src_slotid_fr*/0,   /*src_basecycle_fr*/0,  /*src_repetition_fr*/0,  /*src_startbit*/31,   /*sig_length*/8,  /*des_slotid_fr*/0,   /*des_basecycle_fr*/0,  /*des_repetition_fr*/0,   /*des_startbit*/31,    /*src_cyc*/101,  /*src_id*/0x1f5,   /*src_dlc*/64,   /*des_cyc*/Event,   /*des_id*/0x1da, /*src_updatebit*/199,   /*des_updatebit*/71,      /*initvalue*/0         },
           {   /*sig_name*/"isVehCfgPrmCCPBytePosn8_0",   /*src_can*/"ZCU_CANFD1",   /*src_network_type*/"CANFD",   /*src_slotid_fr*/0,   /*src_basecycle_fr*/0,  /*src_repetition_fr*/0,  /*src_startbit*/63,   /*sig_length*/8,  /*des_slotid_fr*/0,   /*des_basecycle_fr*/0,  /*des_repetition_fr*/0,   /*des_startbit*/63,    /*src_cyc*/101,  /*src_id*/0x1f5,   /*src_dlc*/64,   /*des_cyc*/Event,   /*des_id*/0x1da, /*src_updatebit*/199,   /*des_updatebit*/71,      /*initvalue*/0         },
           {   /*sig_name*/"isVehCfgPrmCCPBytePosn5_0",   /*src_can*/"ZCU_CANFD1",   /*src_network_type*/"CANFD",   /*src_slotid_fr*/0,   /*src_basecycle_fr*/0,  /*src_repetition_fr*/0,  /*src_startbit*/39,   /*sig_length*/8,  /*des_slotid_fr*/0,   /*des_basecycle_fr*/0,  /*des_repetition_fr*/0,   /*des_startbit*/39,    /*src_cyc*/101,  /*src_id*/0x1f5,   /*src_dlc*/64,   /*des_cyc*/Event,   /*des_id*/0x1da, /*src_updatebit*/199,   /*des_updatebit*/71,      /*initvalue*/0         },
           {   /*sig_name*/"isVehCfgPrmBlkIDBytePosn1_0",   /*src_can*/"ZCU_CANFD1",   /*src_network_type*/"CANFD",   /*src_slotid_fr*/0,   /*src_basecycle_fr*/0,  /*src_repetition_fr*/0,  /*src_startbit*/7,   /*sig_length*/8,  /*des_slotid_fr*/0,   /*des_basecycle_fr*/0,  /*des_repetition_fr*/0,   /*des_startbit*/7,    /*src_cyc*/101,  /*src_id*/0x1f5,   /*src_dlc*/64,   /*des_cyc*/Event,   /*des_id*/0x1da, /*src_updatebit*/199,   /*des_updatebit*/71,      /*initvalue*/0         },
           {   /*sig_name*/"isVehCfgPrmCCPBytePosn6_0",   /*src_can*/"ZCU_CANFD1",   /*src_network_type*/"CANFD",   /*src_slotid_fr*/0,   /*src_basecycle_fr*/0,  /*src_repetition_fr*/0,  /*src_startbit*/47,   /*sig_length*/8,  /*des_slotid_fr*/0,   /*des_basecycle_fr*/0,  /*des_repetition_fr*/0,   /*des_startbit*/47,    /*src_cyc*/101,  /*src_id*/0x1f5,   /*src_dlc*/64,   /*des_cyc*/Event,   /*des_id*/0x1da, /*src_updatebit*/199,   /*des_updatebit*/71,      /*initvalue*/0         }
       }
   },
   {
       /*des_can*/ "ZCU_CANFD2",
       /*networktype*/ "CANFD",
       0,
       {
           0
       }
   },
   {
       /*des_can*/ "BodyExposedCAN",
       /*networktype*/ "CAN",
       0,
       {
           0
       }
   }
};

  struct gSignalG{
//    int num[1000];
    char sigGroup_s[1000];
    char sig_name[1000];
    char scr_can[1000];
    char scr_network_type[1000];
    int scr_slotid_fr;
    int scr_basecycle_fr;
    int scr_repetition_fr;
    int scr_startbit;
    int sigG_length;
    int des_slotid_fr;
    int des_basecycle_fr;
    int des_repetition_fr;
    int des_startbit;
    int scr_cyc;
    int scr_id;
    int scr_dlc;
    int des_id;  
    int updatebit_S;
    int updatebit_D;
  };
    
 //data for Signal group routing test
  struct SignalGroup{ 
    char des_can[20]; 
    char des_networktype[20];
    int sum;
    struct gSignalG GSignalG[2500];
  };
  
  struct SignalGroup test_sigG[network_quantity]={
    
       {
       /*des_can*/ "ZCUD_LIN1",
       /*networktype*/ "LIN",
       0,
       {
           0
       }
   },
   {
       /*des_can*/ "CEM_LIN3",
       /*networktype*/ "LIN",
       0,
       {
           0
       }
   },
   {
       /*des_can*/ "CEM_LIN2",
       /*networktype*/ "LIN",
       0,
       {
           0
       }
   },
   {
       /*des_can*/ "CEM_LIN6",
       /*networktype*/ "LIN",
       0,
       {
           0
       }
   },
   {
       /*des_can*/ "CEM_LIN1",
       /*networktype*/ "LIN",
       16,
       {
           {   /*sigGroup_s*/"igVehCfgPrmExt_0",   /*sig_name*/"isVehCfgPrmExtCCPBytePosn8_0",   /*src_can*/"ZCU_CANFD1",   /*src_network_type*/"CANFD",   /*src_slotid_fr*/0,   /*src_basecycle_fr*/0,  /*src_repetition_fr*/0,  /*src_startbit*/127,   /*sigG_length*/8,  /*des_slotid_fr*/0,   /*des_basecycle_fr*/0,  /*des_repetition_fr*/0,   /*des_startbit*/56,    /*src_cyc*/101,  /*src_id*/0x1f5,   /*src_dlc*/64,   /*des_id*/4, /*updatebit_S*/198,   /*updatebit_D*/1000         },
           {   /*sigGroup_s*/"igVehCfgPrmExt_0",   /*sig_name*/"isVehCfgPrmExtCCPBytePosn6_0",   /*src_can*/"ZCU_CANFD1",   /*src_network_type*/"CANFD",   /*src_slotid_fr*/0,   /*src_basecycle_fr*/0,  /*src_repetition_fr*/0,  /*src_startbit*/111,   /*sigG_length*/8,  /*des_slotid_fr*/0,   /*des_basecycle_fr*/0,  /*des_repetition_fr*/0,   /*des_startbit*/40,    /*src_cyc*/101,  /*src_id*/0x1f5,   /*src_dlc*/64,   /*des_id*/4, /*updatebit_S*/198,   /*updatebit_D*/1000         },
           {   /*sigGroup_s*/"igVehCfgPrmExt_0",   /*sig_name*/"isVehCfgPrmExtCCPBytePosn4_0",   /*src_can*/"ZCU_CANFD1",   /*src_network_type*/"CANFD",   /*src_slotid_fr*/0,   /*src_basecycle_fr*/0,  /*src_repetition_fr*/0,  /*src_startbit*/95,   /*sigG_length*/8,  /*des_slotid_fr*/0,   /*des_basecycle_fr*/0,  /*des_repetition_fr*/0,   /*des_startbit*/24,    /*src_cyc*/101,  /*src_id*/0x1f5,   /*src_dlc*/64,   /*des_id*/4, /*updatebit_S*/198,   /*updatebit_D*/1000         },
           {   /*sigGroup_s*/"igVehCfgPrmExt_0",   /*sig_name*/"isVehCfgPrmExtCCPBytePosn3_0",   /*src_can*/"ZCU_CANFD1",   /*src_network_type*/"CANFD",   /*src_slotid_fr*/0,   /*src_basecycle_fr*/0,  /*src_repetition_fr*/0,  /*src_startbit*/87,   /*sigG_length*/8,  /*des_slotid_fr*/0,   /*des_basecycle_fr*/0,  /*des_repetition_fr*/0,   /*des_startbit*/16,    /*src_cyc*/101,  /*src_id*/0x1f5,   /*src_dlc*/64,   /*des_id*/4, /*updatebit_S*/198,   /*updatebit_D*/1000         },
           {   /*sigGroup_s*/"igVehCfgPrmExt_0",   /*sig_name*/"isVehCfgPrmExtCCPBytePosn2_0",   /*src_can*/"ZCU_CANFD1",   /*src_network_type*/"CANFD",   /*src_slotid_fr*/0,   /*src_basecycle_fr*/0,  /*src_repetition_fr*/0,  /*src_startbit*/79,   /*sigG_length*/8,  /*des_slotid_fr*/0,   /*des_basecycle_fr*/0,  /*des_repetition_fr*/0,   /*des_startbit*/8,    /*src_cyc*/101,  /*src_id*/0x1f5,   /*src_dlc*/64,   /*des_id*/4, /*updatebit_S*/198,   /*updatebit_D*/1000         },
           {   /*sigGroup_s*/"igVehCfgPrmExt_0",   /*sig_name*/"isVehCfgPrmExtBlkIDBytePosn1_0",   /*src_can*/"ZCU_CANFD1",   /*src_network_type*/"CANFD",   /*src_slotid_fr*/0,   /*src_basecycle_fr*/0,  /*src_repetition_fr*/0,  /*src_startbit*/71,   /*sigG_length*/8,  /*des_slotid_fr*/0,   /*des_basecycle_fr*/0,  /*des_repetition_fr*/0,   /*des_startbit*/0,    /*src_cyc*/101,  /*src_id*/0x1f5,   /*src_dlc*/64,   /*des_id*/4, /*updatebit_S*/198,   /*updatebit_D*/1000         },
           {   /*sigGroup_s*/"igVehCfgPrmExt_0",   /*sig_name*/"isVehCfgPrmExtCCPBytePosn5_0",   /*src_can*/"ZCU_CANFD1",   /*src_network_type*/"CANFD",   /*src_slotid_fr*/0,   /*src_basecycle_fr*/0,  /*src_repetition_fr*/0,  /*src_startbit*/103,   /*sigG_length*/8,  /*des_slotid_fr*/0,   /*des_basecycle_fr*/0,  /*des_repetition_fr*/0,   /*des_startbit*/32,    /*src_cyc*/101,  /*src_id*/0x1f5,   /*src_dlc*/64,   /*des_id*/4, /*updatebit_S*/198,   /*updatebit_D*/1000         },
           {   /*sigGroup_s*/"igVehCfgPrmExt_0",   /*sig_name*/"isVehCfgPrmExtCCPBytePosn7_0",   /*src_can*/"ZCU_CANFD1",   /*src_network_type*/"CANFD",   /*src_slotid_fr*/0,   /*src_basecycle_fr*/0,  /*src_repetition_fr*/0,  /*src_startbit*/119,   /*sigG_length*/8,  /*des_slotid_fr*/0,   /*des_basecycle_fr*/0,  /*des_repetition_fr*/0,   /*des_startbit*/48,    /*src_cyc*/101,  /*src_id*/0x1f5,   /*src_dlc*/64,   /*des_id*/4, /*updatebit_S*/198,   /*updatebit_D*/1000         },
           {   /*sigGroup_s*/"igVehCfgPrm_0",   /*sig_name*/"isVehCfgPrmCCPBytePosn2_0",   /*src_can*/"ZCU_CANFD1",   /*src_network_type*/"CANFD",   /*src_slotid_fr*/0,   /*src_basecycle_fr*/0,  /*src_repetition_fr*/0,  /*src_startbit*/15,   /*sigG_length*/8,  /*des_slotid_fr*/0,   /*des_basecycle_fr*/0,  /*des_repetition_fr*/0,   /*des_startbit*/8,    /*src_cyc*/101,  /*src_id*/0x1f5,   /*src_dlc*/64,   /*des_id*/17, /*updatebit_S*/199,   /*updatebit_D*/1000         },
           {   /*sigGroup_s*/"igVehCfgPrm_0",   /*sig_name*/"isVehCfgPrmCCPBytePosn7_0",   /*src_can*/"ZCU_CANFD1",   /*src_network_type*/"CANFD",   /*src_slotid_fr*/0,   /*src_basecycle_fr*/0,  /*src_repetition_fr*/0,  /*src_startbit*/55,   /*sigG_length*/8,  /*des_slotid_fr*/0,   /*des_basecycle_fr*/0,  /*des_repetition_fr*/0,   /*des_startbit*/48,    /*src_cyc*/101,  /*src_id*/0x1f5,   /*src_dlc*/64,   /*des_id*/17, /*updatebit_S*/199,   /*updatebit_D*/1000         },
           {   /*sigGroup_s*/"igVehCfgPrm_0",   /*sig_name*/"isVehCfgPrmCCPBytePosn3_0",   /*src_can*/"ZCU_CANFD1",   /*src_network_type*/"CANFD",   /*src_slotid_fr*/0,   /*src_basecycle_fr*/0,  /*src_repetition_fr*/0,  /*src_startbit*/23,   /*sigG_length*/8,  /*des_slotid_fr*/0,   /*des_basecycle_fr*/0,  /*des_repetition_fr*/0,   /*des_startbit*/16,    /*src_cyc*/101,  /*src_id*/0x1f5,   /*src_dlc*/64,   /*des_id*/17, /*updatebit_S*/199,   /*updatebit_D*/1000         },
           {   /*sigGroup_s*/"igVehCfgPrm_0",   /*sig_name*/"isVehCfgPrmCCPBytePosn4_0",   /*src_can*/"ZCU_CANFD1",   /*src_network_type*/"CANFD",   /*src_slotid_fr*/0,   /*src_basecycle_fr*/0,  /*src_repetition_fr*/0,  /*src_startbit*/31,   /*sigG_length*/8,  /*des_slotid_fr*/0,   /*des_basecycle_fr*/0,  /*des_repetition_fr*/0,   /*des_startbit*/24,    /*src_cyc*/101,  /*src_id*/0x1f5,   /*src_dlc*/64,   /*des_id*/17, /*updatebit_S*/199,   /*updatebit_D*/1000         },
           {   /*sigGroup_s*/"igVehCfgPrm_0",   /*sig_name*/"isVehCfgPrmCCPBytePosn8_0",   /*src_can*/"ZCU_CANFD1",   /*src_network_type*/"CANFD",   /*src_slotid_fr*/0,   /*src_basecycle_fr*/0,  /*src_repetition_fr*/0,  /*src_startbit*/63,   /*sigG_length*/8,  /*des_slotid_fr*/0,   /*des_basecycle_fr*/0,  /*des_repetition_fr*/0,   /*des_startbit*/56,    /*src_cyc*/101,  /*src_id*/0x1f5,   /*src_dlc*/64,   /*des_id*/17, /*updatebit_S*/199,   /*updatebit_D*/1000         },
           {   /*sigGroup_s*/"igVehCfgPrm_0",   /*sig_name*/"isVehCfgPrmCCPBytePosn5_0",   /*src_can*/"ZCU_CANFD1",   /*src_network_type*/"CANFD",   /*src_slotid_fr*/0,   /*src_basecycle_fr*/0,  /*src_repetition_fr*/0,  /*src_startbit*/39,   /*sigG_length*/8,  /*des_slotid_fr*/0,   /*des_basecycle_fr*/0,  /*des_repetition_fr*/0,   /*des_startbit*/32,    /*src_cyc*/101,  /*src_id*/0x1f5,   /*src_dlc*/64,   /*des_id*/17, /*updatebit_S*/199,   /*updatebit_D*/1000         },
           {   /*sigGroup_s*/"igVehCfgPrm_0",   /*sig_name*/"isVehCfgPrmBlkIDBytePosn1_0",   /*src_can*/"ZCU_CANFD1",   /*src_network_type*/"CANFD",   /*src_slotid_fr*/0,   /*src_basecycle_fr*/0,  /*src_repetition_fr*/0,  /*src_startbit*/7,   /*sigG_length*/8,  /*des_slotid_fr*/0,   /*des_basecycle_fr*/0,  /*des_repetition_fr*/0,   /*des_startbit*/0,    /*src_cyc*/101,  /*src_id*/0x1f5,   /*src_dlc*/64,   /*des_id*/17, /*updatebit_S*/199,   /*updatebit_D*/1000         },
           {   /*sigGroup_s*/"igVehCfgPrm_0",   /*sig_name*/"isVehCfgPrmCCPBytePosn6_0",   /*src_can*/"ZCU_CANFD1",   /*src_network_type*/"CANFD",   /*src_slotid_fr*/0,   /*src_basecycle_fr*/0,  /*src_repetition_fr*/0,  /*src_startbit*/47,   /*sigG_length*/8,  /*des_slotid_fr*/0,   /*des_basecycle_fr*/0,  /*des_repetition_fr*/0,   /*des_startbit*/40,    /*src_cyc*/101,  /*src_id*/0x1f5,   /*src_dlc*/64,   /*des_id*/17, /*updatebit_S*/199,   /*updatebit_D*/1000         }
       }
   },
   {
       /*des_can*/ "CEM_LIN4",
       /*networktype*/ "LIN",
       0,
       {
           0
       }
   },
   {
       /*des_can*/ "ZCUD_LIN2",
       /*networktype*/ "LIN",
       0,
       {
           0
       }
   },
   {
       /*des_can*/ "ZCUD_LIN3",
       /*networktype*/ "LIN",
       0,
       {
           0
       }
   },
   {
       /*des_can*/ "CEM_LIN7",
       /*networktype*/ "LIN",
       3,
       {
           {   /*sigGroup_s*/"igCmptmtTFrnt_0",   /*sig_name*/"isCmptmtTFrntFanForCmptmtTRunng_0",   /*src_can*/"ZCU_CANFD1",   /*src_network_type*/"CANFD",   /*src_slotid_fr*/0,   /*src_basecycle_fr*/0,  /*src_repetition_fr*/0,  /*src_startbit*/50,   /*sigG_length*/1,  /*des_slotid_fr*/0,   /*des_basecycle_fr*/0,  /*des_repetition_fr*/0,   /*des_startbit*/11,    /*src_cyc*/101,  /*src_id*/0x212,   /*src_dlc*/64,   /*des_id*/33, /*updatebit_S*/49,   /*updatebit_D*/1000         },
           {   /*sigGroup_s*/"igCmptmtTFrnt_0",   /*sig_name*/"isCmptmtTFrntQf_0",   /*src_can*/"ZCU_CANFD1",   /*src_network_type*/"CANFD",   /*src_slotid_fr*/0,   /*src_basecycle_fr*/0,  /*src_repetition_fr*/0,  /*src_startbit*/52,   /*sigG_length*/2,  /*des_slotid_fr*/0,   /*des_basecycle_fr*/0,  /*des_repetition_fr*/0,   /*des_startbit*/12,    /*src_cyc*/101,  /*src_id*/0x212,   /*src_dlc*/64,   /*des_id*/33, /*updatebit_S*/49,   /*updatebit_D*/1000         },
           {   /*sigGroup_s*/"igCmptmtTFrnt_0",   /*sig_name*/"isCmptmtTFrntCmptmtTFrnt_0",   /*src_can*/"ZCU_CANFD1",   /*src_network_type*/"CANFD",   /*src_slotid_fr*/0,   /*src_basecycle_fr*/0,  /*src_repetition_fr*/0,  /*src_startbit*/47,   /*sigG_length*/11,  /*des_slotid_fr*/0,   /*des_basecycle_fr*/0,  /*des_repetition_fr*/0,   /*des_startbit*/0,    /*src_cyc*/101,  /*src_id*/0x212,   /*src_dlc*/64,   /*des_id*/33, /*updatebit_S*/49,   /*updatebit_D*/1000         }
       }
   },
   {
       /*des_can*/ "PropulsionCAN",
       /*networktype*/ "CAN",
       20,
       {
           {   /*sigGroup_s*/"igEpbSts_0",   /*sig_name*/"isEpbStsCntr_0",   /*src_can*/"ZCU_CANFD1",   /*src_network_type*/"CANFD",   /*src_slotid_fr*/0,   /*src_basecycle_fr*/0,  /*src_repetition_fr*/0,  /*src_startbit*/135,   /*sigG_length*/4,  /*des_slotid_fr*/0,   /*des_basecycle_fr*/0,  /*des_repetition_fr*/0,   /*des_startbit*/55,    /*src_cyc*/101,  /*src_id*/0x10a,   /*src_dlc*/64,   /*des_id*/0x19d, /*updatebit_S*/273,   /*updatebit_D*/63         },
           {   /*sigGroup_s*/"igEpbSts_0",   /*sig_name*/"isEpbStsChks_0",   /*src_can*/"ZCU_CANFD1",   /*src_network_type*/"CANFD",   /*src_slotid_fr*/0,   /*src_basecycle_fr*/0,  /*src_repetition_fr*/0,  /*src_startbit*/127,   /*sigG_length*/8,  /*des_slotid_fr*/0,   /*des_basecycle_fr*/0,  /*des_repetition_fr*/0,   /*des_startbit*/47,    /*src_cyc*/101,  /*src_id*/0x10a,   /*src_dlc*/64,   /*des_id*/0x19d, /*updatebit_S*/273,   /*updatebit_D*/63         },
           {   /*sigGroup_s*/"igEpbSts_0",   /*sig_name*/"isEpbStsEpbSts_0",   /*src_can*/"ZCU_CANFD1",   /*src_network_type*/"CANFD",   /*src_slotid_fr*/0,   /*src_basecycle_fr*/0,  /*src_repetition_fr*/0,  /*src_startbit*/131,   /*sigG_length*/4,  /*des_slotid_fr*/0,   /*des_basecycle_fr*/0,  /*des_repetition_fr*/0,   /*des_startbit*/51,    /*src_cyc*/101,  /*src_id*/0x10a,   /*src_dlc*/64,   /*des_id*/0x19d, /*updatebit_S*/273,   /*updatebit_D*/63         },
           {   /*sigGroup_s*/"igStcStsToDmc_0",   /*sig_name*/"isStcStsToDmcFrnt_0",   /*src_can*/"ZCU_CANFD1",   /*src_network_type*/"CANFD",   /*src_slotid_fr*/0,   /*src_basecycle_fr*/0,  /*src_repetition_fr*/0,  /*src_startbit*/319,   /*sigG_length*/8,  /*des_slotid_fr*/0,   /*des_basecycle_fr*/0,  /*des_repetition_fr*/0,   /*des_startbit*/55,    /*src_cyc*/101,  /*src_id*/0x82,   /*src_dlc*/64,   /*des_id*/0x11a, /*updatebit_S*/331,   /*updatebit_D*/4         },
           {   /*sigGroup_s*/"igStcStsToDmc_0",   /*sig_name*/"isStcStsToDmcEngRotTarSpdDMCFrnt_0",   /*src_can*/"ZCU_CANFD1",   /*src_network_type*/"CANFD",   /*src_slotid_fr*/0,   /*src_basecycle_fr*/0,  /*src_repetition_fr*/0,  /*src_startbit*/279,   /*sigG_length*/16,  /*des_slotid_fr*/0,   /*des_basecycle_fr*/0,  /*des_repetition_fr*/0,   /*des_startbit*/23,    /*src_cyc*/101,  /*src_id*/0x82,   /*src_dlc*/64,   /*des_id*/0x11a, /*updatebit_S*/331,   /*updatebit_D*/4         },
           {   /*sigGroup_s*/"igStcStsToDmc_0",   /*sig_name*/"isStcStsToDmcEngRotTarSpdDMCRear_0",   /*src_can*/"ZCU_CANFD1",   /*src_network_type*/"CANFD",   /*src_slotid_fr*/0,   /*src_basecycle_fr*/0,  /*src_repetition_fr*/0,  /*src_startbit*/295,   /*sigG_length*/16,  /*des_slotid_fr*/0,   /*des_basecycle_fr*/0,  /*des_repetition_fr*/0,   /*des_startbit*/39,    /*src_cyc*/101,  /*src_id*/0x82,   /*src_dlc*/64,   /*des_id*/0x11a, /*updatebit_S*/331,   /*updatebit_D*/4         },
           {   /*sigGroup_s*/"igStcStsToDmc_0",   /*sig_name*/"isStcStsToDmcCntr_0",   /*src_can*/"ZCU_CANFD1",   /*src_network_type*/"CANFD",   /*src_slotid_fr*/0,   /*src_basecycle_fr*/0,  /*src_repetition_fr*/0,  /*src_startbit*/335,   /*sigG_length*/4,  /*des_slotid_fr*/0,   /*des_basecycle_fr*/0,  /*des_repetition_fr*/0,   /*des_startbit*/3,    /*src_cyc*/101,  /*src_id*/0x82,   /*src_dlc*/64,   /*des_id*/0x11a, /*updatebit_S*/331,   /*updatebit_D*/4         },
           {   /*sigGroup_s*/"igStcStsToDmc_0",   /*sig_name*/"isStcStsToDmcChks_0",   /*src_can*/"ZCU_CANFD1",   /*src_network_type*/"CANFD",   /*src_slotid_fr*/0,   /*src_basecycle_fr*/0,  /*src_repetition_fr*/0,  /*src_startbit*/311,   /*sigG_length*/8,  /*des_slotid_fr*/0,   /*des_basecycle_fr*/0,  /*des_repetition_fr*/0,   /*des_startbit*/15,    /*src_cyc*/101,  /*src_id*/0x82,   /*src_dlc*/64,   /*des_id*/0x11a, /*updatebit_S*/331,   /*updatebit_D*/4         },
           {   /*sigGroup_s*/"igStcStsToDmc_0",   /*sig_name*/"isStcStsToDmcRear_0",   /*src_can*/"ZCU_CANFD1",   /*src_network_type*/"CANFD",   /*src_slotid_fr*/0,   /*src_basecycle_fr*/0,  /*src_repetition_fr*/0,  /*src_startbit*/327,   /*sigG_length*/8,  /*des_slotid_fr*/0,   /*des_basecycle_fr*/0,  /*des_repetition_fr*/0,   /*des_startbit*/63,    /*src_cyc*/101,  /*src_id*/0x82,   /*src_dlc*/64,   /*des_id*/0x11a, /*updatebit_S*/331,   /*updatebit_D*/4         },
           {   /*sigGroup_s*/"igEscVariantToDmc_0",   /*sig_name*/"isEscVariantToDmcEscVariantToDmc_0",   /*src_can*/"ZCU_CANFD1",   /*src_network_type*/"CANFD",   /*src_slotid_fr*/0,   /*src_basecycle_fr*/0,  /*src_repetition_fr*/0,  /*src_startbit*/127,   /*sigG_length*/8,  /*des_slotid_fr*/0,   /*des_basecycle_fr*/0,  /*des_repetition_fr*/0,   /*des_startbit*/23,    /*src_cyc*/101,  /*src_id*/0x401,   /*src_dlc*/64,   /*des_id*/0x12e, /*updatebit_S*/131,   /*updatebit_D*/4         },
           {   /*sigGroup_s*/"igEscVariantToDmc_0",   /*sig_name*/"isEscVariantToDmcChks_0",   /*src_can*/"ZCU_CANFD1",   /*src_network_type*/"CANFD",   /*src_slotid_fr*/0,   /*src_basecycle_fr*/0,  /*src_repetition_fr*/0,  /*src_startbit*/119,   /*sigG_length*/8,  /*des_slotid_fr*/0,   /*des_basecycle_fr*/0,  /*des_repetition_fr*/0,   /*des_startbit*/15,    /*src_cyc*/101,  /*src_id*/0x401,   /*src_dlc*/64,   /*des_id*/0x12e, /*updatebit_S*/131,   /*updatebit_D*/4         },
           {   /*sigGroup_s*/"igEscVariantToDmc_0",   /*sig_name*/"isEscVariantToDmcCntr_0",   /*src_can*/"ZCU_CANFD1",   /*src_network_type*/"CANFD",   /*src_slotid_fr*/0,   /*src_basecycle_fr*/0,  /*src_repetition_fr*/0,  /*src_startbit*/135,   /*sigG_length*/4,  /*des_slotid_fr*/0,   /*des_basecycle_fr*/0,  /*des_repetition_fr*/0,   /*des_startbit*/3,    /*src_cyc*/101,  /*src_id*/0x401,   /*src_dlc*/64,   /*des_id*/0x12e, /*updatebit_S*/131,   /*updatebit_D*/4         },
           {   /*sigGroup_s*/"igVehMtnSt_0",   /*sig_name*/"isVehMtnStCntr_0",   /*src_can*/"ZCU_CANFD1",   /*src_network_type*/"CANFD",   /*src_slotid_fr*/0,   /*src_basecycle_fr*/0,  /*src_repetition_fr*/0,  /*src_startbit*/423,   /*sigG_length*/4,  /*des_slotid_fr*/0,   /*des_basecycle_fr*/0,  /*des_repetition_fr*/0,   /*des_startbit*/22,    /*src_cyc*/101,  /*src_id*/0x82,   /*src_dlc*/64,   /*des_id*/0x76, /*updatebit_S*/416,   /*updatebit_D*/57         },
           {   /*sigGroup_s*/"igVehMtnSt_0",   /*sig_name*/"isVehMtnStVehMtnSt_0",   /*src_can*/"ZCU_CANFD1",   /*src_network_type*/"CANFD",   /*src_slotid_fr*/0,   /*src_basecycle_fr*/0,  /*src_repetition_fr*/0,  /*src_startbit*/419,   /*sigG_length*/3,  /*des_slotid_fr*/0,   /*des_basecycle_fr*/0,  /*des_repetition_fr*/0,   /*des_startbit*/18,    /*src_cyc*/101,  /*src_id*/0x82,   /*src_dlc*/64,   /*des_id*/0x76, /*updatebit_S*/416,   /*updatebit_D*/57         },
           {   /*sigGroup_s*/"igVehMtnSt_0",   /*sig_name*/"isVehMtnStChks_0",   /*src_can*/"ZCU_CANFD1",   /*src_network_type*/"CANFD",   /*src_slotid_fr*/0,   /*src_basecycle_fr*/0,  /*src_repetition_fr*/0,  /*src_startbit*/415,   /*sigG_length*/8,  /*des_slotid_fr*/0,   /*des_basecycle_fr*/0,  /*des_repetition_fr*/0,   /*des_startbit*/31,    /*src_cyc*/101,  /*src_id*/0x82,   /*src_dlc*/64,   /*des_id*/0x76, /*updatebit_S*/416,   /*updatebit_D*/57         },
           {   /*sigGroup_s*/"igBrkPedlPsd_0",   /*sig_name*/"isBrkPedlPsdBrkPedlPsd_0",   /*src_can*/"ZCU_CANFD1",   /*src_network_type*/"CANFD",   /*src_slotid_fr*/0,   /*src_basecycle_fr*/0,  /*src_repetition_fr*/0,  /*src_startbit*/168,   /*sigG_length*/1,  /*des_slotid_fr*/0,   /*des_basecycle_fr*/0,  /*des_repetition_fr*/0,   /*des_startbit*/6,    /*src_cyc*/101,  /*src_id*/0x82,   /*src_dlc*/64,   /*des_id*/0x76, /*updatebit_S*/400,   /*updatebit_D*/23         },
           {   /*sigGroup_s*/"igBrkPedlPsd_0",   /*sig_name*/"isBrkPedlPsdCntr_0",   /*src_can*/"ZCU_CANFD1",   /*src_network_type*/"CANFD",   /*src_slotid_fr*/0,   /*src_basecycle_fr*/0,  /*src_repetition_fr*/0,  /*src_startbit*/175,   /*sigG_length*/4,  /*des_slotid_fr*/0,   /*des_basecycle_fr*/0,  /*des_repetition_fr*/0,   /*des_startbit*/3,    /*src_cyc*/101,  /*src_id*/0x82,   /*src_dlc*/64,   /*des_id*/0x76, /*updatebit_S*/400,   /*updatebit_D*/23         },
           {   /*sigGroup_s*/"igBrkPedlPsd_0",   /*sig_name*/"isBrkPedlPsdChks_0",   /*src_can*/"ZCU_CANFD1",   /*src_network_type*/"CANFD",   /*src_slotid_fr*/0,   /*src_basecycle_fr*/0,  /*src_repetition_fr*/0,  /*src_startbit*/167,   /*sigG_length*/8,  /*des_slotid_fr*/0,   /*des_basecycle_fr*/0,  /*des_repetition_fr*/0,   /*des_startbit*/15,    /*src_cyc*/101,  /*src_id*/0x82,   /*src_dlc*/64,   /*des_id*/0x76, /*updatebit_S*/400,   /*updatebit_D*/23         },
           {   /*sigGroup_s*/"igBrkPedlPsd_0",   /*sig_name*/"isBrkPedlPsdQf_0",   /*src_can*/"ZCU_CANFD1",   /*src_network_type*/"CANFD",   /*src_slotid_fr*/0,   /*src_basecycle_fr*/0,  /*src_repetition_fr*/0,  /*src_startbit*/171,   /*sigG_length*/2,  /*des_slotid_fr*/0,   /*des_basecycle_fr*/0,  /*des_repetition_fr*/0,   /*des_startbit*/5,    /*src_cyc*/101,  /*src_id*/0x82,   /*src_dlc*/64,   /*des_id*/0x76, /*updatebit_S*/400,   /*updatebit_D*/23         },
           {   /*sigGroup_s*/"igBrkPedlPsd_0",   /*sig_name*/"isBrkPedlPsdBrkPedlNotPsdSafe_0",   /*src_can*/"ZCU_CANFD1",   /*src_network_type*/"CANFD",   /*src_slotid_fr*/0,   /*src_basecycle_fr*/0,  /*src_repetition_fr*/0,  /*src_startbit*/169,   /*sigG_length*/1,  /*des_slotid_fr*/0,   /*des_basecycle_fr*/0,  /*des_repetition_fr*/0,   /*des_startbit*/7,    /*src_cyc*/101,  /*src_id*/0x82,   /*src_dlc*/64,   /*des_id*/0x76, /*updatebit_S*/400,   /*updatebit_D*/23         }
       }
   },
   {
       /*des_can*/ "ChassisCAN1",
       /*networktype*/ "CAN",
       27,
       {
           {   /*sigGroup_s*/"igCmptmtTFrnt_0",   /*sig_name*/"isCmptmtTFrntFanForCmptmtTRunng_0",   /*src_can*/"ZCU_CANFD1",   /*src_network_type*/"CANFD",   /*src_slotid_fr*/0,   /*src_basecycle_fr*/0,  /*src_repetition_fr*/0,  /*src_startbit*/50,   /*sigG_length*/1,  /*des_slotid_fr*/0,   /*des_basecycle_fr*/0,  /*des_repetition_fr*/0,   /*des_startbit*/24,    /*src_cyc*/101,  /*src_id*/0x212,   /*src_dlc*/64,   /*des_id*/0x310, /*updatebit_S*/49,   /*updatebit_D*/23         },
           {   /*sigGroup_s*/"igCmptmtTFrnt_0",   /*sig_name*/"isCmptmtTFrntQf_0",   /*src_can*/"ZCU_CANFD1",   /*src_network_type*/"CANFD",   /*src_slotid_fr*/0,   /*src_basecycle_fr*/0,  /*src_repetition_fr*/0,  /*src_startbit*/52,   /*sigG_length*/2,  /*des_slotid_fr*/0,   /*des_basecycle_fr*/0,  /*des_repetition_fr*/0,   /*des_startbit*/26,    /*src_cyc*/101,  /*src_id*/0x212,   /*src_dlc*/64,   /*des_id*/0x310, /*updatebit_S*/49,   /*updatebit_D*/23         },
           {   /*sigGroup_s*/"igCmptmtTFrnt_0",   /*sig_name*/"isCmptmtTFrntCmptmtTFrnt_0",   /*src_can*/"ZCU_CANFD1",   /*src_network_type*/"CANFD",   /*src_slotid_fr*/0,   /*src_basecycle_fr*/0,  /*src_repetition_fr*/0,  /*src_startbit*/47,   /*sigG_length*/11,  /*des_slotid_fr*/0,   /*des_basecycle_fr*/0,  /*des_repetition_fr*/0,   /*des_startbit*/21,    /*src_cyc*/101,  /*src_id*/0x212,   /*src_dlc*/64,   /*des_id*/0x310, /*updatebit_S*/49,   /*updatebit_D*/23         },
           {   /*sigGroup_s*/"igVehCfgPrmExt_0",   /*sig_name*/"isVehCfgPrmExtCCPBytePosn8_0",   /*src_can*/"ZCU_CANFD1",   /*src_network_type*/"CANFD",   /*src_slotid_fr*/0,   /*src_basecycle_fr*/0,  /*src_repetition_fr*/0,  /*src_startbit*/127,   /*sigG_length*/8,  /*des_slotid_fr*/0,   /*des_basecycle_fr*/0,  /*des_repetition_fr*/0,   /*des_startbit*/63,    /*src_cyc*/101,  /*src_id*/0x1f5,   /*src_dlc*/64,   /*des_id*/0x3f7, /*updatebit_S*/198,   /*updatebit_D*/1000         },
           {   /*sigGroup_s*/"igVehCfgPrmExt_0",   /*sig_name*/"isVehCfgPrmExtCCPBytePosn6_0",   /*src_can*/"ZCU_CANFD1",   /*src_network_type*/"CANFD",   /*src_slotid_fr*/0,   /*src_basecycle_fr*/0,  /*src_repetition_fr*/0,  /*src_startbit*/111,   /*sigG_length*/8,  /*des_slotid_fr*/0,   /*des_basecycle_fr*/0,  /*des_repetition_fr*/0,   /*des_startbit*/47,    /*src_cyc*/101,  /*src_id*/0x1f5,   /*src_dlc*/64,   /*des_id*/0x3f7, /*updatebit_S*/198,   /*updatebit_D*/1000         },
           {   /*sigGroup_s*/"igVehCfgPrmExt_0",   /*sig_name*/"isVehCfgPrmExtCCPBytePosn4_0",   /*src_can*/"ZCU_CANFD1",   /*src_network_type*/"CANFD",   /*src_slotid_fr*/0,   /*src_basecycle_fr*/0,  /*src_repetition_fr*/0,  /*src_startbit*/95,   /*sigG_length*/8,  /*des_slotid_fr*/0,   /*des_basecycle_fr*/0,  /*des_repetition_fr*/0,   /*des_startbit*/31,    /*src_cyc*/101,  /*src_id*/0x1f5,   /*src_dlc*/64,   /*des_id*/0x3f7, /*updatebit_S*/198,   /*updatebit_D*/1000         },
           {   /*sigGroup_s*/"igVehCfgPrmExt_0",   /*sig_name*/"isVehCfgPrmExtCCPBytePosn3_0",   /*src_can*/"ZCU_CANFD1",   /*src_network_type*/"CANFD",   /*src_slotid_fr*/0,   /*src_basecycle_fr*/0,  /*src_repetition_fr*/0,  /*src_startbit*/87,   /*sigG_length*/8,  /*des_slotid_fr*/0,   /*des_basecycle_fr*/0,  /*des_repetition_fr*/0,   /*des_startbit*/23,    /*src_cyc*/101,  /*src_id*/0x1f5,   /*src_dlc*/64,   /*des_id*/0x3f7, /*updatebit_S*/198,   /*updatebit_D*/1000         },
           {   /*sigGroup_s*/"igVehCfgPrmExt_0",   /*sig_name*/"isVehCfgPrmExtCCPBytePosn2_0",   /*src_can*/"ZCU_CANFD1",   /*src_network_type*/"CANFD",   /*src_slotid_fr*/0,   /*src_basecycle_fr*/0,  /*src_repetition_fr*/0,  /*src_startbit*/79,   /*sigG_length*/8,  /*des_slotid_fr*/0,   /*des_basecycle_fr*/0,  /*des_repetition_fr*/0,   /*des_startbit*/15,    /*src_cyc*/101,  /*src_id*/0x1f5,   /*src_dlc*/64,   /*des_id*/0x3f7, /*updatebit_S*/198,   /*updatebit_D*/1000         },
           {   /*sigGroup_s*/"igVehCfgPrmExt_0",   /*sig_name*/"isVehCfgPrmExtBlkIDBytePosn1_0",   /*src_can*/"ZCU_CANFD1",   /*src_network_type*/"CANFD",   /*src_slotid_fr*/0,   /*src_basecycle_fr*/0,  /*src_repetition_fr*/0,  /*src_startbit*/71,   /*sigG_length*/8,  /*des_slotid_fr*/0,   /*des_basecycle_fr*/0,  /*des_repetition_fr*/0,   /*des_startbit*/7,    /*src_cyc*/101,  /*src_id*/0x1f5,   /*src_dlc*/64,   /*des_id*/0x3f7, /*updatebit_S*/198,   /*updatebit_D*/1000         },
           {   /*sigGroup_s*/"igVehCfgPrmExt_0",   /*sig_name*/"isVehCfgPrmExtCCPBytePosn5_0",   /*src_can*/"ZCU_CANFD1",   /*src_network_type*/"CANFD",   /*src_slotid_fr*/0,   /*src_basecycle_fr*/0,  /*src_repetition_fr*/0,  /*src_startbit*/103,   /*sigG_length*/8,  /*des_slotid_fr*/0,   /*des_basecycle_fr*/0,  /*des_repetition_fr*/0,   /*des_startbit*/39,    /*src_cyc*/101,  /*src_id*/0x1f5,   /*src_dlc*/64,   /*des_id*/0x3f7, /*updatebit_S*/198,   /*updatebit_D*/1000         },
           {   /*sigGroup_s*/"igVehCfgPrmExt_0",   /*sig_name*/"isVehCfgPrmExtCCPBytePosn7_0",   /*src_can*/"ZCU_CANFD1",   /*src_network_type*/"CANFD",   /*src_slotid_fr*/0,   /*src_basecycle_fr*/0,  /*src_repetition_fr*/0,  /*src_startbit*/119,   /*sigG_length*/8,  /*des_slotid_fr*/0,   /*des_basecycle_fr*/0,  /*des_repetition_fr*/0,   /*des_startbit*/55,    /*src_cyc*/101,  /*src_id*/0x1f5,   /*src_dlc*/64,   /*des_id*/0x3f7, /*updatebit_S*/198,   /*updatebit_D*/1000         },
           {   /*sigGroup_s*/"igVehCfgPrmExt2_0",   /*sig_name*/"isVehCfgPrmExt2BlkIDBytePosn1_0",   /*src_can*/"ZCU_CANFD1",   /*src_network_type*/"CANFD",   /*src_slotid_fr*/0,   /*src_basecycle_fr*/0,  /*src_repetition_fr*/0,  /*src_startbit*/135,   /*sigG_length*/8,  /*des_slotid_fr*/0,   /*des_basecycle_fr*/0,  /*des_repetition_fr*/0,   /*des_startbit*/7,    /*src_cyc*/101,  /*src_id*/0x1f5,   /*src_dlc*/64,   /*des_id*/0x152, /*updatebit_S*/197,   /*updatebit_D*/1000         },
           {   /*sigGroup_s*/"igVehCfgPrmExt2_0",   /*sig_name*/"isVehCfgPrmExt2CCPBytePosn2_0",   /*src_can*/"ZCU_CANFD1",   /*src_network_type*/"CANFD",   /*src_slotid_fr*/0,   /*src_basecycle_fr*/0,  /*src_repetition_fr*/0,  /*src_startbit*/143,   /*sigG_length*/8,  /*des_slotid_fr*/0,   /*des_basecycle_fr*/0,  /*des_repetition_fr*/0,   /*des_startbit*/15,    /*src_cyc*/101,  /*src_id*/0x1f5,   /*src_dlc*/64,   /*des_id*/0x152, /*updatebit_S*/197,   /*updatebit_D*/1000         },
           {   /*sigGroup_s*/"igVehCfgPrmExt2_0",   /*sig_name*/"isVehCfgPrmExt2CCPBytePosn6_0",   /*src_can*/"ZCU_CANFD1",   /*src_network_type*/"CANFD",   /*src_slotid_fr*/0,   /*src_basecycle_fr*/0,  /*src_repetition_fr*/0,  /*src_startbit*/175,   /*sigG_length*/8,  /*des_slotid_fr*/0,   /*des_basecycle_fr*/0,  /*des_repetition_fr*/0,   /*des_startbit*/47,    /*src_cyc*/101,  /*src_id*/0x1f5,   /*src_dlc*/64,   /*des_id*/0x152, /*updatebit_S*/197,   /*updatebit_D*/1000         },
           {   /*sigGroup_s*/"igVehCfgPrmExt2_0",   /*sig_name*/"isVehCfgPrmExt2CCPBytePosn4_0",   /*src_can*/"ZCU_CANFD1",   /*src_network_type*/"CANFD",   /*src_slotid_fr*/0,   /*src_basecycle_fr*/0,  /*src_repetition_fr*/0,  /*src_startbit*/159,   /*sigG_length*/8,  /*des_slotid_fr*/0,   /*des_basecycle_fr*/0,  /*des_repetition_fr*/0,   /*des_startbit*/31,    /*src_cyc*/101,  /*src_id*/0x1f5,   /*src_dlc*/64,   /*des_id*/0x152, /*updatebit_S*/197,   /*updatebit_D*/1000         },
           {   /*sigGroup_s*/"igVehCfgPrmExt2_0",   /*sig_name*/"isVehCfgPrmExt2CCPBytePosn5_0",   /*src_can*/"ZCU_CANFD1",   /*src_network_type*/"CANFD",   /*src_slotid_fr*/0,   /*src_basecycle_fr*/0,  /*src_repetition_fr*/0,  /*src_startbit*/167,   /*sigG_length*/8,  /*des_slotid_fr*/0,   /*des_basecycle_fr*/0,  /*des_repetition_fr*/0,   /*des_startbit*/39,    /*src_cyc*/101,  /*src_id*/0x1f5,   /*src_dlc*/64,   /*des_id*/0x152, /*updatebit_S*/197,   /*updatebit_D*/1000         },
           {   /*sigGroup_s*/"igVehCfgPrmExt2_0",   /*sig_name*/"isVehCfgPrmExt2CCPBytePosn3_0",   /*src_can*/"ZCU_CANFD1",   /*src_network_type*/"CANFD",   /*src_slotid_fr*/0,   /*src_basecycle_fr*/0,  /*src_repetition_fr*/0,  /*src_startbit*/151,   /*sigG_length*/8,  /*des_slotid_fr*/0,   /*des_basecycle_fr*/0,  /*des_repetition_fr*/0,   /*des_startbit*/23,    /*src_cyc*/101,  /*src_id*/0x1f5,   /*src_dlc*/64,   /*des_id*/0x152, /*updatebit_S*/197,   /*updatebit_D*/1000         },
           {   /*sigGroup_s*/"igVehCfgPrmExt2_0",   /*sig_name*/"isVehCfgPrmExt2CCPBytePosn7_0",   /*src_can*/"ZCU_CANFD1",   /*src_network_type*/"CANFD",   /*src_slotid_fr*/0,   /*src_basecycle_fr*/0,  /*src_repetition_fr*/0,  /*src_startbit*/183,   /*sigG_length*/8,  /*des_slotid_fr*/0,   /*des_basecycle_fr*/0,  /*des_repetition_fr*/0,   /*des_startbit*/55,    /*src_cyc*/101,  /*src_id*/0x1f5,   /*src_dlc*/64,   /*des_id*/0x152, /*updatebit_S*/197,   /*updatebit_D*/1000         },
           {   /*sigGroup_s*/"igVehCfgPrmExt2_0",   /*sig_name*/"isVehCfgPrmExt2CCPBytePosn8_0",   /*src_can*/"ZCU_CANFD1",   /*src_network_type*/"CANFD",   /*src_slotid_fr*/0,   /*src_basecycle_fr*/0,  /*src_repetition_fr*/0,  /*src_startbit*/191,   /*sigG_length*/8,  /*des_slotid_fr*/0,   /*des_basecycle_fr*/0,  /*des_repetition_fr*/0,   /*des_startbit*/63,    /*src_cyc*/101,  /*src_id*/0x1f5,   /*src_dlc*/64,   /*des_id*/0x152, /*updatebit_S*/197,   /*updatebit_D*/1000         },
           {   /*sigGroup_s*/"igVehCfgPrm_0",   /*sig_name*/"isVehCfgPrmCCPBytePosn2_0",   /*src_can*/"ZCU_CANFD1",   /*src_network_type*/"CANFD",   /*src_slotid_fr*/0,   /*src_basecycle_fr*/0,  /*src_repetition_fr*/0,  /*src_startbit*/15,   /*sigG_length*/8,  /*des_slotid_fr*/0,   /*des_basecycle_fr*/0,  /*des_repetition_fr*/0,   /*des_startbit*/15,    /*src_cyc*/101,  /*src_id*/0x1f5,   /*src_dlc*/64,   /*des_id*/0x250, /*updatebit_S*/199,   /*updatebit_D*/1000         },
           {   /*sigGroup_s*/"igVehCfgPrm_0",   /*sig_name*/"isVehCfgPrmCCPBytePosn7_0",   /*src_can*/"ZCU_CANFD1",   /*src_network_type*/"CANFD",   /*src_slotid_fr*/0,   /*src_basecycle_fr*/0,  /*src_repetition_fr*/0,  /*src_startbit*/55,   /*sigG_length*/8,  /*des_slotid_fr*/0,   /*des_basecycle_fr*/0,  /*des_repetition_fr*/0,   /*des_startbit*/55,    /*src_cyc*/101,  /*src_id*/0x1f5,   /*src_dlc*/64,   /*des_id*/0x250, /*updatebit_S*/199,   /*updatebit_D*/1000         },
           {   /*sigGroup_s*/"igVehCfgPrm_0",   /*sig_name*/"isVehCfgPrmCCPBytePosn3_0",   /*src_can*/"ZCU_CANFD1",   /*src_network_type*/"CANFD",   /*src_slotid_fr*/0,   /*src_basecycle_fr*/0,  /*src_repetition_fr*/0,  /*src_startbit*/23,   /*sigG_length*/8,  /*des_slotid_fr*/0,   /*des_basecycle_fr*/0,  /*des_repetition_fr*/0,   /*des_startbit*/23,    /*src_cyc*/101,  /*src_id*/0x1f5,   /*src_dlc*/64,   /*des_id*/0x250, /*updatebit_S*/199,   /*updatebit_D*/1000         },
           {   /*sigGroup_s*/"igVehCfgPrm_0",   /*sig_name*/"isVehCfgPrmCCPBytePosn4_0",   /*src_can*/"ZCU_CANFD1",   /*src_network_type*/"CANFD",   /*src_slotid_fr*/0,   /*src_basecycle_fr*/0,  /*src_repetition_fr*/0,  /*src_startbit*/31,   /*sigG_length*/8,  /*des_slotid_fr*/0,   /*des_basecycle_fr*/0,  /*des_repetition_fr*/0,   /*des_startbit*/31,    /*src_cyc*/101,  /*src_id*/0x1f5,   /*src_dlc*/64,   /*des_id*/0x250, /*updatebit_S*/199,   /*updatebit_D*/1000         },
           {   /*sigGroup_s*/"igVehCfgPrm_0",   /*sig_name*/"isVehCfgPrmCCPBytePosn8_0",   /*src_can*/"ZCU_CANFD1",   /*src_network_type*/"CANFD",   /*src_slotid_fr*/0,   /*src_basecycle_fr*/0,  /*src_repetition_fr*/0,  /*src_startbit*/63,   /*sigG_length*/8,  /*des_slotid_fr*/0,   /*des_basecycle_fr*/0,  /*des_repetition_fr*/0,   /*des_startbit*/63,    /*src_cyc*/101,  /*src_id*/0x1f5,   /*src_dlc*/64,   /*des_id*/0x250, /*updatebit_S*/199,   /*updatebit_D*/1000         },
           {   /*sigGroup_s*/"igVehCfgPrm_0",   /*sig_name*/"isVehCfgPrmCCPBytePosn5_0",   /*src_can*/"ZCU_CANFD1",   /*src_network_type*/"CANFD",   /*src_slotid_fr*/0,   /*src_basecycle_fr*/0,  /*src_repetition_fr*/0,  /*src_startbit*/39,   /*sigG_length*/8,  /*des_slotid_fr*/0,   /*des_basecycle_fr*/0,  /*des_repetition_fr*/0,   /*des_startbit*/39,    /*src_cyc*/101,  /*src_id*/0x1f5,   /*src_dlc*/64,   /*des_id*/0x250, /*updatebit_S*/199,   /*updatebit_D*/1000         },
           {   /*sigGroup_s*/"igVehCfgPrm_0",   /*sig_name*/"isVehCfgPrmBlkIDBytePosn1_0",   /*src_can*/"ZCU_CANFD1",   /*src_network_type*/"CANFD",   /*src_slotid_fr*/0,   /*src_basecycle_fr*/0,  /*src_repetition_fr*/0,  /*src_startbit*/7,   /*sigG_length*/8,  /*des_slotid_fr*/0,   /*des_basecycle_fr*/0,  /*des_repetition_fr*/0,   /*des_startbit*/7,    /*src_cyc*/101,  /*src_id*/0x1f5,   /*src_dlc*/64,   /*des_id*/0x250, /*updatebit_S*/199,   /*updatebit_D*/1000         },
           {   /*sigGroup_s*/"igVehCfgPrm_0",   /*sig_name*/"isVehCfgPrmCCPBytePosn6_0",   /*src_can*/"ZCU_CANFD1",   /*src_network_type*/"CANFD",   /*src_slotid_fr*/0,   /*src_basecycle_fr*/0,  /*src_repetition_fr*/0,  /*src_startbit*/47,   /*sigG_length*/8,  /*des_slotid_fr*/0,   /*des_basecycle_fr*/0,  /*des_repetition_fr*/0,   /*des_startbit*/47,    /*src_cyc*/101,  /*src_id*/0x1f5,   /*src_dlc*/64,   /*des_id*/0x250, /*updatebit_S*/199,   /*updatebit_D*/1000         }
       }
   },
   {
       /*des_can*/ "ZCU_CANFD1",
       /*networktype*/ "CANFD",
       150,
       {
           {   /*sigGroup_s*/"igBltLockStAtRowSecRi_0",   /*sig_name*/"isBltLockStAtRowSecRiBltLockSt1_0",   /*src_can*/"ZCUD_CAN1",   /*src_network_type*/"CAN",   /*src_slotid_fr*/0,   /*src_basecycle_fr*/0,  /*src_repetition_fr*/0,  /*src_startbit*/14,   /*sigG_length*/1,  /*des_slotid_fr*/0,   /*des_basecycle_fr*/0,  /*des_repetition_fr*/0,   /*des_startbit*/11,    /*src_cyc*/101,  /*src_id*/0x70,   /*src_dlc*/8,   /*des_id*/0x353, /*updatebit_S*/12,   /*updatebit_D*/1         },
           {   /*sigGroup_s*/"igBltLockStAtRowSecRi_0",   /*sig_name*/"isBltLockStAtRowSecRiBltLockEquid_0",   /*src_can*/"ZCUD_CAN1",   /*src_network_type*/"CAN",   /*src_slotid_fr*/0,   /*src_basecycle_fr*/0,  /*src_repetition_fr*/0,  /*src_startbit*/15,   /*sigG_length*/1,  /*des_slotid_fr*/0,   /*des_basecycle_fr*/0,  /*des_repetition_fr*/0,   /*des_startbit*/12,    /*src_cyc*/101,  /*src_id*/0x70,   /*src_dlc*/8,   /*des_id*/0x353, /*updatebit_S*/12,   /*updatebit_D*/1         },
           {   /*sigGroup_s*/"igBltLockStAtRowSecRi_0",   /*sig_name*/"isBltLockStAtRowSecRiBltLockSts_0",   /*src_can*/"ZCUD_CAN1",   /*src_network_type*/"CAN",   /*src_slotid_fr*/0,   /*src_basecycle_fr*/0,  /*src_repetition_fr*/0,  /*src_startbit*/13,   /*sigG_length*/1,  /*des_slotid_fr*/0,   /*des_basecycle_fr*/0,  /*des_repetition_fr*/0,   /*des_startbit*/10,    /*src_cyc*/101,  /*src_id*/0x70,   /*src_dlc*/8,   /*des_id*/0x353, /*updatebit_S*/12,   /*updatebit_D*/1         },
           {   /*sigGroup_s*/"igSwtIndcr_0",   /*sig_name*/"isSwtIndcrIndcrTypExtReq_0",   /*src_can*/"ChassisCAN1",   /*src_network_type*/"CAN",   /*src_slotid_fr*/0,   /*src_basecycle_fr*/0,  /*src_repetition_fr*/0,  /*src_startbit*/15,   /*sigG_length*/2,  /*des_slotid_fr*/0,   /*des_basecycle_fr*/0,  /*des_repetition_fr*/0,   /*des_startbit*/183,    /*src_cyc*/101,  /*src_id*/0x2e6,   /*src_dlc*/8,   /*des_id*/0x1f1, /*updatebit_S*/9,   /*updatebit_D*/176         },
           {   /*sigGroup_s*/"igSwtIndcr_0",   /*sig_name*/"isSwtIndcrIndcrTypExtReqChks_0",   /*src_can*/"ChassisCAN1",   /*src_network_type*/"CAN",   /*src_slotid_fr*/0,   /*src_basecycle_fr*/0,  /*src_repetition_fr*/0,  /*src_startbit*/7,   /*sigG_length*/8,  /*des_slotid_fr*/0,   /*des_basecycle_fr*/0,  /*des_repetition_fr*/0,   /*des_startbit*/175,    /*src_cyc*/101,  /*src_id*/0x2e6,   /*src_dlc*/8,   /*des_id*/0x1f1, /*updatebit_S*/9,   /*updatebit_D*/176         },
           {   /*sigGroup_s*/"igSwtIndcr_0",   /*sig_name*/"isSwtIndcrIndcrTypExtReqCntr_0",   /*src_can*/"ChassisCAN1",   /*src_network_type*/"CAN",   /*src_slotid_fr*/0,   /*src_basecycle_fr*/0,  /*src_repetition_fr*/0,  /*src_startbit*/13,   /*sigG_length*/2,  /*des_slotid_fr*/0,   /*des_basecycle_fr*/0,  /*des_repetition_fr*/0,   /*des_startbit*/181,    /*src_cyc*/101,  /*src_id*/0x2e6,   /*src_dlc*/8,   /*des_id*/0x1f1, /*updatebit_S*/9,   /*updatebit_D*/176         },
           {   /*sigGroup_s*/"igSwtIndcr_0",   /*sig_name*/"isSwtIndcrIndcrTypExtReqToUpdQf_0",   /*src_can*/"ChassisCAN1",   /*src_network_type*/"CAN",   /*src_slotid_fr*/0,   /*src_basecycle_fr*/0,  /*src_repetition_fr*/0,  /*src_startbit*/11,   /*sigG_length*/2,  /*des_slotid_fr*/0,   /*des_basecycle_fr*/0,  /*des_repetition_fr*/0,   /*des_startbit*/179,    /*src_cyc*/101,  /*src_id*/0x2e6,   /*src_dlc*/8,   /*des_id*/0x1f1, /*updatebit_S*/9,   /*updatebit_D*/176         },
           {   /*sigGroup_s*/"igCrabMovModSts_0",   /*sig_name*/"isCrabMovModStsChks_0",   /*src_can*/"ChassisCAN1",   /*src_network_type*/"CAN",   /*src_slotid_fr*/0,   /*src_basecycle_fr*/0,  /*src_repetition_fr*/0,  /*src_startbit*/63,   /*sigG_length*/8,  /*des_slotid_fr*/0,   /*des_basecycle_fr*/0,  /*des_repetition_fr*/0,   /*des_startbit*/63,    /*src_cyc*/101,  /*src_id*/0x5b,   /*src_dlc*/8,   /*des_id*/0x61, /*updatebit_S*/55,   /*updatebit_D*/232         },
           {   /*sigGroup_s*/"igCrabMovModSts_0",   /*sig_name*/"isCrabMovModStsTankTurnModSts_0",   /*src_can*/"ChassisCAN1",   /*src_network_type*/"CAN",   /*src_slotid_fr*/0,   /*src_basecycle_fr*/0,  /*src_repetition_fr*/0,  /*src_startbit*/54,   /*sigG_length*/3,  /*des_slotid_fr*/0,   /*des_basecycle_fr*/0,  /*des_repetition_fr*/0,   /*des_startbit*/67,    /*src_cyc*/101,  /*src_id*/0x5b,   /*src_dlc*/8,   /*des_id*/0x61, /*updatebit_S*/55,   /*updatebit_D*/232         },
           {   /*sigGroup_s*/"igCrabMovModSts_0",   /*sig_name*/"isCrabMovModStsCntr_0",   /*src_can*/"ChassisCAN1",   /*src_network_type*/"CAN",   /*src_slotid_fr*/0,   /*src_basecycle_fr*/0,  /*src_repetition_fr*/0,  /*src_startbit*/51,   /*sigG_length*/4,  /*des_slotid_fr*/0,   /*des_basecycle_fr*/0,  /*des_repetition_fr*/0,   /*des_startbit*/71,    /*src_cyc*/101,  /*src_id*/0x5b,   /*src_dlc*/8,   /*des_id*/0x61, /*updatebit_S*/55,   /*updatebit_D*/232         },
           {   /*sigGroup_s*/"igADModCtrlInhbn_0",   /*sig_name*/"isADModCtrlInhbnADModCtrlInhbn_0",   /*src_can*/"ChassisCAN1",   /*src_network_type*/"CAN",   /*src_slotid_fr*/0,   /*src_basecycle_fr*/0,  /*src_repetition_fr*/0,  /*src_startbit*/43,   /*sigG_length*/3,  /*des_slotid_fr*/0,   /*des_basecycle_fr*/0,  /*des_repetition_fr*/0,   /*des_startbit*/251,    /*src_cyc*/101,  /*src_id*/0x76,   /*src_dlc*/8,   /*des_id*/0x485, /*updatebit_S*/40,   /*updatebit_D*/248         },
           {   /*sigGroup_s*/"igADModCtrlInhbn_0",   /*sig_name*/"isADModCtrlInhbnCntr_0",   /*src_can*/"ChassisCAN1",   /*src_network_type*/"CAN",   /*src_slotid_fr*/0,   /*src_basecycle_fr*/0,  /*src_repetition_fr*/0,  /*src_startbit*/47,   /*sigG_length*/4,  /*des_slotid_fr*/0,   /*des_basecycle_fr*/0,  /*des_repetition_fr*/0,   /*des_startbit*/255,    /*src_cyc*/101,  /*src_id*/0x76,   /*src_dlc*/8,   /*des_id*/0x485, /*updatebit_S*/40,   /*updatebit_D*/248         },
           {   /*sigGroup_s*/"igADModCtrlInhbn_0",   /*sig_name*/"isADModCtrlInhbnChks_0",   /*src_can*/"ChassisCAN1",   /*src_network_type*/"CAN",   /*src_slotid_fr*/0,   /*src_basecycle_fr*/0,  /*src_repetition_fr*/0,  /*src_startbit*/39,   /*sigG_length*/8,  /*des_slotid_fr*/0,   /*des_basecycle_fr*/0,  /*des_repetition_fr*/0,   /*des_startbit*/247,    /*src_cyc*/101,  /*src_id*/0x76,   /*src_dlc*/8,   /*des_id*/0x485, /*updatebit_S*/40,   /*updatebit_D*/248         },
           {   /*sigGroup_s*/"igRecOfPostImpctBrkgCfmd_0",   /*sig_name*/"isRecOfPostImpctBrkgCfmdCrashRollovr_0",   /*src_can*/"ZCUD_CAN1",   /*src_network_type*/"CAN",   /*src_slotid_fr*/0,   /*src_basecycle_fr*/0,  /*src_repetition_fr*/0,  /*src_startbit*/55,   /*sigG_length*/2,  /*des_slotid_fr*/0,   /*des_basecycle_fr*/0,  /*des_repetition_fr*/0,   /*des_startbit*/289,    /*src_cyc*/101,  /*src_id*/0x148,   /*src_dlc*/8,   /*des_id*/0x106, /*updatebit_S*/30,   /*updatebit_D*/416         },
           {   /*sigGroup_s*/"igRecOfPostImpctBrkgCfmd_0",   /*sig_name*/"isRecOfPostImpctBrkgCfmdCrashOz_0",   /*src_can*/"ZCUD_CAN1",   /*src_network_type*/"CAN",   /*src_slotid_fr*/0,   /*src_basecycle_fr*/0,  /*src_repetition_fr*/0,  /*src_startbit*/45,   /*sigG_length*/2,  /*des_slotid_fr*/0,   /*des_basecycle_fr*/0,  /*des_repetition_fr*/0,   /*des_startbit*/295,    /*src_cyc*/101,  /*src_id*/0x148,   /*src_dlc*/8,   /*des_id*/0x106, /*updatebit_S*/30,   /*updatebit_D*/416         },
           {   /*sigGroup_s*/"igRecOfPostImpctBrkgCfmd_0",   /*sig_name*/"isRecOfPostImpctBrkgCfmdCrashSideRi_0",   /*src_can*/"ZCUD_CAN1",   /*src_network_type*/"CAN",   /*src_slotid_fr*/0,   /*src_basecycle_fr*/0,  /*src_repetition_fr*/0,  /*src_startbit*/51,   /*sigG_length*/2,  /*des_slotid_fr*/0,   /*des_basecycle_fr*/0,  /*des_repetition_fr*/0,   /*des_startbit*/301,    /*src_cyc*/101,  /*src_id*/0x148,   /*src_dlc*/8,   /*des_id*/0x106, /*updatebit_S*/30,   /*updatebit_D*/416         },
           {   /*sigGroup_s*/"igRecOfPostImpctBrkgCfmd_0",   /*sig_name*/"isRecOfPostImpctBrkgCfmdCrashOffroadRTsevere_0",   /*src_can*/"ZCUD_CAN1",   /*src_network_type*/"CAN",   /*src_slotid_fr*/0,   /*src_basecycle_fr*/0,  /*src_repetition_fr*/0,  /*src_startbit*/47,   /*sigG_length*/2,  /*des_slotid_fr*/0,   /*des_basecycle_fr*/0,  /*des_repetition_fr*/0,   /*des_startbit*/281,    /*src_cyc*/101,  /*src_id*/0x148,   /*src_dlc*/8,   /*des_id*/0x106, /*updatebit_S*/30,   /*updatebit_D*/416         },
           {   /*sigGroup_s*/"igRecOfPostImpctBrkgCfmd_0",   /*sig_name*/"isRecOfPostImpctBrkgCfmdCrashFrnt_0",   /*src_can*/"ZCUD_CAN1",   /*src_network_type*/"CAN",   /*src_slotid_fr*/0,   /*src_basecycle_fr*/0,  /*src_repetition_fr*/0,  /*src_startbit*/25,   /*sigG_length*/2,  /*des_slotid_fr*/0,   /*des_basecycle_fr*/0,  /*des_repetition_fr*/0,   /*des_startbit*/275,    /*src_cyc*/101,  /*src_id*/0x148,   /*src_dlc*/8,   /*des_id*/0x106, /*updatebit_S*/30,   /*updatebit_D*/416         },
           {   /*sigGroup_s*/"igRecOfPostImpctBrkgCfmd_0",   /*sig_name*/"isRecOfPostImpctBrkgCfmdCrashSideLe_0",   /*src_can*/"ZCUD_CAN1",   /*src_network_type*/"CAN",   /*src_slotid_fr*/0,   /*src_basecycle_fr*/0,  /*src_repetition_fr*/0,  /*src_startbit*/53,   /*sigG_length*/2,  /*des_slotid_fr*/0,   /*des_basecycle_fr*/0,  /*des_repetition_fr*/0,   /*des_startbit*/303,    /*src_cyc*/101,  /*src_id*/0x148,   /*src_dlc*/8,   /*des_id*/0x106, /*updatebit_S*/30,   /*updatebit_D*/416         },
           {   /*sigGroup_s*/"igRecOfPostImpctBrkgCfmd_0",   /*sig_name*/"isRecOfPostImpctBrkgCfmdCrashLargeAnimal_0",   /*src_can*/"ZCUD_CAN1",   /*src_network_type*/"CAN",   /*src_slotid_fr*/0,   /*src_basecycle_fr*/0,  /*src_repetition_fr*/0,  /*src_startbit*/39,   /*sigG_length*/2,  /*des_slotid_fr*/0,   /*des_basecycle_fr*/0,  /*des_repetition_fr*/0,   /*des_startbit*/273,    /*src_cyc*/101,  /*src_id*/0x148,   /*src_dlc*/8,   /*des_id*/0x106, /*updatebit_S*/30,   /*updatebit_D*/416         },
           {   /*sigGroup_s*/"igRecOfPostImpctBrkgCfmd_0",   /*sig_name*/"isRecOfPostImpctBrkgCfmdCrashRe_0",   /*src_can*/"ZCUD_CAN1",   /*src_network_type*/"CAN",   /*src_slotid_fr*/0,   /*src_basecycle_fr*/0,  /*src_repetition_fr*/0,  /*src_startbit*/41,   /*sigG_length*/2,  /*des_slotid_fr*/0,   /*des_basecycle_fr*/0,  /*des_repetition_fr*/0,   /*des_startbit*/291,    /*src_cyc*/101,  /*src_id*/0x148,   /*src_dlc*/8,   /*des_id*/0x106, /*updatebit_S*/30,   /*updatebit_D*/416         },
           {   /*sigGroup_s*/"igRecOfPostImpctBrkgCfmd_0",   /*sig_name*/"isRecOfPostImpctBrkgCfmdPostImpctBrkgCfmd_0",   /*src_can*/"ZCUD_CAN1",   /*src_network_type*/"CAN",   /*src_slotid_fr*/0,   /*src_basecycle_fr*/0,  /*src_repetition_fr*/0,  /*src_startbit*/49,   /*sigG_length*/2,  /*des_slotid_fr*/0,   /*des_basecycle_fr*/0,  /*des_repetition_fr*/0,   /*des_startbit*/299,    /*src_cyc*/101,  /*src_id*/0x148,   /*src_dlc*/8,   /*des_id*/0x106, /*updatebit_S*/30,   /*updatebit_D*/416         },
           {   /*sigGroup_s*/"igRecOfPostImpctBrkgCfmd_0",   /*sig_name*/"isRecOfPostImpctBrkgCfmdCrashOffroadD_0",   /*src_can*/"ZCUD_CAN1",   /*src_network_type*/"CAN",   /*src_slotid_fr*/0,   /*src_basecycle_fr*/0,  /*src_repetition_fr*/0,  /*src_startbit*/35,   /*sigG_length*/2,  /*des_slotid_fr*/0,   /*des_basecycle_fr*/0,  /*des_repetition_fr*/0,   /*des_startbit*/285,    /*src_cyc*/101,  /*src_id*/0x148,   /*src_dlc*/8,   /*des_id*/0x106, /*updatebit_S*/30,   /*updatebit_D*/416         },
           {   /*sigGroup_s*/"igRecOfPostImpctBrkgCfmd_0",   /*sig_name*/"isRecOfPostImpctBrkgCfmdCrashOffroadA_0",   /*src_can*/"ZCUD_CAN1",   /*src_network_type*/"CAN",   /*src_slotid_fr*/0,   /*src_basecycle_fr*/0,  /*src_repetition_fr*/0,  /*src_startbit*/37,   /*sigG_length*/2,  /*des_slotid_fr*/0,   /*des_basecycle_fr*/0,  /*des_repetition_fr*/0,   /*des_startbit*/287,    /*src_cyc*/101,  /*src_id*/0x148,   /*src_dlc*/8,   /*des_id*/0x106, /*updatebit_S*/30,   /*updatebit_D*/416         },
           {   /*sigGroup_s*/"igRecOfPostImpctBrkgCfmd_0",   /*sig_name*/"isRecOfPostImpctBrkgCfmdCntr_0",   /*src_can*/"ZCUD_CAN1",   /*src_network_type*/"CAN",   /*src_slotid_fr*/0,   /*src_basecycle_fr*/0,  /*src_repetition_fr*/0,  /*src_startbit*/29,   /*sigG_length*/4,  /*des_slotid_fr*/0,   /*des_basecycle_fr*/0,  /*des_repetition_fr*/0,   /*des_startbit*/279,    /*src_cyc*/101,  /*src_id*/0x148,   /*src_dlc*/8,   /*des_id*/0x106, /*updatebit_S*/30,   /*updatebit_D*/416         },
           {   /*sigGroup_s*/"igRecOfPostImpctBrkgCfmd_0",   /*sig_name*/"isRecOfPostImpctBrkgCfmdChks_0",   /*src_can*/"ZCUD_CAN1",   /*src_network_type*/"CAN",   /*src_slotid_fr*/0,   /*src_basecycle_fr*/0,  /*src_repetition_fr*/0,  /*src_startbit*/63,   /*sigG_length*/8,  /*des_slotid_fr*/0,   /*des_basecycle_fr*/0,  /*des_repetition_fr*/0,   /*des_startbit*/271,    /*src_cyc*/101,  /*src_id*/0x148,   /*src_dlc*/8,   /*des_id*/0x106, /*updatebit_S*/30,   /*updatebit_D*/416         },
           {   /*sigGroup_s*/"igRecOfPostImpctBrkgCfmd_0",   /*sig_name*/"isRecOfPostImpctBrkgCfmdCrashOffroadRT_0",   /*src_can*/"ZCUD_CAN1",   /*src_network_type*/"CAN",   /*src_slotid_fr*/0,   /*src_basecycle_fr*/0,  /*src_repetition_fr*/0,  /*src_startbit*/33,   /*sigG_length*/2,  /*des_slotid_fr*/0,   /*des_basecycle_fr*/0,  /*des_repetition_fr*/0,   /*des_startbit*/283,    /*src_cyc*/101,  /*src_id*/0x148,   /*src_dlc*/8,   /*des_id*/0x106, /*updatebit_S*/30,   /*updatebit_D*/416         },
           {   /*sigGroup_s*/"igRecOfPostImpctBrkgCfmd_0",   /*sig_name*/"isRecOfPostImpctBrkgCfmdCrashPed_0",   /*src_can*/"ZCUD_CAN1",   /*src_network_type*/"CAN",   /*src_slotid_fr*/0,   /*src_basecycle_fr*/0,  /*src_repetition_fr*/0,  /*src_startbit*/43,   /*sigG_length*/2,  /*des_slotid_fr*/0,   /*des_basecycle_fr*/0,  /*des_repetition_fr*/0,   /*des_startbit*/293,    /*src_cyc*/101,  /*src_id*/0x148,   /*src_dlc*/8,   /*des_id*/0x106, /*updatebit_S*/30,   /*updatebit_D*/416         },
           {   /*sigGroup_s*/"igDrvrGearShiftParkReq_0",   /*sig_name*/"isDrvrGearShiftParkReqSts_0",   /*src_can*/"PropulsionCAN",   /*src_network_type*/"CAN",   /*src_slotid_fr*/0,   /*src_basecycle_fr*/0,  /*src_repetition_fr*/0,  /*src_startbit*/13,   /*sigG_length*/2,  /*des_slotid_fr*/0,   /*des_basecycle_fr*/0,  /*des_repetition_fr*/0,   /*des_startbit*/235,    /*src_cyc*/101,  /*src_id*/0x135,   /*src_dlc*/8,   /*des_id*/0x61, /*updatebit_S*/15,   /*updatebit_D*/418         },
           {   /*sigGroup_s*/"igDrvrGearShiftParkReq_0",   /*sig_name*/"isDrvrGearShiftParkReqCntr_0",   /*src_can*/"PropulsionCAN",   /*src_network_type*/"CAN",   /*src_slotid_fr*/0,   /*src_basecycle_fr*/0,  /*src_repetition_fr*/0,  /*src_startbit*/11,   /*sigG_length*/4,  /*des_slotid_fr*/0,   /*des_basecycle_fr*/0,  /*des_repetition_fr*/0,   /*des_startbit*/239,    /*src_cyc*/101,  /*src_id*/0x135,   /*src_dlc*/8,   /*des_id*/0x61, /*updatebit_S*/15,   /*updatebit_D*/418         },
           {   /*sigGroup_s*/"igDrvrGearShiftParkReq_0",   /*sig_name*/"isDrvrGearShiftParkReqChks_0",   /*src_can*/"PropulsionCAN",   /*src_network_type*/"CAN",   /*src_slotid_fr*/0,   /*src_basecycle_fr*/0,  /*src_repetition_fr*/0,  /*src_startbit*/23,   /*sigG_length*/8,  /*des_slotid_fr*/0,   /*des_basecycle_fr*/0,  /*des_repetition_fr*/0,   /*des_startbit*/231,    /*src_cyc*/101,  /*src_id*/0x135,   /*src_dlc*/8,   /*des_id*/0x61, /*updatebit_S*/15,   /*updatebit_D*/418         },
           {   /*sigGroup_s*/"igDrvrGearShiftParkReq_0",   /*sig_name*/"isDrvrGearShiftParkReq1_0",   /*src_can*/"PropulsionCAN",   /*src_network_type*/"CAN",   /*src_slotid_fr*/0,   /*src_basecycle_fr*/0,  /*src_repetition_fr*/0,  /*src_startbit*/14,   /*sigG_length*/1,  /*des_slotid_fr*/0,   /*des_basecycle_fr*/0,  /*des_repetition_fr*/0,   /*des_startbit*/233,    /*src_cyc*/101,  /*src_id*/0x135,   /*src_dlc*/8,   /*des_id*/0x61, /*updatebit_S*/15,   /*updatebit_D*/418         },
           {   /*sigGroup_s*/"igBltLockStAtRowSecMid_0",   /*sig_name*/"isBltLockStAtRowSecMidBltLockEquid_0",   /*src_can*/"ZCUD_CAN1",   /*src_network_type*/"CAN",   /*src_slotid_fr*/0,   /*src_basecycle_fr*/0,  /*src_repetition_fr*/0,  /*src_startbit*/3,   /*sigG_length*/1,  /*des_slotid_fr*/0,   /*des_basecycle_fr*/0,  /*des_repetition_fr*/0,   /*des_startbit*/15,    /*src_cyc*/101,  /*src_id*/0x70,   /*src_dlc*/8,   /*des_id*/0x353, /*updatebit_S*/0,   /*updatebit_D*/0         },
           {   /*sigGroup_s*/"igBltLockStAtRowSecMid_0",   /*sig_name*/"isBltLockStAtRowSecMidBltLockSts_0",   /*src_can*/"ZCUD_CAN1",   /*src_network_type*/"CAN",   /*src_slotid_fr*/0,   /*src_basecycle_fr*/0,  /*src_repetition_fr*/0,  /*src_startbit*/1,   /*sigG_length*/1,  /*des_slotid_fr*/0,   /*des_basecycle_fr*/0,  /*des_repetition_fr*/0,   /*des_startbit*/13,    /*src_cyc*/101,  /*src_id*/0x70,   /*src_dlc*/8,   /*des_id*/0x353, /*updatebit_S*/0,   /*updatebit_D*/0         },
           {   /*sigGroup_s*/"igBltLockStAtRowSecMid_0",   /*sig_name*/"isBltLockStAtRowSecMidBltLockSt1_0",   /*src_can*/"ZCUD_CAN1",   /*src_network_type*/"CAN",   /*src_slotid_fr*/0,   /*src_basecycle_fr*/0,  /*src_repetition_fr*/0,  /*src_startbit*/2,   /*sigG_length*/1,  /*des_slotid_fr*/0,   /*des_basecycle_fr*/0,  /*des_repetition_fr*/0,   /*des_startbit*/14,    /*src_cyc*/101,  /*src_id*/0x70,   /*src_dlc*/8,   /*des_id*/0x353, /*updatebit_S*/0,   /*updatebit_D*/0         },
           {   /*sigGroup_s*/"igPtTqAtWhlReAct_0",   /*sig_name*/"isPtTqAtWhlReActPtTqAtWhlReLeAct_0",   /*src_can*/"ChassisCANFD2",   /*src_network_type*/"CANFD",   /*src_slotid_fr*/0,   /*src_basecycle_fr*/0,  /*src_repetition_fr*/0,  /*src_startbit*/247,   /*sigG_length*/16,  /*des_slotid_fr*/0,   /*des_basecycle_fr*/0,  /*des_repetition_fr*/0,   /*des_startbit*/407,    /*src_cyc*/101,  /*src_id*/0x7c,   /*src_dlc*/64,   /*des_id*/0x1f1, /*updatebit_S*/280,   /*updatebit_D*/440         },
           {   /*sigGroup_s*/"igPtTqAtWhlReAct_0",   /*sig_name*/"isPtTqAtWhlReActPtTqAtWhlsReQly_0",   /*src_can*/"ChassisCANFD2",   /*src_network_type*/"CANFD",   /*src_slotid_fr*/0,   /*src_basecycle_fr*/0,  /*src_repetition_fr*/0,  /*src_startbit*/283,   /*sigG_length*/3,  /*des_slotid_fr*/0,   /*des_basecycle_fr*/0,  /*des_repetition_fr*/0,   /*des_startbit*/443,    /*src_cyc*/101,  /*src_id*/0x7c,   /*src_dlc*/64,   /*des_id*/0x1f1, /*updatebit_S*/280,   /*updatebit_D*/440         },
           {   /*sigGroup_s*/"igPtTqAtWhlReAct_0",   /*sig_name*/"isPtTqAtWhlReActPtTqAtWhlReRiAct_0",   /*src_can*/"ChassisCANFD2",   /*src_network_type*/"CANFD",   /*src_slotid_fr*/0,   /*src_basecycle_fr*/0,  /*src_repetition_fr*/0,  /*src_startbit*/263,   /*sigG_length*/16,  /*des_slotid_fr*/0,   /*des_basecycle_fr*/0,  /*des_repetition_fr*/0,   /*des_startbit*/423,    /*src_cyc*/101,  /*src_id*/0x7c,   /*src_dlc*/64,   /*des_id*/0x1f1, /*updatebit_S*/280,   /*updatebit_D*/440         },
           {   /*sigGroup_s*/"igPtTqAtWhlReAct_0",   /*sig_name*/"isPtTqAtWhlReActCntr_0",   /*src_can*/"ChassisCANFD2",   /*src_network_type*/"CANFD",   /*src_slotid_fr*/0,   /*src_basecycle_fr*/0,  /*src_repetition_fr*/0,  /*src_startbit*/287,   /*sigG_length*/4,  /*des_slotid_fr*/0,   /*des_basecycle_fr*/0,  /*des_repetition_fr*/0,   /*des_startbit*/447,    /*src_cyc*/101,  /*src_id*/0x7c,   /*src_dlc*/64,   /*des_id*/0x1f1, /*updatebit_S*/280,   /*updatebit_D*/440         },
           {   /*sigGroup_s*/"igPtTqAtWhlReAct_0",   /*sig_name*/"isPtTqAtWhlReActPtTqAtAxleReAct_0",   /*src_can*/"ChassisCANFD2",   /*src_network_type*/"CANFD",   /*src_slotid_fr*/0,   /*src_basecycle_fr*/0,  /*src_repetition_fr*/0,  /*src_startbit*/231,   /*sigG_length*/16,  /*des_slotid_fr*/0,   /*des_basecycle_fr*/0,  /*des_repetition_fr*/0,   /*des_startbit*/391,    /*src_cyc*/101,  /*src_id*/0x7c,   /*src_dlc*/64,   /*des_id*/0x1f1, /*updatebit_S*/280,   /*updatebit_D*/440         },
           {   /*sigGroup_s*/"igPtTqAtWhlReAct_0",   /*sig_name*/"isPtTqAtWhlReActChks_0",   /*src_can*/"ChassisCANFD2",   /*src_network_type*/"CANFD",   /*src_slotid_fr*/0,   /*src_basecycle_fr*/0,  /*src_repetition_fr*/0,  /*src_startbit*/279,   /*sigG_length*/8,  /*des_slotid_fr*/0,   /*des_basecycle_fr*/0,  /*des_repetition_fr*/0,   /*des_startbit*/439,    /*src_cyc*/101,  /*src_id*/0x7c,   /*src_dlc*/64,   /*des_id*/0x1f1, /*updatebit_S*/280,   /*updatebit_D*/440         },
           {   /*sigGroup_s*/"igBltLockStAtRowThrdLe_0",   /*sig_name*/"isBltLockStAtRowThrdLeBltLockSt1_0",   /*src_can*/"ZCUD_CAN1",   /*src_network_type*/"CAN",   /*src_slotid_fr*/0,   /*src_basecycle_fr*/0,  /*src_repetition_fr*/0,  /*src_startbit*/10,   /*sigG_length*/1,  /*des_slotid_fr*/0,   /*des_basecycle_fr*/0,  /*des_repetition_fr*/0,   /*des_startbit*/22,    /*src_cyc*/101,  /*src_id*/0x70,   /*src_dlc*/8,   /*des_id*/0x353, /*updatebit_S*/8,   /*updatebit_D*/8         },
           {   /*sigGroup_s*/"igBltLockStAtRowThrdLe_0",   /*sig_name*/"isBltLockStAtRowThrdLeBltLockEquid_0",   /*src_can*/"ZCUD_CAN1",   /*src_network_type*/"CAN",   /*src_slotid_fr*/0,   /*src_basecycle_fr*/0,  /*src_repetition_fr*/0,  /*src_startbit*/11,   /*sigG_length*/1,  /*des_slotid_fr*/0,   /*des_basecycle_fr*/0,  /*des_repetition_fr*/0,   /*des_startbit*/23,    /*src_cyc*/101,  /*src_id*/0x70,   /*src_dlc*/8,   /*des_id*/0x353, /*updatebit_S*/8,   /*updatebit_D*/8         },
           {   /*sigGroup_s*/"igBltLockStAtRowThrdLe_0",   /*sig_name*/"isBltLockStAtRowThrdLeBltLockSts_0",   /*src_can*/"ZCUD_CAN1",   /*src_network_type*/"CAN",   /*src_slotid_fr*/0,   /*src_basecycle_fr*/0,  /*src_repetition_fr*/0,  /*src_startbit*/9,   /*sigG_length*/1,  /*des_slotid_fr*/0,   /*des_basecycle_fr*/0,  /*des_repetition_fr*/0,   /*des_startbit*/21,    /*src_cyc*/101,  /*src_id*/0x70,   /*src_dlc*/8,   /*des_id*/0x353, /*updatebit_S*/8,   /*updatebit_D*/8         },
           {   /*sigGroup_s*/"igRecOfPostImpctBrkgSuspc_0",   /*sig_name*/"isRecOfPostImpctBrkgSuspcChks_0",   /*src_can*/"ZCUD_CAN1",   /*src_network_type*/"CAN",   /*src_slotid_fr*/0,   /*src_basecycle_fr*/0,  /*src_repetition_fr*/0,  /*src_startbit*/39,   /*sigG_length*/8,  /*des_slotid_fr*/0,   /*des_basecycle_fr*/0,  /*des_repetition_fr*/0,   /*des_startbit*/191,    /*src_cyc*/101,  /*src_id*/0x70,   /*src_dlc*/8,   /*des_id*/0x81, /*updatebit_S*/41,   /*updatebit_D*/193         },
           {   /*sigGroup_s*/"igRecOfPostImpctBrkgSuspc_0",   /*sig_name*/"isRecOfPostImpctBrkgSuspcCntr_0",   /*src_can*/"ZCUD_CAN1",   /*src_network_type*/"CAN",   /*src_slotid_fr*/0,   /*src_basecycle_fr*/0,  /*src_repetition_fr*/0,  /*src_startbit*/47,   /*sigG_length*/4,  /*des_slotid_fr*/0,   /*des_basecycle_fr*/0,  /*des_repetition_fr*/0,   /*des_startbit*/199,    /*src_cyc*/101,  /*src_id*/0x70,   /*src_dlc*/8,   /*des_id*/0x81, /*updatebit_S*/41,   /*updatebit_D*/193         },
           {   /*sigGroup_s*/"igRecOfPostImpctBrkgSuspc_0",   /*sig_name*/"isRecOfPostImpctBrkgSuspcSuspcPostImpctBrkg_0",   /*src_can*/"ZCUD_CAN1",   /*src_network_type*/"CAN",   /*src_slotid_fr*/0,   /*src_basecycle_fr*/0,  /*src_repetition_fr*/0,  /*src_startbit*/43,   /*sigG_length*/2,  /*des_slotid_fr*/0,   /*des_basecycle_fr*/0,  /*des_repetition_fr*/0,   /*des_startbit*/195,    /*src_cyc*/101,  /*src_id*/0x70,   /*src_dlc*/8,   /*des_id*/0x81, /*updatebit_S*/41,   /*updatebit_D*/193         },
           {   /*sigGroup_s*/"igEngSt1WdSts_0",   /*sig_name*/"isEngSt1WdStsChks_0",   /*src_can*/"PropulsionCAN",   /*src_network_type*/"CAN",   /*src_slotid_fr*/0,   /*src_basecycle_fr*/0,  /*src_repetition_fr*/0,  /*src_startbit*/23,   /*sigG_length*/8,  /*des_slotid_fr*/0,   /*des_basecycle_fr*/0,  /*des_repetition_fr*/0,   /*des_startbit*/263,    /*src_cyc*/101,  /*src_id*/0x4b,   /*src_dlc*/8,   /*des_id*/0x61, /*updatebit_S*/8,   /*updatebit_D*/420         },
           {   /*sigGroup_s*/"igEngSt1WdSts_0",   /*sig_name*/"isEngSt1WdStsCntr_0",   /*src_can*/"PropulsionCAN",   /*src_network_type*/"CAN",   /*src_slotid_fr*/0,   /*src_basecycle_fr*/0,  /*src_repetition_fr*/0,  /*src_startbit*/31,   /*sigG_length*/4,  /*des_slotid_fr*/0,   /*des_basecycle_fr*/0,  /*des_repetition_fr*/0,   /*des_startbit*/271,    /*src_cyc*/101,  /*src_id*/0x4b,   /*src_dlc*/8,   /*des_id*/0x61, /*updatebit_S*/8,   /*updatebit_D*/420         },
           {   /*sigGroup_s*/"igEngSt1WdSts_0",   /*sig_name*/"isEngSt1WdStsEngSt1WdSts_0",   /*src_can*/"PropulsionCAN",   /*src_network_type*/"CAN",   /*src_slotid_fr*/0,   /*src_basecycle_fr*/0,  /*src_repetition_fr*/0,  /*src_startbit*/27,   /*sigG_length*/4,  /*des_slotid_fr*/0,   /*des_basecycle_fr*/0,  /*des_repetition_fr*/0,   /*des_startbit*/267,    /*src_cyc*/101,  /*src_id*/0x4b,   /*src_dlc*/8,   /*des_id*/0x61, /*updatebit_S*/8,   /*updatebit_D*/420         },
           {   /*sigGroup_s*/"igEngT_0",   /*sig_name*/"isEngTQf_0",   /*src_can*/"PropulsionCAN",   /*src_network_type*/"CAN",   /*src_slotid_fr*/0,   /*src_basecycle_fr*/0,  /*src_repetition_fr*/0,  /*src_startbit*/1,   /*sigG_length*/2,  /*des_slotid_fr*/0,   /*des_basecycle_fr*/0,  /*des_repetition_fr*/0,   /*des_startbit*/63,    /*src_cyc*/101,  /*src_id*/0x171,   /*src_dlc*/8,   /*des_id*/0x1f1, /*updatebit_S*/2,   /*updatebit_D*/61         },
           {   /*sigGroup_s*/"igEngT_0",   /*sig_name*/"isEngTEngT_0",   /*src_can*/"PropulsionCAN",   /*src_network_type*/"CAN",   /*src_slotid_fr*/0,   /*src_basecycle_fr*/0,  /*src_repetition_fr*/0,  /*src_startbit*/15,   /*sigG_length*/8,  /*des_slotid_fr*/0,   /*des_basecycle_fr*/0,  /*des_repetition_fr*/0,   /*des_startbit*/55,    /*src_cyc*/101,  /*src_id*/0x171,   /*src_dlc*/8,   /*des_id*/0x1f1, /*updatebit_S*/2,   /*updatebit_D*/61         },
           {   /*sigGroup_s*/"igWhlMotSysSpdActSafe_0",   /*sig_name*/"isWhlMotSysSpdActSafeChks_0",   /*src_can*/"PropulsionCAN",   /*src_network_type*/"CAN",   /*src_slotid_fr*/0,   /*src_basecycle_fr*/0,  /*src_repetition_fr*/0,  /*src_startbit*/23,   /*sigG_length*/8,  /*des_slotid_fr*/0,   /*des_basecycle_fr*/0,  /*des_repetition_fr*/0,   /*des_startbit*/447,    /*src_cyc*/101,  /*src_id*/0x105,   /*src_dlc*/8,   /*des_id*/0x61, /*updatebit_S*/25,   /*updatebit_D*/487         },
           {   /*sigGroup_s*/"igWhlMotSysSpdActSafe_0",   /*sig_name*/"isWhlMotSysSpdActSafeIsgSpdActSgn800_0",   /*src_can*/"PropulsionCAN",   /*src_network_type*/"CAN",   /*src_slotid_fr*/0,   /*src_basecycle_fr*/0,  /*src_repetition_fr*/0,  /*src_startbit*/7,   /*sigG_length*/16,  /*des_slotid_fr*/0,   /*des_basecycle_fr*/0,  /*des_repetition_fr*/0,   /*des_startbit*/431,    /*src_cyc*/101,  /*src_id*/0x105,   /*src_dlc*/8,   /*des_id*/0x61, /*updatebit_S*/25,   /*updatebit_D*/487         },
           {   /*sigGroup_s*/"igWhlMotSysSpdActSafe_0",   /*sig_name*/"isWhlMotSysSpdActSafeQF_0",   /*src_can*/"PropulsionCAN",   /*src_network_type*/"CAN",   /*src_slotid_fr*/0,   /*src_basecycle_fr*/0,  /*src_repetition_fr*/0,  /*src_startbit*/27,   /*sigG_length*/2,  /*des_slotid_fr*/0,   /*des_basecycle_fr*/0,  /*des_repetition_fr*/0,   /*des_startbit*/451,    /*src_cyc*/101,  /*src_id*/0x105,   /*src_dlc*/8,   /*des_id*/0x61, /*updatebit_S*/25,   /*updatebit_D*/487         },
           {   /*sigGroup_s*/"igWhlMotSysSpdActSafe_0",   /*sig_name*/"isWhlMotSysSpdActSafeCntr_0",   /*src_can*/"PropulsionCAN",   /*src_network_type*/"CAN",   /*src_slotid_fr*/0,   /*src_basecycle_fr*/0,  /*src_repetition_fr*/0,  /*src_startbit*/31,   /*sigG_length*/4,  /*des_slotid_fr*/0,   /*des_basecycle_fr*/0,  /*des_repetition_fr*/0,   /*des_startbit*/455,    /*src_cyc*/101,  /*src_id*/0x105,   /*src_dlc*/8,   /*des_id*/0x61, /*updatebit_S*/25,   /*updatebit_D*/487         },
           {   /*sigGroup_s*/"igTurnIndcrSwt_0",   /*sig_name*/"isTurnIndcrSwtIndcrTypExtReqCntr_0",   /*src_can*/"CEM_LIN4",   /*src_network_type*/"LIN",   /*src_slotid_fr*/0,   /*src_basecycle_fr*/0,  /*src_repetition_fr*/0,  /*src_startbit*/24,   /*sigG_length*/2,  /*des_slotid_fr*/0,   /*des_basecycle_fr*/0,  /*des_repetition_fr*/0,   /*des_startbit*/469,    /*src_cyc*/101,  /*src_id*/32,   /*src_dlc*/5,   /*des_id*/0x1f1, /*updatebit_S*/1000,   /*updatebit_D*/465         },
           {   /*sigGroup_s*/"igTurnIndcrSwt_0",   /*sig_name*/"isTurnIndcrSwtIndcrTypExtReqChks_0",   /*src_can*/"CEM_LIN4",   /*src_network_type*/"LIN",   /*src_slotid_fr*/0,   /*src_basecycle_fr*/0,  /*src_repetition_fr*/0,  /*src_startbit*/14,   /*sigG_length*/8,  /*des_slotid_fr*/0,   /*des_basecycle_fr*/0,  /*des_repetition_fr*/0,   /*des_startbit*/463,    /*src_cyc*/101,  /*src_id*/32,   /*src_dlc*/5,   /*des_id*/0x1f1, /*updatebit_S*/1000,   /*updatebit_D*/465         },
           {   /*sigGroup_s*/"igTurnIndcrSwt_0",   /*sig_name*/"isTurnIndcrSwtIndcrTypExtReq_0",   /*src_can*/"CEM_LIN4",   /*src_network_type*/"LIN",   /*src_slotid_fr*/0,   /*src_basecycle_fr*/0,  /*src_repetition_fr*/0,  /*src_startbit*/22,   /*sigG_length*/2,  /*des_slotid_fr*/0,   /*des_basecycle_fr*/0,  /*des_repetition_fr*/0,   /*des_startbit*/471,    /*src_cyc*/101,  /*src_id*/32,   /*src_dlc*/5,   /*des_id*/0x1f1, /*updatebit_S*/1000,   /*updatebit_D*/465         },
           {   /*sigGroup_s*/"igTurnIndcrSwt_0",   /*sig_name*/"isTurnIndcrSwtIndcrTypExtReqToUpdQf_0",   /*src_can*/"CEM_LIN4",   /*src_network_type*/"LIN",   /*src_slotid_fr*/0,   /*src_basecycle_fr*/0,  /*src_repetition_fr*/0,  /*src_startbit*/26,   /*sigG_length*/2,  /*des_slotid_fr*/0,   /*des_basecycle_fr*/0,  /*des_repetition_fr*/0,   /*des_startbit*/467,    /*src_cyc*/101,  /*src_id*/32,   /*src_dlc*/5,   /*des_id*/0x1f1, /*updatebit_S*/1000,   /*updatebit_D*/465         },
           {   /*sigGroup_s*/"igSBWSysDegradationStsR1_0",   /*sig_name*/"isSBWSysDegradationStsR1DegradationSts_0",   /*src_can*/"ZCUD_CANFD3",   /*src_network_type*/"CANFD",   /*src_slotid_fr*/0,   /*src_basecycle_fr*/0,  /*src_repetition_fr*/0,  /*src_startbit*/11,   /*sigG_length*/4,  /*des_slotid_fr*/0,   /*des_basecycle_fr*/0,  /*des_repetition_fr*/0,   /*des_startbit*/363,    /*src_cyc*/101,  /*src_id*/0x110,   /*src_dlc*/64,   /*des_id*/0x106, /*updatebit_S*/23,   /*updatebit_D*/315         },
           {   /*sigGroup_s*/"igSBWSysDegradationStsR1_0",   /*sig_name*/"isSBWSysDegradationStsR1Chks_0",   /*src_can*/"ZCUD_CANFD3",   /*src_network_type*/"CANFD",   /*src_slotid_fr*/0,   /*src_basecycle_fr*/0,  /*src_repetition_fr*/0,  /*src_startbit*/7,   /*sigG_length*/8,  /*des_slotid_fr*/0,   /*des_basecycle_fr*/0,  /*des_repetition_fr*/0,   /*des_startbit*/359,    /*src_cyc*/101,  /*src_id*/0x110,   /*src_dlc*/64,   /*des_id*/0x106, /*updatebit_S*/23,   /*updatebit_D*/315         },
           {   /*sigGroup_s*/"igSBWSysDegradationStsR1_0",   /*sig_name*/"isSBWSysDegradationStsR1Cntr_0",   /*src_can*/"ZCUD_CANFD3",   /*src_network_type*/"CANFD",   /*src_slotid_fr*/0,   /*src_basecycle_fr*/0,  /*src_repetition_fr*/0,  /*src_startbit*/15,   /*sigG_length*/4,  /*des_slotid_fr*/0,   /*des_basecycle_fr*/0,  /*des_repetition_fr*/0,   /*des_startbit*/367,    /*src_cyc*/101,  /*src_id*/0x110,   /*src_dlc*/64,   /*des_id*/0x106, /*updatebit_S*/23,   /*updatebit_D*/315         },
           {   /*sigGroup_s*/"igSBWSysDegradationStsH1_0",   /*sig_name*/"isSBWSysDegradationStsH1Cntr_0",   /*src_can*/"ZCUD_CANFD3",   /*src_network_type*/"CANFD",   /*src_slotid_fr*/0,   /*src_basecycle_fr*/0,  /*src_repetition_fr*/0,  /*src_startbit*/15,   /*sigG_length*/4,  /*des_slotid_fr*/0,   /*des_basecycle_fr*/0,  /*des_repetition_fr*/0,   /*des_startbit*/351,    /*src_cyc*/101,  /*src_id*/0x100,   /*src_dlc*/64,   /*des_id*/0x106, /*updatebit_S*/23,   /*updatebit_D*/420         },
           {   /*sigGroup_s*/"igSBWSysDegradationStsH1_0",   /*sig_name*/"isSBWSysDegradationStsH1DegradationSts_0",   /*src_can*/"ZCUD_CANFD3",   /*src_network_type*/"CANFD",   /*src_slotid_fr*/0,   /*src_basecycle_fr*/0,  /*src_repetition_fr*/0,  /*src_startbit*/11,   /*sigG_length*/4,  /*des_slotid_fr*/0,   /*des_basecycle_fr*/0,  /*des_repetition_fr*/0,   /*des_startbit*/347,    /*src_cyc*/101,  /*src_id*/0x100,   /*src_dlc*/64,   /*des_id*/0x106, /*updatebit_S*/23,   /*updatebit_D*/420         },
           {   /*sigGroup_s*/"igSBWSysDegradationStsH1_0",   /*sig_name*/"isSBWSysDegradationStsH1Chks_0",   /*src_can*/"ZCUD_CANFD3",   /*src_network_type*/"CANFD",   /*src_slotid_fr*/0,   /*src_basecycle_fr*/0,  /*src_repetition_fr*/0,  /*src_startbit*/7,   /*sigG_length*/8,  /*des_slotid_fr*/0,   /*des_basecycle_fr*/0,  /*des_repetition_fr*/0,   /*des_startbit*/343,    /*src_cyc*/101,  /*src_id*/0x100,   /*src_dlc*/64,   /*des_id*/0x106, /*updatebit_S*/23,   /*updatebit_D*/420         },
           {   /*sigGroup_s*/"igPinionSteerAgGroupR1_0",   /*sig_name*/"isPinionSteerAgGroupR1PinionSteerAgSpd1Qf_0",   /*src_can*/"ZCUD_CANFD3",   /*src_network_type*/"CANFD",   /*src_slotid_fr*/0,   /*src_basecycle_fr*/0,  /*src_repetition_fr*/0,  /*src_startbit*/62,   /*sigG_length*/2,  /*des_slotid_fr*/0,   /*des_basecycle_fr*/0,  /*des_repetition_fr*/0,   /*des_startbit*/94,    /*src_cyc*/101,  /*src_id*/0x50,   /*src_dlc*/64,   /*des_id*/0x81, /*updatebit_S*/58,   /*updatebit_D*/90         },
           {   /*sigGroup_s*/"igPinionSteerAgGroupR1_0",   /*sig_name*/"isPinionSteerAgGroupR1Chks_0",   /*src_can*/"ZCUD_CANFD3",   /*src_network_type*/"CANFD",   /*src_slotid_fr*/0,   /*src_basecycle_fr*/0,  /*src_repetition_fr*/0,  /*src_startbit*/44,   /*sigG_length*/8,  /*des_slotid_fr*/0,   /*des_basecycle_fr*/0,  /*des_repetition_fr*/0,   /*des_startbit*/76,    /*src_cyc*/101,  /*src_id*/0x50,   /*src_dlc*/64,   /*des_id*/0x81, /*updatebit_S*/58,   /*updatebit_D*/90         },
           {   /*sigGroup_s*/"igPinionSteerAgGroupR1_0",   /*sig_name*/"isPinionSteerAgGroupR1Cntr_0",   /*src_can*/"ZCUD_CANFD3",   /*src_network_type*/"CANFD",   /*src_slotid_fr*/0,   /*src_basecycle_fr*/0,  /*src_repetition_fr*/0,  /*src_startbit*/52,   /*sigG_length*/4,  /*des_slotid_fr*/0,   /*des_basecycle_fr*/0,  /*des_repetition_fr*/0,   /*des_startbit*/84,    /*src_cyc*/101,  /*src_id*/0x50,   /*src_dlc*/64,   /*des_id*/0x81, /*updatebit_S*/58,   /*updatebit_D*/90         },
           {   /*sigGroup_s*/"igPinionSteerAgGroupR1_0",   /*sig_name*/"isPinionSteerAgGroupR1PinionSteerAgSpd1_0",   /*src_can*/"ZCUD_CANFD3",   /*src_network_type*/"CANFD",   /*src_slotid_fr*/0,   /*src_basecycle_fr*/0,  /*src_repetition_fr*/0,  /*src_startbit*/8,   /*sigG_length*/14,  /*des_slotid_fr*/0,   /*des_basecycle_fr*/0,  /*des_repetition_fr*/0,   /*des_startbit*/40,    /*src_cyc*/101,  /*src_id*/0x50,   /*src_dlc*/64,   /*des_id*/0x81, /*updatebit_S*/58,   /*updatebit_D*/90         },
           {   /*sigGroup_s*/"igPinionSteerAgGroupR1_0",   /*sig_name*/"isPinionSteerAgGroupR1SteerWhlTq_0",   /*src_can*/"ZCUD_CANFD3",   /*src_network_type*/"CANFD",   /*src_slotid_fr*/0,   /*src_basecycle_fr*/0,  /*src_repetition_fr*/0,  /*src_startbit*/26,   /*sigG_length*/14,  /*des_slotid_fr*/0,   /*des_basecycle_fr*/0,  /*des_repetition_fr*/0,   /*des_startbit*/58,    /*src_cyc*/101,  /*src_id*/0x50,   /*src_dlc*/64,   /*des_id*/0x81, /*updatebit_S*/58,   /*updatebit_D*/90         },
           {   /*sigGroup_s*/"igPinionSteerAgGroupR1_0",   /*sig_name*/"isPinionSteerAgGroupR1PinionSteerAg1_0",   /*src_can*/"ZCUD_CANFD3",   /*src_network_type*/"CANFD",   /*src_slotid_fr*/0,   /*src_basecycle_fr*/0,  /*src_repetition_fr*/0,  /*src_startbit*/7,   /*sigG_length*/15,  /*des_slotid_fr*/0,   /*des_basecycle_fr*/0,  /*des_repetition_fr*/0,   /*des_startbit*/39,    /*src_cyc*/101,  /*src_id*/0x50,   /*src_dlc*/64,   /*des_id*/0x81, /*updatebit_S*/58,   /*updatebit_D*/90         },
           {   /*sigGroup_s*/"igPinionSteerAgGroupR1_0",   /*sig_name*/"isPinionSteerAgGroupR1PinionSteerAg1Qf_0",   /*src_can*/"ZCUD_CANFD3",   /*src_network_type*/"CANFD",   /*src_slotid_fr*/0,   /*src_basecycle_fr*/0,  /*src_repetition_fr*/0,  /*src_startbit*/48,   /*sigG_length*/2,  /*des_slotid_fr*/0,   /*des_basecycle_fr*/0,  /*des_repetition_fr*/0,   /*des_startbit*/80,    /*src_cyc*/101,  /*src_id*/0x50,   /*src_dlc*/64,   /*des_id*/0x81, /*updatebit_S*/58,   /*updatebit_D*/90         },
           {   /*sigGroup_s*/"igPinionSteerAgGroupR1_0",   /*sig_name*/"isPinionSteerAgGroupR1SteerWhlTqQf_0",   /*src_can*/"ZCUD_CANFD3",   /*src_network_type*/"CANFD",   /*src_slotid_fr*/0,   /*src_basecycle_fr*/0,  /*src_repetition_fr*/0,  /*src_startbit*/60,   /*sigG_length*/2,  /*des_slotid_fr*/0,   /*des_basecycle_fr*/0,  /*des_repetition_fr*/0,   /*des_startbit*/92,    /*src_cyc*/101,  /*src_id*/0x50,   /*src_dlc*/64,   /*des_id*/0x81, /*updatebit_S*/58,   /*updatebit_D*/90         },
           {   /*sigGroup_s*/"igDrvrGearShiftDirReq1_0",   /*sig_name*/"isDrvrGearShiftDirReq1DwnTipAut_0",   /*src_can*/"PropulsionCAN",   /*src_network_type*/"CAN",   /*src_slotid_fr*/0,   /*src_basecycle_fr*/0,  /*src_repetition_fr*/0,  /*src_startbit*/13,   /*sigG_length*/1,  /*des_slotid_fr*/0,   /*des_basecycle_fr*/0,  /*des_repetition_fr*/0,   /*des_startbit*/204,    /*src_cyc*/101,  /*src_id*/0x136,   /*src_dlc*/8,   /*des_id*/0x61, /*updatebit_S*/1,   /*updatebit_D*/416         },
           {   /*sigGroup_s*/"igDrvrGearShiftDirReq1_0",   /*sig_name*/"isDrvrGearShiftDirReq1DwnDwnTipAut_0",   /*src_can*/"PropulsionCAN",   /*src_network_type*/"CAN",   /*src_slotid_fr*/0,   /*src_basecycle_fr*/0,  /*src_repetition_fr*/0,  /*src_startbit*/12,   /*sigG_length*/1,  /*des_slotid_fr*/0,   /*des_basecycle_fr*/0,  /*des_repetition_fr*/0,   /*des_startbit*/205,    /*src_cyc*/101,  /*src_id*/0x136,   /*src_dlc*/8,   /*des_id*/0x61, /*updatebit_S*/1,   /*updatebit_D*/416         },
           {   /*sigGroup_s*/"igDrvrGearShiftDirReq1_0",   /*sig_name*/"isDrvrGearShiftDirReq1UpUpTipAut_0",   /*src_can*/"PropulsionCAN",   /*src_network_type*/"CAN",   /*src_slotid_fr*/0,   /*src_basecycle_fr*/0,  /*src_repetition_fr*/0,  /*src_startbit*/0,   /*sigG_length*/1,  /*des_slotid_fr*/0,   /*des_basecycle_fr*/0,  /*des_repetition_fr*/0,   /*des_startbit*/201,    /*src_cyc*/101,  /*src_id*/0x136,   /*src_dlc*/8,   /*des_id*/0x61, /*updatebit_S*/1,   /*updatebit_D*/416         },
           {   /*sigGroup_s*/"igDrvrGearShiftDirReq1_0",   /*sig_name*/"isDrvrGearShiftDirReq1Chks_0",   /*src_can*/"PropulsionCAN",   /*src_network_type*/"CAN",   /*src_slotid_fr*/0,   /*src_basecycle_fr*/0,  /*src_repetition_fr*/0,  /*src_startbit*/23,   /*sigG_length*/8,  /*des_slotid_fr*/0,   /*des_basecycle_fr*/0,  /*des_repetition_fr*/0,   /*des_startbit*/185,    /*src_cyc*/101,  /*src_id*/0x136,   /*src_dlc*/8,   /*des_id*/0x61, /*updatebit_S*/1,   /*updatebit_D*/416         },
           {   /*sigGroup_s*/"igDrvrGearShiftDirReq1_0",   /*sig_name*/"isDrvrGearShiftDirReq1Cntr_0",   /*src_can*/"PropulsionCAN",   /*src_network_type*/"CAN",   /*src_slotid_fr*/0,   /*src_basecycle_fr*/0,  /*src_repetition_fr*/0,  /*src_startbit*/11,   /*sigG_length*/4,  /*des_slotid_fr*/0,   /*des_basecycle_fr*/0,  /*des_repetition_fr*/0,   /*des_startbit*/193,    /*src_cyc*/101,  /*src_id*/0x136,   /*src_dlc*/8,   /*des_id*/0x61, /*updatebit_S*/1,   /*updatebit_D*/416         },
           {   /*sigGroup_s*/"igDrvrGearShiftDirReq1_0",   /*sig_name*/"isDrvrGearShiftDirReq1UpTipAut_0",   /*src_can*/"PropulsionCAN",   /*src_network_type*/"CAN",   /*src_slotid_fr*/0,   /*src_basecycle_fr*/0,  /*src_repetition_fr*/0,  /*src_startbit*/15,   /*sigG_length*/1,  /*des_slotid_fr*/0,   /*des_basecycle_fr*/0,  /*des_repetition_fr*/0,   /*des_startbit*/202,    /*src_cyc*/101,  /*src_id*/0x136,   /*src_dlc*/8,   /*des_id*/0x61, /*updatebit_S*/1,   /*updatebit_D*/416         },
           {   /*sigGroup_s*/"igDrvrGearShiftDirReq1_0",   /*sig_name*/"isDrvrGearShiftDirReq1PosnAut_0",   /*src_can*/"PropulsionCAN",   /*src_network_type*/"CAN",   /*src_slotid_fr*/0,   /*src_basecycle_fr*/0,  /*src_repetition_fr*/0,  /*src_startbit*/14,   /*sigG_length*/1,  /*des_slotid_fr*/0,   /*des_basecycle_fr*/0,  /*des_repetition_fr*/0,   /*des_startbit*/203,    /*src_cyc*/101,  /*src_id*/0x136,   /*src_dlc*/8,   /*des_id*/0x61, /*updatebit_S*/1,   /*updatebit_D*/416         },
           {   /*sigGroup_s*/"igBltLockStAtDrvr_0",   /*sig_name*/"isBltLockStAtDrvrBltLockSt1_0",   /*src_can*/"ZCUD_CAN1",   /*src_network_type*/"CAN",   /*src_slotid_fr*/0,   /*src_basecycle_fr*/0,  /*src_repetition_fr*/0,  /*src_startbit*/57,   /*sigG_length*/1,  /*des_slotid_fr*/0,   /*des_basecycle_fr*/0,  /*des_repetition_fr*/0,   /*des_startbit*/34,    /*src_cyc*/101,  /*src_id*/0x89,   /*src_dlc*/8,   /*des_id*/0x106, /*updatebit_S*/7,   /*updatebit_D*/107         },
           {   /*sigGroup_s*/"igBltLockStAtDrvr_0",   /*sig_name*/"isBltLockStAtDrvrBltLockSts_0",   /*src_can*/"ZCUD_CAN1",   /*src_network_type*/"CAN",   /*src_slotid_fr*/0,   /*src_basecycle_fr*/0,  /*src_repetition_fr*/0,  /*src_startbit*/56,   /*sigG_length*/1,  /*des_slotid_fr*/0,   /*des_basecycle_fr*/0,  /*des_repetition_fr*/0,   /*des_startbit*/33,    /*src_cyc*/101,  /*src_id*/0x89,   /*src_dlc*/8,   /*des_id*/0x106, /*updatebit_S*/7,   /*updatebit_D*/107         },
           {   /*sigGroup_s*/"igTurnIndcrMonostable_0",   /*sig_name*/"isTurnIndcrMonostableChks_0",   /*src_can*/"ChassisCAN1",   /*src_network_type*/"CAN",   /*src_slotid_fr*/0,   /*src_basecycle_fr*/0,  /*src_repetition_fr*/0,  /*src_startbit*/23,   /*sigG_length*/8,  /*des_slotid_fr*/0,   /*des_basecycle_fr*/0,  /*des_repetition_fr*/0,   /*des_startbit*/207,    /*src_cyc*/101,  /*src_id*/0x2e6,   /*src_dlc*/8,   /*des_id*/0x1f1, /*updatebit_S*/24,   /*updatebit_D*/208         },
           {   /*sigGroup_s*/"igTurnIndcrMonostable_0",   /*sig_name*/"isTurnIndcrMonostableCntr_0",   /*src_can*/"ChassisCAN1",   /*src_network_type*/"CAN",   /*src_slotid_fr*/0,   /*src_basecycle_fr*/0,  /*src_repetition_fr*/0,  /*src_startbit*/31,   /*sigG_length*/2,  /*des_slotid_fr*/0,   /*des_basecycle_fr*/0,  /*des_repetition_fr*/0,   /*des_startbit*/215,    /*src_cyc*/101,  /*src_id*/0x2e6,   /*src_dlc*/8,   /*des_id*/0x1f1, /*updatebit_S*/24,   /*updatebit_D*/208         },
           {   /*sigGroup_s*/"igTurnIndcrMonostable_0",   /*sig_name*/"isTurnIndcrMonostableTurnIndcrMonostable_0",   /*src_can*/"ChassisCAN1",   /*src_network_type*/"CAN",   /*src_slotid_fr*/0,   /*src_basecycle_fr*/0,  /*src_repetition_fr*/0,  /*src_startbit*/27,   /*sigG_length*/3,  /*des_slotid_fr*/0,   /*des_basecycle_fr*/0,  /*des_repetition_fr*/0,   /*des_startbit*/211,    /*src_cyc*/101,  /*src_id*/0x2e6,   /*src_dlc*/8,   /*des_id*/0x1f1, /*updatebit_S*/24,   /*updatebit_D*/208         },
           {   /*sigGroup_s*/"igTurnIndcrMonostable_0",   /*sig_name*/"isTurnIndcrMonostableQf_0",   /*src_can*/"ChassisCAN1",   /*src_network_type*/"CAN",   /*src_slotid_fr*/0,   /*src_basecycle_fr*/0,  /*src_repetition_fr*/0,  /*src_startbit*/29,   /*sigG_length*/2,  /*des_slotid_fr*/0,   /*des_basecycle_fr*/0,  /*des_repetition_fr*/0,   /*des_startbit*/213,    /*src_cyc*/101,  /*src_id*/0x2e6,   /*src_dlc*/8,   /*des_id*/0x1f1, /*updatebit_S*/24,   /*updatebit_D*/208         },
           {   /*sigGroup_s*/"igBltLockStSafeAtDrvr_0",   /*sig_name*/"isBltLockStSafeAtDrvrBltLockStErrSts_0",   /*src_can*/"ZCUD_CAN1",   /*src_network_type*/"CAN",   /*src_slotid_fr*/0,   /*src_basecycle_fr*/0,  /*src_repetition_fr*/0,  /*src_startbit*/12,   /*sigG_length*/1,  /*des_slotid_fr*/0,   /*des_basecycle_fr*/0,  /*des_repetition_fr*/0,   /*des_startbit*/50,    /*src_cyc*/101,  /*src_id*/0x21,   /*src_dlc*/8,   /*des_id*/0x106, /*updatebit_S*/14,   /*updatebit_D*/108         },
           {   /*sigGroup_s*/"igBltLockStSafeAtDrvr_0",   /*sig_name*/"isBltLockStSafeAtDrvrCntr_0",   /*src_can*/"ZCUD_CAN1",   /*src_network_type*/"CAN",   /*src_slotid_fr*/0,   /*src_basecycle_fr*/0,  /*src_repetition_fr*/0,  /*src_startbit*/11,   /*sigG_length*/4,  /*des_slotid_fr*/0,   /*des_basecycle_fr*/0,  /*des_repetition_fr*/0,   /*des_startbit*/55,    /*src_cyc*/101,  /*src_id*/0x21,   /*src_dlc*/8,   /*des_id*/0x106, /*updatebit_S*/14,   /*updatebit_D*/108         },
           {   /*sigGroup_s*/"igBltLockStSafeAtDrvr_0",   /*sig_name*/"isBltLockStSafeAtDrvrChks_0",   /*src_can*/"ZCUD_CAN1",   /*src_network_type*/"CAN",   /*src_slotid_fr*/0,   /*src_basecycle_fr*/0,  /*src_repetition_fr*/0,  /*src_startbit*/23,   /*sigG_length*/8,  /*des_slotid_fr*/0,   /*des_basecycle_fr*/0,  /*des_repetition_fr*/0,   /*des_startbit*/47,    /*src_cyc*/101,  /*src_id*/0x21,   /*src_dlc*/8,   /*des_id*/0x106, /*updatebit_S*/14,   /*updatebit_D*/108         },
           {   /*sigGroup_s*/"igBltLockStSafeAtDrvr_0",   /*sig_name*/"isBltLockStSafeAtDrvrBltLockSt1_0",   /*src_can*/"ZCUD_CAN1",   /*src_network_type*/"CAN",   /*src_slotid_fr*/0,   /*src_basecycle_fr*/0,  /*src_repetition_fr*/0,  /*src_startbit*/13,   /*sigG_length*/1,  /*des_slotid_fr*/0,   /*des_basecycle_fr*/0,  /*des_repetition_fr*/0,   /*des_startbit*/51,    /*src_cyc*/101,  /*src_id*/0x21,   /*src_dlc*/8,   /*des_id*/0x106, /*updatebit_S*/14,   /*updatebit_D*/108         },
           {   /*sigGroup_s*/"igPtBrkTq_0",   /*sig_name*/"isPtBrkTqQf_0",   /*src_can*/"ChassisCANFD2",   /*src_network_type*/"CANFD",   /*src_slotid_fr*/0,   /*src_basecycle_fr*/0,  /*src_repetition_fr*/0,  /*src_startbit*/348,   /*sigG_length*/2,  /*des_slotid_fr*/0,   /*des_basecycle_fr*/0,  /*des_repetition_fr*/0,   /*des_startbit*/345,    /*src_cyc*/101,  /*src_id*/0x7c,   /*src_dlc*/64,   /*des_id*/0x61, /*updatebit_S*/346,   /*updatebit_D*/472         },
           {   /*sigGroup_s*/"igPtBrkTq_0",   /*sig_name*/"isPtBrkTqRgnAtAxleReAct_0",   /*src_can*/"ChassisCANFD2",   /*src_network_type*/"CANFD",   /*src_slotid_fr*/0,   /*src_basecycle_fr*/0,  /*src_repetition_fr*/0,  /*src_startbit*/313,   /*sigG_length*/15,  /*des_slotid_fr*/0,   /*des_basecycle_fr*/0,  /*des_repetition_fr*/0,   /*des_startbit*/391,    /*src_cyc*/101,  /*src_id*/0x7c,   /*src_dlc*/64,   /*des_id*/0x61, /*updatebit_S*/346,   /*updatebit_D*/472         },
           {   /*sigGroup_s*/"igPtBrkTq_0",   /*sig_name*/"isPtBrkTqActTot_0",   /*src_can*/"ChassisCANFD2",   /*src_network_type*/"CANFD",   /*src_slotid_fr*/0,   /*src_basecycle_fr*/0,  /*src_repetition_fr*/0,  /*src_startbit*/295,   /*sigG_length*/15,  /*des_slotid_fr*/0,   /*des_basecycle_fr*/0,  /*des_repetition_fr*/0,   /*des_startbit*/359,    /*src_cyc*/101,  /*src_id*/0x7c,   /*src_dlc*/64,   /*des_id*/0x61, /*updatebit_S*/346,   /*updatebit_D*/472         },
           {   /*sigGroup_s*/"igPtBrkTq_0",   /*sig_name*/"isPtBrkTqActTotQf_0",   /*src_can*/"ChassisCANFD2",   /*src_network_type*/"CANFD",   /*src_slotid_fr*/0,   /*src_basecycle_fr*/0,  /*src_repetition_fr*/0,  /*src_startbit*/350,   /*sigG_length*/2,  /*des_slotid_fr*/0,   /*des_basecycle_fr*/0,  /*des_repetition_fr*/0,   /*des_startbit*/351,    /*src_cyc*/101,  /*src_id*/0x7c,   /*src_dlc*/64,   /*des_id*/0x61, /*updatebit_S*/346,   /*updatebit_D*/472         },
           {   /*sigGroup_s*/"igPtBrkTq_0",   /*sig_name*/"isPtBrkTqChks_0",   /*src_can*/"ChassisCANFD2",   /*src_network_type*/"CANFD",   /*src_slotid_fr*/0,   /*src_basecycle_fr*/0,  /*src_repetition_fr*/0,  /*src_startbit*/330,   /*sigG_length*/8,  /*des_slotid_fr*/0,   /*des_basecycle_fr*/0,  /*des_repetition_fr*/0,   /*des_startbit*/343,    /*src_cyc*/101,  /*src_id*/0x7c,   /*src_dlc*/64,   /*des_id*/0x61, /*updatebit_S*/346,   /*updatebit_D*/472         },
           {   /*sigGroup_s*/"igPtBrkTq_0",   /*sig_name*/"isPtBrkTqCntr_0",   /*src_can*/"ChassisCANFD2",   /*src_network_type*/"CANFD",   /*src_slotid_fr*/0,   /*src_basecycle_fr*/0,  /*src_repetition_fr*/0,  /*src_startbit*/338,   /*sigG_length*/4,  /*des_slotid_fr*/0,   /*des_basecycle_fr*/0,  /*des_repetition_fr*/0,   /*des_startbit*/349,    /*src_cyc*/101,  /*src_id*/0x7c,   /*src_dlc*/64,   /*des_id*/0x61, /*updatebit_S*/346,   /*updatebit_D*/472         },
           {   /*sigGroup_s*/"igPtBrkTq_0",   /*sig_name*/"isPtBrkTqReqForBrkSys_0",   /*src_can*/"ChassisCANFD2",   /*src_network_type*/"CANFD",   /*src_slotid_fr*/0,   /*src_basecycle_fr*/0,  /*src_repetition_fr*/0,  /*src_startbit*/296,   /*sigG_length*/15,  /*des_slotid_fr*/0,   /*des_basecycle_fr*/0,  /*des_repetition_fr*/0,   /*des_startbit*/375,    /*src_cyc*/101,  /*src_id*/0x7c,   /*src_dlc*/64,   /*des_id*/0x61, /*updatebit_S*/346,   /*updatebit_D*/472         },
           {   /*sigGroup_s*/"igRWATarPinionAgR2_0",   /*sig_name*/"isRWATarPinionAgR2RefPinionAg_0",   /*src_can*/"ChassisCAN1",   /*src_network_type*/"CAN",   /*src_slotid_fr*/0,   /*src_basecycle_fr*/0,  /*src_repetition_fr*/0,  /*src_startbit*/39,   /*sigG_length*/15,  /*des_slotid_fr*/0,   /*des_basecycle_fr*/0,  /*des_repetition_fr*/0,   /*des_startbit*/327,    /*src_cyc*/101,  /*src_id*/0x13b,   /*src_dlc*/8,   /*des_id*/0x106, /*updatebit_S*/40,   /*updatebit_D*/419         },
           {   /*sigGroup_s*/"igRWATarPinionAgR2_0",   /*sig_name*/"isRWATarPinionAgR2Qf_0",   /*src_can*/"ChassisCAN1",   /*src_network_type*/"CAN",   /*src_slotid_fr*/0,   /*src_basecycle_fr*/0,  /*src_repetition_fr*/0,  /*src_startbit*/25,   /*sigG_length*/2,  /*des_slotid_fr*/0,   /*des_basecycle_fr*/0,  /*des_repetition_fr*/0,   /*des_startbit*/313,    /*src_cyc*/101,  /*src_id*/0x13b,   /*src_dlc*/8,   /*des_id*/0x106, /*updatebit_S*/40,   /*updatebit_D*/419         },
           {   /*sigGroup_s*/"igAbsCtrlActv_0",   /*sig_name*/"isAbsCtrlActvCtrlSts1_0",   /*src_can*/"ChassisCAN1",   /*src_network_type*/"CAN",   /*src_slotid_fr*/0,   /*src_basecycle_fr*/0,  /*src_repetition_fr*/0,  /*src_startbit*/43,   /*sigG_length*/1,  /*des_slotid_fr*/0,   /*des_basecycle_fr*/0,  /*des_repetition_fr*/0,   /*des_startbit*/395,    /*src_cyc*/101,  /*src_id*/0xb9,   /*src_dlc*/8,   /*des_id*/0x106, /*updatebit_S*/24,   /*updatebit_D*/394         },
           {   /*sigGroup_s*/"igAbsCtrlActv_0",   /*sig_name*/"isAbsCtrlActvChks_0",   /*src_can*/"ChassisCAN1",   /*src_network_type*/"CAN",   /*src_slotid_fr*/0,   /*src_basecycle_fr*/0,  /*src_repetition_fr*/0,  /*src_startbit*/39,   /*sigG_length*/8,  /*des_slotid_fr*/0,   /*des_basecycle_fr*/0,  /*des_repetition_fr*/0,   /*des_startbit*/391,    /*src_cyc*/101,  /*src_id*/0xb9,   /*src_dlc*/8,   /*des_id*/0x106, /*updatebit_S*/24,   /*updatebit_D*/394         },
           {   /*sigGroup_s*/"igAbsCtrlActv_0",   /*sig_name*/"isAbsCtrlActvCntr_0",   /*src_can*/"ChassisCAN1",   /*src_network_type*/"CAN",   /*src_slotid_fr*/0,   /*src_basecycle_fr*/0,  /*src_repetition_fr*/0,  /*src_startbit*/47,   /*sigG_length*/4,  /*des_slotid_fr*/0,   /*des_basecycle_fr*/0,  /*des_repetition_fr*/0,   /*des_startbit*/399,    /*src_cyc*/101,  /*src_id*/0xb9,   /*src_dlc*/8,   /*des_id*/0x106, /*updatebit_S*/24,   /*updatebit_D*/394         },
           {   /*sigGroup_s*/"igBltLockStAtRowSecLe_0",   /*sig_name*/"isBltLockStAtRowSecLeBltLockEquid_0",   /*src_can*/"ZCUD_CAN1",   /*src_network_type*/"CAN",   /*src_slotid_fr*/0,   /*src_basecycle_fr*/0,  /*src_repetition_fr*/0,  /*src_startbit*/7,   /*sigG_length*/1,  /*des_slotid_fr*/0,   /*des_basecycle_fr*/0,  /*des_repetition_fr*/0,   /*des_startbit*/7,    /*src_cyc*/101,  /*src_id*/0x70,   /*src_dlc*/8,   /*des_id*/0x353, /*updatebit_S*/4,   /*updatebit_D*/2         },
           {   /*sigGroup_s*/"igBltLockStAtRowSecLe_0",   /*sig_name*/"isBltLockStAtRowSecLeBltLockSts_0",   /*src_can*/"ZCUD_CAN1",   /*src_network_type*/"CAN",   /*src_slotid_fr*/0,   /*src_basecycle_fr*/0,  /*src_repetition_fr*/0,  /*src_startbit*/5,   /*sigG_length*/1,  /*des_slotid_fr*/0,   /*des_basecycle_fr*/0,  /*des_repetition_fr*/0,   /*des_startbit*/5,    /*src_cyc*/101,  /*src_id*/0x70,   /*src_dlc*/8,   /*des_id*/0x353, /*updatebit_S*/4,   /*updatebit_D*/2         },
           {   /*sigGroup_s*/"igBltLockStAtRowSecLe_0",   /*sig_name*/"isBltLockStAtRowSecLeBltLockSt1_0",   /*src_can*/"ZCUD_CAN1",   /*src_network_type*/"CAN",   /*src_slotid_fr*/0,   /*src_basecycle_fr*/0,  /*src_repetition_fr*/0,  /*src_startbit*/6,   /*sigG_length*/1,  /*des_slotid_fr*/0,   /*des_basecycle_fr*/0,  /*des_repetition_fr*/0,   /*des_startbit*/6,    /*src_cyc*/101,  /*src_id*/0x70,   /*src_dlc*/8,   /*des_id*/0x353, /*updatebit_S*/4,   /*updatebit_D*/2         },
           {   /*sigGroup_s*/"igDrvrGearShiftDirReq2_0",   /*sig_name*/"isDrvrGearShiftDirReq2Cntr_0",   /*src_can*/"PropulsionCAN",   /*src_network_type*/"CAN",   /*src_slotid_fr*/0,   /*src_basecycle_fr*/0,  /*src_repetition_fr*/0,  /*src_startbit*/35,   /*sigG_length*/4,  /*des_slotid_fr*/0,   /*des_basecycle_fr*/0,  /*des_repetition_fr*/0,   /*des_startbit*/208,    /*src_cyc*/101,  /*src_id*/0x136,   /*src_dlc*/8,   /*des_id*/0x61, /*updatebit_S*/25,   /*updatebit_D*/417         },
           {   /*sigGroup_s*/"igDrvrGearShiftDirReq2_0",   /*sig_name*/"isDrvrGearShiftDirReq2Chks_0",   /*src_can*/"PropulsionCAN",   /*src_network_type*/"CAN",   /*src_slotid_fr*/0,   /*src_basecycle_fr*/0,  /*src_repetition_fr*/0,  /*src_startbit*/47,   /*sigG_length*/8,  /*des_slotid_fr*/0,   /*des_basecycle_fr*/0,  /*des_repetition_fr*/0,   /*des_startbit*/200,    /*src_cyc*/101,  /*src_id*/0x136,   /*src_dlc*/8,   /*des_id*/0x61, /*updatebit_S*/25,   /*updatebit_D*/417         },
           {   /*sigGroup_s*/"igDrvrGearShiftDirReq2_0",   /*sig_name*/"isDrvrGearShiftDirReq2UpTipAut_0",   /*src_can*/"PropulsionCAN",   /*src_network_type*/"CAN",   /*src_slotid_fr*/0,   /*src_basecycle_fr*/0,  /*src_repetition_fr*/0,  /*src_startbit*/39,   /*sigG_length*/1,  /*des_slotid_fr*/0,   /*des_basecycle_fr*/0,  /*des_repetition_fr*/0,   /*des_startbit*/217,    /*src_cyc*/101,  /*src_id*/0x136,   /*src_dlc*/8,   /*des_id*/0x61, /*updatebit_S*/25,   /*updatebit_D*/417         },
           {   /*sigGroup_s*/"igDrvrGearShiftDirReq2_0",   /*sig_name*/"isDrvrGearShiftDirReq2PosnAut_0",   /*src_can*/"PropulsionCAN",   /*src_network_type*/"CAN",   /*src_slotid_fr*/0,   /*src_basecycle_fr*/0,  /*src_repetition_fr*/0,  /*src_startbit*/38,   /*sigG_length*/1,  /*des_slotid_fr*/0,   /*des_basecycle_fr*/0,  /*des_repetition_fr*/0,   /*des_startbit*/218,    /*src_cyc*/101,  /*src_id*/0x136,   /*src_dlc*/8,   /*des_id*/0x61, /*updatebit_S*/25,   /*updatebit_D*/417         },
           {   /*sigGroup_s*/"igDrvrGearShiftDirReq2_0",   /*sig_name*/"isDrvrGearShiftDirReq2DwnDwnTipAut_0",   /*src_can*/"PropulsionCAN",   /*src_network_type*/"CAN",   /*src_slotid_fr*/0,   /*src_basecycle_fr*/0,  /*src_repetition_fr*/0,  /*src_startbit*/36,   /*sigG_length*/1,  /*des_slotid_fr*/0,   /*des_basecycle_fr*/0,  /*des_repetition_fr*/0,   /*des_startbit*/220,    /*src_cyc*/101,  /*src_id*/0x136,   /*src_dlc*/8,   /*des_id*/0x61, /*updatebit_S*/25,   /*updatebit_D*/417         },
           {   /*sigGroup_s*/"igDrvrGearShiftDirReq2_0",   /*sig_name*/"isDrvrGearShiftDirReq2UpUpTipAut_0",   /*src_can*/"PropulsionCAN",   /*src_network_type*/"CAN",   /*src_slotid_fr*/0,   /*src_basecycle_fr*/0,  /*src_repetition_fr*/0,  /*src_startbit*/24,   /*sigG_length*/1,  /*des_slotid_fr*/0,   /*des_basecycle_fr*/0,  /*des_repetition_fr*/0,   /*des_startbit*/216,    /*src_cyc*/101,  /*src_id*/0x136,   /*src_dlc*/8,   /*des_id*/0x61, /*updatebit_S*/25,   /*updatebit_D*/417         },
           {   /*sigGroup_s*/"igDrvrGearShiftDirReq2_0",   /*sig_name*/"isDrvrGearShiftDirReq2DwnTipAut_0",   /*src_can*/"PropulsionCAN",   /*src_network_type*/"CAN",   /*src_slotid_fr*/0,   /*src_basecycle_fr*/0,  /*src_repetition_fr*/0,  /*src_startbit*/37,   /*sigG_length*/1,  /*des_slotid_fr*/0,   /*des_basecycle_fr*/0,  /*des_repetition_fr*/0,   /*des_startbit*/219,    /*src_cyc*/101,  /*src_id*/0x136,   /*src_dlc*/8,   /*des_id*/0x61, /*updatebit_S*/25,   /*updatebit_D*/417         },
           {   /*sigGroup_s*/"igHvBattT_0",   /*sig_name*/"isHvBattTMax_0",   /*src_can*/"PropulsionCAN",   /*src_network_type*/"CAN",   /*src_slotid_fr*/0,   /*src_basecycle_fr*/0,  /*src_repetition_fr*/0,  /*src_startbit*/10,   /*sigG_length*/13,  /*des_slotid_fr*/0,   /*des_basecycle_fr*/0,  /*des_repetition_fr*/0,   /*des_startbit*/162,    /*src_cyc*/101,  /*src_id*/0x187,   /*src_dlc*/8,   /*des_id*/0x221, /*updatebit_S*/32,   /*updatebit_D*/184         },
           {   /*sigGroup_s*/"igHvBattT_0",   /*sig_name*/"isHvBattTAvg_0",   /*src_can*/"PropulsionCAN",   /*src_network_type*/"CAN",   /*src_slotid_fr*/0,   /*src_basecycle_fr*/0,  /*src_repetition_fr*/0,  /*src_startbit*/7,   /*sigG_length*/13,  /*des_slotid_fr*/0,   /*des_basecycle_fr*/0,  /*des_repetition_fr*/0,   /*des_startbit*/159,    /*src_cyc*/101,  /*src_id*/0x187,   /*src_dlc*/8,   /*des_id*/0x221, /*updatebit_S*/32,   /*updatebit_D*/184         },
           {   /*sigGroup_s*/"igHvBattT_0",   /*sig_name*/"isHvBattTMin_0",   /*src_can*/"PropulsionCAN",   /*src_network_type*/"CAN",   /*src_slotid_fr*/0,   /*src_basecycle_fr*/0,  /*src_repetition_fr*/0,  /*src_startbit*/29,   /*sigG_length*/13,  /*des_slotid_fr*/0,   /*des_basecycle_fr*/0,  /*des_repetition_fr*/0,   /*des_startbit*/181,    /*src_cyc*/101,  /*src_id*/0x187,   /*src_dlc*/8,   /*des_id*/0x221, /*updatebit_S*/32,   /*updatebit_D*/184         },
           {   /*sigGroup_s*/"igAMBSts_0",   /*sig_name*/"isAMBStsQF_0",   /*src_can*/"CEM_LIN1",   /*src_network_type*/"LIN",   /*src_slotid_fr*/0,   /*src_basecycle_fr*/0,  /*src_repetition_fr*/0,  /*src_startbit*/56,   /*sigG_length*/2,  /*des_slotid_fr*/0,   /*des_basecycle_fr*/0,  /*des_repetition_fr*/0,   /*des_startbit*/127,    /*src_cyc*/101,  /*src_id*/2,   /*src_dlc*/8,   /*des_id*/0x221, /*updatebit_S*/1000,   /*updatebit_D*/5         },
           {   /*sigGroup_s*/"igAMBSts_0",   /*sig_name*/"isAMBStsFWLiIllmn_0",   /*src_can*/"CEM_LIN1",   /*src_network_type*/"LIN",   /*src_slotid_fr*/0,   /*src_basecycle_fr*/0,  /*src_repetition_fr*/0,  /*src_startbit*/44,   /*sigG_length*/12,  /*des_slotid_fr*/0,   /*des_basecycle_fr*/0,  /*des_repetition_fr*/0,   /*des_startbit*/107,    /*src_cyc*/101,  /*src_id*/2,   /*src_dlc*/8,   /*des_id*/0x221, /*updatebit_S*/1000,   /*updatebit_D*/5         },
           {   /*sigGroup_s*/"igAMBSts_0",   /*sig_name*/"isAMBStsAMBLiIllmn_0",   /*src_can*/"CEM_LIN1",   /*src_network_type*/"LIN",   /*src_slotid_fr*/0,   /*src_basecycle_fr*/0,  /*src_repetition_fr*/0,  /*src_startbit*/32,   /*sigG_length*/12,  /*des_slotid_fr*/0,   /*des_basecycle_fr*/0,  /*des_repetition_fr*/0,   /*des_startbit*/103,    /*src_cyc*/101,  /*src_id*/2,   /*src_dlc*/8,   /*des_id*/0x221, /*updatebit_S*/1000,   /*updatebit_D*/5         },
           {   /*sigGroup_s*/"igBltLockStAtPass_0",   /*sig_name*/"isBltLockStAtPassBltLockSt1_0",   /*src_can*/"ZCUD_CAN1",   /*src_network_type*/"CAN",   /*src_slotid_fr*/0,   /*src_basecycle_fr*/0,  /*src_repetition_fr*/0,  /*src_startbit*/63,   /*sigG_length*/1,  /*des_slotid_fr*/0,   /*des_basecycle_fr*/0,  /*des_repetition_fr*/0,   /*des_startbit*/4,    /*src_cyc*/101,  /*src_id*/0x89,   /*src_dlc*/8,   /*des_id*/0x221, /*updatebit_S*/6,   /*updatebit_D*/2         },
           {   /*sigGroup_s*/"igBltLockStAtPass_0",   /*sig_name*/"isBltLockStAtPassBltLockSts_0",   /*src_can*/"ZCUD_CAN1",   /*src_network_type*/"CAN",   /*src_slotid_fr*/0,   /*src_basecycle_fr*/0,  /*src_repetition_fr*/0,  /*src_startbit*/62,   /*sigG_length*/1,  /*des_slotid_fr*/0,   /*des_basecycle_fr*/0,  /*des_repetition_fr*/0,   /*des_startbit*/3,    /*src_cyc*/101,  /*src_id*/0x89,   /*src_dlc*/8,   /*des_id*/0x221, /*updatebit_S*/6,   /*updatebit_D*/2         },
           {   /*sigGroup_s*/"igPinionSteerAgGroup_0",   /*sig_name*/"isPinionSteerAgGroupPinionSteerAg1Qf_0",   /*src_can*/"ChassisCAN1",   /*src_network_type*/"CAN",   /*src_slotid_fr*/0,   /*src_basecycle_fr*/0,  /*src_repetition_fr*/0,  /*src_startbit*/15,   /*sigG_length*/2,  /*des_slotid_fr*/0,   /*des_basecycle_fr*/0,  /*des_repetition_fr*/0,   /*des_startbit*/333,    /*src_cyc*/101,  /*src_id*/0x4e,   /*src_dlc*/8,   /*des_id*/0x61, /*updatebit_S*/57,   /*updatebit_D*/448         },
           {   /*sigGroup_s*/"igPinionSteerAgGroup_0",   /*sig_name*/"isPinionSteerAgGroupCntr_0",   /*src_can*/"ChassisCAN1",   /*src_network_type*/"CAN",   /*src_slotid_fr*/0,   /*src_basecycle_fr*/0,  /*src_repetition_fr*/0,  /*src_startbit*/63,   /*sigG_length*/4,  /*des_slotid_fr*/0,   /*des_basecycle_fr*/0,  /*des_repetition_fr*/0,   /*des_startbit*/321,    /*src_cyc*/101,  /*src_id*/0x4e,   /*src_dlc*/8,   /*des_id*/0x61, /*updatebit_S*/57,   /*updatebit_D*/448         },
           {   /*sigGroup_s*/"igPinionSteerAgGroup_0",   /*sig_name*/"isPinionSteerAgGroupSteerWhlTq_0",   /*src_can*/"ChassisCAN1",   /*src_network_type*/"CAN",   /*src_slotid_fr*/0,   /*src_basecycle_fr*/0,  /*src_repetition_fr*/0,  /*src_startbit*/29,   /*sigG_length*/14,  /*des_slotid_fr*/0,   /*des_basecycle_fr*/0,  /*des_repetition_fr*/0,   /*des_startbit*/311,    /*src_cyc*/101,  /*src_id*/0x4e,   /*src_dlc*/8,   /*des_id*/0x61, /*updatebit_S*/57,   /*updatebit_D*/448         },
           {   /*sigGroup_s*/"igPinionSteerAgGroup_0",   /*sig_name*/"isPinionSteerAgGroupPinionSteerAg1_0",   /*src_can*/"ChassisCAN1",   /*src_network_type*/"CAN",   /*src_slotid_fr*/0,   /*src_basecycle_fr*/0,  /*src_repetition_fr*/0,  /*src_startbit*/46,   /*sigG_length*/15,  /*des_slotid_fr*/0,   /*des_basecycle_fr*/0,  /*des_repetition_fr*/0,   /*des_startbit*/276,    /*src_cyc*/101,  /*src_id*/0x4e,   /*src_dlc*/8,   /*des_id*/0x61, /*updatebit_S*/57,   /*updatebit_D*/448         },
           {   /*sigGroup_s*/"igPinionSteerAgGroup_0",   /*sig_name*/"isPinionSteerAgGroupPinionSteerAgSpd1_0",   /*src_can*/"ChassisCAN1",   /*src_network_type*/"CAN",   /*src_slotid_fr*/0,   /*src_basecycle_fr*/0,  /*src_repetition_fr*/0,  /*src_startbit*/13,   /*sigG_length*/14,  /*des_slotid_fr*/0,   /*des_basecycle_fr*/0,  /*des_repetition_fr*/0,   /*des_startbit*/293,    /*src_cyc*/101,  /*src_id*/0x4e,   /*src_dlc*/8,   /*des_id*/0x61, /*updatebit_S*/57,   /*updatebit_D*/448         },
           {   /*sigGroup_s*/"igPinionSteerAgGroup_0",   /*sig_name*/"isPinionSteerAgGroupSteerWhlTqQf_0",   /*src_can*/"ChassisCAN1",   /*src_network_type*/"CAN",   /*src_slotid_fr*/0,   /*src_basecycle_fr*/0,  /*src_repetition_fr*/0,  /*src_startbit*/59,   /*sigG_length*/2,  /*des_slotid_fr*/0,   /*des_basecycle_fr*/0,  /*des_repetition_fr*/0,   /*des_startbit*/329,    /*src_cyc*/101,  /*src_id*/0x4e,   /*src_dlc*/8,   /*des_id*/0x61, /*updatebit_S*/57,   /*updatebit_D*/448         },
           {   /*sigGroup_s*/"igPinionSteerAgGroup_0",   /*sig_name*/"isPinionSteerAgGroupPinionSteerAgSpd1Qf_0",   /*src_can*/"ChassisCAN1",   /*src_network_type*/"CAN",   /*src_slotid_fr*/0,   /*src_basecycle_fr*/0,  /*src_repetition_fr*/0,  /*src_startbit*/31,   /*sigG_length*/2,  /*des_slotid_fr*/0,   /*des_basecycle_fr*/0,  /*des_repetition_fr*/0,   /*des_startbit*/331,    /*src_cyc*/101,  /*src_id*/0x4e,   /*src_dlc*/8,   /*des_id*/0x61, /*updatebit_S*/57,   /*updatebit_D*/448         },
           {   /*sigGroup_s*/"igPinionSteerAgGroup_0",   /*sig_name*/"isPinionSteerAgGroupChks_0",   /*src_can*/"ChassisCAN1",   /*src_network_type*/"CAN",   /*src_slotid_fr*/0,   /*src_basecycle_fr*/0,  /*src_repetition_fr*/0,  /*src_startbit*/7,   /*sigG_length*/8,  /*des_slotid_fr*/0,   /*des_basecycle_fr*/0,  /*des_repetition_fr*/0,   /*des_startbit*/313,    /*src_cyc*/101,  /*src_id*/0x4e,   /*src_dlc*/8,   /*des_id*/0x61, /*updatebit_S*/57,   /*updatebit_D*/448         },
           {   /*sigGroup_s*/"igBltLockStAtRowThrdRi_0",   /*sig_name*/"isBltLockStAtRowThrdRiBltLockSts_0",   /*src_can*/"ZCUD_CAN1",   /*src_network_type*/"CAN",   /*src_slotid_fr*/0,   /*src_basecycle_fr*/0,  /*src_repetition_fr*/0,  /*src_startbit*/21,   /*sigG_length*/1,  /*des_slotid_fr*/0,   /*des_basecycle_fr*/0,  /*des_repetition_fr*/0,   /*des_startbit*/18,    /*src_cyc*/101,  /*src_id*/0x70,   /*src_dlc*/8,   /*des_id*/0x353, /*updatebit_S*/20,   /*updatebit_D*/9         },
           {   /*sigGroup_s*/"igBltLockStAtRowThrdRi_0",   /*sig_name*/"isBltLockStAtRowThrdRiBltLockEquid_0",   /*src_can*/"ZCUD_CAN1",   /*src_network_type*/"CAN",   /*src_slotid_fr*/0,   /*src_basecycle_fr*/0,  /*src_repetition_fr*/0,  /*src_startbit*/23,   /*sigG_length*/1,  /*des_slotid_fr*/0,   /*des_basecycle_fr*/0,  /*des_repetition_fr*/0,   /*des_startbit*/20,    /*src_cyc*/101,  /*src_id*/0x70,   /*src_dlc*/8,   /*des_id*/0x353, /*updatebit_S*/20,   /*updatebit_D*/9         },
           {   /*sigGroup_s*/"igBltLockStAtRowThrdRi_0",   /*sig_name*/"isBltLockStAtRowThrdRiBltLockSt1_0",   /*src_can*/"ZCUD_CAN1",   /*src_network_type*/"CAN",   /*src_slotid_fr*/0,   /*src_basecycle_fr*/0,  /*src_repetition_fr*/0,  /*src_startbit*/22,   /*sigG_length*/1,  /*des_slotid_fr*/0,   /*des_basecycle_fr*/0,  /*des_repetition_fr*/0,   /*des_startbit*/19,    /*src_cyc*/101,  /*src_id*/0x70,   /*src_dlc*/8,   /*des_id*/0x353, /*updatebit_S*/20,   /*updatebit_D*/9         },
           {   /*sigGroup_s*/"igTwliBriRaw_0",   /*sig_name*/"isTwliBriRawQf_0",   /*src_can*/"CEM_LIN1",   /*src_network_type*/"LIN",   /*src_slotid_fr*/0,   /*src_basecycle_fr*/0,  /*src_repetition_fr*/0,  /*src_startbit*/24,   /*sigG_length*/2,  /*des_slotid_fr*/0,   /*des_basecycle_fr*/0,  /*des_repetition_fr*/0,   /*des_startbit*/223,    /*src_cyc*/101,  /*src_id*/21,   /*src_dlc*/8,   /*des_id*/0x1f1, /*updatebit_S*/1000,   /*updatebit_D*/233         },
           {   /*sigGroup_s*/"igTwliBriRaw_0",   /*sig_name*/"isTwliBriRawTwliBriRaw_0",   /*src_can*/"CEM_LIN1",   /*src_network_type*/"LIN",   /*src_slotid_fr*/0,   /*src_basecycle_fr*/0,  /*src_repetition_fr*/0,  /*src_startbit*/26,   /*sigG_length*/14,  /*des_slotid_fr*/0,   /*des_basecycle_fr*/0,  /*des_repetition_fr*/0,   /*des_startbit*/221,    /*src_cyc*/101,  /*src_id*/21,   /*src_dlc*/8,   /*des_id*/0x1f1, /*updatebit_S*/1000,   /*updatebit_D*/233         },
           {   /*sigGroup_s*/"igAccrPedlRat_0",   /*sig_name*/"isAccrPedlRatCntr_0",   /*src_can*/"ChassisCANFD2",   /*src_network_type*/"CANFD",   /*src_slotid_fr*/0,   /*src_basecycle_fr*/0,  /*src_repetition_fr*/0,  /*src_startbit*/115,   /*sigG_length*/4,  /*des_slotid_fr*/0,   /*des_basecycle_fr*/0,  /*des_repetition_fr*/0,   /*des_startbit*/16,    /*src_cyc*/101,  /*src_id*/0xde,   /*src_dlc*/64,   /*des_id*/0x106, /*updatebit_S*/168,   /*updatebit_D*/105         },
           {   /*sigGroup_s*/"igAccrPedlRat_0",   /*sig_name*/"isAccrPedlRatChks_0",   /*src_can*/"ChassisCANFD2",   /*src_network_type*/"CANFD",   /*src_slotid_fr*/0,   /*src_basecycle_fr*/0,  /*src_repetition_fr*/0,  /*src_startbit*/107,   /*sigG_length*/8,  /*des_slotid_fr*/0,   /*des_basecycle_fr*/0,  /*des_repetition_fr*/0,   /*des_startbit*/8,    /*src_cyc*/101,  /*src_id*/0xde,   /*src_dlc*/64,   /*des_id*/0x106, /*updatebit_S*/168,   /*updatebit_D*/105         },
           {   /*sigGroup_s*/"igAccrPedlRat_0",   /*sig_name*/"isAccrPedlRatAccrPedlRat_0",   /*src_can*/"ChassisCANFD2",   /*src_network_type*/"CANFD",   /*src_slotid_fr*/0,   /*src_basecycle_fr*/0,  /*src_repetition_fr*/0,  /*src_startbit*/90,   /*sigG_length*/15,  /*des_slotid_fr*/0,   /*des_basecycle_fr*/0,  /*des_repetition_fr*/0,   /*des_startbit*/7,    /*src_cyc*/101,  /*src_id*/0xde,   /*src_dlc*/64,   /*des_id*/0x106, /*updatebit_S*/168,   /*updatebit_D*/105         },
           {   /*sigGroup_s*/"igJID_0",   /*sig_name*/"isJIDByte3_0",   /*src_can*/"ZCUD_CAN1",   /*src_network_type*/"CAN",   /*src_slotid_fr*/0,   /*src_basecycle_fr*/0,  /*src_repetition_fr*/0,  /*src_startbit*/31,   /*sigG_length*/8,  /*des_slotid_fr*/0,   /*des_basecycle_fr*/0,  /*des_repetition_fr*/0,   /*des_startbit*/39,    /*src_cyc*/101,  /*src_id*/0x22a,   /*src_dlc*/8,   /*des_id*/0x363, /*updatebit_S*/1000,   /*updatebit_D*/3         },
           {   /*sigGroup_s*/"igJID_0",   /*sig_name*/"isJIDByte0_0",   /*src_can*/"ZCUD_CAN1",   /*src_network_type*/"CAN",   /*src_slotid_fr*/0,   /*src_basecycle_fr*/0,  /*src_repetition_fr*/0,  /*src_startbit*/7,   /*sigG_length*/8,  /*des_slotid_fr*/0,   /*des_basecycle_fr*/0,  /*des_repetition_fr*/0,   /*des_startbit*/15,    /*src_cyc*/101,  /*src_id*/0x22a,   /*src_dlc*/8,   /*des_id*/0x363, /*updatebit_S*/1000,   /*updatebit_D*/3         },
           {   /*sigGroup_s*/"igJID_0",   /*sig_name*/"isJIDByte7_0",   /*src_can*/"ZCUD_CAN1",   /*src_network_type*/"CAN",   /*src_slotid_fr*/0,   /*src_basecycle_fr*/0,  /*src_repetition_fr*/0,  /*src_startbit*/63,   /*sigG_length*/8,  /*des_slotid_fr*/0,   /*des_basecycle_fr*/0,  /*des_repetition_fr*/0,   /*des_startbit*/71,    /*src_cyc*/101,  /*src_id*/0x22a,   /*src_dlc*/8,   /*des_id*/0x363, /*updatebit_S*/1000,   /*updatebit_D*/3         },
           {   /*sigGroup_s*/"igJID_0",   /*sig_name*/"isJIDByte2_0",   /*src_can*/"ZCUD_CAN1",   /*src_network_type*/"CAN",   /*src_slotid_fr*/0,   /*src_basecycle_fr*/0,  /*src_repetition_fr*/0,  /*src_startbit*/23,   /*sigG_length*/8,  /*des_slotid_fr*/0,   /*des_basecycle_fr*/0,  /*des_repetition_fr*/0,   /*des_startbit*/31,    /*src_cyc*/101,  /*src_id*/0x22a,   /*src_dlc*/8,   /*des_id*/0x363, /*updatebit_S*/1000,   /*updatebit_D*/3         },
           {   /*sigGroup_s*/"igJID_0",   /*sig_name*/"isJIDByte6_0",   /*src_can*/"ZCUD_CAN1",   /*src_network_type*/"CAN",   /*src_slotid_fr*/0,   /*src_basecycle_fr*/0,  /*src_repetition_fr*/0,  /*src_startbit*/55,   /*sigG_length*/8,  /*des_slotid_fr*/0,   /*des_basecycle_fr*/0,  /*des_repetition_fr*/0,   /*des_startbit*/63,    /*src_cyc*/101,  /*src_id*/0x22a,   /*src_dlc*/8,   /*des_id*/0x363, /*updatebit_S*/1000,   /*updatebit_D*/3         },
           {   /*sigGroup_s*/"igJID_0",   /*sig_name*/"isJIDByte4_0",   /*src_can*/"ZCUD_CAN1",   /*src_network_type*/"CAN",   /*src_slotid_fr*/0,   /*src_basecycle_fr*/0,  /*src_repetition_fr*/0,  /*src_startbit*/39,   /*sigG_length*/8,  /*des_slotid_fr*/0,   /*des_basecycle_fr*/0,  /*des_repetition_fr*/0,   /*des_startbit*/47,    /*src_cyc*/101,  /*src_id*/0x22a,   /*src_dlc*/8,   /*des_id*/0x363, /*updatebit_S*/1000,   /*updatebit_D*/3         },
           {   /*sigGroup_s*/"igJID_0",   /*sig_name*/"isJIDByte5_0",   /*src_can*/"ZCUD_CAN1",   /*src_network_type*/"CAN",   /*src_slotid_fr*/0,   /*src_basecycle_fr*/0,  /*src_repetition_fr*/0,  /*src_startbit*/47,   /*sigG_length*/8,  /*des_slotid_fr*/0,   /*des_basecycle_fr*/0,  /*des_repetition_fr*/0,   /*des_startbit*/55,    /*src_cyc*/101,  /*src_id*/0x22a,   /*src_dlc*/8,   /*des_id*/0x363, /*updatebit_S*/1000,   /*updatebit_D*/3         },
           {   /*sigGroup_s*/"igJID_0",   /*sig_name*/"isJIDByte1_0",   /*src_can*/"ZCUD_CAN1",   /*src_network_type*/"CAN",   /*src_slotid_fr*/0,   /*src_basecycle_fr*/0,  /*src_repetition_fr*/0,  /*src_startbit*/15,   /*sigG_length*/8,  /*des_slotid_fr*/0,   /*des_basecycle_fr*/0,  /*des_repetition_fr*/0,   /*des_startbit*/23,    /*src_cyc*/101,  /*src_id*/0x22a,   /*src_dlc*/8,   /*des_id*/0x363, /*updatebit_S*/1000,   /*updatebit_D*/3         },
           {   /*sigGroup_s*/"igDrvrDesDir_0",   /*sig_name*/"isDrvrDesDirDrvrDesDir_0",   /*src_can*/"ChassisCAN1",   /*src_network_type*/"CAN",   /*src_slotid_fr*/0,   /*src_basecycle_fr*/0,  /*src_repetition_fr*/0,  /*src_startbit*/27,   /*sigG_length*/3,  /*des_slotid_fr*/0,   /*des_basecycle_fr*/0,  /*des_repetition_fr*/0,   /*des_startbit*/155,    /*src_cyc*/101,  /*src_id*/0x76,   /*src_dlc*/8,   /*des_id*/0x243, /*updatebit_S*/24,   /*updatebit_D*/152         },
           {   /*sigGroup_s*/"igDrvrDesDir_0",   /*sig_name*/"isDrvrDesDirChks_0",   /*src_can*/"ChassisCAN1",   /*src_network_type*/"CAN",   /*src_slotid_fr*/0,   /*src_basecycle_fr*/0,  /*src_repetition_fr*/0,  /*src_startbit*/23,   /*sigG_length*/8,  /*des_slotid_fr*/0,   /*des_basecycle_fr*/0,  /*des_repetition_fr*/0,   /*des_startbit*/151,    /*src_cyc*/101,  /*src_id*/0x76,   /*src_dlc*/8,   /*des_id*/0x243, /*updatebit_S*/24,   /*updatebit_D*/152         },
           {   /*sigGroup_s*/"igDrvrDesDir_0",   /*sig_name*/"isDrvrDesDirCntr_0",   /*src_can*/"ChassisCAN1",   /*src_network_type*/"CAN",   /*src_slotid_fr*/0,   /*src_basecycle_fr*/0,  /*src_repetition_fr*/0,  /*src_startbit*/31,   /*sigG_length*/4,  /*des_slotid_fr*/0,   /*des_basecycle_fr*/0,  /*des_repetition_fr*/0,   /*des_startbit*/159,    /*src_cyc*/101,  /*src_id*/0x76,   /*src_dlc*/8,   /*des_id*/0x243, /*updatebit_S*/24,   /*updatebit_D*/152         },
           {   /*sigGroup_s*/"igRWATarPinionAgR1_0",   /*sig_name*/"isRWATarPinionAgR1RefPinionAg_0",   /*src_can*/"ZCUD_CANFD3",   /*src_network_type*/"CANFD",   /*src_slotid_fr*/0,   /*src_basecycle_fr*/0,  /*src_repetition_fr*/0,  /*src_startbit*/20,   /*sigG_length*/15,  /*des_slotid_fr*/0,   /*des_basecycle_fr*/0,  /*des_repetition_fr*/0,   /*des_startbit*/407,    /*src_cyc*/101,  /*src_id*/0x110,   /*src_dlc*/64,   /*des_id*/0x61, /*updatebit_S*/35,   /*updatebit_D*/474         },
           {   /*sigGroup_s*/"igRWATarPinionAgR1_0",   /*sig_name*/"isRWATarPinionAgR1Qf_0",   /*src_can*/"ZCUD_CANFD3",   /*src_network_type*/"CANFD",   /*src_slotid_fr*/0,   /*src_basecycle_fr*/0,  /*src_repetition_fr*/0,  /*src_startbit*/37,   /*sigG_length*/2,  /*des_slotid_fr*/0,   /*des_basecycle_fr*/0,  /*des_repetition_fr*/0,   /*des_startbit*/423,    /*src_cyc*/101,  /*src_id*/0x110,   /*src_dlc*/64,   /*des_id*/0x61, /*updatebit_S*/35,   /*updatebit_D*/474         }
       }
   },
   {
       /*des_can*/ "ZCUD_CANFD3",
       /*networktype*/ "CANFD",
       38,
       {
           {   /*sigGroup_s*/"igCmptmtTFrnt_0",   /*sig_name*/"isCmptmtTFrntFanForCmptmtTRunng_0",   /*src_can*/"ZCU_CANFD1",   /*src_network_type*/"CANFD",   /*src_slotid_fr*/0,   /*src_basecycle_fr*/0,  /*src_repetition_fr*/0,  /*src_startbit*/50,   /*sigG_length*/1,  /*des_slotid_fr*/0,   /*des_basecycle_fr*/0,  /*des_repetition_fr*/0,   /*des_startbit*/10,    /*src_cyc*/101,  /*src_id*/0x212,   /*src_dlc*/64,   /*des_id*/0x2f0, /*updatebit_S*/49,   /*updatebit_D*/9         },
           {   /*sigGroup_s*/"igCmptmtTFrnt_0",   /*sig_name*/"isCmptmtTFrntQf_0",   /*src_can*/"ZCU_CANFD1",   /*src_network_type*/"CANFD",   /*src_slotid_fr*/0,   /*src_basecycle_fr*/0,  /*src_repetition_fr*/0,  /*src_startbit*/52,   /*sigG_length*/2,  /*des_slotid_fr*/0,   /*des_basecycle_fr*/0,  /*des_repetition_fr*/0,   /*des_startbit*/12,    /*src_cyc*/101,  /*src_id*/0x212,   /*src_dlc*/64,   /*des_id*/0x2f0, /*updatebit_S*/49,   /*updatebit_D*/9         },
           {   /*sigGroup_s*/"igCmptmtTFrnt_0",   /*sig_name*/"isCmptmtTFrntCmptmtTFrnt_0",   /*src_can*/"ZCU_CANFD1",   /*src_network_type*/"CANFD",   /*src_slotid_fr*/0,   /*src_basecycle_fr*/0,  /*src_repetition_fr*/0,  /*src_startbit*/47,   /*sigG_length*/11,  /*des_slotid_fr*/0,   /*des_basecycle_fr*/0,  /*des_repetition_fr*/0,   /*des_startbit*/7,    /*src_cyc*/101,  /*src_id*/0x212,   /*src_dlc*/64,   /*des_id*/0x2f0, /*updatebit_S*/49,   /*updatebit_D*/9         },
           {   /*sigGroup_s*/"igVehCfgPrmExt_0",   /*sig_name*/"isVehCfgPrmExtCCPBytePosn8_0",   /*src_can*/"ZCU_CANFD1",   /*src_network_type*/"CANFD",   /*src_slotid_fr*/0,   /*src_basecycle_fr*/0,  /*src_repetition_fr*/0,  /*src_startbit*/127,   /*sigG_length*/8,  /*des_slotid_fr*/0,   /*des_basecycle_fr*/0,  /*des_repetition_fr*/0,   /*des_startbit*/127,    /*src_cyc*/101,  /*src_id*/0x1f5,   /*src_dlc*/64,   /*des_id*/0x225, /*updatebit_S*/198,   /*updatebit_D*/362         },
           {   /*sigGroup_s*/"igVehCfgPrmExt_0",   /*sig_name*/"isVehCfgPrmExtCCPBytePosn6_0",   /*src_can*/"ZCU_CANFD1",   /*src_network_type*/"CANFD",   /*src_slotid_fr*/0,   /*src_basecycle_fr*/0,  /*src_repetition_fr*/0,  /*src_startbit*/111,   /*sigG_length*/8,  /*des_slotid_fr*/0,   /*des_basecycle_fr*/0,  /*des_repetition_fr*/0,   /*des_startbit*/111,    /*src_cyc*/101,  /*src_id*/0x1f5,   /*src_dlc*/64,   /*des_id*/0x225, /*updatebit_S*/198,   /*updatebit_D*/362         },
           {   /*sigGroup_s*/"igVehCfgPrmExt_0",   /*sig_name*/"isVehCfgPrmExtCCPBytePosn4_0",   /*src_can*/"ZCU_CANFD1",   /*src_network_type*/"CANFD",   /*src_slotid_fr*/0,   /*src_basecycle_fr*/0,  /*src_repetition_fr*/0,  /*src_startbit*/95,   /*sigG_length*/8,  /*des_slotid_fr*/0,   /*des_basecycle_fr*/0,  /*des_repetition_fr*/0,   /*des_startbit*/95,    /*src_cyc*/101,  /*src_id*/0x1f5,   /*src_dlc*/64,   /*des_id*/0x225, /*updatebit_S*/198,   /*updatebit_D*/362         },
           {   /*sigGroup_s*/"igVehCfgPrmExt_0",   /*sig_name*/"isVehCfgPrmExtCCPBytePosn3_0",   /*src_can*/"ZCU_CANFD1",   /*src_network_type*/"CANFD",   /*src_slotid_fr*/0,   /*src_basecycle_fr*/0,  /*src_repetition_fr*/0,  /*src_startbit*/87,   /*sigG_length*/8,  /*des_slotid_fr*/0,   /*des_basecycle_fr*/0,  /*des_repetition_fr*/0,   /*des_startbit*/87,    /*src_cyc*/101,  /*src_id*/0x1f5,   /*src_dlc*/64,   /*des_id*/0x225, /*updatebit_S*/198,   /*updatebit_D*/362         },
           {   /*sigGroup_s*/"igVehCfgPrmExt_0",   /*sig_name*/"isVehCfgPrmExtCCPBytePosn2_0",   /*src_can*/"ZCU_CANFD1",   /*src_network_type*/"CANFD",   /*src_slotid_fr*/0,   /*src_basecycle_fr*/0,  /*src_repetition_fr*/0,  /*src_startbit*/79,   /*sigG_length*/8,  /*des_slotid_fr*/0,   /*des_basecycle_fr*/0,  /*des_repetition_fr*/0,   /*des_startbit*/79,    /*src_cyc*/101,  /*src_id*/0x1f5,   /*src_dlc*/64,   /*des_id*/0x225, /*updatebit_S*/198,   /*updatebit_D*/362         },
           {   /*sigGroup_s*/"igVehCfgPrmExt_0",   /*sig_name*/"isVehCfgPrmExtBlkIDBytePosn1_0",   /*src_can*/"ZCU_CANFD1",   /*src_network_type*/"CANFD",   /*src_slotid_fr*/0,   /*src_basecycle_fr*/0,  /*src_repetition_fr*/0,  /*src_startbit*/71,   /*sigG_length*/8,  /*des_slotid_fr*/0,   /*des_basecycle_fr*/0,  /*des_repetition_fr*/0,   /*des_startbit*/71,    /*src_cyc*/101,  /*src_id*/0x1f5,   /*src_dlc*/64,   /*des_id*/0x225, /*updatebit_S*/198,   /*updatebit_D*/362         },
           {   /*sigGroup_s*/"igVehCfgPrmExt_0",   /*sig_name*/"isVehCfgPrmExtCCPBytePosn5_0",   /*src_can*/"ZCU_CANFD1",   /*src_network_type*/"CANFD",   /*src_slotid_fr*/0,   /*src_basecycle_fr*/0,  /*src_repetition_fr*/0,  /*src_startbit*/103,   /*sigG_length*/8,  /*des_slotid_fr*/0,   /*des_basecycle_fr*/0,  /*des_repetition_fr*/0,   /*des_startbit*/103,    /*src_cyc*/101,  /*src_id*/0x1f5,   /*src_dlc*/64,   /*des_id*/0x225, /*updatebit_S*/198,   /*updatebit_D*/362         },
           {   /*sigGroup_s*/"igVehCfgPrmExt_0",   /*sig_name*/"isVehCfgPrmExtCCPBytePosn7_0",   /*src_can*/"ZCU_CANFD1",   /*src_network_type*/"CANFD",   /*src_slotid_fr*/0,   /*src_basecycle_fr*/0,  /*src_repetition_fr*/0,  /*src_startbit*/119,   /*sigG_length*/8,  /*des_slotid_fr*/0,   /*des_basecycle_fr*/0,  /*des_repetition_fr*/0,   /*des_startbit*/119,    /*src_cyc*/101,  /*src_id*/0x1f5,   /*src_dlc*/64,   /*des_id*/0x225, /*updatebit_S*/198,   /*updatebit_D*/362         },
           {   /*sigGroup_s*/"igVehCfgPrmExt2_0",   /*sig_name*/"isVehCfgPrmExt2BlkIDBytePosn1_0",   /*src_can*/"ZCU_CANFD1",   /*src_network_type*/"CANFD",   /*src_slotid_fr*/0,   /*src_basecycle_fr*/0,  /*src_repetition_fr*/0,  /*src_startbit*/135,   /*sigG_length*/8,  /*des_slotid_fr*/0,   /*des_basecycle_fr*/0,  /*des_repetition_fr*/0,   /*des_startbit*/135,    /*src_cyc*/101,  /*src_id*/0x1f5,   /*src_dlc*/64,   /*des_id*/0x225, /*updatebit_S*/197,   /*updatebit_D*/361         },
           {   /*sigGroup_s*/"igVehCfgPrmExt2_0",   /*sig_name*/"isVehCfgPrmExt2CCPBytePosn2_0",   /*src_can*/"ZCU_CANFD1",   /*src_network_type*/"CANFD",   /*src_slotid_fr*/0,   /*src_basecycle_fr*/0,  /*src_repetition_fr*/0,  /*src_startbit*/143,   /*sigG_length*/8,  /*des_slotid_fr*/0,   /*des_basecycle_fr*/0,  /*des_repetition_fr*/0,   /*des_startbit*/143,    /*src_cyc*/101,  /*src_id*/0x1f5,   /*src_dlc*/64,   /*des_id*/0x225, /*updatebit_S*/197,   /*updatebit_D*/361         },
           {   /*sigGroup_s*/"igVehCfgPrmExt2_0",   /*sig_name*/"isVehCfgPrmExt2CCPBytePosn6_0",   /*src_can*/"ZCU_CANFD1",   /*src_network_type*/"CANFD",   /*src_slotid_fr*/0,   /*src_basecycle_fr*/0,  /*src_repetition_fr*/0,  /*src_startbit*/175,   /*sigG_length*/8,  /*des_slotid_fr*/0,   /*des_basecycle_fr*/0,  /*des_repetition_fr*/0,   /*des_startbit*/175,    /*src_cyc*/101,  /*src_id*/0x1f5,   /*src_dlc*/64,   /*des_id*/0x225, /*updatebit_S*/197,   /*updatebit_D*/361         },
           {   /*sigGroup_s*/"igVehCfgPrmExt2_0",   /*sig_name*/"isVehCfgPrmExt2CCPBytePosn4_0",   /*src_can*/"ZCU_CANFD1",   /*src_network_type*/"CANFD",   /*src_slotid_fr*/0,   /*src_basecycle_fr*/0,  /*src_repetition_fr*/0,  /*src_startbit*/159,   /*sigG_length*/8,  /*des_slotid_fr*/0,   /*des_basecycle_fr*/0,  /*des_repetition_fr*/0,   /*des_startbit*/159,    /*src_cyc*/101,  /*src_id*/0x1f5,   /*src_dlc*/64,   /*des_id*/0x225, /*updatebit_S*/197,   /*updatebit_D*/361         },
           {   /*sigGroup_s*/"igVehCfgPrmExt2_0",   /*sig_name*/"isVehCfgPrmExt2CCPBytePosn5_0",   /*src_can*/"ZCU_CANFD1",   /*src_network_type*/"CANFD",   /*src_slotid_fr*/0,   /*src_basecycle_fr*/0,  /*src_repetition_fr*/0,  /*src_startbit*/167,   /*sigG_length*/8,  /*des_slotid_fr*/0,   /*des_basecycle_fr*/0,  /*des_repetition_fr*/0,   /*des_startbit*/167,    /*src_cyc*/101,  /*src_id*/0x1f5,   /*src_dlc*/64,   /*des_id*/0x225, /*updatebit_S*/197,   /*updatebit_D*/361         },
           {   /*sigGroup_s*/"igVehCfgPrmExt2_0",   /*sig_name*/"isVehCfgPrmExt2CCPBytePosn3_0",   /*src_can*/"ZCU_CANFD1",   /*src_network_type*/"CANFD",   /*src_slotid_fr*/0,   /*src_basecycle_fr*/0,  /*src_repetition_fr*/0,  /*src_startbit*/151,   /*sigG_length*/8,  /*des_slotid_fr*/0,   /*des_basecycle_fr*/0,  /*des_repetition_fr*/0,   /*des_startbit*/151,    /*src_cyc*/101,  /*src_id*/0x1f5,   /*src_dlc*/64,   /*des_id*/0x225, /*updatebit_S*/197,   /*updatebit_D*/361         },
           {   /*sigGroup_s*/"igVehCfgPrmExt2_0",   /*sig_name*/"isVehCfgPrmExt2CCPBytePosn7_0",   /*src_can*/"ZCU_CANFD1",   /*src_network_type*/"CANFD",   /*src_slotid_fr*/0,   /*src_basecycle_fr*/0,  /*src_repetition_fr*/0,  /*src_startbit*/183,   /*sigG_length*/8,  /*des_slotid_fr*/0,   /*des_basecycle_fr*/0,  /*des_repetition_fr*/0,   /*des_startbit*/183,    /*src_cyc*/101,  /*src_id*/0x1f5,   /*src_dlc*/64,   /*des_id*/0x225, /*updatebit_S*/197,   /*updatebit_D*/361         },
           {   /*sigGroup_s*/"igVehCfgPrmExt2_0",   /*sig_name*/"isVehCfgPrmExt2CCPBytePosn8_0",   /*src_can*/"ZCU_CANFD1",   /*src_network_type*/"CANFD",   /*src_slotid_fr*/0,   /*src_basecycle_fr*/0,  /*src_repetition_fr*/0,  /*src_startbit*/191,   /*sigG_length*/8,  /*des_slotid_fr*/0,   /*des_basecycle_fr*/0,  /*des_repetition_fr*/0,   /*des_startbit*/191,    /*src_cyc*/101,  /*src_id*/0x1f5,   /*src_dlc*/64,   /*des_id*/0x225, /*updatebit_S*/197,   /*updatebit_D*/361         },
           {   /*sigGroup_s*/"igVehMtnSt_0",   /*sig_name*/"isVehMtnStCntr_0",   /*src_can*/"ZCU_CANFD1",   /*src_network_type*/"CANFD",   /*src_slotid_fr*/0,   /*src_basecycle_fr*/0,  /*src_repetition_fr*/0,  /*src_startbit*/423,   /*sigG_length*/4,  /*des_slotid_fr*/0,   /*des_basecycle_fr*/0,  /*des_repetition_fr*/0,   /*des_startbit*/215,    /*src_cyc*/101,  /*src_id*/0x82,   /*src_dlc*/64,   /*des_id*/0x55, /*updatebit_S*/416,   /*updatebit_D*/208         },
           {   /*sigGroup_s*/"igVehMtnSt_0",   /*sig_name*/"isVehMtnStVehMtnSt_0",   /*src_can*/"ZCU_CANFD1",   /*src_network_type*/"CANFD",   /*src_slotid_fr*/0,   /*src_basecycle_fr*/0,  /*src_repetition_fr*/0,  /*src_startbit*/419,   /*sigG_length*/3,  /*des_slotid_fr*/0,   /*des_basecycle_fr*/0,  /*des_repetition_fr*/0,   /*des_startbit*/211,    /*src_cyc*/101,  /*src_id*/0x82,   /*src_dlc*/64,   /*des_id*/0x55, /*updatebit_S*/416,   /*updatebit_D*/208         },
           {   /*sigGroup_s*/"igVehMtnSt_0",   /*sig_name*/"isVehMtnStChks_0",   /*src_can*/"ZCU_CANFD1",   /*src_network_type*/"CANFD",   /*src_slotid_fr*/0,   /*src_basecycle_fr*/0,  /*src_repetition_fr*/0,  /*src_startbit*/415,   /*sigG_length*/8,  /*des_slotid_fr*/0,   /*des_basecycle_fr*/0,  /*des_repetition_fr*/0,   /*des_startbit*/207,    /*src_cyc*/101,  /*src_id*/0x82,   /*src_dlc*/64,   /*des_id*/0x55, /*updatebit_S*/416,   /*updatebit_D*/208         },
           {   /*sigGroup_s*/"igVehCfgPrm_0",   /*sig_name*/"isVehCfgPrmCCPBytePosn2_0",   /*src_can*/"ZCU_CANFD1",   /*src_network_type*/"CANFD",   /*src_slotid_fr*/0,   /*src_basecycle_fr*/0,  /*src_repetition_fr*/0,  /*src_startbit*/15,   /*sigG_length*/8,  /*des_slotid_fr*/0,   /*des_basecycle_fr*/0,  /*des_repetition_fr*/0,   /*des_startbit*/15,    /*src_cyc*/101,  /*src_id*/0x1f5,   /*src_dlc*/64,   /*des_id*/0x225, /*updatebit_S*/199,   /*updatebit_D*/363         },
           {   /*sigGroup_s*/"igVehCfgPrm_0",   /*sig_name*/"isVehCfgPrmCCPBytePosn7_0",   /*src_can*/"ZCU_CANFD1",   /*src_network_type*/"CANFD",   /*src_slotid_fr*/0,   /*src_basecycle_fr*/0,  /*src_repetition_fr*/0,  /*src_startbit*/55,   /*sigG_length*/8,  /*des_slotid_fr*/0,   /*des_basecycle_fr*/0,  /*des_repetition_fr*/0,   /*des_startbit*/55,    /*src_cyc*/101,  /*src_id*/0x1f5,   /*src_dlc*/64,   /*des_id*/0x225, /*updatebit_S*/199,   /*updatebit_D*/363         },
           {   /*sigGroup_s*/"igVehCfgPrm_0",   /*sig_name*/"isVehCfgPrmCCPBytePosn3_0",   /*src_can*/"ZCU_CANFD1",   /*src_network_type*/"CANFD",   /*src_slotid_fr*/0,   /*src_basecycle_fr*/0,  /*src_repetition_fr*/0,  /*src_startbit*/23,   /*sigG_length*/8,  /*des_slotid_fr*/0,   /*des_basecycle_fr*/0,  /*des_repetition_fr*/0,   /*des_startbit*/23,    /*src_cyc*/101,  /*src_id*/0x1f5,   /*src_dlc*/64,   /*des_id*/0x225, /*updatebit_S*/199,   /*updatebit_D*/363         },
           {   /*sigGroup_s*/"igVehCfgPrm_0",   /*sig_name*/"isVehCfgPrmCCPBytePosn4_0",   /*src_can*/"ZCU_CANFD1",   /*src_network_type*/"CANFD",   /*src_slotid_fr*/0,   /*src_basecycle_fr*/0,  /*src_repetition_fr*/0,  /*src_startbit*/31,   /*sigG_length*/8,  /*des_slotid_fr*/0,   /*des_basecycle_fr*/0,  /*des_repetition_fr*/0,   /*des_startbit*/31,    /*src_cyc*/101,  /*src_id*/0x1f5,   /*src_dlc*/64,   /*des_id*/0x225, /*updatebit_S*/199,   /*updatebit_D*/363         },
           {   /*sigGroup_s*/"igVehCfgPrm_0",   /*sig_name*/"isVehCfgPrmCCPBytePosn8_0",   /*src_can*/"ZCU_CANFD1",   /*src_network_type*/"CANFD",   /*src_slotid_fr*/0,   /*src_basecycle_fr*/0,  /*src_repetition_fr*/0,  /*src_startbit*/63,   /*sigG_length*/8,  /*des_slotid_fr*/0,   /*des_basecycle_fr*/0,  /*des_repetition_fr*/0,   /*des_startbit*/63,    /*src_cyc*/101,  /*src_id*/0x1f5,   /*src_dlc*/64,   /*des_id*/0x225, /*updatebit_S*/199,   /*updatebit_D*/363         },
           {   /*sigGroup_s*/"igVehCfgPrm_0",   /*sig_name*/"isVehCfgPrmCCPBytePosn5_0",   /*src_can*/"ZCU_CANFD1",   /*src_network_type*/"CANFD",   /*src_slotid_fr*/0,   /*src_basecycle_fr*/0,  /*src_repetition_fr*/0,  /*src_startbit*/39,   /*sigG_length*/8,  /*des_slotid_fr*/0,   /*des_basecycle_fr*/0,  /*des_repetition_fr*/0,   /*des_startbit*/39,    /*src_cyc*/101,  /*src_id*/0x1f5,   /*src_dlc*/64,   /*des_id*/0x225, /*updatebit_S*/199,   /*updatebit_D*/363         },
           {   /*sigGroup_s*/"igVehCfgPrm_0",   /*sig_name*/"isVehCfgPrmBlkIDBytePosn1_0",   /*src_can*/"ZCU_CANFD1",   /*src_network_type*/"CANFD",   /*src_slotid_fr*/0,   /*src_basecycle_fr*/0,  /*src_repetition_fr*/0,  /*src_startbit*/7,   /*sigG_length*/8,  /*des_slotid_fr*/0,   /*des_basecycle_fr*/0,  /*des_repetition_fr*/0,   /*des_startbit*/7,    /*src_cyc*/101,  /*src_id*/0x1f5,   /*src_dlc*/64,   /*des_id*/0x225, /*updatebit_S*/199,   /*updatebit_D*/363         },
           {   /*sigGroup_s*/"igVehCfgPrm_0",   /*sig_name*/"isVehCfgPrmCCPBytePosn6_0",   /*src_can*/"ZCU_CANFD1",   /*src_network_type*/"CANFD",   /*src_slotid_fr*/0,   /*src_basecycle_fr*/0,  /*src_repetition_fr*/0,  /*src_startbit*/47,   /*sigG_length*/8,  /*des_slotid_fr*/0,   /*des_basecycle_fr*/0,  /*des_repetition_fr*/0,   /*des_startbit*/47,    /*src_cyc*/101,  /*src_id*/0x1f5,   /*src_dlc*/64,   /*des_id*/0x225, /*updatebit_S*/199,   /*updatebit_D*/363         },
           {   /*sigGroup_s*/"igEscSt_0",   /*sig_name*/"isEscStChks_0",   /*src_can*/"ZCU_CANFD1",   /*src_network_type*/"CANFD",   /*src_slotid_fr*/0,   /*src_basecycle_fr*/0,  /*src_repetition_fr*/0,  /*src_startbit*/343,   /*sigG_length*/8,  /*des_slotid_fr*/0,   /*des_basecycle_fr*/0,  /*des_repetition_fr*/0,   /*des_startbit*/191,    /*src_cyc*/101,  /*src_id*/0x82,   /*src_dlc*/64,   /*des_id*/0x55, /*updatebit_S*/344,   /*updatebit_D*/192         },
           {   /*sigGroup_s*/"igEscSt_0",   /*sig_name*/"isEscStEscSt_0",   /*src_can*/"ZCU_CANFD1",   /*src_network_type*/"CANFD",   /*src_slotid_fr*/0,   /*src_basecycle_fr*/0,  /*src_repetition_fr*/0,  /*src_startbit*/347,   /*sigG_length*/3,  /*des_slotid_fr*/0,   /*des_basecycle_fr*/0,  /*des_repetition_fr*/0,   /*des_startbit*/195,    /*src_cyc*/101,  /*src_id*/0x82,   /*src_dlc*/64,   /*des_id*/0x55, /*updatebit_S*/344,   /*updatebit_D*/192         },
           {   /*sigGroup_s*/"igEscSt_0",   /*sig_name*/"isEscStCntr_0",   /*src_can*/"ZCU_CANFD1",   /*src_network_type*/"CANFD",   /*src_slotid_fr*/0,   /*src_basecycle_fr*/0,  /*src_repetition_fr*/0,  /*src_startbit*/351,   /*sigG_length*/4,  /*des_slotid_fr*/0,   /*des_basecycle_fr*/0,  /*des_repetition_fr*/0,   /*des_startbit*/199,    /*src_cyc*/101,  /*src_id*/0x82,   /*src_dlc*/64,   /*des_id*/0x55, /*updatebit_S*/344,   /*updatebit_D*/192         },
           {   /*sigGroup_s*/"igBrkPedlPsd_0",   /*sig_name*/"isBrkPedlPsdBrkPedlPsd_0",   /*src_can*/"ZCU_CANFD1",   /*src_network_type*/"CANFD",   /*src_slotid_fr*/0,   /*src_basecycle_fr*/0,  /*src_repetition_fr*/0,  /*src_startbit*/168,   /*sigG_length*/1,  /*des_slotid_fr*/0,   /*des_basecycle_fr*/0,  /*des_repetition_fr*/0,   /*des_startbit*/48,    /*src_cyc*/101,  /*src_id*/0x82,   /*src_dlc*/64,   /*des_id*/0x121, /*updatebit_S*/400,   /*updatebit_D*/68         },
           {   /*sigGroup_s*/"igBrkPedlPsd_0",   /*sig_name*/"isBrkPedlPsdCntr_0",   /*src_can*/"ZCU_CANFD1",   /*src_network_type*/"CANFD",   /*src_slotid_fr*/0,   /*src_basecycle_fr*/0,  /*src_repetition_fr*/0,  /*src_startbit*/175,   /*sigG_length*/4,  /*des_slotid_fr*/0,   /*des_basecycle_fr*/0,  /*des_repetition_fr*/0,   /*des_startbit*/55,    /*src_cyc*/101,  /*src_id*/0x82,   /*src_dlc*/64,   /*des_id*/0x121, /*updatebit_S*/400,   /*updatebit_D*/68         },
           {   /*sigGroup_s*/"igBrkPedlPsd_0",   /*sig_name*/"isBrkPedlPsdChks_0",   /*src_can*/"ZCU_CANFD1",   /*src_network_type*/"CANFD",   /*src_slotid_fr*/0,   /*src_basecycle_fr*/0,  /*src_repetition_fr*/0,  /*src_startbit*/167,   /*sigG_length*/8,  /*des_slotid_fr*/0,   /*des_basecycle_fr*/0,  /*des_repetition_fr*/0,   /*des_startbit*/47,    /*src_cyc*/101,  /*src_id*/0x82,   /*src_dlc*/64,   /*des_id*/0x121, /*updatebit_S*/400,   /*updatebit_D*/68         },
           {   /*sigGroup_s*/"igBrkPedlPsd_0",   /*sig_name*/"isBrkPedlPsdQf_0",   /*src_can*/"ZCU_CANFD1",   /*src_network_type*/"CANFD",   /*src_slotid_fr*/0,   /*src_basecycle_fr*/0,  /*src_repetition_fr*/0,  /*src_startbit*/171,   /*sigG_length*/2,  /*des_slotid_fr*/0,   /*des_basecycle_fr*/0,  /*des_repetition_fr*/0,   /*des_startbit*/51,    /*src_cyc*/101,  /*src_id*/0x82,   /*src_dlc*/64,   /*des_id*/0x121, /*updatebit_S*/400,   /*updatebit_D*/68         },
           {   /*sigGroup_s*/"igBrkPedlPsd_0",   /*sig_name*/"isBrkPedlPsdBrkPedlNotPsdSafe_0",   /*src_can*/"ZCU_CANFD1",   /*src_network_type*/"CANFD",   /*src_slotid_fr*/0,   /*src_basecycle_fr*/0,  /*src_repetition_fr*/0,  /*src_startbit*/169,   /*sigG_length*/1,  /*des_slotid_fr*/0,   /*des_basecycle_fr*/0,  /*des_repetition_fr*/0,   /*des_startbit*/49,    /*src_cyc*/101,  /*src_id*/0x82,   /*src_dlc*/64,   /*des_id*/0x121, /*updatebit_S*/400,   /*updatebit_D*/68         }
       }
   },
   {
       /*des_can*/ "ChassisCANFD2",
       /*networktype*/ "CANFD",
       99,
       {
           {   /*sigGroup_s*/"igHmiMovgObj1_0",   /*sig_name*/"isHmiMovgObj1HdDirOfMovgObj_0",   /*src_can*/"ZCU_CANFD1",   /*src_network_type*/"CANFD",   /*src_slotid_fr*/0,   /*src_basecycle_fr*/0,  /*src_repetition_fr*/0,  /*src_startbit*/3,   /*sigG_length*/12,  /*des_slotid_fr*/0,   /*des_basecycle_fr*/0,  /*des_repetition_fr*/0,   /*des_startbit*/39,    /*src_cyc*/101,  /*src_id*/0x1b5,   /*src_dlc*/64,   /*des_id*/0x13c, /*updatebit_S*/35,   /*updatebit_D*/67         },
           {   /*sigGroup_s*/"igHmiMovgObj1_0",   /*sig_name*/"isHmiMovgObj1DstLatOfMovgObj_0",   /*src_can*/"ZCU_CANFD1",   /*src_network_type*/"CANFD",   /*src_slotid_fr*/0,   /*src_basecycle_fr*/0,  /*src_repetition_fr*/0,  /*src_startbit*/31,   /*sigG_length*/9,  /*des_slotid_fr*/0,   /*des_basecycle_fr*/0,  /*des_repetition_fr*/0,   /*des_startbit*/43,    /*src_cyc*/101,  /*src_id*/0x1b5,   /*src_dlc*/64,   /*des_id*/0x13c, /*updatebit_S*/35,   /*updatebit_D*/67         },
           {   /*sigGroup_s*/"igHmiMovgObj1_0",   /*sig_name*/"isHmiMovgObj1DstLgtOfMovgobj_0",   /*src_can*/"ZCU_CANFD1",   /*src_network_type*/"CANFD",   /*src_slotid_fr*/0,   /*src_basecycle_fr*/0,  /*src_repetition_fr*/0,  /*src_startbit*/23,   /*sigG_length*/8,  /*des_slotid_fr*/0,   /*des_basecycle_fr*/0,  /*des_repetition_fr*/0,   /*des_startbit*/50,    /*src_cyc*/101,  /*src_id*/0x1b5,   /*src_dlc*/64,   /*des_id*/0x13c, /*updatebit_S*/35,   /*updatebit_D*/67         },
           {   /*sigGroup_s*/"igHmiMovgObj1_0",   /*sig_name*/"isHmiMovgObj1HmiMovgObjTyp_0",   /*src_can*/"ZCU_CANFD1",   /*src_network_type*/"CANFD",   /*src_slotid_fr*/0,   /*src_basecycle_fr*/0,  /*src_repetition_fr*/0,  /*src_startbit*/7,   /*sigG_length*/4,  /*des_slotid_fr*/0,   /*des_basecycle_fr*/0,  /*des_repetition_fr*/0,   /*des_startbit*/58,    /*src_cyc*/101,  /*src_id*/0x1b5,   /*src_dlc*/64,   /*des_id*/0x13c, /*updatebit_S*/35,   /*updatebit_D*/67         },
           {   /*sigGroup_s*/"igHmiMovgObj1_0",   /*sig_name*/"isHmiMovgObj1ColorOfHmiMovgObj_0",   /*src_can*/"ZCU_CANFD1",   /*src_network_type*/"CANFD",   /*src_slotid_fr*/0,   /*src_basecycle_fr*/0,  /*src_repetition_fr*/0,  /*src_startbit*/38,   /*sigG_length*/3,  /*des_slotid_fr*/0,   /*des_basecycle_fr*/0,  /*des_repetition_fr*/0,   /*des_startbit*/70,    /*src_cyc*/101,  /*src_id*/0x1b5,   /*src_dlc*/64,   /*des_id*/0x13c, /*updatebit_S*/35,   /*updatebit_D*/67         },
           {   /*sigGroup_s*/"igVehCfgPrmExt_0",   /*sig_name*/"isVehCfgPrmExtCCPBytePosn8_0",   /*src_can*/"ZCU_CANFD1",   /*src_network_type*/"CANFD",   /*src_slotid_fr*/0,   /*src_basecycle_fr*/0,  /*src_repetition_fr*/0,  /*src_startbit*/127,   /*sigG_length*/8,  /*des_slotid_fr*/0,   /*des_basecycle_fr*/0,  /*des_repetition_fr*/0,   /*des_startbit*/407,    /*src_cyc*/101,  /*src_id*/0x1f5,   /*src_dlc*/64,   /*des_id*/0x16f, /*updatebit_S*/198,   /*updatebit_D*/232         },
           {   /*sigGroup_s*/"igVehCfgPrmExt_0",   /*sig_name*/"isVehCfgPrmExtCCPBytePosn6_0",   /*src_can*/"ZCU_CANFD1",   /*src_network_type*/"CANFD",   /*src_slotid_fr*/0,   /*src_basecycle_fr*/0,  /*src_repetition_fr*/0,  /*src_startbit*/111,   /*sigG_length*/8,  /*des_slotid_fr*/0,   /*des_basecycle_fr*/0,  /*des_repetition_fr*/0,   /*des_startbit*/391,    /*src_cyc*/101,  /*src_id*/0x1f5,   /*src_dlc*/64,   /*des_id*/0x16f, /*updatebit_S*/198,   /*updatebit_D*/232         },
           {   /*sigGroup_s*/"igVehCfgPrmExt_0",   /*sig_name*/"isVehCfgPrmExtCCPBytePosn4_0",   /*src_can*/"ZCU_CANFD1",   /*src_network_type*/"CANFD",   /*src_slotid_fr*/0,   /*src_basecycle_fr*/0,  /*src_repetition_fr*/0,  /*src_startbit*/95,   /*sigG_length*/8,  /*des_slotid_fr*/0,   /*des_basecycle_fr*/0,  /*des_repetition_fr*/0,   /*des_startbit*/375,    /*src_cyc*/101,  /*src_id*/0x1f5,   /*src_dlc*/64,   /*des_id*/0x16f, /*updatebit_S*/198,   /*updatebit_D*/232         },
           {   /*sigGroup_s*/"igVehCfgPrmExt_0",   /*sig_name*/"isVehCfgPrmExtCCPBytePosn3_0",   /*src_can*/"ZCU_CANFD1",   /*src_network_type*/"CANFD",   /*src_slotid_fr*/0,   /*src_basecycle_fr*/0,  /*src_repetition_fr*/0,  /*src_startbit*/87,   /*sigG_length*/8,  /*des_slotid_fr*/0,   /*des_basecycle_fr*/0,  /*des_repetition_fr*/0,   /*des_startbit*/367,    /*src_cyc*/101,  /*src_id*/0x1f5,   /*src_dlc*/64,   /*des_id*/0x16f, /*updatebit_S*/198,   /*updatebit_D*/232         },
           {   /*sigGroup_s*/"igVehCfgPrmExt_0",   /*sig_name*/"isVehCfgPrmExtCCPBytePosn2_0",   /*src_can*/"ZCU_CANFD1",   /*src_network_type*/"CANFD",   /*src_slotid_fr*/0,   /*src_basecycle_fr*/0,  /*src_repetition_fr*/0,  /*src_startbit*/79,   /*sigG_length*/8,  /*des_slotid_fr*/0,   /*des_basecycle_fr*/0,  /*des_repetition_fr*/0,   /*des_startbit*/359,    /*src_cyc*/101,  /*src_id*/0x1f5,   /*src_dlc*/64,   /*des_id*/0x16f, /*updatebit_S*/198,   /*updatebit_D*/232         },
           {   /*sigGroup_s*/"igVehCfgPrmExt_0",   /*sig_name*/"isVehCfgPrmExtBlkIDBytePosn1_0",   /*src_can*/"ZCU_CANFD1",   /*src_network_type*/"CANFD",   /*src_slotid_fr*/0,   /*src_basecycle_fr*/0,  /*src_repetition_fr*/0,  /*src_startbit*/71,   /*sigG_length*/8,  /*des_slotid_fr*/0,   /*des_basecycle_fr*/0,  /*des_repetition_fr*/0,   /*des_startbit*/351,    /*src_cyc*/101,  /*src_id*/0x1f5,   /*src_dlc*/64,   /*des_id*/0x16f, /*updatebit_S*/198,   /*updatebit_D*/232         },
           {   /*sigGroup_s*/"igVehCfgPrmExt_0",   /*sig_name*/"isVehCfgPrmExtCCPBytePosn5_0",   /*src_can*/"ZCU_CANFD1",   /*src_network_type*/"CANFD",   /*src_slotid_fr*/0,   /*src_basecycle_fr*/0,  /*src_repetition_fr*/0,  /*src_startbit*/103,   /*sigG_length*/8,  /*des_slotid_fr*/0,   /*des_basecycle_fr*/0,  /*des_repetition_fr*/0,   /*des_startbit*/383,    /*src_cyc*/101,  /*src_id*/0x1f5,   /*src_dlc*/64,   /*des_id*/0x16f, /*updatebit_S*/198,   /*updatebit_D*/232         },
           {   /*sigGroup_s*/"igVehCfgPrmExt_0",   /*sig_name*/"isVehCfgPrmExtCCPBytePosn7_0",   /*src_can*/"ZCU_CANFD1",   /*src_network_type*/"CANFD",   /*src_slotid_fr*/0,   /*src_basecycle_fr*/0,  /*src_repetition_fr*/0,  /*src_startbit*/119,   /*sigG_length*/8,  /*des_slotid_fr*/0,   /*des_basecycle_fr*/0,  /*des_repetition_fr*/0,   /*des_startbit*/399,    /*src_cyc*/101,  /*src_id*/0x1f5,   /*src_dlc*/64,   /*des_id*/0x16f, /*updatebit_S*/198,   /*updatebit_D*/232         },
           {   /*sigGroup_s*/"igPosnFromSatlt_0",   /*sig_name*/"isPosnFromSatltUTCForHr_0",   /*src_can*/"ZCU_CANFD1",   /*src_network_type*/"CANFD",   /*src_slotid_fr*/0,   /*src_basecycle_fr*/0,  /*src_repetition_fr*/0,  /*src_startbit*/296,   /*sigG_length*/5,  /*des_slotid_fr*/0,   /*des_basecycle_fr*/0,  /*des_repetition_fr*/0,   /*des_startbit*/184,    /*src_cyc*/101,  /*src_id*/0x56,   /*src_dlc*/64,   /*des_id*/0x59, /*updatebit_S*/352,   /*updatebit_D*/204         },
           {   /*sigGroup_s*/"igPosnFromSatlt_0",   /*sig_name*/"isPosnFromSatltPosnSpd_0",   /*src_can*/"ZCU_CANFD1",   /*src_network_type*/"CANFD",   /*src_slotid_fr*/0,   /*src_basecycle_fr*/0,  /*src_repetition_fr*/0,  /*src_startbit*/184,   /*sigG_length*/17,  /*des_slotid_fr*/0,   /*des_basecycle_fr*/0,  /*des_repetition_fr*/0,   /*des_startbit*/72,    /*src_cyc*/101,  /*src_id*/0x56,   /*src_dlc*/64,   /*des_id*/0x59, /*updatebit_S*/352,   /*updatebit_D*/204         },
           {   /*sigGroup_s*/"igPosnFromSatlt_0",   /*sig_name*/"isPosnFromSatltPosnAlti_0",   /*src_can*/"ZCU_CANFD1",   /*src_network_type*/"CANFD",   /*src_slotid_fr*/0,   /*src_basecycle_fr*/0,  /*src_repetition_fr*/0,  /*src_startbit*/230,   /*sigG_length*/16,  /*des_slotid_fr*/0,   /*des_basecycle_fr*/0,  /*des_repetition_fr*/0,   /*des_startbit*/118,    /*src_cyc*/101,  /*src_id*/0x56,   /*src_dlc*/64,   /*des_id*/0x59, /*updatebit_S*/352,   /*updatebit_D*/204         },
           {   /*sigGroup_s*/"igPosnFromSatlt_0",   /*sig_name*/"isPosnFromSatltTiForSec_0",   /*src_can*/"ZCU_CANFD1",   /*src_network_type*/"CANFD",   /*src_slotid_fr*/0,   /*src_basecycle_fr*/0,  /*src_repetition_fr*/0,  /*src_startbit*/287,   /*sigG_length*/6,  /*des_slotid_fr*/0,   /*des_basecycle_fr*/0,  /*des_repetition_fr*/0,   /*des_startbit*/175,    /*src_cyc*/101,  /*src_id*/0x56,   /*src_dlc*/64,   /*des_id*/0x59, /*updatebit_S*/352,   /*updatebit_D*/204         },
           {   /*sigGroup_s*/"igPosnFromSatlt_0",   /*sig_name*/"isPosnFromSatltTiForMsec_0",   /*src_can*/"ZCU_CANFD1",   /*src_network_type*/"CANFD",   /*src_slotid_fr*/0,   /*src_basecycle_fr*/0,  /*src_repetition_fr*/0,  /*src_startbit*/262,   /*sigG_length*/10,  /*des_slotid_fr*/0,   /*des_basecycle_fr*/0,  /*des_repetition_fr*/0,   /*des_startbit*/150,    /*src_cyc*/101,  /*src_id*/0x56,   /*src_dlc*/64,   /*des_id*/0x59, /*updatebit_S*/352,   /*updatebit_D*/204         },
           {   /*sigGroup_s*/"igPosnFromSatlt_0",   /*sig_name*/"isPosnFromSatltUTCForDay_0",   /*src_can*/"ZCU_CANFD1",   /*src_network_type*/"CANFD",   /*src_slotid_fr*/0,   /*src_basecycle_fr*/0,  /*src_repetition_fr*/0,  /*src_startbit*/301,   /*sigG_length*/5,  /*des_slotid_fr*/0,   /*des_basecycle_fr*/0,  /*des_repetition_fr*/0,   /*des_startbit*/189,    /*src_cyc*/101,  /*src_id*/0x56,   /*src_dlc*/64,   /*des_id*/0x59, /*updatebit_S*/352,   /*updatebit_D*/204         },
           {   /*sigGroup_s*/"igPosnFromSatlt_0",   /*sig_name*/"isPosnFromSatltPosnVVert_0",   /*src_can*/"ZCU_CANFD1",   /*src_network_type*/"CANFD",   /*src_slotid_fr*/0,   /*src_basecycle_fr*/0,  /*src_repetition_fr*/0,  /*src_startbit*/170,   /*sigG_length*/18,  /*des_slotid_fr*/0,   /*des_basecycle_fr*/0,  /*des_repetition_fr*/0,   /*des_startbit*/58,    /*src_cyc*/101,  /*src_id*/0x56,   /*src_dlc*/64,   /*des_id*/0x59, /*updatebit_S*/352,   /*updatebit_D*/204         },
           {   /*sigGroup_s*/"igPosnFromSatlt_0",   /*sig_name*/"isPosnFromSatltPosnLat_0",   /*src_can*/"ZCU_CANFD1",   /*src_network_type*/"CANFD",   /*src_slotid_fr*/0,   /*src_basecycle_fr*/0,  /*src_repetition_fr*/0,  /*src_startbit*/136,   /*sigG_length*/30,  /*des_slotid_fr*/0,   /*des_basecycle_fr*/0,  /*des_repetition_fr*/0,   /*des_startbit*/24,    /*src_cyc*/101,  /*src_id*/0x56,   /*src_dlc*/64,   /*des_id*/0x59, /*updatebit_S*/352,   /*updatebit_D*/204         },
           {   /*sigGroup_s*/"igPosnFromSatlt_0",   /*sig_name*/"isPosnFromSatltPosnVHozl_0",   /*src_can*/"ZCU_CANFD1",   /*src_network_type*/"CANFD",   /*src_slotid_fr*/0,   /*src_basecycle_fr*/0,  /*src_repetition_fr*/0,  /*src_startbit*/215,   /*sigG_length*/17,  /*des_slotid_fr*/0,   /*des_basecycle_fr*/0,  /*des_repetition_fr*/0,   /*des_startbit*/103,    /*src_cyc*/101,  /*src_id*/0x56,   /*src_dlc*/64,   /*des_id*/0x59, /*updatebit_S*/352,   /*updatebit_D*/204         },
           {   /*sigGroup_s*/"igPosnFromSatlt_0",   /*sig_name*/"isPosnFromSatltPosnDir_0",   /*src_can*/"ZCU_CANFD1",   /*src_network_type*/"CANFD",   /*src_slotid_fr*/0,   /*src_basecycle_fr*/0,  /*src_repetition_fr*/0,  /*src_startbit*/246,   /*sigG_length*/16,  /*des_slotid_fr*/0,   /*des_basecycle_fr*/0,  /*des_repetition_fr*/0,   /*des_startbit*/134,    /*src_cyc*/101,  /*src_id*/0x56,   /*src_dlc*/64,   /*des_id*/0x59, /*updatebit_S*/352,   /*updatebit_D*/204         },
           {   /*sigGroup_s*/"igPosnFromSatlt_0",   /*sig_name*/"isPosnFromSatltUTCForMth_0",   /*src_can*/"ZCU_CANFD1",   /*src_network_type*/"CANFD",   /*src_slotid_fr*/0,   /*src_basecycle_fr*/0,  /*src_repetition_fr*/0,  /*src_startbit*/307,   /*sigG_length*/4,  /*des_slotid_fr*/0,   /*des_basecycle_fr*/0,  /*des_repetition_fr*/0,   /*des_startbit*/195,    /*src_cyc*/101,  /*src_id*/0x56,   /*src_dlc*/64,   /*des_id*/0x59, /*updatebit_S*/352,   /*updatebit_D*/204         },
           {   /*sigGroup_s*/"igPosnFromSatlt_0",   /*sig_name*/"isPosnFromSatltTiForMins_0",   /*src_can*/"ZCU_CANFD1",   /*src_network_type*/"CANFD",   /*src_slotid_fr*/0,   /*src_basecycle_fr*/0,  /*src_repetition_fr*/0,  /*src_startbit*/277,   /*sigG_length*/6,  /*des_slotid_fr*/0,   /*des_basecycle_fr*/0,  /*des_repetition_fr*/0,   /*des_startbit*/165,    /*src_cyc*/101,  /*src_id*/0x56,   /*src_dlc*/64,   /*des_id*/0x59, /*updatebit_S*/352,   /*updatebit_D*/204         },
           {   /*sigGroup_s*/"igPosnFromSatlt_0",   /*sig_name*/"isPosnFromSatltCntr_0",   /*src_can*/"ZCU_CANFD1",   /*src_network_type*/"CANFD",   /*src_slotid_fr*/0,   /*src_basecycle_fr*/0,  /*src_repetition_fr*/0,  /*src_startbit*/319,   /*sigG_length*/3,  /*des_slotid_fr*/0,   /*des_basecycle_fr*/0,  /*des_repetition_fr*/0,   /*des_startbit*/207,    /*src_cyc*/101,  /*src_id*/0x56,   /*src_dlc*/64,   /*des_id*/0x59, /*updatebit_S*/352,   /*updatebit_D*/204         },
           {   /*sigGroup_s*/"igPosnFromSatlt_0",   /*sig_name*/"isPosnFromSatltUTCForSec_0",   /*src_can*/"ZCU_CANFD1",   /*src_network_type*/"CANFD",   /*src_slotid_fr*/0,   /*src_basecycle_fr*/0,  /*src_repetition_fr*/0,  /*src_startbit*/291,   /*sigG_length*/6,  /*des_slotid_fr*/0,   /*des_basecycle_fr*/0,  /*des_repetition_fr*/0,   /*des_startbit*/179,    /*src_cyc*/101,  /*src_id*/0x56,   /*src_dlc*/64,   /*des_id*/0x59, /*updatebit_S*/352,   /*updatebit_D*/204         },
           {   /*sigGroup_s*/"igPosnFromSatlt_0",   /*sig_name*/"isPosnFromSatltUTCForMins_0",   /*src_can*/"ZCU_CANFD1",   /*src_network_type*/"CANFD",   /*src_slotid_fr*/0,   /*src_basecycle_fr*/0,  /*src_repetition_fr*/0,  /*src_startbit*/281,   /*sigG_length*/6,  /*des_slotid_fr*/0,   /*des_basecycle_fr*/0,  /*des_repetition_fr*/0,   /*des_startbit*/169,    /*src_cyc*/101,  /*src_id*/0x56,   /*src_dlc*/64,   /*des_id*/0x59, /*updatebit_S*/352,   /*updatebit_D*/204         },
           {   /*sigGroup_s*/"igPosnFromSatlt_0",   /*sig_name*/"isPosnFromSatltPosnLgt_0",   /*src_can*/"ZCU_CANFD1",   /*src_network_type*/"CANFD",   /*src_slotid_fr*/0,   /*src_basecycle_fr*/0,  /*src_repetition_fr*/0,  /*src_startbit*/119,   /*sigG_length*/31,  /*des_slotid_fr*/0,   /*des_basecycle_fr*/0,  /*des_repetition_fr*/0,   /*des_startbit*/7,    /*src_cyc*/101,  /*src_id*/0x56,   /*src_dlc*/64,   /*des_id*/0x59, /*updatebit_S*/352,   /*updatebit_D*/204         },
           {   /*sigGroup_s*/"igPosnFromSatlt_0",   /*sig_name*/"isPosnFromSatltUTCForYr_0",   /*src_can*/"ZCU_CANFD1",   /*src_network_type*/"CANFD",   /*src_slotid_fr*/0,   /*src_basecycle_fr*/0,  /*src_repetition_fr*/0,  /*src_startbit*/268,   /*sigG_length*/7,  /*des_slotid_fr*/0,   /*des_basecycle_fr*/0,  /*des_repetition_fr*/0,   /*des_startbit*/156,    /*src_cyc*/101,  /*src_id*/0x56,   /*src_dlc*/64,   /*des_id*/0x59, /*updatebit_S*/352,   /*updatebit_D*/204         },
           {   /*sigGroup_s*/"igVehCfgPrmExt2_0",   /*sig_name*/"isVehCfgPrmExt2BlkIDBytePosn1_0",   /*src_can*/"ZCU_CANFD1",   /*src_network_type*/"CANFD",   /*src_slotid_fr*/0,   /*src_basecycle_fr*/0,  /*src_repetition_fr*/0,  /*src_startbit*/135,   /*sigG_length*/8,  /*des_slotid_fr*/0,   /*des_basecycle_fr*/0,  /*des_repetition_fr*/0,   /*des_startbit*/415,    /*src_cyc*/101,  /*src_id*/0x1f5,   /*src_dlc*/64,   /*des_id*/0x16f, /*updatebit_S*/197,   /*updatebit_D*/233         },
           {   /*sigGroup_s*/"igVehCfgPrmExt2_0",   /*sig_name*/"isVehCfgPrmExt2CCPBytePosn2_0",   /*src_can*/"ZCU_CANFD1",   /*src_network_type*/"CANFD",   /*src_slotid_fr*/0,   /*src_basecycle_fr*/0,  /*src_repetition_fr*/0,  /*src_startbit*/143,   /*sigG_length*/8,  /*des_slotid_fr*/0,   /*des_basecycle_fr*/0,  /*des_repetition_fr*/0,   /*des_startbit*/423,    /*src_cyc*/101,  /*src_id*/0x1f5,   /*src_dlc*/64,   /*des_id*/0x16f, /*updatebit_S*/197,   /*updatebit_D*/233         },
           {   /*sigGroup_s*/"igVehCfgPrmExt2_0",   /*sig_name*/"isVehCfgPrmExt2CCPBytePosn6_0",   /*src_can*/"ZCU_CANFD1",   /*src_network_type*/"CANFD",   /*src_slotid_fr*/0,   /*src_basecycle_fr*/0,  /*src_repetition_fr*/0,  /*src_startbit*/175,   /*sigG_length*/8,  /*des_slotid_fr*/0,   /*des_basecycle_fr*/0,  /*des_repetition_fr*/0,   /*des_startbit*/455,    /*src_cyc*/101,  /*src_id*/0x1f5,   /*src_dlc*/64,   /*des_id*/0x16f, /*updatebit_S*/197,   /*updatebit_D*/233         },
           {   /*sigGroup_s*/"igVehCfgPrmExt2_0",   /*sig_name*/"isVehCfgPrmExt2CCPBytePosn4_0",   /*src_can*/"ZCU_CANFD1",   /*src_network_type*/"CANFD",   /*src_slotid_fr*/0,   /*src_basecycle_fr*/0,  /*src_repetition_fr*/0,  /*src_startbit*/159,   /*sigG_length*/8,  /*des_slotid_fr*/0,   /*des_basecycle_fr*/0,  /*des_repetition_fr*/0,   /*des_startbit*/439,    /*src_cyc*/101,  /*src_id*/0x1f5,   /*src_dlc*/64,   /*des_id*/0x16f, /*updatebit_S*/197,   /*updatebit_D*/233         },
           {   /*sigGroup_s*/"igVehCfgPrmExt2_0",   /*sig_name*/"isVehCfgPrmExt2CCPBytePosn5_0",   /*src_can*/"ZCU_CANFD1",   /*src_network_type*/"CANFD",   /*src_slotid_fr*/0,   /*src_basecycle_fr*/0,  /*src_repetition_fr*/0,  /*src_startbit*/167,   /*sigG_length*/8,  /*des_slotid_fr*/0,   /*des_basecycle_fr*/0,  /*des_repetition_fr*/0,   /*des_startbit*/447,    /*src_cyc*/101,  /*src_id*/0x1f5,   /*src_dlc*/64,   /*des_id*/0x16f, /*updatebit_S*/197,   /*updatebit_D*/233         },
           {   /*sigGroup_s*/"igVehCfgPrmExt2_0",   /*sig_name*/"isVehCfgPrmExt2CCPBytePosn3_0",   /*src_can*/"ZCU_CANFD1",   /*src_network_type*/"CANFD",   /*src_slotid_fr*/0,   /*src_basecycle_fr*/0,  /*src_repetition_fr*/0,  /*src_startbit*/151,   /*sigG_length*/8,  /*des_slotid_fr*/0,   /*des_basecycle_fr*/0,  /*des_repetition_fr*/0,   /*des_startbit*/431,    /*src_cyc*/101,  /*src_id*/0x1f5,   /*src_dlc*/64,   /*des_id*/0x16f, /*updatebit_S*/197,   /*updatebit_D*/233         },
           {   /*sigGroup_s*/"igVehCfgPrmExt2_0",   /*sig_name*/"isVehCfgPrmExt2CCPBytePosn7_0",   /*src_can*/"ZCU_CANFD1",   /*src_network_type*/"CANFD",   /*src_slotid_fr*/0,   /*src_basecycle_fr*/0,  /*src_repetition_fr*/0,  /*src_startbit*/183,   /*sigG_length*/8,  /*des_slotid_fr*/0,   /*des_basecycle_fr*/0,  /*des_repetition_fr*/0,   /*des_startbit*/463,    /*src_cyc*/101,  /*src_id*/0x1f5,   /*src_dlc*/64,   /*des_id*/0x16f, /*updatebit_S*/197,   /*updatebit_D*/233         },
           {   /*sigGroup_s*/"igVehCfgPrmExt2_0",   /*sig_name*/"isVehCfgPrmExt2CCPBytePosn8_0",   /*src_can*/"ZCU_CANFD1",   /*src_network_type*/"CANFD",   /*src_slotid_fr*/0,   /*src_basecycle_fr*/0,  /*src_repetition_fr*/0,  /*src_startbit*/191,   /*sigG_length*/8,  /*des_slotid_fr*/0,   /*des_basecycle_fr*/0,  /*des_repetition_fr*/0,   /*des_startbit*/471,    /*src_cyc*/101,  /*src_id*/0x1f5,   /*src_dlc*/64,   /*des_id*/0x16f, /*updatebit_S*/197,   /*updatebit_D*/233         },
           {   /*sigGroup_s*/"igHznProfSho_0",   /*sig_name*/"isHznProfShoUpdate_0",   /*src_can*/"ZCU_CANFD1",   /*src_network_type*/"CANFD",   /*src_slotid_fr*/0,   /*src_basecycle_fr*/0,  /*src_repetition_fr*/0,  /*src_startbit*/186,   /*sigG_length*/1,  /*des_slotid_fr*/0,   /*des_basecycle_fr*/0,  /*des_repetition_fr*/0,   /*des_startbit*/368,    /*src_cyc*/101,  /*src_id*/0x338,   /*src_dlc*/64,   /*des_id*/0x13c, /*updatebit_S*/128,   /*updatebit_D*/232         },
           {   /*sigGroup_s*/"igHznProfSho_0",   /*sig_name*/"isHznProfShoProfileType_0",   /*src_can*/"ZCU_CANFD1",   /*src_network_type*/"CANFD",   /*src_slotid_fr*/0,   /*src_basecycle_fr*/0,  /*src_repetition_fr*/0,  /*src_startbit*/191,   /*sigG_length*/5,  /*des_slotid_fr*/0,   /*des_basecycle_fr*/0,  /*des_repetition_fr*/0,   /*des_startbit*/366,    /*src_cyc*/101,  /*src_id*/0x338,   /*src_dlc*/64,   /*des_id*/0x13c, /*updatebit_S*/128,   /*updatebit_D*/232         },
           {   /*sigGroup_s*/"igHznProfSho_0",   /*sig_name*/"isHznProfShoDistance1_0",   /*src_can*/"ZCU_CANFD1",   /*src_network_type*/"CANFD",   /*src_slotid_fr*/0,   /*src_basecycle_fr*/0,  /*src_repetition_fr*/0,  /*src_startbit*/137,   /*sigG_length*/10,  /*des_slotid_fr*/0,   /*des_basecycle_fr*/0,  /*des_repetition_fr*/0,   /*des_startbit*/322,    /*src_cyc*/101,  /*src_id*/0x338,   /*src_dlc*/64,   /*des_id*/0x13c, /*updatebit_S*/128,   /*updatebit_D*/232         },
           {   /*sigGroup_s*/"igHznProfSho_0",   /*sig_name*/"isHznProfShoAccuracy_0",   /*src_can*/"ZCU_CANFD1",   /*src_network_type*/"CANFD",   /*src_slotid_fr*/0,   /*src_basecycle_fr*/0,  /*src_repetition_fr*/0,  /*src_startbit*/143,   /*sigG_length*/2,  /*des_slotid_fr*/0,   /*des_basecycle_fr*/0,  /*des_repetition_fr*/0,   /*des_startbit*/374,    /*src_cyc*/101,  /*src_id*/0x338,   /*src_dlc*/64,   /*des_id*/0x13c, /*updatebit_S*/128,   /*updatebit_D*/232         },
           {   /*sigGroup_s*/"igHznProfSho_0",   /*sig_name*/"isHznProfShoRetransmission_0",   /*src_can*/"ZCU_CANFD1",   /*src_network_type*/"CANFD",   /*src_slotid_fr*/0,   /*src_basecycle_fr*/0,  /*src_repetition_fr*/0,  /*src_startbit*/138,   /*sigG_length*/1,  /*des_slotid_fr*/0,   /*des_basecycle_fr*/0,  /*des_repetition_fr*/0,   /*des_startbit*/369,    /*src_cyc*/101,  /*src_id*/0x338,   /*src_dlc*/64,   /*des_id*/0x13c, /*updatebit_S*/128,   /*updatebit_D*/232         },
           {   /*sigGroup_s*/"igHznProfSho_0",   /*sig_name*/"isHznProfShoCyclicCounter_0",   /*src_can*/"ZCU_CANFD1",   /*src_network_type*/"CANFD",   /*src_slotid_fr*/0,   /*src_basecycle_fr*/0,  /*src_repetition_fr*/0,  /*src_startbit*/140,   /*sigG_length*/2,  /*des_slotid_fr*/0,   /*des_basecycle_fr*/0,  /*des_repetition_fr*/0,   /*des_startbit*/372,    /*src_cyc*/101,  /*src_id*/0x338,   /*src_dlc*/64,   /*des_id*/0x13c, /*updatebit_S*/128,   /*updatebit_D*/232         },
           {   /*sigGroup_s*/"igHznProfSho_0",   /*sig_name*/"isHznProfShoPathIndex_0",   /*src_can*/"ZCU_CANFD1",   /*src_network_type*/"CANFD",   /*src_slotid_fr*/0,   /*src_basecycle_fr*/0,  /*src_repetition_fr*/0,  /*src_startbit*/175,   /*sigG_length*/6,  /*des_slotid_fr*/0,   /*des_basecycle_fr*/0,  /*des_repetition_fr*/0,   /*des_startbit*/356,    /*src_cyc*/101,  /*src_id*/0x338,   /*src_dlc*/64,   /*des_id*/0x13c, /*updatebit_S*/128,   /*updatebit_D*/232         },
           {   /*sigGroup_s*/"igHznProfSho_0",   /*sig_name*/"isHznProfShoValue0_0",   /*src_can*/"ZCU_CANFD1",   /*src_network_type*/"CANFD",   /*src_slotid_fr*/0,   /*src_basecycle_fr*/0,  /*src_repetition_fr*/0,  /*src_startbit*/169,   /*sigG_length*/10,  /*des_slotid_fr*/0,   /*des_basecycle_fr*/0,  /*des_repetition_fr*/0,   /*des_startbit*/328,    /*src_cyc*/101,  /*src_id*/0x338,   /*src_dlc*/64,   /*des_id*/0x13c, /*updatebit_S*/128,   /*updatebit_D*/232         },
           {   /*sigGroup_s*/"igHznProfSho_0",   /*sig_name*/"isHznProfShoValue1_0",   /*src_can*/"ZCU_CANFD1",   /*src_network_type*/"CANFD",   /*src_slotid_fr*/0,   /*src_basecycle_fr*/0,  /*src_repetition_fr*/0,  /*src_startbit*/185,   /*sigG_length*/10,  /*des_slotid_fr*/0,   /*des_basecycle_fr*/0,  /*des_repetition_fr*/0,   /*des_startbit*/350,    /*src_cyc*/101,  /*src_id*/0x338,   /*src_dlc*/64,   /*des_id*/0x13c, /*updatebit_S*/128,   /*updatebit_D*/232         },
           {   /*sigGroup_s*/"igHznProfSho_0",   /*sig_name*/"isHznProfShoControlPoint_0",   /*src_can*/"ZCU_CANFD1",   /*src_network_type*/"CANFD",   /*src_slotid_fr*/0,   /*src_basecycle_fr*/0,  /*src_repetition_fr*/0,  /*src_startbit*/141,   /*sigG_length*/1,  /*des_slotid_fr*/0,   /*des_basecycle_fr*/0,  /*des_repetition_fr*/0,   /*des_startbit*/370,    /*src_cyc*/101,  /*src_id*/0x338,   /*src_dlc*/64,   /*des_id*/0x13c, /*updatebit_S*/128,   /*updatebit_D*/232         },
           {   /*sigGroup_s*/"igHznProfSho_0",   /*sig_name*/"isHznProfShoMessageType_0",   /*src_can*/"ZCU_CANFD1",   /*src_network_type*/"CANFD",   /*src_slotid_fr*/0,   /*src_basecycle_fr*/0,  /*src_repetition_fr*/0,  /*src_startbit*/159,   /*sigG_length*/3,  /*des_slotid_fr*/0,   /*des_basecycle_fr*/0,  /*des_repetition_fr*/0,   /*des_startbit*/361,    /*src_cyc*/101,  /*src_id*/0x338,   /*src_dlc*/64,   /*des_id*/0x13c, /*updatebit_S*/128,   /*updatebit_D*/232         },
           {   /*sigGroup_s*/"igHznProfSho_0",   /*sig_name*/"isHznProfShoOffset_0",   /*src_can*/"ZCU_CANFD1",   /*src_network_type*/"CANFD",   /*src_slotid_fr*/0,   /*src_basecycle_fr*/0,  /*src_repetition_fr*/0,  /*src_startbit*/156,   /*sigG_length*/13,  /*des_slotid_fr*/0,   /*des_basecycle_fr*/0,  /*des_repetition_fr*/0,   /*des_startbit*/319,    /*src_cyc*/101,  /*src_id*/0x338,   /*src_dlc*/64,   /*des_id*/0x13c, /*updatebit_S*/128,   /*updatebit_D*/232         },
           {   /*sigGroup_s*/"igVehSpdIndcd_0",   /*sig_name*/"isVehSpdIndcdVeSpdIndcdUnit_0",   /*src_can*/"ZCU_CANFD1",   /*src_network_type*/"CANFD",   /*src_slotid_fr*/0,   /*src_basecycle_fr*/0,  /*src_repetition_fr*/0,  /*src_startbit*/134,   /*sigG_length*/2,  /*des_slotid_fr*/0,   /*des_basecycle_fr*/0,  /*des_repetition_fr*/0,   /*des_startbit*/214,    /*src_cyc*/101,  /*src_id*/0x160,   /*src_dlc*/64,   /*des_id*/0xdf, /*updatebit_S*/132,   /*updatebit_D*/212         },
           {   /*sigGroup_s*/"igVehSpdIndcd_0",   /*sig_name*/"isVehSpdIndcdVehSpdIndcd_0",   /*src_can*/"ZCU_CANFD1",   /*src_network_type*/"CANFD",   /*src_slotid_fr*/0,   /*src_basecycle_fr*/0,  /*src_repetition_fr*/0,  /*src_startbit*/127,   /*sigG_length*/9,  /*des_slotid_fr*/0,   /*des_basecycle_fr*/0,  /*des_repetition_fr*/0,   /*des_startbit*/207,    /*src_cyc*/101,  /*src_id*/0x160,   /*src_dlc*/64,   /*des_id*/0xdf, /*updatebit_S*/132,   /*updatebit_D*/212         },
           {   /*sigGroup_s*/"igHznEdge_0",   /*sig_name*/"isHznEdgeCyclicCounter_0",   /*src_can*/"ZCU_CANFD1",   /*src_network_type*/"CANFD",   /*src_slotid_fr*/0,   /*src_basecycle_fr*/0,  /*src_repetition_fr*/0,  /*src_startbit*/5,   /*sigG_length*/2,  /*des_slotid_fr*/0,   /*des_basecycle_fr*/0,  /*des_repetition_fr*/0,   /*des_startbit*/298,    /*src_cyc*/101,  /*src_id*/0x338,   /*src_dlc*/64,   /*des_id*/0x13c, /*updatebit_S*/66,   /*updatebit_D*/224         },
           {   /*sigGroup_s*/"igHznEdge_0",   /*sig_name*/"isHznEdgeRelativeProbability_0",   /*src_can*/"ZCU_CANFD1",   /*src_network_type*/"CANFD",   /*src_slotid_fr*/0,   /*src_basecycle_fr*/0,  /*src_repetition_fr*/0,  /*src_startbit*/71,   /*sigG_length*/5,  /*des_slotid_fr*/0,   /*des_basecycle_fr*/0,  /*des_repetition_fr*/0,   /*des_startbit*/286,    /*src_cyc*/101,  /*src_id*/0x338,   /*src_dlc*/64,   /*des_id*/0x13c, /*updatebit_S*/66,   /*updatebit_D*/224         },
           {   /*sigGroup_s*/"igHznEdge_0",   /*sig_name*/"isHznEdgeComplexIntersection_0",   /*src_can*/"ZCU_CANFD1",   /*src_network_type*/"CANFD",   /*src_slotid_fr*/0,   /*src_basecycle_fr*/0,  /*src_repetition_fr*/0,  /*src_startbit*/7,   /*sigG_length*/2,  /*des_slotid_fr*/0,   /*des_basecycle_fr*/0,  /*des_repetition_fr*/0,   /*des_startbit*/300,    /*src_cyc*/101,  /*src_id*/0x338,   /*src_dlc*/64,   /*des_id*/0x13c, /*updatebit_S*/66,   /*updatebit_D*/224         },
           {   /*sigGroup_s*/"igHznEdge_0",   /*sig_name*/"isHznEdgeNumberOfLanesInOppositeDirection_0",   /*src_can*/"ZCU_CANFD1",   /*src_network_type*/"CANFD",   /*src_slotid_fr*/0,   /*src_basecycle_fr*/0,  /*src_repetition_fr*/0,  /*src_startbit*/39,   /*sigG_length*/2,  /*des_slotid_fr*/0,   /*des_basecycle_fr*/0,  /*des_repetition_fr*/0,   /*des_startbit*/296,    /*src_cyc*/101,  /*src_id*/0x338,   /*src_dlc*/64,   /*des_id*/0x13c, /*updatebit_S*/66,   /*updatebit_D*/224         },
           {   /*sigGroup_s*/"igHznEdge_0",   /*sig_name*/"isHznEdgeLastStubAtOffset_0",   /*src_can*/"ZCU_CANFD1",   /*src_network_type*/"CANFD",   /*src_slotid_fr*/0,   /*src_basecycle_fr*/0,  /*src_repetition_fr*/0,  /*src_startbit*/12,   /*sigG_length*/1,  /*des_slotid_fr*/0,   /*des_basecycle_fr*/0,  /*des_repetition_fr*/0,   /*des_startbit*/306,    /*src_cyc*/101,  /*src_id*/0x338,   /*src_dlc*/64,   /*des_id*/0x13c, /*updatebit_S*/66,   /*updatebit_D*/224         },
           {   /*sigGroup_s*/"igHznEdge_0",   /*sig_name*/"isHznEdgeSubPathIndex_0",   /*src_can*/"ZCU_CANFD1",   /*src_network_type*/"CANFD",   /*src_slotid_fr*/0,   /*src_basecycle_fr*/0,  /*src_repetition_fr*/0,  /*src_startbit*/63,   /*sigG_length*/6,  /*des_slotid_fr*/0,   /*des_basecycle_fr*/0,  /*des_repetition_fr*/0,   /*des_startbit*/276,    /*src_cyc*/101,  /*src_id*/0x338,   /*src_dlc*/64,   /*des_id*/0x13c, /*updatebit_S*/66,   /*updatebit_D*/224         },
           {   /*sigGroup_s*/"igHznEdge_0",   /*sig_name*/"isHznEdgeTurnAngle_0",   /*src_can*/"ZCU_CANFD1",   /*src_network_type*/"CANFD",   /*src_slotid_fr*/0,   /*src_basecycle_fr*/0,  /*src_repetition_fr*/0,  /*src_startbit*/55,   /*sigG_length*/8,  /*des_slotid_fr*/0,   /*des_basecycle_fr*/0,  /*des_repetition_fr*/0,   /*des_startbit*/258,    /*src_cyc*/101,  /*src_id*/0x338,   /*src_dlc*/64,   /*des_id*/0x13c, /*updatebit_S*/66,   /*updatebit_D*/224         },
           {   /*sigGroup_s*/"igHznEdge_0",   /*sig_name*/"isHznEdgeOffset_0",   /*src_can*/"ZCU_CANFD1",   /*src_network_type*/"CANFD",   /*src_slotid_fr*/0,   /*src_basecycle_fr*/0,  /*src_repetition_fr*/0,  /*src_startbit*/20,   /*sigG_length*/13,  /*des_slotid_fr*/0,   /*des_basecycle_fr*/0,  /*des_repetition_fr*/0,   /*des_startbit*/255,    /*src_cyc*/101,  /*src_id*/0x338,   /*src_dlc*/64,   /*des_id*/0x13c, /*updatebit_S*/66,   /*updatebit_D*/224         },
           {   /*sigGroup_s*/"igHznEdge_0",   /*sig_name*/"isHznEdgeRetransmission_0",   /*src_can*/"ZCU_CANFD1",   /*src_network_type*/"CANFD",   /*src_slotid_fr*/0,   /*src_basecycle_fr*/0,  /*src_repetition_fr*/0,  /*src_startbit*/8,   /*sigG_length*/1,  /*des_slotid_fr*/0,   /*des_basecycle_fr*/0,  /*des_repetition_fr*/0,   /*des_startbit*/305,    /*src_cyc*/101,  /*src_id*/0x338,   /*src_dlc*/64,   /*des_id*/0x13c, /*updatebit_S*/66,   /*updatebit_D*/224         },
           {   /*sigGroup_s*/"igHznEdge_0",   /*sig_name*/"isHznEdgePartOfCalculatedRoute_0",   /*src_can*/"ZCU_CANFD1",   /*src_network_type*/"CANFD",   /*src_slotid_fr*/0,   /*src_basecycle_fr*/0,  /*src_repetition_fr*/0,  /*src_startbit*/37,   /*sigG_length*/2,  /*des_slotid_fr*/0,   /*des_basecycle_fr*/0,  /*des_repetition_fr*/0,   /*des_startbit*/310,    /*src_cyc*/101,  /*src_id*/0x338,   /*src_dlc*/64,   /*des_id*/0x13c, /*updatebit_S*/66,   /*updatebit_D*/224         },
           {   /*sigGroup_s*/"igHznEdge_0",   /*sig_name*/"isHznEdgeFormOfWay_0",   /*src_can*/"ZCU_CANFD1",   /*src_network_type*/"CANFD",   /*src_slotid_fr*/0,   /*src_basecycle_fr*/0,  /*src_repetition_fr*/0,  /*src_startbit*/3,   /*sigG_length*/4,  /*des_slotid_fr*/0,   /*des_basecycle_fr*/0,  /*des_repetition_fr*/0,   /*des_startbit*/281,    /*src_cyc*/101,  /*src_id*/0x338,   /*src_dlc*/64,   /*des_id*/0x13c, /*updatebit_S*/66,   /*updatebit_D*/224         },
           {   /*sigGroup_s*/"igHznEdge_0",   /*sig_name*/"isHznEdgeUpdate_0",   /*src_can*/"ZCU_CANFD1",   /*src_network_type*/"CANFD",   /*src_slotid_fr*/0,   /*src_basecycle_fr*/0,  /*src_repetition_fr*/0,  /*src_startbit*/33,   /*sigG_length*/1,  /*des_slotid_fr*/0,   /*des_basecycle_fr*/0,  /*des_repetition_fr*/0,   /*des_startbit*/304,    /*src_cyc*/101,  /*src_id*/0x338,   /*src_dlc*/64,   /*des_id*/0x13c, /*updatebit_S*/66,   /*updatebit_D*/224         },
           {   /*sigGroup_s*/"igHznEdge_0",   /*sig_name*/"isHznEdgePathIndex_0",   /*src_can*/"ZCU_CANFD1",   /*src_network_type*/"CANFD",   /*src_slotid_fr*/0,   /*src_basecycle_fr*/0,  /*src_repetition_fr*/0,  /*src_startbit*/47,   /*sigG_length*/6,  /*des_slotid_fr*/0,   /*des_basecycle_fr*/0,  /*des_repetition_fr*/0,   /*des_startbit*/266,    /*src_cyc*/101,  /*src_id*/0x338,   /*src_dlc*/64,   /*des_id*/0x13c, /*updatebit_S*/66,   /*updatebit_D*/224         },
           {   /*sigGroup_s*/"igHznEdge_0",   /*sig_name*/"isHznEdgeFunctionalRoadClass_0",   /*src_can*/"ZCU_CANFD1",   /*src_network_type*/"CANFD",   /*src_slotid_fr*/0,   /*src_basecycle_fr*/0,  /*src_repetition_fr*/0,  /*src_startbit*/15,   /*sigG_length*/3,  /*des_slotid_fr*/0,   /*des_basecycle_fr*/0,  /*des_repetition_fr*/0,   /*des_startbit*/293,    /*src_cyc*/101,  /*src_id*/0x338,   /*src_dlc*/64,   /*des_id*/0x13c, /*updatebit_S*/66,   /*updatebit_D*/224         },
           {   /*sigGroup_s*/"igHznEdge_0",   /*sig_name*/"isHznEdgeRightofWay_0",   /*src_can*/"ZCU_CANFD1",   /*src_network_type*/"CANFD",   /*src_slotid_fr*/0,   /*src_basecycle_fr*/0,  /*src_repetition_fr*/0,  /*src_startbit*/35,   /*sigG_length*/2,  /*des_slotid_fr*/0,   /*des_basecycle_fr*/0,  /*des_repetition_fr*/0,   /*des_startbit*/308,    /*src_cyc*/101,  /*src_id*/0x338,   /*src_dlc*/64,   /*des_id*/0x13c, /*updatebit_S*/66,   /*updatebit_D*/224         },
           {   /*sigGroup_s*/"igHznEdge_0",   /*sig_name*/"isHznEdgeMessageType_0",   /*src_can*/"ZCU_CANFD1",   /*src_network_type*/"CANFD",   /*src_slotid_fr*/0,   /*src_basecycle_fr*/0,  /*src_repetition_fr*/0,  /*src_startbit*/11,   /*sigG_length*/3,  /*des_slotid_fr*/0,   /*des_basecycle_fr*/0,  /*des_repetition_fr*/0,   /*des_startbit*/290,    /*src_cyc*/101,  /*src_id*/0x338,   /*src_dlc*/64,   /*des_id*/0x13c, /*updatebit_S*/66,   /*updatebit_D*/224         },
           {   /*sigGroup_s*/"igHznEdge_0",   /*sig_name*/"isHznEdgeNumberOfLanesInDrivingDirection_0",   /*src_can*/"ZCU_CANFD1",   /*src_network_type*/"CANFD",   /*src_slotid_fr*/0,   /*src_basecycle_fr*/0,  /*src_repetition_fr*/0,  /*src_startbit*/23,   /*sigG_length*/3,  /*des_slotid_fr*/0,   /*des_basecycle_fr*/0,  /*des_repetition_fr*/0,   /*des_startbit*/303,    /*src_cyc*/101,  /*src_id*/0x338,   /*src_dlc*/64,   /*des_id*/0x13c, /*updatebit_S*/66,   /*updatebit_D*/224         },
           {   /*sigGroup_s*/"igGearPrkgAssiReqGroup_0",   /*sig_name*/"isGearPrkgAssiReqGroupGearPrkgAssiReq1_0",   /*src_can*/"ZCU_CANFD1",   /*src_network_type*/"CANFD",   /*src_slotid_fr*/0,   /*src_basecycle_fr*/0,  /*src_repetition_fr*/0,  /*src_startbit*/11,   /*sigG_length*/2,  /*des_slotid_fr*/0,   /*des_basecycle_fr*/0,  /*des_repetition_fr*/0,   /*des_startbit*/371,    /*src_cyc*/101,  /*src_id*/0x60,   /*src_dlc*/64,   /*des_id*/0x4f, /*updatebit_S*/8,   /*updatebit_D*/369         },
           {   /*sigGroup_s*/"igGearPrkgAssiReqGroup_0",   /*sig_name*/"isGearPrkgAssiReqGroupCntr_0",   /*src_can*/"ZCU_CANFD1",   /*src_network_type*/"CANFD",   /*src_slotid_fr*/0,   /*src_basecycle_fr*/0,  /*src_repetition_fr*/0,  /*src_startbit*/15,   /*sigG_length*/4,  /*des_slotid_fr*/0,   /*des_basecycle_fr*/0,  /*des_repetition_fr*/0,   /*des_startbit*/375,    /*src_cyc*/101,  /*src_id*/0x60,   /*src_dlc*/64,   /*des_id*/0x4f, /*updatebit_S*/8,   /*updatebit_D*/369         },
           {   /*sigGroup_s*/"igGearPrkgAssiReqGroup_0",   /*sig_name*/"isGearPrkgAssiReqGroupChks_0",   /*src_can*/"ZCU_CANFD1",   /*src_network_type*/"CANFD",   /*src_slotid_fr*/0,   /*src_basecycle_fr*/0,  /*src_repetition_fr*/0,  /*src_startbit*/7,   /*sigG_length*/8,  /*des_slotid_fr*/0,   /*des_basecycle_fr*/0,  /*des_repetition_fr*/0,   /*des_startbit*/367,    /*src_cyc*/101,  /*src_id*/0x60,   /*src_dlc*/64,   /*des_id*/0x4f, /*updatebit_S*/8,   /*updatebit_D*/369         },
           {   /*sigGroup_s*/"igMAIAccInhitReq_0",   /*sig_name*/"isMAIAccInhitReqMAIAccInhitReq_0",   /*src_can*/"ZCU_CANFD1",   /*src_network_type*/"CANFD",   /*src_slotid_fr*/0,   /*src_basecycle_fr*/0,  /*src_repetition_fr*/0,  /*src_startbit*/67,   /*sigG_length*/1,  /*des_slotid_fr*/0,   /*des_basecycle_fr*/0,  /*des_repetition_fr*/0,   /*des_startbit*/235,    /*src_cyc*/101,  /*src_id*/0x71,   /*src_dlc*/64,   /*des_id*/0x59, /*updatebit_S*/168,   /*updatebit_D*/217         },
           {   /*sigGroup_s*/"igMAIAccInhitReq_0",   /*sig_name*/"isMAIAccInhitReqChks_0",   /*src_can*/"ZCU_CANFD1",   /*src_network_type*/"CANFD",   /*src_slotid_fr*/0,   /*src_basecycle_fr*/0,  /*src_repetition_fr*/0,  /*src_startbit*/63,   /*sigG_length*/8,  /*des_slotid_fr*/0,   /*des_basecycle_fr*/0,  /*des_repetition_fr*/0,   /*des_startbit*/231,    /*src_cyc*/101,  /*src_id*/0x71,   /*src_dlc*/64,   /*des_id*/0x59, /*updatebit_S*/168,   /*updatebit_D*/217         },
           {   /*sigGroup_s*/"igMAIAccInhitReq_0",   /*sig_name*/"isMAIAccInhitReqCntr_0",   /*src_can*/"ZCU_CANFD1",   /*src_network_type*/"CANFD",   /*src_slotid_fr*/0,   /*src_basecycle_fr*/0,  /*src_repetition_fr*/0,  /*src_startbit*/71,   /*sigG_length*/4,  /*des_slotid_fr*/0,   /*des_basecycle_fr*/0,  /*des_repetition_fr*/0,   /*des_startbit*/239,    /*src_cyc*/101,  /*src_id*/0x71,   /*src_dlc*/64,   /*des_id*/0x59, /*updatebit_S*/168,   /*updatebit_D*/217         },
           {   /*sigGroup_s*/"igListOfNodAv_0",   /*sig_name*/"isListOfNodAv7_0",   /*src_can*/"ZCU_CANFD1",   /*src_network_type*/"CANFD",   /*src_slotid_fr*/0,   /*src_basecycle_fr*/0,  /*src_repetition_fr*/0,  /*src_startbit*/215,   /*sigG_length*/32,  /*des_slotid_fr*/0,   /*des_basecycle_fr*/0,  /*des_repetition_fr*/0,   /*des_startbit*/255,    /*src_cyc*/101,  /*src_id*/0x379,   /*src_dlc*/64,   /*des_id*/0x35c, /*updatebit_S*/15,   /*updatebit_D*/48         },
           {   /*sigGroup_s*/"igListOfNodAv_0",   /*sig_name*/"isListOfNodAv8_0",   /*src_can*/"ZCU_CANFD1",   /*src_network_type*/"CANFD",   /*src_slotid_fr*/0,   /*src_basecycle_fr*/0,  /*src_repetition_fr*/0,  /*src_startbit*/247,   /*sigG_length*/32,  /*des_slotid_fr*/0,   /*des_basecycle_fr*/0,  /*des_repetition_fr*/0,   /*des_startbit*/287,    /*src_cyc*/101,  /*src_id*/0x379,   /*src_dlc*/64,   /*des_id*/0x35c, /*updatebit_S*/15,   /*updatebit_D*/48         },
           {   /*sigGroup_s*/"igListOfNodAv_0",   /*sig_name*/"isListOfNodAv5_0",   /*src_can*/"ZCU_CANFD1",   /*src_network_type*/"CANFD",   /*src_slotid_fr*/0,   /*src_basecycle_fr*/0,  /*src_repetition_fr*/0,  /*src_startbit*/151,   /*sigG_length*/32,  /*des_slotid_fr*/0,   /*des_basecycle_fr*/0,  /*des_repetition_fr*/0,   /*des_startbit*/191,    /*src_cyc*/101,  /*src_id*/0x379,   /*src_dlc*/64,   /*des_id*/0x35c, /*updatebit_S*/15,   /*updatebit_D*/48         },
           {   /*sigGroup_s*/"igListOfNodAv_0",   /*sig_name*/"isListOfNodAv3_0",   /*src_can*/"ZCU_CANFD1",   /*src_network_type*/"CANFD",   /*src_slotid_fr*/0,   /*src_basecycle_fr*/0,  /*src_repetition_fr*/0,  /*src_startbit*/87,   /*sigG_length*/32,  /*des_slotid_fr*/0,   /*des_basecycle_fr*/0,  /*des_repetition_fr*/0,   /*des_startbit*/127,    /*src_cyc*/101,  /*src_id*/0x379,   /*src_dlc*/64,   /*des_id*/0x35c, /*updatebit_S*/15,   /*updatebit_D*/48         },
           {   /*sigGroup_s*/"igListOfNodAv_0",   /*sig_name*/"isListOfNodAv4_0",   /*src_can*/"ZCU_CANFD1",   /*src_network_type*/"CANFD",   /*src_slotid_fr*/0,   /*src_basecycle_fr*/0,  /*src_repetition_fr*/0,  /*src_startbit*/119,   /*sigG_length*/32,  /*des_slotid_fr*/0,   /*des_basecycle_fr*/0,  /*des_repetition_fr*/0,   /*des_startbit*/159,    /*src_cyc*/101,  /*src_id*/0x379,   /*src_dlc*/64,   /*des_id*/0x35c, /*updatebit_S*/15,   /*updatebit_D*/48         },
           {   /*sigGroup_s*/"igListOfNodAv_0",   /*sig_name*/"isListOfNodAv1_0",   /*src_can*/"ZCU_CANFD1",   /*src_network_type*/"CANFD",   /*src_slotid_fr*/0,   /*src_basecycle_fr*/0,  /*src_repetition_fr*/0,  /*src_startbit*/23,   /*sigG_length*/32,  /*des_slotid_fr*/0,   /*des_basecycle_fr*/0,  /*des_repetition_fr*/0,   /*des_startbit*/63,    /*src_cyc*/101,  /*src_id*/0x379,   /*src_dlc*/64,   /*des_id*/0x35c, /*updatebit_S*/15,   /*updatebit_D*/48         },
           {   /*sigGroup_s*/"igListOfNodAv_0",   /*sig_name*/"isListOfNodAv2_0",   /*src_can*/"ZCU_CANFD1",   /*src_network_type*/"CANFD",   /*src_slotid_fr*/0,   /*src_basecycle_fr*/0,  /*src_repetition_fr*/0,  /*src_startbit*/55,   /*sigG_length*/32,  /*des_slotid_fr*/0,   /*des_basecycle_fr*/0,  /*des_repetition_fr*/0,   /*des_startbit*/95,    /*src_cyc*/101,  /*src_id*/0x379,   /*src_dlc*/64,   /*des_id*/0x35c, /*updatebit_S*/15,   /*updatebit_D*/48         },
           {   /*sigGroup_s*/"igListOfNodAv_0",   /*sig_name*/"isListOfNodAv6_0",   /*src_can*/"ZCU_CANFD1",   /*src_network_type*/"CANFD",   /*src_slotid_fr*/0,   /*src_basecycle_fr*/0,  /*src_repetition_fr*/0,  /*src_startbit*/183,   /*sigG_length*/32,  /*des_slotid_fr*/0,   /*des_basecycle_fr*/0,  /*des_repetition_fr*/0,   /*des_startbit*/223,    /*src_cyc*/101,  /*src_id*/0x379,   /*src_dlc*/64,   /*des_id*/0x35c, /*updatebit_S*/15,   /*updatebit_D*/48         },
           {   /*sigGroup_s*/"igVehCfgPrm_0",   /*sig_name*/"isVehCfgPrmCCPBytePosn2_0",   /*src_can*/"ZCU_CANFD1",   /*src_network_type*/"CANFD",   /*src_slotid_fr*/0,   /*src_basecycle_fr*/0,  /*src_repetition_fr*/0,  /*src_startbit*/15,   /*sigG_length*/8,  /*des_slotid_fr*/0,   /*des_basecycle_fr*/0,  /*des_repetition_fr*/0,   /*des_startbit*/295,    /*src_cyc*/101,  /*src_id*/0x1f5,   /*src_dlc*/64,   /*des_id*/0x16f, /*updatebit_S*/199,   /*updatebit_D*/216         },
           {   /*sigGroup_s*/"igVehCfgPrm_0",   /*sig_name*/"isVehCfgPrmCCPBytePosn7_0",   /*src_can*/"ZCU_CANFD1",   /*src_network_type*/"CANFD",   /*src_slotid_fr*/0,   /*src_basecycle_fr*/0,  /*src_repetition_fr*/0,  /*src_startbit*/55,   /*sigG_length*/8,  /*des_slotid_fr*/0,   /*des_basecycle_fr*/0,  /*des_repetition_fr*/0,   /*des_startbit*/335,    /*src_cyc*/101,  /*src_id*/0x1f5,   /*src_dlc*/64,   /*des_id*/0x16f, /*updatebit_S*/199,   /*updatebit_D*/216         },
           {   /*sigGroup_s*/"igVehCfgPrm_0",   /*sig_name*/"isVehCfgPrmCCPBytePosn3_0",   /*src_can*/"ZCU_CANFD1",   /*src_network_type*/"CANFD",   /*src_slotid_fr*/0,   /*src_basecycle_fr*/0,  /*src_repetition_fr*/0,  /*src_startbit*/23,   /*sigG_length*/8,  /*des_slotid_fr*/0,   /*des_basecycle_fr*/0,  /*des_repetition_fr*/0,   /*des_startbit*/303,    /*src_cyc*/101,  /*src_id*/0x1f5,   /*src_dlc*/64,   /*des_id*/0x16f, /*updatebit_S*/199,   /*updatebit_D*/216         },
           {   /*sigGroup_s*/"igVehCfgPrm_0",   /*sig_name*/"isVehCfgPrmCCPBytePosn4_0",   /*src_can*/"ZCU_CANFD1",   /*src_network_type*/"CANFD",   /*src_slotid_fr*/0,   /*src_basecycle_fr*/0,  /*src_repetition_fr*/0,  /*src_startbit*/31,   /*sigG_length*/8,  /*des_slotid_fr*/0,   /*des_basecycle_fr*/0,  /*des_repetition_fr*/0,   /*des_startbit*/311,    /*src_cyc*/101,  /*src_id*/0x1f5,   /*src_dlc*/64,   /*des_id*/0x16f, /*updatebit_S*/199,   /*updatebit_D*/216         },
           {   /*sigGroup_s*/"igVehCfgPrm_0",   /*sig_name*/"isVehCfgPrmCCPBytePosn8_0",   /*src_can*/"ZCU_CANFD1",   /*src_network_type*/"CANFD",   /*src_slotid_fr*/0,   /*src_basecycle_fr*/0,  /*src_repetition_fr*/0,  /*src_startbit*/63,   /*sigG_length*/8,  /*des_slotid_fr*/0,   /*des_basecycle_fr*/0,  /*des_repetition_fr*/0,   /*des_startbit*/343,    /*src_cyc*/101,  /*src_id*/0x1f5,   /*src_dlc*/64,   /*des_id*/0x16f, /*updatebit_S*/199,   /*updatebit_D*/216         },
           {   /*sigGroup_s*/"igVehCfgPrm_0",   /*sig_name*/"isVehCfgPrmCCPBytePosn5_0",   /*src_can*/"ZCU_CANFD1",   /*src_network_type*/"CANFD",   /*src_slotid_fr*/0,   /*src_basecycle_fr*/0,  /*src_repetition_fr*/0,  /*src_startbit*/39,   /*sigG_length*/8,  /*des_slotid_fr*/0,   /*des_basecycle_fr*/0,  /*des_repetition_fr*/0,   /*des_startbit*/319,    /*src_cyc*/101,  /*src_id*/0x1f5,   /*src_dlc*/64,   /*des_id*/0x16f, /*updatebit_S*/199,   /*updatebit_D*/216         },
           {   /*sigGroup_s*/"igVehCfgPrm_0",   /*sig_name*/"isVehCfgPrmBlkIDBytePosn1_0",   /*src_can*/"ZCU_CANFD1",   /*src_network_type*/"CANFD",   /*src_slotid_fr*/0,   /*src_basecycle_fr*/0,  /*src_repetition_fr*/0,  /*src_startbit*/7,   /*sigG_length*/8,  /*des_slotid_fr*/0,   /*des_basecycle_fr*/0,  /*des_repetition_fr*/0,   /*des_startbit*/287,    /*src_cyc*/101,  /*src_id*/0x1f5,   /*src_dlc*/64,   /*des_id*/0x16f, /*updatebit_S*/199,   /*updatebit_D*/216         },
           {   /*sigGroup_s*/"igVehCfgPrm_0",   /*sig_name*/"isVehCfgPrmCCPBytePosn6_0",   /*src_can*/"ZCU_CANFD1",   /*src_network_type*/"CANFD",   /*src_slotid_fr*/0,   /*src_basecycle_fr*/0,  /*src_repetition_fr*/0,  /*src_startbit*/47,   /*sigG_length*/8,  /*des_slotid_fr*/0,   /*des_basecycle_fr*/0,  /*des_repetition_fr*/0,   /*des_startbit*/327,    /*src_cyc*/101,  /*src_id*/0x1f5,   /*src_dlc*/64,   /*des_id*/0x16f, /*updatebit_S*/199,   /*updatebit_D*/216         },
           {   /*sigGroup_s*/"igPinionSteerAgGroupForBkp_0",   /*sig_name*/"isPinionSteerAgGroupForBkpChks_0",   /*src_can*/"ZCU_CANFD1",   /*src_network_type*/"CANFD",   /*src_slotid_fr*/0,   /*src_basecycle_fr*/0,  /*src_repetition_fr*/0,  /*src_startbit*/111,   /*sigG_length*/8,  /*des_slotid_fr*/0,   /*des_basecycle_fr*/0,  /*des_repetition_fr*/0,   /*des_startbit*/87,    /*src_cyc*/101,  /*src_id*/0x71,   /*src_dlc*/64,   /*des_id*/0x335, /*updatebit_S*/182,   /*updatebit_D*/71         },
           {   /*sigGroup_s*/"igPinionSteerAgGroupForBkp_0",   /*sig_name*/"isPinionSteerAgGroupForBkpCntr_0",   /*src_can*/"ZCU_CANFD1",   /*src_network_type*/"CANFD",   /*src_slotid_fr*/0,   /*src_basecycle_fr*/0,  /*src_repetition_fr*/0,  /*src_startbit*/119,   /*sigG_length*/4,  /*des_slotid_fr*/0,   /*des_basecycle_fr*/0,  /*des_repetition_fr*/0,   /*des_startbit*/127,    /*src_cyc*/101,  /*src_id*/0x71,   /*src_dlc*/64,   /*des_id*/0x335, /*updatebit_S*/182,   /*updatebit_D*/71         },
           {   /*sigGroup_s*/"igPinionSteerAgGroupForBkp_0",   /*sig_name*/"isPinionSteerAgGroupForBkpSteerWhlTqQfForBkp_0",   /*src_can*/"ZCU_CANFD1",   /*src_network_type*/"CANFD",   /*src_slotid_fr*/0,   /*src_basecycle_fr*/0,  /*src_repetition_fr*/0,  /*src_startbit*/113,   /*sigG_length*/2,  /*des_slotid_fr*/0,   /*des_basecycle_fr*/0,  /*des_repetition_fr*/0,   /*des_startbit*/123,    /*src_cyc*/101,  /*src_id*/0x71,   /*src_dlc*/64,   /*des_id*/0x335, /*updatebit_S*/182,   /*updatebit_D*/71         },
           {   /*sigGroup_s*/"igPinionSteerAgGroupForBkp_0",   /*sig_name*/"isPinionSteerAgGroupForBkpPinionSteerAgQfForBkp_0",   /*src_can*/"ZCU_CANFD1",   /*src_network_type*/"CANFD",   /*src_slotid_fr*/0,   /*src_basecycle_fr*/0,  /*src_repetition_fr*/0,  /*src_startbit*/97,   /*sigG_length*/2,  /*des_slotid_fr*/0,   /*des_basecycle_fr*/0,  /*des_repetition_fr*/0,   /*des_startbit*/95,    /*src_cyc*/101,  /*src_id*/0x71,   /*src_dlc*/64,   /*des_id*/0x335, /*updatebit_S*/182,   /*updatebit_D*/71         },
           {   /*sigGroup_s*/"igPinionSteerAgGroupForBkp_0",   /*sig_name*/"isPinionSteerAgGroupForBkpPinionSteerAgSpdQfForBkp_0",   /*src_can*/"ZCU_CANFD1",   /*src_network_type*/"CANFD",   /*src_slotid_fr*/0,   /*src_basecycle_fr*/0,  /*src_repetition_fr*/0,  /*src_startbit*/115,   /*sigG_length*/2,  /*des_slotid_fr*/0,   /*des_basecycle_fr*/0,  /*des_repetition_fr*/0,   /*des_startbit*/111,    /*src_cyc*/101,  /*src_id*/0x71,   /*src_dlc*/64,   /*des_id*/0x335, /*updatebit_S*/182,   /*updatebit_D*/71         },
           {   /*sigGroup_s*/"igPinionSteerAgGroupForBkp_0",   /*sig_name*/"isPinionSteerAgGroupForBkpSteerWhlTqForBkp_0",   /*src_can*/"ZCU_CANFD1",   /*src_network_type*/"CANFD",   /*src_slotid_fr*/0,   /*src_basecycle_fr*/0,  /*src_repetition_fr*/0,  /*src_startbit*/95,   /*sigG_length*/14,  /*des_slotid_fr*/0,   /*des_basecycle_fr*/0,  /*des_repetition_fr*/0,   /*des_startbit*/109,    /*src_cyc*/101,  /*src_id*/0x71,   /*src_dlc*/64,   /*des_id*/0x335, /*updatebit_S*/182,   /*updatebit_D*/71         },
           {   /*sigGroup_s*/"igPinionSteerAgGroupForBkp_0",   /*sig_name*/"isPinionSteerAgGroupForBkpPinionSteerAgForBkp_0",   /*src_can*/"ZCU_CANFD1",   /*src_network_type*/"CANFD",   /*src_slotid_fr*/0,   /*src_basecycle_fr*/0,  /*src_repetition_fr*/0,  /*src_startbit*/79,   /*sigG_length*/15,  /*des_slotid_fr*/0,   /*des_basecycle_fr*/0,  /*des_repetition_fr*/0,   /*des_startbit*/70,    /*src_cyc*/101,  /*src_id*/0x71,   /*src_dlc*/64,   /*des_id*/0x335, /*updatebit_S*/182,   /*updatebit_D*/71         },
           {   /*sigGroup_s*/"igPinionSteerAgGroupForBkp_0",   /*sig_name*/"isPinionSteerAgGroupForBkpPinionSteerAgSpdForBkp_0",   /*src_can*/"ZCU_CANFD1",   /*src_network_type*/"CANFD",   /*src_slotid_fr*/0,   /*src_basecycle_fr*/0,  /*src_repetition_fr*/0,  /*src_startbit*/127,   /*sigG_length*/14,  /*des_slotid_fr*/0,   /*des_basecycle_fr*/0,  /*des_repetition_fr*/0,   /*des_startbit*/93,    /*src_cyc*/101,  /*src_id*/0x71,   /*src_dlc*/64,   /*des_id*/0x335, /*updatebit_S*/182,   /*updatebit_D*/71         }
       }
   },
   {
       /*des_can*/ "ZCUD_CAN1",
       /*networktype*/ "CAN",
       106,
       {
           {   /*sigGroup_s*/"igSftyDecelGroupSafe_0",   /*sig_name*/"isSftyDecelGroupSafeCntr_0",   /*src_can*/"ZCU_CANFD1",   /*src_network_type*/"CANFD",   /*src_slotid_fr*/0,   /*src_basecycle_fr*/0,  /*src_repetition_fr*/0,  /*src_startbit*/207,   /*sigG_length*/4,  /*des_slotid_fr*/0,   /*des_basecycle_fr*/0,  /*des_repetition_fr*/0,   /*des_startbit*/43,    /*src_cyc*/101,  /*src_id*/0x71,   /*src_dlc*/64,   /*des_id*/0x83, /*updatebit_S*/202,   /*updatebit_D*/51         },
           {   /*sigGroup_s*/"igSftyDecelGroupSafe_0",   /*sig_name*/"isSftyDecelGroupSafeAsySftyDecelReq_0",   /*src_can*/"ZCU_CANFD1",   /*src_network_type*/"CANFD",   /*src_slotid_fr*/0,   /*src_basecycle_fr*/0,  /*src_repetition_fr*/0,  /*src_startbit*/191,   /*sigG_length*/8,  /*des_slotid_fr*/0,   /*des_basecycle_fr*/0,  /*des_repetition_fr*/0,   /*des_startbit*/31,    /*src_cyc*/101,  /*src_id*/0x71,   /*src_dlc*/64,   /*des_id*/0x83, /*updatebit_S*/202,   /*updatebit_D*/51         },
           {   /*sigGroup_s*/"igSftyDecelGroupSafe_0",   /*sig_name*/"isSftyDecelGroupSafeAsySftyEnaDecel_0",   /*src_can*/"ZCU_CANFD1",   /*src_network_type*/"CANFD",   /*src_slotid_fr*/0,   /*src_basecycle_fr*/0,  /*src_repetition_fr*/0,  /*src_startbit*/203,   /*sigG_length*/1,  /*des_slotid_fr*/0,   /*des_basecycle_fr*/0,  /*des_repetition_fr*/0,   /*des_startbit*/44,    /*src_cyc*/101,  /*src_id*/0x71,   /*src_dlc*/64,   /*des_id*/0x83, /*updatebit_S*/202,   /*updatebit_D*/51         },
           {   /*sigGroup_s*/"igSftyDecelGroupSafe_0",   /*sig_name*/"isSftyDecelGroupSafeChks_0",   /*src_can*/"ZCU_CANFD1",   /*src_network_type*/"CANFD",   /*src_slotid_fr*/0,   /*src_basecycle_fr*/0,  /*src_repetition_fr*/0,  /*src_startbit*/199,   /*sigG_length*/8,  /*des_slotid_fr*/0,   /*des_basecycle_fr*/0,  /*des_repetition_fr*/0,   /*des_startbit*/39,    /*src_cyc*/101,  /*src_id*/0x71,   /*src_dlc*/64,   /*des_id*/0x83, /*updatebit_S*/202,   /*updatebit_D*/51         },
           {   /*sigGroup_s*/"igAsySftyFctStsToEDR_0",   /*sig_name*/"isAsySftyFctStsToEDRACSFCFctSts_0",   /*src_can*/"ZCU_CANFD1",   /*src_network_type*/"CANFD",   /*src_slotid_fr*/0,   /*src_basecycle_fr*/0,  /*src_repetition_fr*/0,  /*src_startbit*/230,   /*sigG_length*/3,  /*des_slotid_fr*/0,   /*des_basecycle_fr*/0,  /*des_repetition_fr*/0,   /*des_startbit*/28,    /*src_cyc*/101,  /*src_id*/0x265,   /*src_dlc*/64,   /*des_id*/0x210, /*updatebit_S*/241,   /*updatebit_D*/49         },
           {   /*sigGroup_s*/"igAsySftyFctStsToEDR_0",   /*sig_name*/"isAsySftyFctStsToEDRACSFB1FctSts_0",   /*src_can*/"ZCU_CANFD1",   /*src_network_type*/"CANFD",   /*src_slotid_fr*/0,   /*src_basecycle_fr*/0,  /*src_repetition_fr*/0,  /*src_startbit*/220,   /*sigG_length*/3,  /*des_slotid_fr*/0,   /*des_basecycle_fr*/0,  /*des_repetition_fr*/0,   /*des_startbit*/18,    /*src_cyc*/101,  /*src_id*/0x265,   /*src_dlc*/64,   /*des_id*/0x210, /*updatebit_S*/241,   /*updatebit_D*/49         },
           {   /*sigGroup_s*/"igAsySftyFctStsToEDR_0",   /*sig_name*/"isAsySftyFctStsToEDRCSFFctSts_0",   /*src_can*/"ZCU_CANFD1",   /*src_network_type*/"CANFD",   /*src_slotid_fr*/0,   /*src_basecycle_fr*/0,  /*src_repetition_fr*/0,  /*src_startbit*/234,   /*sigG_length*/3,  /*des_slotid_fr*/0,   /*des_basecycle_fr*/0,  /*des_repetition_fr*/0,   /*des_startbit*/44,    /*src_cyc*/101,  /*src_id*/0x265,   /*src_dlc*/64,   /*des_id*/0x210, /*updatebit_S*/241,   /*updatebit_D*/49         },
           {   /*sigGroup_s*/"igAsySftyFctStsToEDR_0",   /*sig_name*/"isAsySftyFctStsToEDRACSFB2FctSts_0",   /*src_can*/"ZCU_CANFD1",   /*src_network_type*/"CANFD",   /*src_slotid_fr*/0,   /*src_basecycle_fr*/0,  /*src_repetition_fr*/0,  /*src_startbit*/217,   /*sigG_length*/3,  /*des_slotid_fr*/0,   /*des_basecycle_fr*/0,  /*des_repetition_fr*/0,   /*des_startbit*/31,    /*src_cyc*/101,  /*src_id*/0x265,   /*src_dlc*/64,   /*des_id*/0x210, /*updatebit_S*/241,   /*updatebit_D*/49         },
           {   /*sigGroup_s*/"igAsySftyFctStsToEDR_0",   /*sig_name*/"isAsySftyFctStsToEDRACSFEFctSts_0",   /*src_can*/"ZCU_CANFD1",   /*src_network_type*/"CANFD",   /*src_slotid_fr*/0,   /*src_basecycle_fr*/0,  /*src_repetition_fr*/0,  /*src_startbit*/224,   /*sigG_length*/3,  /*des_slotid_fr*/0,   /*des_basecycle_fr*/0,  /*des_repetition_fr*/0,   /*des_startbit*/36,    /*src_cyc*/101,  /*src_id*/0x265,   /*src_dlc*/64,   /*des_id*/0x210, /*updatebit_S*/241,   /*updatebit_D*/49         },
           {   /*sigGroup_s*/"igAsySftyFctStsToEDR_0",   /*sig_name*/"isAsySftyFctStsToEDRLDWSFctSts_0",   /*src_can*/"ZCU_CANFD1",   /*src_network_type*/"CANFD",   /*src_slotid_fr*/0,   /*src_basecycle_fr*/0,  /*src_repetition_fr*/0,  /*src_startbit*/244,   /*sigG_length*/3,  /*des_slotid_fr*/0,   /*des_basecycle_fr*/0,  /*des_repetition_fr*/0,   /*des_startbit*/52,    /*src_cyc*/101,  /*src_id*/0x265,   /*src_dlc*/64,   /*des_id*/0x210, /*updatebit_S*/241,   /*updatebit_D*/49         },
           {   /*sigGroup_s*/"igAsySftyFctStsToEDR_0",   /*sig_name*/"isAsySftyFctStsToEDRACCFctSTs_0",   /*src_can*/"ZCU_CANFD1",   /*src_network_type*/"CANFD",   /*src_slotid_fr*/0,   /*src_basecycle_fr*/0,  /*src_repetition_fr*/0,  /*src_startbit*/223,   /*sigG_length*/3,  /*des_slotid_fr*/0,   /*des_basecycle_fr*/0,  /*des_repetition_fr*/0,   /*des_startbit*/21,    /*src_cyc*/101,  /*src_id*/0x265,   /*src_dlc*/64,   /*des_id*/0x210, /*updatebit_S*/241,   /*updatebit_D*/49         },
           {   /*sigGroup_s*/"igAsySftyFctStsToEDR_0",   /*sig_name*/"isAsySftyFctStsToEDRESFFctSts_0",   /*src_can*/"ZCU_CANFD1",   /*src_network_type*/"CANFD",   /*src_slotid_fr*/0,   /*src_basecycle_fr*/0,  /*src_repetition_fr*/0,  /*src_startbit*/247,   /*sigG_length*/3,  /*des_slotid_fr*/0,   /*des_basecycle_fr*/0,  /*des_repetition_fr*/0,   /*des_startbit*/55,    /*src_cyc*/101,  /*src_id*/0x265,   /*src_dlc*/64,   /*des_id*/0x210, /*updatebit_S*/241,   /*updatebit_D*/49         },
           {   /*sigGroup_s*/"igAsySftyFctStsToEDR_0",   /*sig_name*/"isAsySftyFctStsToEDRAEBSFctSts_0",   /*src_can*/"ZCU_CANFD1",   /*src_network_type*/"CANFD",   /*src_slotid_fr*/0,   /*src_basecycle_fr*/0,  /*src_repetition_fr*/0,  /*src_startbit*/237,   /*sigG_length*/3,  /*des_slotid_fr*/0,   /*des_basecycle_fr*/0,  /*des_repetition_fr*/0,   /*des_startbit*/47,    /*src_cyc*/101,  /*src_id*/0x265,   /*src_dlc*/64,   /*des_id*/0x210, /*updatebit_S*/241,   /*updatebit_D*/49         },
           {   /*sigGroup_s*/"igAsySftyFctStsToEDR_0",   /*sig_name*/"isAsySftyFctStsToEDRACSFDFctSts_0",   /*src_can*/"ZCU_CANFD1",   /*src_network_type*/"CANFD",   /*src_slotid_fr*/0,   /*src_basecycle_fr*/0,  /*src_repetition_fr*/0,  /*src_startbit*/227,   /*sigG_length*/3,  /*des_slotid_fr*/0,   /*des_basecycle_fr*/0,  /*des_repetition_fr*/0,   /*des_startbit*/39,    /*src_cyc*/101,  /*src_id*/0x265,   /*src_dlc*/64,   /*des_id*/0x210, /*updatebit_S*/241,   /*updatebit_D*/49         },
           {   /*sigGroup_s*/"igPrkgStsToEDR_0",   /*sig_name*/"isPrkgStsToEDRHPATo_0",   /*src_can*/"ZCU_CANFD1",   /*src_network_type*/"CANFD",   /*src_slotid_fr*/0,   /*src_basecycle_fr*/0,  /*src_repetition_fr*/0,  /*src_startbit*/4,   /*sigG_length*/3,  /*des_slotid_fr*/0,   /*des_basecycle_fr*/0,  /*des_repetition_fr*/0,   /*des_startbit*/36,    /*src_cyc*/101,  /*src_id*/0x211,   /*src_dlc*/64,   /*des_id*/0x228, /*updatebit_S*/18,   /*updatebit_D*/50         },
           {   /*sigGroup_s*/"igPrkgStsToEDR_0",   /*sig_name*/"isPrkgStsToEDRAPATo_0",   /*src_can*/"ZCU_CANFD1",   /*src_network_type*/"CANFD",   /*src_slotid_fr*/0,   /*src_basecycle_fr*/0,  /*src_repetition_fr*/0,  /*src_startbit*/7,   /*sigG_length*/3,  /*des_slotid_fr*/0,   /*des_basecycle_fr*/0,  /*des_repetition_fr*/0,   /*des_startbit*/39,    /*src_cyc*/101,  /*src_id*/0x211,   /*src_dlc*/64,   /*des_id*/0x228, /*updatebit_S*/18,   /*updatebit_D*/50         },
           {   /*sigGroup_s*/"igPrkgStsToEDR_0",   /*sig_name*/"isPrkgStsToEDRreserved3_0",   /*src_can*/"ZCU_CANFD1",   /*src_network_type*/"CANFD",   /*src_slotid_fr*/0,   /*src_basecycle_fr*/0,  /*src_repetition_fr*/0,  /*src_startbit*/8,   /*sigG_length*/3,  /*des_slotid_fr*/0,   /*des_basecycle_fr*/0,  /*des_repetition_fr*/0,   /*des_startbit*/40,    /*src_cyc*/101,  /*src_id*/0x211,   /*src_dlc*/64,   /*des_id*/0x228, /*updatebit_S*/18,   /*updatebit_D*/50         },
           {   /*sigGroup_s*/"igPrkgStsToEDR_0",   /*sig_name*/"isPrkgStsToEDRRPATo_0",   /*src_can*/"ZCU_CANFD1",   /*src_network_type*/"CANFD",   /*src_slotid_fr*/0,   /*src_basecycle_fr*/0,  /*src_repetition_fr*/0,  /*src_startbit*/21,   /*sigG_length*/3,  /*des_slotid_fr*/0,   /*des_basecycle_fr*/0,  /*des_repetition_fr*/0,   /*des_startbit*/53,    /*src_cyc*/101,  /*src_id*/0x211,   /*src_dlc*/64,   /*des_id*/0x228, /*updatebit_S*/18,   /*updatebit_D*/50         },
           {   /*sigGroup_s*/"igPrkgStsToEDR_0",   /*sig_name*/"isPrkgStsToEDRreserved1_0",   /*src_can*/"ZCU_CANFD1",   /*src_network_type*/"CANFD",   /*src_slotid_fr*/0,   /*src_basecycle_fr*/0,  /*src_repetition_fr*/0,  /*src_startbit*/14,   /*sigG_length*/3,  /*des_slotid_fr*/0,   /*des_basecycle_fr*/0,  /*des_repetition_fr*/0,   /*des_startbit*/46,    /*src_cyc*/101,  /*src_id*/0x211,   /*src_dlc*/64,   /*des_id*/0x228, /*updatebit_S*/18,   /*updatebit_D*/50         },
           {   /*sigGroup_s*/"igPrkgStsToEDR_0",   /*sig_name*/"isPrkgStsToEDRLSDAandTBATo_0",   /*src_can*/"ZCU_CANFD1",   /*src_network_type*/"CANFD",   /*src_slotid_fr*/0,   /*src_basecycle_fr*/0,  /*src_repetition_fr*/0,  /*src_startbit*/1,   /*sigG_length*/3,  /*des_slotid_fr*/0,   /*des_basecycle_fr*/0,  /*des_repetition_fr*/0,   /*des_startbit*/33,    /*src_cyc*/101,  /*src_id*/0x211,   /*src_dlc*/64,   /*des_id*/0x228, /*updatebit_S*/18,   /*updatebit_D*/50         },
           {   /*sigGroup_s*/"igPrkgStsToEDR_0",   /*sig_name*/"isPrkgStsToEDRreserved2_0",   /*src_can*/"ZCU_CANFD1",   /*src_network_type*/"CANFD",   /*src_slotid_fr*/0,   /*src_basecycle_fr*/0,  /*src_repetition_fr*/0,  /*src_startbit*/11,   /*sigG_length*/3,  /*des_slotid_fr*/0,   /*des_basecycle_fr*/0,  /*des_repetition_fr*/0,   /*des_startbit*/43,    /*src_cyc*/101,  /*src_id*/0x211,   /*src_dlc*/64,   /*des_id*/0x228, /*updatebit_S*/18,   /*updatebit_D*/50         },
           {   /*sigGroup_s*/"igADTakeoverReqGroup_0",   /*sig_name*/"isADTakeoverReqGroupChks_0",   /*src_can*/"ZCU_CANFD1",   /*src_network_type*/"CANFD",   /*src_slotid_fr*/0,   /*src_basecycle_fr*/0,  /*src_repetition_fr*/0,  /*src_startbit*/271,   /*sigG_length*/8,  /*des_slotid_fr*/0,   /*des_basecycle_fr*/0,  /*des_repetition_fr*/0,   /*des_startbit*/15,    /*src_cyc*/101,  /*src_id*/0x241,   /*src_dlc*/64,   /*des_id*/0x210, /*updatebit_S*/286,   /*updatebit_D*/7         },
           {   /*sigGroup_s*/"igADTakeoverReqGroup_0",   /*sig_name*/"isADTakeoverReqGroupADTakeoverMsg_0",   /*src_can*/"ZCU_CANFD1",   /*src_network_type*/"CANFD",   /*src_slotid_fr*/0,   /*src_basecycle_fr*/0,  /*src_repetition_fr*/0,  /*src_startbit*/275,   /*sigG_length*/3,  /*des_slotid_fr*/0,   /*des_basecycle_fr*/0,  /*des_repetition_fr*/0,   /*des_startbit*/6,    /*src_cyc*/101,  /*src_id*/0x241,   /*src_dlc*/64,   /*des_id*/0x210, /*updatebit_S*/286,   /*updatebit_D*/7         },
           {   /*sigGroup_s*/"igADTakeoverReqGroup_0",   /*sig_name*/"isADTakeoverReqGroupADTakeoverAudio_0",   /*src_can*/"ZCU_CANFD1",   /*src_network_type*/"CANFD",   /*src_slotid_fr*/0,   /*src_basecycle_fr*/0,  /*src_repetition_fr*/0,  /*src_startbit*/272,   /*sigG_length*/2,  /*des_slotid_fr*/0,   /*des_basecycle_fr*/0,  /*des_repetition_fr*/0,   /*des_startbit*/23,    /*src_cyc*/101,  /*src_id*/0x241,   /*src_dlc*/64,   /*des_id*/0x210, /*updatebit_S*/286,   /*updatebit_D*/7         },
           {   /*sigGroup_s*/"igADTakeoverReqGroup_0",   /*sig_name*/"isADTakeoverReqGroupCntr_0",   /*src_can*/"ZCU_CANFD1",   /*src_network_type*/"CANFD",   /*src_slotid_fr*/0,   /*src_basecycle_fr*/0,  /*src_repetition_fr*/0,  /*src_startbit*/279,   /*sigG_length*/4,  /*des_slotid_fr*/0,   /*des_basecycle_fr*/0,  /*des_repetition_fr*/0,   /*des_startbit*/3,    /*src_cyc*/101,  /*src_id*/0x241,   /*src_dlc*/64,   /*des_id*/0x210, /*updatebit_S*/286,   /*updatebit_D*/7         },
           {   /*sigGroup_s*/"igBrkSysCylPMst_0",   /*sig_name*/"isBrkSysCylPMstChks_0",   /*src_can*/"ZCU_CANFD1",   /*src_network_type*/"CANFD",   /*src_slotid_fr*/0,   /*src_basecycle_fr*/0,  /*src_repetition_fr*/0,  /*src_startbit*/249,   /*sigG_length*/8,  /*des_slotid_fr*/0,   /*des_basecycle_fr*/0,  /*des_repetition_fr*/0,   /*des_startbit*/15,    /*src_cyc*/101,  /*src_id*/0x82,   /*src_dlc*/64,   /*des_id*/0x54, /*updatebit_S*/431,   /*updatebit_D*/6         },
           {   /*sigGroup_s*/"igBrkSysCylPMst_0",   /*sig_name*/"isBrkSysCylPMstCntr_0",   /*src_can*/"ZCU_CANFD1",   /*src_network_type*/"CANFD",   /*src_slotid_fr*/0,   /*src_basecycle_fr*/0,  /*src_repetition_fr*/0,  /*src_startbit*/257,   /*sigG_length*/4,  /*des_slotid_fr*/0,   /*des_basecycle_fr*/0,  /*des_repetition_fr*/0,   /*des_startbit*/3,    /*src_cyc*/101,  /*src_id*/0x82,   /*src_dlc*/64,   /*des_id*/0x54, /*updatebit_S*/431,   /*updatebit_D*/6         },
           {   /*sigGroup_s*/"igBrkSysCylPMst_0",   /*sig_name*/"isBrkSysCylPMstAct_0",   /*src_can*/"ZCU_CANFD1",   /*src_network_type*/"CANFD",   /*src_slotid_fr*/0,   /*src_basecycle_fr*/0,  /*src_repetition_fr*/0,  /*src_startbit*/231,   /*sigG_length*/10,  /*des_slotid_fr*/0,   /*des_basecycle_fr*/0,  /*des_repetition_fr*/0,   /*des_startbit*/23,    /*src_cyc*/101,  /*src_id*/0x82,   /*src_dlc*/64,   /*des_id*/0x54, /*updatebit_S*/431,   /*updatebit_D*/6         },
           {   /*sigGroup_s*/"igBrkSysCylPMst_0",   /*sig_name*/"isBrkSysCylPMstTar_0",   /*src_can*/"ZCU_CANFD1",   /*src_network_type*/"CANFD",   /*src_slotid_fr*/0,   /*src_basecycle_fr*/0,  /*src_repetition_fr*/0,  /*src_startbit*/237,   /*sigG_length*/10,  /*des_slotid_fr*/0,   /*des_basecycle_fr*/0,  /*des_repetition_fr*/0,   /*des_startbit*/29,    /*src_cyc*/101,  /*src_id*/0x82,   /*src_dlc*/64,   /*des_id*/0x54, /*updatebit_S*/431,   /*updatebit_D*/6         },
           {   /*sigGroup_s*/"igBrkSysCylPMst_0",   /*sig_name*/"isBrkSysCylPMstActQf_0",   /*src_can*/"ZCU_CANFD1",   /*src_network_type*/"CANFD",   /*src_slotid_fr*/0,   /*src_basecycle_fr*/0,  /*src_repetition_fr*/0,  /*src_startbit*/269,   /*sigG_length*/2,  /*des_slotid_fr*/0,   /*des_basecycle_fr*/0,  /*des_repetition_fr*/0,   /*des_startbit*/5,    /*src_cyc*/101,  /*src_id*/0x82,   /*src_dlc*/64,   /*des_id*/0x54, /*updatebit_S*/431,   /*updatebit_D*/6         },
           {   /*sigGroup_s*/"igBrkSysCylPMst_0",   /*sig_name*/"isBrkSysCylPMstVirt_0",   /*src_can*/"ZCU_CANFD1",   /*src_network_type*/"CANFD",   /*src_slotid_fr*/0,   /*src_basecycle_fr*/0,  /*src_repetition_fr*/0,  /*src_startbit*/243,   /*sigG_length*/10,  /*des_slotid_fr*/0,   /*des_basecycle_fr*/0,  /*des_repetition_fr*/0,   /*des_startbit*/35,    /*src_cyc*/101,  /*src_id*/0x82,   /*src_dlc*/64,   /*des_id*/0x54, /*updatebit_S*/431,   /*updatebit_D*/6         },
           {   /*sigGroup_s*/"igBrkSysCylPMst_0",   /*sig_name*/"isBrkSysCylPMstVirtQf_0",   /*src_can*/"ZCU_CANFD1",   /*src_network_type*/"CANFD",   /*src_slotid_fr*/0,   /*src_basecycle_fr*/0,  /*src_repetition_fr*/0,  /*src_startbit*/267,   /*sigG_length*/2,  /*des_slotid_fr*/0,   /*des_basecycle_fr*/0,  /*des_repetition_fr*/0,   /*des_startbit*/41,    /*src_cyc*/101,  /*src_id*/0x82,   /*src_dlc*/64,   /*des_id*/0x54, /*updatebit_S*/431,   /*updatebit_D*/6         },
           {   /*sigGroup_s*/"igCmptmtTFrnt_0",   /*sig_name*/"isCmptmtTFrntFanForCmptmtTRunng_0",   /*src_can*/"ZCU_CANFD1",   /*src_network_type*/"CANFD",   /*src_slotid_fr*/0,   /*src_basecycle_fr*/0,  /*src_repetition_fr*/0,  /*src_startbit*/50,   /*sigG_length*/1,  /*des_slotid_fr*/0,   /*des_basecycle_fr*/0,  /*des_repetition_fr*/0,   /*des_startbit*/35,    /*src_cyc*/101,  /*src_id*/0x212,   /*src_dlc*/64,   /*des_id*/0x121, /*updatebit_S*/49,   /*updatebit_D*/38         },
           {   /*sigGroup_s*/"igCmptmtTFrnt_0",   /*sig_name*/"isCmptmtTFrntQf_0",   /*src_can*/"ZCU_CANFD1",   /*src_network_type*/"CANFD",   /*src_slotid_fr*/0,   /*src_basecycle_fr*/0,  /*src_repetition_fr*/0,  /*src_startbit*/52,   /*sigG_length*/2,  /*des_slotid_fr*/0,   /*des_basecycle_fr*/0,  /*des_repetition_fr*/0,   /*des_startbit*/37,    /*src_cyc*/101,  /*src_id*/0x212,   /*src_dlc*/64,   /*des_id*/0x121, /*updatebit_S*/49,   /*updatebit_D*/38         },
           {   /*sigGroup_s*/"igCmptmtTFrnt_0",   /*sig_name*/"isCmptmtTFrntCmptmtTFrnt_0",   /*src_can*/"ZCU_CANFD1",   /*src_network_type*/"CANFD",   /*src_slotid_fr*/0,   /*src_basecycle_fr*/0,  /*src_repetition_fr*/0,  /*src_startbit*/47,   /*sigG_length*/11,  /*des_slotid_fr*/0,   /*des_basecycle_fr*/0,  /*des_repetition_fr*/0,   /*des_startbit*/34,    /*src_cyc*/101,  /*src_id*/0x212,   /*src_dlc*/64,   /*des_id*/0x121, /*updatebit_S*/49,   /*updatebit_D*/38         },
           {   /*sigGroup_s*/"igPreCrashFrontData_0",   /*sig_name*/"isPreCrashFrontDataCntr_0",   /*src_can*/"ZCU_CANFD1",   /*src_network_type*/"CANFD",   /*src_slotid_fr*/0,   /*src_basecycle_fr*/0,  /*src_repetition_fr*/0,  /*src_startbit*/223,   /*sigG_length*/4,  /*des_slotid_fr*/0,   /*des_basecycle_fr*/0,  /*des_repetition_fr*/0,   /*des_startbit*/47,    /*src_cyc*/101,  /*src_id*/0x190,   /*src_dlc*/64,   /*des_id*/0x50, /*updatebit_S*/216,   /*updatebit_D*/40         },
           {   /*sigGroup_s*/"igPreCrashFrontData_0",   /*sig_name*/"isPreCrashFrontDataClosingVelocity_0",   /*src_can*/"ZCU_CANFD1",   /*src_network_type*/"CANFD",   /*src_slotid_fr*/0,   /*src_basecycle_fr*/0,  /*src_repetition_fr*/0,  /*src_startbit*/199,   /*sigG_length*/8,  /*des_slotid_fr*/0,   /*des_basecycle_fr*/0,  /*des_repetition_fr*/0,   /*des_startbit*/31,    /*src_cyc*/101,  /*src_id*/0x190,   /*src_dlc*/64,   /*des_id*/0x50, /*updatebit_S*/216,   /*updatebit_D*/40         },
           {   /*sigGroup_s*/"igPreCrashFrontData_0",   /*sig_name*/"isPreCrashFrontDataOverLap_0",   /*src_can*/"ZCU_CANFD1",   /*src_network_type*/"CANFD",   /*src_slotid_fr*/0,   /*src_basecycle_fr*/0,  /*src_repetition_fr*/0,  /*src_startbit*/207,   /*sigG_length*/8,  /*des_slotid_fr*/0,   /*des_basecycle_fr*/0,  /*des_repetition_fr*/0,   /*des_startbit*/15,    /*src_cyc*/101,  /*src_id*/0x190,   /*src_dlc*/64,   /*des_id*/0x50, /*updatebit_S*/216,   /*updatebit_D*/40         },
           {   /*sigGroup_s*/"igPreCrashFrontData_0",   /*sig_name*/"isPreCrashFrontDataTimeToImpact_0",   /*src_can*/"ZCU_CANFD1",   /*src_network_type*/"CANFD",   /*src_slotid_fr*/0,   /*src_basecycle_fr*/0,  /*src_repetition_fr*/0,  /*src_startbit*/215,   /*sigG_length*/8,  /*des_slotid_fr*/0,   /*des_basecycle_fr*/0,  /*des_repetition_fr*/0,   /*des_startbit*/39,    /*src_cyc*/101,  /*src_id*/0x190,   /*src_dlc*/64,   /*des_id*/0x50, /*updatebit_S*/216,   /*updatebit_D*/40         },
           {   /*sigGroup_s*/"igPreCrashFrontData_0",   /*sig_name*/"isPreCrashFrontDataChks_0",   /*src_can*/"ZCU_CANFD1",   /*src_network_type*/"CANFD",   /*src_slotid_fr*/0,   /*src_basecycle_fr*/0,  /*src_repetition_fr*/0,  /*src_startbit*/191,   /*sigG_length*/8,  /*des_slotid_fr*/0,   /*des_basecycle_fr*/0,  /*des_repetition_fr*/0,   /*des_startbit*/23,    /*src_cyc*/101,  /*src_id*/0x190,   /*src_dlc*/64,   /*des_id*/0x50, /*updatebit_S*/216,   /*updatebit_D*/40         },
           {   /*sigGroup_s*/"igPreCrashFrontData_0",   /*sig_name*/"isPreCrashFrontDataObjectClass_0",   /*src_can*/"ZCU_CANFD1",   /*src_network_type*/"CANFD",   /*src_slotid_fr*/0,   /*src_basecycle_fr*/0,  /*src_repetition_fr*/0,  /*src_startbit*/219,   /*sigG_length*/3,  /*des_slotid_fr*/0,   /*des_basecycle_fr*/0,  /*des_repetition_fr*/0,   /*des_startbit*/43,    /*src_cyc*/101,  /*src_id*/0x190,   /*src_dlc*/64,   /*des_id*/0x50, /*updatebit_S*/216,   /*updatebit_D*/40         },
           {   /*sigGroup_s*/"igVehCfgPrmExt_0",   /*sig_name*/"isVehCfgPrmExtCCPBytePosn8_0",   /*src_can*/"ZCU_CANFD1",   /*src_network_type*/"CANFD",   /*src_slotid_fr*/0,   /*src_basecycle_fr*/0,  /*src_repetition_fr*/0,  /*src_startbit*/127,   /*sigG_length*/8,  /*des_slotid_fr*/0,   /*des_basecycle_fr*/0,  /*des_repetition_fr*/0,   /*des_startbit*/63,    /*src_cyc*/101,  /*src_id*/0x1f5,   /*src_dlc*/64,   /*des_id*/0x132, /*updatebit_S*/198,   /*updatebit_D*/1000         },
           {   /*sigGroup_s*/"igVehCfgPrmExt_0",   /*sig_name*/"isVehCfgPrmExtCCPBytePosn6_0",   /*src_can*/"ZCU_CANFD1",   /*src_network_type*/"CANFD",   /*src_slotid_fr*/0,   /*src_basecycle_fr*/0,  /*src_repetition_fr*/0,  /*src_startbit*/111,   /*sigG_length*/8,  /*des_slotid_fr*/0,   /*des_basecycle_fr*/0,  /*des_repetition_fr*/0,   /*des_startbit*/47,    /*src_cyc*/101,  /*src_id*/0x1f5,   /*src_dlc*/64,   /*des_id*/0x132, /*updatebit_S*/198,   /*updatebit_D*/1000         },
           {   /*sigGroup_s*/"igVehCfgPrmExt_0",   /*sig_name*/"isVehCfgPrmExtCCPBytePosn4_0",   /*src_can*/"ZCU_CANFD1",   /*src_network_type*/"CANFD",   /*src_slotid_fr*/0,   /*src_basecycle_fr*/0,  /*src_repetition_fr*/0,  /*src_startbit*/95,   /*sigG_length*/8,  /*des_slotid_fr*/0,   /*des_basecycle_fr*/0,  /*des_repetition_fr*/0,   /*des_startbit*/31,    /*src_cyc*/101,  /*src_id*/0x1f5,   /*src_dlc*/64,   /*des_id*/0x132, /*updatebit_S*/198,   /*updatebit_D*/1000         },
           {   /*sigGroup_s*/"igVehCfgPrmExt_0",   /*sig_name*/"isVehCfgPrmExtCCPBytePosn3_0",   /*src_can*/"ZCU_CANFD1",   /*src_network_type*/"CANFD",   /*src_slotid_fr*/0,   /*src_basecycle_fr*/0,  /*src_repetition_fr*/0,  /*src_startbit*/87,   /*sigG_length*/8,  /*des_slotid_fr*/0,   /*des_basecycle_fr*/0,  /*des_repetition_fr*/0,   /*des_startbit*/23,    /*src_cyc*/101,  /*src_id*/0x1f5,   /*src_dlc*/64,   /*des_id*/0x132, /*updatebit_S*/198,   /*updatebit_D*/1000         },
           {   /*sigGroup_s*/"igVehCfgPrmExt_0",   /*sig_name*/"isVehCfgPrmExtCCPBytePosn2_0",   /*src_can*/"ZCU_CANFD1",   /*src_network_type*/"CANFD",   /*src_slotid_fr*/0,   /*src_basecycle_fr*/0,  /*src_repetition_fr*/0,  /*src_startbit*/79,   /*sigG_length*/8,  /*des_slotid_fr*/0,   /*des_basecycle_fr*/0,  /*des_repetition_fr*/0,   /*des_startbit*/15,    /*src_cyc*/101,  /*src_id*/0x1f5,   /*src_dlc*/64,   /*des_id*/0x132, /*updatebit_S*/198,   /*updatebit_D*/1000         },
           {   /*sigGroup_s*/"igVehCfgPrmExt_0",   /*sig_name*/"isVehCfgPrmExtBlkIDBytePosn1_0",   /*src_can*/"ZCU_CANFD1",   /*src_network_type*/"CANFD",   /*src_slotid_fr*/0,   /*src_basecycle_fr*/0,  /*src_repetition_fr*/0,  /*src_startbit*/71,   /*sigG_length*/8,  /*des_slotid_fr*/0,   /*des_basecycle_fr*/0,  /*des_repetition_fr*/0,   /*des_startbit*/7,    /*src_cyc*/101,  /*src_id*/0x1f5,   /*src_dlc*/64,   /*des_id*/0x132, /*updatebit_S*/198,   /*updatebit_D*/1000         },
           {   /*sigGroup_s*/"igVehCfgPrmExt_0",   /*sig_name*/"isVehCfgPrmExtCCPBytePosn5_0",   /*src_can*/"ZCU_CANFD1",   /*src_network_type*/"CANFD",   /*src_slotid_fr*/0,   /*src_basecycle_fr*/0,  /*src_repetition_fr*/0,  /*src_startbit*/103,   /*sigG_length*/8,  /*des_slotid_fr*/0,   /*des_basecycle_fr*/0,  /*des_repetition_fr*/0,   /*des_startbit*/39,    /*src_cyc*/101,  /*src_id*/0x1f5,   /*src_dlc*/64,   /*des_id*/0x132, /*updatebit_S*/198,   /*updatebit_D*/1000         },
           {   /*sigGroup_s*/"igVehCfgPrmExt_0",   /*sig_name*/"isVehCfgPrmExtCCPBytePosn7_0",   /*src_can*/"ZCU_CANFD1",   /*src_network_type*/"CANFD",   /*src_slotid_fr*/0,   /*src_basecycle_fr*/0,  /*src_repetition_fr*/0,  /*src_startbit*/119,   /*sigG_length*/8,  /*des_slotid_fr*/0,   /*des_basecycle_fr*/0,  /*des_repetition_fr*/0,   /*des_startbit*/55,    /*src_cyc*/101,  /*src_id*/0x1f5,   /*src_dlc*/64,   /*des_id*/0x132, /*updatebit_S*/198,   /*updatebit_D*/1000         },
           {   /*sigGroup_s*/"igVin_0",   /*sig_name*/"isVinBlockNr_0",   /*src_can*/"ZCU_CANFD1",   /*src_network_type*/"CANFD",   /*src_slotid_fr*/0,   /*src_basecycle_fr*/0,  /*src_repetition_fr*/0,  /*src_startbit*/15,   /*sigG_length*/8,  /*des_slotid_fr*/0,   /*des_basecycle_fr*/0,  /*des_repetition_fr*/0,   /*des_startbit*/7,    /*src_cyc*/101,  /*src_id*/0x340,   /*src_dlc*/64,   /*des_id*/0x80, /*updatebit_S*/79,   /*updatebit_D*/1000         },
           {   /*sigGroup_s*/"igVin_0",   /*sig_name*/"isVinVINSignalPos4_0",   /*src_can*/"ZCU_CANFD1",   /*src_network_type*/"CANFD",   /*src_slotid_fr*/0,   /*src_basecycle_fr*/0,  /*src_repetition_fr*/0,  /*src_startbit*/47,   /*sigG_length*/8,  /*des_slotid_fr*/0,   /*des_basecycle_fr*/0,  /*des_repetition_fr*/0,   /*des_startbit*/39,    /*src_cyc*/101,  /*src_id*/0x340,   /*src_dlc*/64,   /*des_id*/0x80, /*updatebit_S*/79,   /*updatebit_D*/1000         },
           {   /*sigGroup_s*/"igVin_0",   /*sig_name*/"isVinVINSignalPos1_0",   /*src_can*/"ZCU_CANFD1",   /*src_network_type*/"CANFD",   /*src_slotid_fr*/0,   /*src_basecycle_fr*/0,  /*src_repetition_fr*/0,  /*src_startbit*/23,   /*sigG_length*/8,  /*des_slotid_fr*/0,   /*des_basecycle_fr*/0,  /*des_repetition_fr*/0,   /*des_startbit*/15,    /*src_cyc*/101,  /*src_id*/0x340,   /*src_dlc*/64,   /*des_id*/0x80, /*updatebit_S*/79,   /*updatebit_D*/1000         },
           {   /*sigGroup_s*/"igVin_0",   /*sig_name*/"isVinVINSignalPos3_0",   /*src_can*/"ZCU_CANFD1",   /*src_network_type*/"CANFD",   /*src_slotid_fr*/0,   /*src_basecycle_fr*/0,  /*src_repetition_fr*/0,  /*src_startbit*/39,   /*sigG_length*/8,  /*des_slotid_fr*/0,   /*des_basecycle_fr*/0,  /*des_repetition_fr*/0,   /*des_startbit*/31,    /*src_cyc*/101,  /*src_id*/0x340,   /*src_dlc*/64,   /*des_id*/0x80, /*updatebit_S*/79,   /*updatebit_D*/1000         },
           {   /*sigGroup_s*/"igVin_0",   /*sig_name*/"isVinVINSignalPos7_0",   /*src_can*/"ZCU_CANFD1",   /*src_network_type*/"CANFD",   /*src_slotid_fr*/0,   /*src_basecycle_fr*/0,  /*src_repetition_fr*/0,  /*src_startbit*/71,   /*sigG_length*/8,  /*des_slotid_fr*/0,   /*des_basecycle_fr*/0,  /*des_repetition_fr*/0,   /*des_startbit*/63,    /*src_cyc*/101,  /*src_id*/0x340,   /*src_dlc*/64,   /*des_id*/0x80, /*updatebit_S*/79,   /*updatebit_D*/1000         },
           {   /*sigGroup_s*/"igVin_0",   /*sig_name*/"isVinVINSignalPos6_0",   /*src_can*/"ZCU_CANFD1",   /*src_network_type*/"CANFD",   /*src_slotid_fr*/0,   /*src_basecycle_fr*/0,  /*src_repetition_fr*/0,  /*src_startbit*/63,   /*sigG_length*/8,  /*des_slotid_fr*/0,   /*des_basecycle_fr*/0,  /*des_repetition_fr*/0,   /*des_startbit*/55,    /*src_cyc*/101,  /*src_id*/0x340,   /*src_dlc*/64,   /*des_id*/0x80, /*updatebit_S*/79,   /*updatebit_D*/1000         },
           {   /*sigGroup_s*/"igVin_0",   /*sig_name*/"isVinVINSignalPos5_0",   /*src_can*/"ZCU_CANFD1",   /*src_network_type*/"CANFD",   /*src_slotid_fr*/0,   /*src_basecycle_fr*/0,  /*src_repetition_fr*/0,  /*src_startbit*/55,   /*sigG_length*/8,  /*des_slotid_fr*/0,   /*des_basecycle_fr*/0,  /*des_repetition_fr*/0,   /*des_startbit*/47,    /*src_cyc*/101,  /*src_id*/0x340,   /*src_dlc*/64,   /*des_id*/0x80, /*updatebit_S*/79,   /*updatebit_D*/1000         },
           {   /*sigGroup_s*/"igVin_0",   /*sig_name*/"isVinVINSignalPos2_0",   /*src_can*/"ZCU_CANFD1",   /*src_network_type*/"CANFD",   /*src_slotid_fr*/0,   /*src_basecycle_fr*/0,  /*src_repetition_fr*/0,  /*src_startbit*/31,   /*sigG_length*/8,  /*des_slotid_fr*/0,   /*des_basecycle_fr*/0,  /*des_repetition_fr*/0,   /*des_startbit*/23,    /*src_cyc*/101,  /*src_id*/0x340,   /*src_dlc*/64,   /*des_id*/0x80, /*updatebit_S*/79,   /*updatebit_D*/1000         },
           {   /*sigGroup_s*/"igBrkPedlrRat_0",   /*sig_name*/"isBrkPedlrRatPerc_0",   /*src_can*/"ZCU_CANFD1",   /*src_network_type*/"CANFD",   /*src_slotid_fr*/0,   /*src_basecycle_fr*/0,  /*src_repetition_fr*/0,  /*src_startbit*/6,   /*sigG_length*/15,  /*des_slotid_fr*/0,   /*des_basecycle_fr*/0,  /*des_repetition_fr*/0,   /*des_startbit*/6,    /*src_cyc*/101,  /*src_id*/0x1e3,   /*src_dlc*/64,   /*des_id*/0x384, /*updatebit_S*/7,   /*updatebit_D*/7         },
           {   /*sigGroup_s*/"igBrkPedlrRat_0",   /*sig_name*/"isBrkPedlrRatQf_0",   /*src_can*/"ZCU_CANFD1",   /*src_network_type*/"CANFD",   /*src_slotid_fr*/0,   /*src_basecycle_fr*/0,  /*src_repetition_fr*/0,  /*src_startbit*/23,   /*sigG_length*/2,  /*des_slotid_fr*/0,   /*des_basecycle_fr*/0,  /*des_repetition_fr*/0,   /*des_startbit*/23,    /*src_cyc*/101,  /*src_id*/0x1e3,   /*src_dlc*/64,   /*des_id*/0x384, /*updatebit_S*/7,   /*updatebit_D*/7         },
           {   /*sigGroup_s*/"igEpbSts_0",   /*sig_name*/"isEpbStsCntr_0",   /*src_can*/"ZCU_CANFD1",   /*src_network_type*/"CANFD",   /*src_slotid_fr*/0,   /*src_basecycle_fr*/0,  /*src_repetition_fr*/0,  /*src_startbit*/135,   /*sigG_length*/4,  /*des_slotid_fr*/0,   /*des_basecycle_fr*/0,  /*des_repetition_fr*/0,   /*des_startbit*/11,    /*src_cyc*/101,  /*src_id*/0x10a,   /*src_dlc*/64,   /*des_id*/0x131, /*updatebit_S*/273,   /*updatebit_D*/50         },
           {   /*sigGroup_s*/"igEpbSts_0",   /*sig_name*/"isEpbStsChks_0",   /*src_can*/"ZCU_CANFD1",   /*src_network_type*/"CANFD",   /*src_slotid_fr*/0,   /*src_basecycle_fr*/0,  /*src_repetition_fr*/0,  /*src_startbit*/127,   /*sigG_length*/8,  /*des_slotid_fr*/0,   /*des_basecycle_fr*/0,  /*des_repetition_fr*/0,   /*des_startbit*/7,    /*src_cyc*/101,  /*src_id*/0x10a,   /*src_dlc*/64,   /*des_id*/0x131, /*updatebit_S*/273,   /*updatebit_D*/50         },
           {   /*sigGroup_s*/"igEpbSts_0",   /*sig_name*/"isEpbStsEpbSts_0",   /*src_can*/"ZCU_CANFD1",   /*src_network_type*/"CANFD",   /*src_slotid_fr*/0,   /*src_basecycle_fr*/0,  /*src_repetition_fr*/0,  /*src_startbit*/131,   /*sigG_length*/4,  /*des_slotid_fr*/0,   /*des_basecycle_fr*/0,  /*des_repetition_fr*/0,   /*des_startbit*/15,    /*src_cyc*/101,  /*src_id*/0x10a,   /*src_dlc*/64,   /*des_id*/0x131, /*updatebit_S*/273,   /*updatebit_D*/50         },
           {   /*sigGroup_s*/"igVehCfgPrmExt2_0",   /*sig_name*/"isVehCfgPrmExt2BlkIDBytePosn1_0",   /*src_can*/"ZCU_CANFD1",   /*src_network_type*/"CANFD",   /*src_slotid_fr*/0,   /*src_basecycle_fr*/0,  /*src_repetition_fr*/0,  /*src_startbit*/135,   /*sigG_length*/8,  /*des_slotid_fr*/0,   /*des_basecycle_fr*/0,  /*des_repetition_fr*/0,   /*des_startbit*/7,    /*src_cyc*/101,  /*src_id*/0x1f5,   /*src_dlc*/64,   /*des_id*/0x318, /*updatebit_S*/197,   /*updatebit_D*/1000         },
           {   /*sigGroup_s*/"igVehCfgPrmExt2_0",   /*sig_name*/"isVehCfgPrmExt2CCPBytePosn2_0",   /*src_can*/"ZCU_CANFD1",   /*src_network_type*/"CANFD",   /*src_slotid_fr*/0,   /*src_basecycle_fr*/0,  /*src_repetition_fr*/0,  /*src_startbit*/143,   /*sigG_length*/8,  /*des_slotid_fr*/0,   /*des_basecycle_fr*/0,  /*des_repetition_fr*/0,   /*des_startbit*/15,    /*src_cyc*/101,  /*src_id*/0x1f5,   /*src_dlc*/64,   /*des_id*/0x318, /*updatebit_S*/197,   /*updatebit_D*/1000         },
           {   /*sigGroup_s*/"igVehCfgPrmExt2_0",   /*sig_name*/"isVehCfgPrmExt2CCPBytePosn6_0",   /*src_can*/"ZCU_CANFD1",   /*src_network_type*/"CANFD",   /*src_slotid_fr*/0,   /*src_basecycle_fr*/0,  /*src_repetition_fr*/0,  /*src_startbit*/175,   /*sigG_length*/8,  /*des_slotid_fr*/0,   /*des_basecycle_fr*/0,  /*des_repetition_fr*/0,   /*des_startbit*/47,    /*src_cyc*/101,  /*src_id*/0x1f5,   /*src_dlc*/64,   /*des_id*/0x318, /*updatebit_S*/197,   /*updatebit_D*/1000         },
           {   /*sigGroup_s*/"igVehCfgPrmExt2_0",   /*sig_name*/"isVehCfgPrmExt2CCPBytePosn4_0",   /*src_can*/"ZCU_CANFD1",   /*src_network_type*/"CANFD",   /*src_slotid_fr*/0,   /*src_basecycle_fr*/0,  /*src_repetition_fr*/0,  /*src_startbit*/159,   /*sigG_length*/8,  /*des_slotid_fr*/0,   /*des_basecycle_fr*/0,  /*des_repetition_fr*/0,   /*des_startbit*/31,    /*src_cyc*/101,  /*src_id*/0x1f5,   /*src_dlc*/64,   /*des_id*/0x318, /*updatebit_S*/197,   /*updatebit_D*/1000         },
           {   /*sigGroup_s*/"igVehCfgPrmExt2_0",   /*sig_name*/"isVehCfgPrmExt2CCPBytePosn5_0",   /*src_can*/"ZCU_CANFD1",   /*src_network_type*/"CANFD",   /*src_slotid_fr*/0,   /*src_basecycle_fr*/0,  /*src_repetition_fr*/0,  /*src_startbit*/167,   /*sigG_length*/8,  /*des_slotid_fr*/0,   /*des_basecycle_fr*/0,  /*des_repetition_fr*/0,   /*des_startbit*/39,    /*src_cyc*/101,  /*src_id*/0x1f5,   /*src_dlc*/64,   /*des_id*/0x318, /*updatebit_S*/197,   /*updatebit_D*/1000         },
           {   /*sigGroup_s*/"igVehCfgPrmExt2_0",   /*sig_name*/"isVehCfgPrmExt2CCPBytePosn3_0",   /*src_can*/"ZCU_CANFD1",   /*src_network_type*/"CANFD",   /*src_slotid_fr*/0,   /*src_basecycle_fr*/0,  /*src_repetition_fr*/0,  /*src_startbit*/151,   /*sigG_length*/8,  /*des_slotid_fr*/0,   /*des_basecycle_fr*/0,  /*des_repetition_fr*/0,   /*des_startbit*/23,    /*src_cyc*/101,  /*src_id*/0x1f5,   /*src_dlc*/64,   /*des_id*/0x318, /*updatebit_S*/197,   /*updatebit_D*/1000         },
           {   /*sigGroup_s*/"igVehCfgPrmExt2_0",   /*sig_name*/"isVehCfgPrmExt2CCPBytePosn7_0",   /*src_can*/"ZCU_CANFD1",   /*src_network_type*/"CANFD",   /*src_slotid_fr*/0,   /*src_basecycle_fr*/0,  /*src_repetition_fr*/0,  /*src_startbit*/183,   /*sigG_length*/8,  /*des_slotid_fr*/0,   /*des_basecycle_fr*/0,  /*des_repetition_fr*/0,   /*des_startbit*/55,    /*src_cyc*/101,  /*src_id*/0x1f5,   /*src_dlc*/64,   /*des_id*/0x318, /*updatebit_S*/197,   /*updatebit_D*/1000         },
           {   /*sigGroup_s*/"igVehCfgPrmExt2_0",   /*sig_name*/"isVehCfgPrmExt2CCPBytePosn8_0",   /*src_can*/"ZCU_CANFD1",   /*src_network_type*/"CANFD",   /*src_slotid_fr*/0,   /*src_basecycle_fr*/0,  /*src_repetition_fr*/0,  /*src_startbit*/191,   /*sigG_length*/8,  /*des_slotid_fr*/0,   /*des_basecycle_fr*/0,  /*des_repetition_fr*/0,   /*des_startbit*/63,    /*src_cyc*/101,  /*src_id*/0x1f5,   /*src_dlc*/64,   /*des_id*/0x318, /*updatebit_S*/197,   /*updatebit_D*/1000         },
           {   /*sigGroup_s*/"igBrkAndAbsWarnIndcnReq_0",   /*sig_name*/"isBrkAndAbsWarnIndcnReqCntr_0",   /*src_can*/"ZCU_CANFD1",   /*src_network_type*/"CANFD",   /*src_slotid_fr*/0,   /*src_basecycle_fr*/0,  /*src_repetition_fr*/0,  /*src_startbit*/111,   /*sigG_length*/4,  /*des_slotid_fr*/0,   /*des_basecycle_fr*/0,  /*des_repetition_fr*/0,   /*des_startbit*/31,    /*src_cyc*/101,  /*src_id*/0x240,   /*src_dlc*/64,   /*des_id*/0x388, /*updatebit_S*/104,   /*updatebit_D*/24         },
           {   /*sigGroup_s*/"igBrkAndAbsWarnIndcnReq_0",   /*sig_name*/"isBrkAndAbsWarnIndcnReqBrkWarnIndcnReq_0",   /*src_can*/"ZCU_CANFD1",   /*src_network_type*/"CANFD",   /*src_slotid_fr*/0,   /*src_basecycle_fr*/0,  /*src_repetition_fr*/0,  /*src_startbit*/105,   /*sigG_length*/1,  /*des_slotid_fr*/0,   /*des_basecycle_fr*/0,  /*des_repetition_fr*/0,   /*des_startbit*/25,    /*src_cyc*/101,  /*src_id*/0x240,   /*src_dlc*/64,   /*des_id*/0x388, /*updatebit_S*/104,   /*updatebit_D*/24         },
           {   /*sigGroup_s*/"igBrkAndAbsWarnIndcnReq_0",   /*sig_name*/"isBrkAndAbsWarnIndcnReqAbsWarnIndcnReq_0",   /*src_can*/"ZCU_CANFD1",   /*src_network_type*/"CANFD",   /*src_slotid_fr*/0,   /*src_basecycle_fr*/0,  /*src_repetition_fr*/0,  /*src_startbit*/107,   /*sigG_length*/2,  /*des_slotid_fr*/0,   /*des_basecycle_fr*/0,  /*des_repetition_fr*/0,   /*des_startbit*/27,    /*src_cyc*/101,  /*src_id*/0x240,   /*src_dlc*/64,   /*des_id*/0x388, /*updatebit_S*/104,   /*updatebit_D*/24         },
           {   /*sigGroup_s*/"igBrkAndAbsWarnIndcnReq_0",   /*sig_name*/"isBrkAndAbsWarnIndcnReqChks_0",   /*src_can*/"ZCU_CANFD1",   /*src_network_type*/"CANFD",   /*src_slotid_fr*/0,   /*src_basecycle_fr*/0,  /*src_repetition_fr*/0,  /*src_startbit*/103,   /*sigG_length*/8,  /*des_slotid_fr*/0,   /*des_basecycle_fr*/0,  /*des_repetition_fr*/0,   /*des_startbit*/23,    /*src_cyc*/101,  /*src_id*/0x240,   /*src_dlc*/64,   /*des_id*/0x388, /*updatebit_S*/104,   /*updatebit_D*/24         },
           {   /*sigGroup_s*/"igVehSpdIndcd_0",   /*sig_name*/"isVehSpdIndcdVeSpdIndcdUnit_0",   /*src_can*/"ZCU_CANFD1",   /*src_network_type*/"CANFD",   /*src_slotid_fr*/0,   /*src_basecycle_fr*/0,  /*src_repetition_fr*/0,  /*src_startbit*/134,   /*sigG_length*/2,  /*des_slotid_fr*/0,   /*des_basecycle_fr*/0,  /*des_repetition_fr*/0,   /*des_startbit*/18,    /*src_cyc*/101,  /*src_id*/0x160,   /*src_dlc*/64,   /*des_id*/0x131, /*updatebit_S*/132,   /*updatebit_D*/19         },
           {   /*sigGroup_s*/"igVehSpdIndcd_0",   /*sig_name*/"isVehSpdIndcdVehSpdIndcd_0",   /*src_can*/"ZCU_CANFD1",   /*src_network_type*/"CANFD",   /*src_slotid_fr*/0,   /*src_basecycle_fr*/0,  /*src_repetition_fr*/0,  /*src_startbit*/127,   /*sigG_length*/9,  /*des_slotid_fr*/0,   /*des_basecycle_fr*/0,  /*des_repetition_fr*/0,   /*des_startbit*/16,    /*src_cyc*/101,  /*src_id*/0x160,   /*src_dlc*/64,   /*des_id*/0x131, /*updatebit_S*/132,   /*updatebit_D*/19         },
           {   /*sigGroup_s*/"igVehMtnSt_0",   /*sig_name*/"isVehMtnStCntr_0",   /*src_can*/"ZCU_CANFD1",   /*src_network_type*/"CANFD",   /*src_slotid_fr*/0,   /*src_basecycle_fr*/0,  /*src_repetition_fr*/0,  /*src_startbit*/423,   /*sigG_length*/4,  /*des_slotid_fr*/0,   /*des_basecycle_fr*/0,  /*des_repetition_fr*/0,   /*des_startbit*/6,    /*src_cyc*/101,  /*src_id*/0x82,   /*src_dlc*/64,   /*des_id*/0x40, /*updatebit_S*/416,   /*updatebit_D*/7         },
           {   /*sigGroup_s*/"igVehMtnSt_0",   /*sig_name*/"isVehMtnStVehMtnSt_0",   /*src_can*/"ZCU_CANFD1",   /*src_network_type*/"CANFD",   /*src_slotid_fr*/0,   /*src_basecycle_fr*/0,  /*src_repetition_fr*/0,  /*src_startbit*/419,   /*sigG_length*/3,  /*des_slotid_fr*/0,   /*des_basecycle_fr*/0,  /*des_repetition_fr*/0,   /*des_startbit*/2,    /*src_cyc*/101,  /*src_id*/0x82,   /*src_dlc*/64,   /*des_id*/0x40, /*updatebit_S*/416,   /*updatebit_D*/7         },
           {   /*sigGroup_s*/"igVehMtnSt_0",   /*sig_name*/"isVehMtnStChks_0",   /*src_can*/"ZCU_CANFD1",   /*src_network_type*/"CANFD",   /*src_slotid_fr*/0,   /*src_basecycle_fr*/0,  /*src_repetition_fr*/0,  /*src_startbit*/415,   /*sigG_length*/8,  /*des_slotid_fr*/0,   /*des_basecycle_fr*/0,  /*des_repetition_fr*/0,   /*des_startbit*/15,    /*src_cyc*/101,  /*src_id*/0x82,   /*src_dlc*/64,   /*des_id*/0x40, /*updatebit_S*/416,   /*updatebit_D*/7         },
           {   /*sigGroup_s*/"igVehCfgPrm_0",   /*sig_name*/"isVehCfgPrmCCPBytePosn2_0",   /*src_can*/"ZCU_CANFD1",   /*src_network_type*/"CANFD",   /*src_slotid_fr*/0,   /*src_basecycle_fr*/0,  /*src_repetition_fr*/0,  /*src_startbit*/15,   /*sigG_length*/8,  /*des_slotid_fr*/0,   /*des_basecycle_fr*/0,  /*des_repetition_fr*/0,   /*des_startbit*/15,    /*src_cyc*/101,  /*src_id*/0x1f5,   /*src_dlc*/64,   /*des_id*/0x340, /*updatebit_S*/199,   /*updatebit_D*/1000         },
           {   /*sigGroup_s*/"igVehCfgPrm_0",   /*sig_name*/"isVehCfgPrmCCPBytePosn7_0",   /*src_can*/"ZCU_CANFD1",   /*src_network_type*/"CANFD",   /*src_slotid_fr*/0,   /*src_basecycle_fr*/0,  /*src_repetition_fr*/0,  /*src_startbit*/55,   /*sigG_length*/8,  /*des_slotid_fr*/0,   /*des_basecycle_fr*/0,  /*des_repetition_fr*/0,   /*des_startbit*/55,    /*src_cyc*/101,  /*src_id*/0x1f5,   /*src_dlc*/64,   /*des_id*/0x340, /*updatebit_S*/199,   /*updatebit_D*/1000         },
           {   /*sigGroup_s*/"igVehCfgPrm_0",   /*sig_name*/"isVehCfgPrmCCPBytePosn3_0",   /*src_can*/"ZCU_CANFD1",   /*src_network_type*/"CANFD",   /*src_slotid_fr*/0,   /*src_basecycle_fr*/0,  /*src_repetition_fr*/0,  /*src_startbit*/23,   /*sigG_length*/8,  /*des_slotid_fr*/0,   /*des_basecycle_fr*/0,  /*des_repetition_fr*/0,   /*des_startbit*/23,    /*src_cyc*/101,  /*src_id*/0x1f5,   /*src_dlc*/64,   /*des_id*/0x340, /*updatebit_S*/199,   /*updatebit_D*/1000         },
           {   /*sigGroup_s*/"igVehCfgPrm_0",   /*sig_name*/"isVehCfgPrmCCPBytePosn4_0",   /*src_can*/"ZCU_CANFD1",   /*src_network_type*/"CANFD",   /*src_slotid_fr*/0,   /*src_basecycle_fr*/0,  /*src_repetition_fr*/0,  /*src_startbit*/31,   /*sigG_length*/8,  /*des_slotid_fr*/0,   /*des_basecycle_fr*/0,  /*des_repetition_fr*/0,   /*des_startbit*/31,    /*src_cyc*/101,  /*src_id*/0x1f5,   /*src_dlc*/64,   /*des_id*/0x340, /*updatebit_S*/199,   /*updatebit_D*/1000         },
           {   /*sigGroup_s*/"igVehCfgPrm_0",   /*sig_name*/"isVehCfgPrmCCPBytePosn8_0",   /*src_can*/"ZCU_CANFD1",   /*src_network_type*/"CANFD",   /*src_slotid_fr*/0,   /*src_basecycle_fr*/0,  /*src_repetition_fr*/0,  /*src_startbit*/63,   /*sigG_length*/8,  /*des_slotid_fr*/0,   /*des_basecycle_fr*/0,  /*des_repetition_fr*/0,   /*des_startbit*/63,    /*src_cyc*/101,  /*src_id*/0x1f5,   /*src_dlc*/64,   /*des_id*/0x340, /*updatebit_S*/199,   /*updatebit_D*/1000         },
           {   /*sigGroup_s*/"igVehCfgPrm_0",   /*sig_name*/"isVehCfgPrmCCPBytePosn5_0",   /*src_can*/"ZCU_CANFD1",   /*src_network_type*/"CANFD",   /*src_slotid_fr*/0,   /*src_basecycle_fr*/0,  /*src_repetition_fr*/0,  /*src_startbit*/39,   /*sigG_length*/8,  /*des_slotid_fr*/0,   /*des_basecycle_fr*/0,  /*des_repetition_fr*/0,   /*des_startbit*/39,    /*src_cyc*/101,  /*src_id*/0x1f5,   /*src_dlc*/64,   /*des_id*/0x340, /*updatebit_S*/199,   /*updatebit_D*/1000         },
           {   /*sigGroup_s*/"igVehCfgPrm_0",   /*sig_name*/"isVehCfgPrmBlkIDBytePosn1_0",   /*src_can*/"ZCU_CANFD1",   /*src_network_type*/"CANFD",   /*src_slotid_fr*/0,   /*src_basecycle_fr*/0,  /*src_repetition_fr*/0,  /*src_startbit*/7,   /*sigG_length*/8,  /*des_slotid_fr*/0,   /*des_basecycle_fr*/0,  /*des_repetition_fr*/0,   /*des_startbit*/7,    /*src_cyc*/101,  /*src_id*/0x1f5,   /*src_dlc*/64,   /*des_id*/0x340, /*updatebit_S*/199,   /*updatebit_D*/1000         },
           {   /*sigGroup_s*/"igVehCfgPrm_0",   /*sig_name*/"isVehCfgPrmCCPBytePosn6_0",   /*src_can*/"ZCU_CANFD1",   /*src_network_type*/"CANFD",   /*src_slotid_fr*/0,   /*src_basecycle_fr*/0,  /*src_repetition_fr*/0,  /*src_startbit*/47,   /*sigG_length*/8,  /*des_slotid_fr*/0,   /*des_basecycle_fr*/0,  /*des_repetition_fr*/0,   /*des_startbit*/47,    /*src_cyc*/101,  /*src_id*/0x1f5,   /*src_dlc*/64,   /*des_id*/0x340, /*updatebit_S*/199,   /*updatebit_D*/1000         },
           {   /*sigGroup_s*/"igEscSt_0",   /*sig_name*/"isEscStChks_0",   /*src_can*/"ZCU_CANFD1",   /*src_network_type*/"CANFD",   /*src_slotid_fr*/0,   /*src_basecycle_fr*/0,  /*src_repetition_fr*/0,  /*src_startbit*/343,   /*sigG_length*/8,  /*des_slotid_fr*/0,   /*des_basecycle_fr*/0,  /*des_repetition_fr*/0,   /*des_startbit*/47,    /*src_cyc*/101,  /*src_id*/0x82,   /*src_dlc*/64,   /*des_id*/0x384, /*updatebit_S*/344,   /*updatebit_D*/39         },
           {   /*sigGroup_s*/"igEscSt_0",   /*sig_name*/"isEscStEscSt_0",   /*src_can*/"ZCU_CANFD1",   /*src_network_type*/"CANFD",   /*src_slotid_fr*/0,   /*src_basecycle_fr*/0,  /*src_repetition_fr*/0,  /*src_startbit*/347,   /*sigG_length*/3,  /*des_slotid_fr*/0,   /*des_basecycle_fr*/0,  /*des_repetition_fr*/0,   /*des_startbit*/38,    /*src_cyc*/101,  /*src_id*/0x82,   /*src_dlc*/64,   /*des_id*/0x384, /*updatebit_S*/344,   /*updatebit_D*/39         },
           {   /*sigGroup_s*/"igEscSt_0",   /*sig_name*/"isEscStCntr_0",   /*src_can*/"ZCU_CANFD1",   /*src_network_type*/"CANFD",   /*src_slotid_fr*/0,   /*src_basecycle_fr*/0,  /*src_repetition_fr*/0,  /*src_startbit*/351,   /*sigG_length*/4,  /*des_slotid_fr*/0,   /*des_basecycle_fr*/0,  /*des_repetition_fr*/0,   /*des_startbit*/35,    /*src_cyc*/101,  /*src_id*/0x82,   /*src_dlc*/64,   /*des_id*/0x384, /*updatebit_S*/344,   /*updatebit_D*/39         },
           {   /*sigGroup_s*/"igBrkPedlPsd_0",   /*sig_name*/"isBrkPedlPsdBrkPedlPsd_0",   /*src_can*/"ZCU_CANFD1",   /*src_network_type*/"CANFD",   /*src_slotid_fr*/0,   /*src_basecycle_fr*/0,  /*src_repetition_fr*/0,  /*src_startbit*/168,   /*sigG_length*/1,  /*des_slotid_fr*/0,   /*des_basecycle_fr*/0,  /*des_repetition_fr*/0,   /*des_startbit*/6,    /*src_cyc*/101,  /*src_id*/0x82,   /*src_dlc*/64,   /*des_id*/0x32f, /*updatebit_S*/400,   /*updatebit_D*/23         },
           {   /*sigGroup_s*/"igBrkPedlPsd_0",   /*sig_name*/"isBrkPedlPsdCntr_0",   /*src_can*/"ZCU_CANFD1",   /*src_network_type*/"CANFD",   /*src_slotid_fr*/0,   /*src_basecycle_fr*/0,  /*src_repetition_fr*/0,  /*src_startbit*/175,   /*sigG_length*/4,  /*des_slotid_fr*/0,   /*des_basecycle_fr*/0,  /*des_repetition_fr*/0,   /*des_startbit*/3,    /*src_cyc*/101,  /*src_id*/0x82,   /*src_dlc*/64,   /*des_id*/0x32f, /*updatebit_S*/400,   /*updatebit_D*/23         },
           {   /*sigGroup_s*/"igBrkPedlPsd_0",   /*sig_name*/"isBrkPedlPsdChks_0",   /*src_can*/"ZCU_CANFD1",   /*src_network_type*/"CANFD",   /*src_slotid_fr*/0,   /*src_basecycle_fr*/0,  /*src_repetition_fr*/0,  /*src_startbit*/167,   /*sigG_length*/8,  /*des_slotid_fr*/0,   /*des_basecycle_fr*/0,  /*des_repetition_fr*/0,   /*des_startbit*/15,    /*src_cyc*/101,  /*src_id*/0x82,   /*src_dlc*/64,   /*des_id*/0x32f, /*updatebit_S*/400,   /*updatebit_D*/23         },
           {   /*sigGroup_s*/"igBrkPedlPsd_0",   /*sig_name*/"isBrkPedlPsdQf_0",   /*src_can*/"ZCU_CANFD1",   /*src_network_type*/"CANFD",   /*src_slotid_fr*/0,   /*src_basecycle_fr*/0,  /*src_repetition_fr*/0,  /*src_startbit*/171,   /*sigG_length*/2,  /*des_slotid_fr*/0,   /*des_basecycle_fr*/0,  /*des_repetition_fr*/0,   /*des_startbit*/5,    /*src_cyc*/101,  /*src_id*/0x82,   /*src_dlc*/64,   /*des_id*/0x32f, /*updatebit_S*/400,   /*updatebit_D*/23         },
           {   /*sigGroup_s*/"igBrkPedlPsd_0",   /*sig_name*/"isBrkPedlPsdBrkPedlNotPsdSafe_0",   /*src_can*/"ZCU_CANFD1",   /*src_network_type*/"CANFD",   /*src_slotid_fr*/0,   /*src_basecycle_fr*/0,  /*src_repetition_fr*/0,  /*src_startbit*/169,   /*sigG_length*/1,  /*des_slotid_fr*/0,   /*des_basecycle_fr*/0,  /*des_repetition_fr*/0,   /*des_startbit*/7,    /*src_cyc*/101,  /*src_id*/0x82,   /*src_dlc*/64,   /*des_id*/0x32f, /*updatebit_S*/400,   /*updatebit_D*/23         },
           {   /*sigGroup_s*/"igAsyALgtSts_0",   /*sig_name*/"isAsyALgtStsAsyALgtSts_0",   /*src_can*/"ZCU_CANFD1",   /*src_network_type*/"CANFD",   /*src_slotid_fr*/0,   /*src_basecycle_fr*/0,  /*src_repetition_fr*/0,  /*src_startbit*/311,   /*sigG_length*/4,  /*des_slotid_fr*/0,   /*des_basecycle_fr*/0,  /*des_repetition_fr*/0,   /*des_startbit*/43,    /*src_cyc*/101,  /*src_id*/0x109,   /*src_dlc*/64,   /*des_id*/0x320, /*updatebit_S*/352,   /*updatebit_D*/63         },
           {   /*sigGroup_s*/"igAsyALgtSts_0",   /*sig_name*/"isAsyALgtStsCntr_0",   /*src_can*/"ZCU_CANFD1",   /*src_network_type*/"CANFD",   /*src_slotid_fr*/0,   /*src_basecycle_fr*/0,  /*src_repetition_fr*/0,  /*src_startbit*/307,   /*sigG_length*/4,  /*des_slotid_fr*/0,   /*des_basecycle_fr*/0,  /*des_repetition_fr*/0,   /*des_startbit*/47,    /*src_cyc*/101,  /*src_id*/0x109,   /*src_dlc*/64,   /*des_id*/0x320, /*updatebit_S*/352,   /*updatebit_D*/63         },
           {   /*sigGroup_s*/"igAsyALgtSts_0",   /*sig_name*/"isAsyALgtStsChks_0",   /*src_can*/"ZCU_CANFD1",   /*src_network_type*/"CANFD",   /*src_slotid_fr*/0,   /*src_basecycle_fr*/0,  /*src_repetition_fr*/0,  /*src_startbit*/303,   /*sigG_length*/8,  /*des_slotid_fr*/0,   /*des_basecycle_fr*/0,  /*des_repetition_fr*/0,   /*des_startbit*/39,    /*src_cyc*/101,  /*src_id*/0x109,   /*src_dlc*/64,   /*des_id*/0x320, /*updatebit_S*/352,   /*updatebit_D*/63         },
           {   /*sigGroup_s*/"igOccupyMonSts_0",   /*sig_name*/"isOccupyMonStsDrvrSts_0",   /*src_can*/"ZCU_CANFD1",   /*src_network_type*/"CANFD",   /*src_slotid_fr*/0,   /*src_basecycle_fr*/0,  /*src_repetition_fr*/0,  /*src_startbit*/143,   /*sigG_length*/2,  /*des_slotid_fr*/0,   /*des_basecycle_fr*/0,  /*des_repetition_fr*/0,   /*des_startbit*/27,    /*src_cyc*/101,  /*src_id*/0x105,   /*src_dlc*/64,   /*des_id*/0x78, /*updatebit_S*/112,   /*updatebit_D*/28         },
           {   /*sigGroup_s*/"igOccupyMonSts_0",   /*sig_name*/"isOccupyMonStsSecMidSts_0",   /*src_can*/"ZCU_CANFD1",   /*src_network_type*/"CANFD",   /*src_slotid_fr*/0,   /*src_basecycle_fr*/0,  /*src_repetition_fr*/0,  /*src_startbit*/137,   /*sigG_length*/2,  /*des_slotid_fr*/0,   /*des_basecycle_fr*/0,  /*des_repetition_fr*/0,   /*des_startbit*/37,    /*src_cyc*/101,  /*src_id*/0x105,   /*src_dlc*/64,   /*des_id*/0x78, /*updatebit_S*/112,   /*updatebit_D*/28         },
           {   /*sigGroup_s*/"igOccupyMonSts_0",   /*sig_name*/"isOccupyMonStsThrdLeSts_0",   /*src_can*/"ZCU_CANFD1",   /*src_network_type*/"CANFD",   /*src_slotid_fr*/0,   /*src_basecycle_fr*/0,  /*src_repetition_fr*/0,  /*src_startbit*/149,   /*sigG_length*/2,  /*des_slotid_fr*/0,   /*des_basecycle_fr*/0,  /*des_repetition_fr*/0,   /*des_startbit*/33,    /*src_cyc*/101,  /*src_id*/0x105,   /*src_dlc*/64,   /*des_id*/0x78, /*updatebit_S*/112,   /*updatebit_D*/28         },
           {   /*sigGroup_s*/"igOccupyMonSts_0",   /*sig_name*/"isOccupyMonStsSeccLeSts_0",   /*src_can*/"ZCU_CANFD1",   /*src_network_type*/"CANFD",   /*src_slotid_fr*/0,   /*src_basecycle_fr*/0,  /*src_repetition_fr*/0,  /*src_startbit*/139,   /*sigG_length*/2,  /*des_slotid_fr*/0,   /*des_basecycle_fr*/0,  /*des_repetition_fr*/0,   /*des_startbit*/39,    /*src_cyc*/101,  /*src_id*/0x105,   /*src_dlc*/64,   /*des_id*/0x78, /*updatebit_S*/112,   /*updatebit_D*/28         },
           {   /*sigGroup_s*/"igOccupyMonSts_0",   /*sig_name*/"isOccupyMonStsSecRiSts_0",   /*src_can*/"ZCU_CANFD1",   /*src_network_type*/"CANFD",   /*src_slotid_fr*/0,   /*src_basecycle_fr*/0,  /*src_repetition_fr*/0,  /*src_startbit*/151,   /*sigG_length*/2,  /*des_slotid_fr*/0,   /*des_basecycle_fr*/0,  /*des_repetition_fr*/0,   /*des_startbit*/35,    /*src_cyc*/101,  /*src_id*/0x105,   /*src_dlc*/64,   /*des_id*/0x78, /*updatebit_S*/112,   /*updatebit_D*/28         },
           {   /*sigGroup_s*/"igOccupyMonSts_0",   /*sig_name*/"isOccupyMonStsPassSts_0",   /*src_can*/"ZCU_CANFD1",   /*src_network_type*/"CANFD",   /*src_slotid_fr*/0,   /*src_basecycle_fr*/0,  /*src_repetition_fr*/0,  /*src_startbit*/141,   /*sigG_length*/2,  /*des_slotid_fr*/0,   /*des_basecycle_fr*/0,  /*des_repetition_fr*/0,   /*des_startbit*/25,    /*src_cyc*/101,  /*src_id*/0x105,   /*src_dlc*/64,   /*des_id*/0x78, /*updatebit_S*/112,   /*updatebit_D*/28         },
           {   /*sigGroup_s*/"igOccupyMonSts_0",   /*sig_name*/"isOccupyMonStsThrdMidSts_0",   /*src_can*/"ZCU_CANFD1",   /*src_network_type*/"CANFD",   /*src_slotid_fr*/0,   /*src_basecycle_fr*/0,  /*src_repetition_fr*/0,  /*src_startbit*/147,   /*sigG_length*/2,  /*des_slotid_fr*/0,   /*des_basecycle_fr*/0,  /*des_repetition_fr*/0,   /*des_startbit*/47,    /*src_cyc*/101,  /*src_id*/0x105,   /*src_dlc*/64,   /*des_id*/0x78, /*updatebit_S*/112,   /*updatebit_D*/28         },
           {   /*sigGroup_s*/"igOccupyMonSts_0",   /*sig_name*/"isOccupyMonStsThrdRiSts_0",   /*src_can*/"ZCU_CANFD1",   /*src_network_type*/"CANFD",   /*src_slotid_fr*/0,   /*src_basecycle_fr*/0,  /*src_repetition_fr*/0,  /*src_startbit*/145,   /*sigG_length*/2,  /*des_slotid_fr*/0,   /*des_basecycle_fr*/0,  /*des_repetition_fr*/0,   /*des_startbit*/45,    /*src_cyc*/101,  /*src_id*/0x105,   /*src_dlc*/64,   /*des_id*/0x78, /*updatebit_S*/112,   /*updatebit_D*/28         }
       }
   },
   {
       /*des_can*/ "ZCUD_CANFD4",
       /*networktype*/ "CANFD",
       27,
       {
           {   /*sigGroup_s*/"igVehCfgPrmExt_0",   /*sig_name*/"isVehCfgPrmExtCCPBytePosn8_0",   /*src_can*/"ZCU_CANFD1",   /*src_network_type*/"CANFD",   /*src_slotid_fr*/0,   /*src_basecycle_fr*/0,  /*src_repetition_fr*/0,  /*src_startbit*/127,   /*sigG_length*/8,  /*des_slotid_fr*/0,   /*des_basecycle_fr*/0,  /*des_repetition_fr*/0,   /*des_startbit*/135,    /*src_cyc*/101,  /*src_id*/0x1f5,   /*src_dlc*/64,   /*des_id*/0x1da, /*updatebit_S*/198,   /*updatebit_D*/70         },
           {   /*sigGroup_s*/"igVehCfgPrmExt_0",   /*sig_name*/"isVehCfgPrmExtCCPBytePosn6_0",   /*src_can*/"ZCU_CANFD1",   /*src_network_type*/"CANFD",   /*src_slotid_fr*/0,   /*src_basecycle_fr*/0,  /*src_repetition_fr*/0,  /*src_startbit*/111,   /*sigG_length*/8,  /*des_slotid_fr*/0,   /*des_basecycle_fr*/0,  /*des_repetition_fr*/0,   /*des_startbit*/119,    /*src_cyc*/101,  /*src_id*/0x1f5,   /*src_dlc*/64,   /*des_id*/0x1da, /*updatebit_S*/198,   /*updatebit_D*/70         },
           {   /*sigGroup_s*/"igVehCfgPrmExt_0",   /*sig_name*/"isVehCfgPrmExtCCPBytePosn4_0",   /*src_can*/"ZCU_CANFD1",   /*src_network_type*/"CANFD",   /*src_slotid_fr*/0,   /*src_basecycle_fr*/0,  /*src_repetition_fr*/0,  /*src_startbit*/95,   /*sigG_length*/8,  /*des_slotid_fr*/0,   /*des_basecycle_fr*/0,  /*des_repetition_fr*/0,   /*des_startbit*/103,    /*src_cyc*/101,  /*src_id*/0x1f5,   /*src_dlc*/64,   /*des_id*/0x1da, /*updatebit_S*/198,   /*updatebit_D*/70         },
           {   /*sigGroup_s*/"igVehCfgPrmExt_0",   /*sig_name*/"isVehCfgPrmExtCCPBytePosn3_0",   /*src_can*/"ZCU_CANFD1",   /*src_network_type*/"CANFD",   /*src_slotid_fr*/0,   /*src_basecycle_fr*/0,  /*src_repetition_fr*/0,  /*src_startbit*/87,   /*sigG_length*/8,  /*des_slotid_fr*/0,   /*des_basecycle_fr*/0,  /*des_repetition_fr*/0,   /*des_startbit*/95,    /*src_cyc*/101,  /*src_id*/0x1f5,   /*src_dlc*/64,   /*des_id*/0x1da, /*updatebit_S*/198,   /*updatebit_D*/70         },
           {   /*sigGroup_s*/"igVehCfgPrmExt_0",   /*sig_name*/"isVehCfgPrmExtCCPBytePosn2_0",   /*src_can*/"ZCU_CANFD1",   /*src_network_type*/"CANFD",   /*src_slotid_fr*/0,   /*src_basecycle_fr*/0,  /*src_repetition_fr*/0,  /*src_startbit*/79,   /*sigG_length*/8,  /*des_slotid_fr*/0,   /*des_basecycle_fr*/0,  /*des_repetition_fr*/0,   /*des_startbit*/87,    /*src_cyc*/101,  /*src_id*/0x1f5,   /*src_dlc*/64,   /*des_id*/0x1da, /*updatebit_S*/198,   /*updatebit_D*/70         },
           {   /*sigGroup_s*/"igVehCfgPrmExt_0",   /*sig_name*/"isVehCfgPrmExtBlkIDBytePosn1_0",   /*src_can*/"ZCU_CANFD1",   /*src_network_type*/"CANFD",   /*src_slotid_fr*/0,   /*src_basecycle_fr*/0,  /*src_repetition_fr*/0,  /*src_startbit*/71,   /*sigG_length*/8,  /*des_slotid_fr*/0,   /*des_basecycle_fr*/0,  /*des_repetition_fr*/0,   /*des_startbit*/79,    /*src_cyc*/101,  /*src_id*/0x1f5,   /*src_dlc*/64,   /*des_id*/0x1da, /*updatebit_S*/198,   /*updatebit_D*/70         },
           {   /*sigGroup_s*/"igVehCfgPrmExt_0",   /*sig_name*/"isVehCfgPrmExtCCPBytePosn5_0",   /*src_can*/"ZCU_CANFD1",   /*src_network_type*/"CANFD",   /*src_slotid_fr*/0,   /*src_basecycle_fr*/0,  /*src_repetition_fr*/0,  /*src_startbit*/103,   /*sigG_length*/8,  /*des_slotid_fr*/0,   /*des_basecycle_fr*/0,  /*des_repetition_fr*/0,   /*des_startbit*/111,    /*src_cyc*/101,  /*src_id*/0x1f5,   /*src_dlc*/64,   /*des_id*/0x1da, /*updatebit_S*/198,   /*updatebit_D*/70         },
           {   /*sigGroup_s*/"igVehCfgPrmExt_0",   /*sig_name*/"isVehCfgPrmExtCCPBytePosn7_0",   /*src_can*/"ZCU_CANFD1",   /*src_network_type*/"CANFD",   /*src_slotid_fr*/0,   /*src_basecycle_fr*/0,  /*src_repetition_fr*/0,  /*src_startbit*/119,   /*sigG_length*/8,  /*des_slotid_fr*/0,   /*des_basecycle_fr*/0,  /*des_repetition_fr*/0,   /*des_startbit*/127,    /*src_cyc*/101,  /*src_id*/0x1f5,   /*src_dlc*/64,   /*des_id*/0x1da, /*updatebit_S*/198,   /*updatebit_D*/70         },
           {   /*sigGroup_s*/"igVehCfgPrmExt2_0",   /*sig_name*/"isVehCfgPrmExt2BlkIDBytePosn1_0",   /*src_can*/"ZCU_CANFD1",   /*src_network_type*/"CANFD",   /*src_slotid_fr*/0,   /*src_basecycle_fr*/0,  /*src_repetition_fr*/0,  /*src_startbit*/135,   /*sigG_length*/8,  /*des_slotid_fr*/0,   /*des_basecycle_fr*/0,  /*des_repetition_fr*/0,   /*des_startbit*/143,    /*src_cyc*/101,  /*src_id*/0x1f5,   /*src_dlc*/64,   /*des_id*/0x1da, /*updatebit_S*/197,   /*updatebit_D*/69         },
           {   /*sigGroup_s*/"igVehCfgPrmExt2_0",   /*sig_name*/"isVehCfgPrmExt2CCPBytePosn2_0",   /*src_can*/"ZCU_CANFD1",   /*src_network_type*/"CANFD",   /*src_slotid_fr*/0,   /*src_basecycle_fr*/0,  /*src_repetition_fr*/0,  /*src_startbit*/143,   /*sigG_length*/8,  /*des_slotid_fr*/0,   /*des_basecycle_fr*/0,  /*des_repetition_fr*/0,   /*des_startbit*/151,    /*src_cyc*/101,  /*src_id*/0x1f5,   /*src_dlc*/64,   /*des_id*/0x1da, /*updatebit_S*/197,   /*updatebit_D*/69         },
           {   /*sigGroup_s*/"igVehCfgPrmExt2_0",   /*sig_name*/"isVehCfgPrmExt2CCPBytePosn6_0",   /*src_can*/"ZCU_CANFD1",   /*src_network_type*/"CANFD",   /*src_slotid_fr*/0,   /*src_basecycle_fr*/0,  /*src_repetition_fr*/0,  /*src_startbit*/175,   /*sigG_length*/8,  /*des_slotid_fr*/0,   /*des_basecycle_fr*/0,  /*des_repetition_fr*/0,   /*des_startbit*/183,    /*src_cyc*/101,  /*src_id*/0x1f5,   /*src_dlc*/64,   /*des_id*/0x1da, /*updatebit_S*/197,   /*updatebit_D*/69         },
           {   /*sigGroup_s*/"igVehCfgPrmExt2_0",   /*sig_name*/"isVehCfgPrmExt2CCPBytePosn4_0",   /*src_can*/"ZCU_CANFD1",   /*src_network_type*/"CANFD",   /*src_slotid_fr*/0,   /*src_basecycle_fr*/0,  /*src_repetition_fr*/0,  /*src_startbit*/159,   /*sigG_length*/8,  /*des_slotid_fr*/0,   /*des_basecycle_fr*/0,  /*des_repetition_fr*/0,   /*des_startbit*/167,    /*src_cyc*/101,  /*src_id*/0x1f5,   /*src_dlc*/64,   /*des_id*/0x1da, /*updatebit_S*/197,   /*updatebit_D*/69         },
           {   /*sigGroup_s*/"igVehCfgPrmExt2_0",   /*sig_name*/"isVehCfgPrmExt2CCPBytePosn5_0",   /*src_can*/"ZCU_CANFD1",   /*src_network_type*/"CANFD",   /*src_slotid_fr*/0,   /*src_basecycle_fr*/0,  /*src_repetition_fr*/0,  /*src_startbit*/167,   /*sigG_length*/8,  /*des_slotid_fr*/0,   /*des_basecycle_fr*/0,  /*des_repetition_fr*/0,   /*des_startbit*/175,    /*src_cyc*/101,  /*src_id*/0x1f5,   /*src_dlc*/64,   /*des_id*/0x1da, /*updatebit_S*/197,   /*updatebit_D*/69         },
           {   /*sigGroup_s*/"igVehCfgPrmExt2_0",   /*sig_name*/"isVehCfgPrmExt2CCPBytePosn3_0",   /*src_can*/"ZCU_CANFD1",   /*src_network_type*/"CANFD",   /*src_slotid_fr*/0,   /*src_basecycle_fr*/0,  /*src_repetition_fr*/0,  /*src_startbit*/151,   /*sigG_length*/8,  /*des_slotid_fr*/0,   /*des_basecycle_fr*/0,  /*des_repetition_fr*/0,   /*des_startbit*/159,    /*src_cyc*/101,  /*src_id*/0x1f5,   /*src_dlc*/64,   /*des_id*/0x1da, /*updatebit_S*/197,   /*updatebit_D*/69         },
           {   /*sigGroup_s*/"igVehCfgPrmExt2_0",   /*sig_name*/"isVehCfgPrmExt2CCPBytePosn7_0",   /*src_can*/"ZCU_CANFD1",   /*src_network_type*/"CANFD",   /*src_slotid_fr*/0,   /*src_basecycle_fr*/0,  /*src_repetition_fr*/0,  /*src_startbit*/183,   /*sigG_length*/8,  /*des_slotid_fr*/0,   /*des_basecycle_fr*/0,  /*des_repetition_fr*/0,   /*des_startbit*/191,    /*src_cyc*/101,  /*src_id*/0x1f5,   /*src_dlc*/64,   /*des_id*/0x1da, /*updatebit_S*/197,   /*updatebit_D*/69         },
           {   /*sigGroup_s*/"igVehCfgPrmExt2_0",   /*sig_name*/"isVehCfgPrmExt2CCPBytePosn8_0",   /*src_can*/"ZCU_CANFD1",   /*src_network_type*/"CANFD",   /*src_slotid_fr*/0,   /*src_basecycle_fr*/0,  /*src_repetition_fr*/0,  /*src_startbit*/191,   /*sigG_length*/8,  /*des_slotid_fr*/0,   /*des_basecycle_fr*/0,  /*des_repetition_fr*/0,   /*des_startbit*/199,    /*src_cyc*/101,  /*src_id*/0x1f5,   /*src_dlc*/64,   /*des_id*/0x1da, /*updatebit_S*/197,   /*updatebit_D*/69         },
           {   /*sigGroup_s*/"igVehMtnSt_0",   /*sig_name*/"isVehMtnStCntr_0",   /*src_can*/"ZCU_CANFD1",   /*src_network_type*/"CANFD",   /*src_slotid_fr*/0,   /*src_basecycle_fr*/0,  /*src_repetition_fr*/0,  /*src_startbit*/423,   /*sigG_length*/4,  /*des_slotid_fr*/0,   /*des_basecycle_fr*/0,  /*des_repetition_fr*/0,   /*des_startbit*/55,    /*src_cyc*/101,  /*src_id*/0x82,   /*src_dlc*/64,   /*des_id*/0x100, /*updatebit_S*/416,   /*updatebit_D*/48         },
           {   /*sigGroup_s*/"igVehMtnSt_0",   /*sig_name*/"isVehMtnStVehMtnSt_0",   /*src_can*/"ZCU_CANFD1",   /*src_network_type*/"CANFD",   /*src_slotid_fr*/0,   /*src_basecycle_fr*/0,  /*src_repetition_fr*/0,  /*src_startbit*/419,   /*sigG_length*/3,  /*des_slotid_fr*/0,   /*des_basecycle_fr*/0,  /*des_repetition_fr*/0,   /*des_startbit*/51,    /*src_cyc*/101,  /*src_id*/0x82,   /*src_dlc*/64,   /*des_id*/0x100, /*updatebit_S*/416,   /*updatebit_D*/48         },
           {   /*sigGroup_s*/"igVehMtnSt_0",   /*sig_name*/"isVehMtnStChks_0",   /*src_can*/"ZCU_CANFD1",   /*src_network_type*/"CANFD",   /*src_slotid_fr*/0,   /*src_basecycle_fr*/0,  /*src_repetition_fr*/0,  /*src_startbit*/415,   /*sigG_length*/8,  /*des_slotid_fr*/0,   /*des_basecycle_fr*/0,  /*des_repetition_fr*/0,   /*des_startbit*/47,    /*src_cyc*/101,  /*src_id*/0x82,   /*src_dlc*/64,   /*des_id*/0x100, /*updatebit_S*/416,   /*updatebit_D*/48         },
           {   /*sigGroup_s*/"igVehCfgPrm_0",   /*sig_name*/"isVehCfgPrmCCPBytePosn2_0",   /*src_can*/"ZCU_CANFD1",   /*src_network_type*/"CANFD",   /*src_slotid_fr*/0,   /*src_basecycle_fr*/0,  /*src_repetition_fr*/0,  /*src_startbit*/15,   /*sigG_length*/8,  /*des_slotid_fr*/0,   /*des_basecycle_fr*/0,  /*des_repetition_fr*/0,   /*des_startbit*/15,    /*src_cyc*/101,  /*src_id*/0x1f5,   /*src_dlc*/64,   /*des_id*/0x1da, /*updatebit_S*/199,   /*updatebit_D*/71         },
           {   /*sigGroup_s*/"igVehCfgPrm_0",   /*sig_name*/"isVehCfgPrmCCPBytePosn7_0",   /*src_can*/"ZCU_CANFD1",   /*src_network_type*/"CANFD",   /*src_slotid_fr*/0,   /*src_basecycle_fr*/0,  /*src_repetition_fr*/0,  /*src_startbit*/55,   /*sigG_length*/8,  /*des_slotid_fr*/0,   /*des_basecycle_fr*/0,  /*des_repetition_fr*/0,   /*des_startbit*/55,    /*src_cyc*/101,  /*src_id*/0x1f5,   /*src_dlc*/64,   /*des_id*/0x1da, /*updatebit_S*/199,   /*updatebit_D*/71         },
           {   /*sigGroup_s*/"igVehCfgPrm_0",   /*sig_name*/"isVehCfgPrmCCPBytePosn3_0",   /*src_can*/"ZCU_CANFD1",   /*src_network_type*/"CANFD",   /*src_slotid_fr*/0,   /*src_basecycle_fr*/0,  /*src_repetition_fr*/0,  /*src_startbit*/23,   /*sigG_length*/8,  /*des_slotid_fr*/0,   /*des_basecycle_fr*/0,  /*des_repetition_fr*/0,   /*des_startbit*/23,    /*src_cyc*/101,  /*src_id*/0x1f5,   /*src_dlc*/64,   /*des_id*/0x1da, /*updatebit_S*/199,   /*updatebit_D*/71         },
           {   /*sigGroup_s*/"igVehCfgPrm_0",   /*sig_name*/"isVehCfgPrmCCPBytePosn4_0",   /*src_can*/"ZCU_CANFD1",   /*src_network_type*/"CANFD",   /*src_slotid_fr*/0,   /*src_basecycle_fr*/0,  /*src_repetition_fr*/0,  /*src_startbit*/31,   /*sigG_length*/8,  /*des_slotid_fr*/0,   /*des_basecycle_fr*/0,  /*des_repetition_fr*/0,   /*des_startbit*/31,    /*src_cyc*/101,  /*src_id*/0x1f5,   /*src_dlc*/64,   /*des_id*/0x1da, /*updatebit_S*/199,   /*updatebit_D*/71         },
           {   /*sigGroup_s*/"igVehCfgPrm_0",   /*sig_name*/"isVehCfgPrmCCPBytePosn8_0",   /*src_can*/"ZCU_CANFD1",   /*src_network_type*/"CANFD",   /*src_slotid_fr*/0,   /*src_basecycle_fr*/0,  /*src_repetition_fr*/0,  /*src_startbit*/63,   /*sigG_length*/8,  /*des_slotid_fr*/0,   /*des_basecycle_fr*/0,  /*des_repetition_fr*/0,   /*des_startbit*/63,    /*src_cyc*/101,  /*src_id*/0x1f5,   /*src_dlc*/64,   /*des_id*/0x1da, /*updatebit_S*/199,   /*updatebit_D*/71         },
           {   /*sigGroup_s*/"igVehCfgPrm_0",   /*sig_name*/"isVehCfgPrmCCPBytePosn5_0",   /*src_can*/"ZCU_CANFD1",   /*src_network_type*/"CANFD",   /*src_slotid_fr*/0,   /*src_basecycle_fr*/0,  /*src_repetition_fr*/0,  /*src_startbit*/39,   /*sigG_length*/8,  /*des_slotid_fr*/0,   /*des_basecycle_fr*/0,  /*des_repetition_fr*/0,   /*des_startbit*/39,    /*src_cyc*/101,  /*src_id*/0x1f5,   /*src_dlc*/64,   /*des_id*/0x1da, /*updatebit_S*/199,   /*updatebit_D*/71         },
           {   /*sigGroup_s*/"igVehCfgPrm_0",   /*sig_name*/"isVehCfgPrmBlkIDBytePosn1_0",   /*src_can*/"ZCU_CANFD1",   /*src_network_type*/"CANFD",   /*src_slotid_fr*/0,   /*src_basecycle_fr*/0,  /*src_repetition_fr*/0,  /*src_startbit*/7,   /*sigG_length*/8,  /*des_slotid_fr*/0,   /*des_basecycle_fr*/0,  /*des_repetition_fr*/0,   /*des_startbit*/7,    /*src_cyc*/101,  /*src_id*/0x1f5,   /*src_dlc*/64,   /*des_id*/0x1da, /*updatebit_S*/199,   /*updatebit_D*/71         },
           {   /*sigGroup_s*/"igVehCfgPrm_0",   /*sig_name*/"isVehCfgPrmCCPBytePosn6_0",   /*src_can*/"ZCU_CANFD1",   /*src_network_type*/"CANFD",   /*src_slotid_fr*/0,   /*src_basecycle_fr*/0,  /*src_repetition_fr*/0,  /*src_startbit*/47,   /*sigG_length*/8,  /*des_slotid_fr*/0,   /*des_basecycle_fr*/0,  /*des_repetition_fr*/0,   /*des_startbit*/47,    /*src_cyc*/101,  /*src_id*/0x1f5,   /*src_dlc*/64,   /*des_id*/0x1da, /*updatebit_S*/199,   /*updatebit_D*/71         }
       }
   },
   {
       /*des_can*/ "ZCU_CANFD2",
       /*networktype*/ "CANFD",
       0,
       {
           0
       }
   },
   {
       /*des_can*/ "BodyExposedCAN",
       /*networktype*/ "CAN",
       0,
       {
           0
       }
   }
};
}



void settestchannel(int num)
{
  switch(num)
  {
  case 0:

        setBusContext(getBusNameContext("ZCUD_LIN1"));
        teststep("step", "Start test on ZCUD_LIN1");
        break;
  case 1:

        setBusContext(getBusNameContext("CEM_LIN3"));
        teststep("step", "Start test on CEM_LIN3");
        break;
  case 2:

        setBusContext(getBusNameContext("CEM_LIN2"));
        teststep("step", "Start test on CEM_LIN2");
        break;
  case 3:

        setBusContext(getBusNameContext("CEM_LIN6"));
        teststep("step", "Start test on CEM_LIN6");
        break;
  case 4:

        setBusContext(getBusNameContext("CEM_LIN1"));
        teststep("step", "Start test on CEM_LIN1");
        break;
  case 5:

        setBusContext(getBusNameContext("CEM_LIN4"));
        teststep("step", "Start test on CEM_LIN4");
        break;
  case 6:

        setBusContext(getBusNameContext("ZCUD_LIN2"));
        teststep("step", "Start test on ZCUD_LIN2");
        break;
  case 7:

        setBusContext(getBusNameContext("ZCUD_LIN3"));
        teststep("step", "Start test on ZCUD_LIN3");
        break;
  case 8:

        setBusContext(getBusNameContext("CEM_LIN7"));
        teststep("step", "Start test on CEM_LIN7");
        break;
  case 9:

        setBusContext(getBusNameContext("PropulsionCAN"));
        teststep("step", "Start test on PropulsionCAN");
        break;
  case 10:

        setBusContext(getBusNameContext("ChassisCAN1"));
        teststep("step", "Start test on ChassisCAN1");
        break;
  case 11:

        setBusContext(getBusNameContext("ZCU_CANFD1"));
        teststep("step", "Start test on ZCU_CANFD1");
        break;
  case 12:

        setBusContext(getBusNameContext("ZCUD_CANFD3"));
        teststep("step", "Start test on ZCUD_CANFD3");
        break;
  case 13:

        setBusContext(getBusNameContext("ChassisCANFD2"));
        teststep("step", "Start test on ChassisCANFD2");
        break;
  case 14:

        setBusContext(getBusNameContext("ZCUD_CAN1"));
        teststep("step", "Start test on ZCUD_CAN1");
        break;
  case 15:

        setBusContext(getBusNameContext("ZCUD_CANFD4"));
        teststep("step", "Start test on ZCUD_CANFD4");
        break;
  case 16:

        setBusContext(getBusNameContext("ZCU_CANFD2"));
        teststep("step", "Start test on ZCU_CANFD2");
        break;
  case 17:

        setBusContext(getBusNameContext("BodyExposedCAN"));
        teststep("step", "Start test on BodyExposedCAN");
        break;

  Default:
        testStepFail("step", "Bus context channel number is wrong!");
  }
}



void getbusbytestchannel(char BusName[],char BusType[],int num)
{
  switch(num)
  {

    case 0:
        strncpy(BusName,"ZCUD_LIN1",elcount(BusName));
        strncpy(BusType,"LIN",elcount(BusType));
        break;
    case 1:
        strncpy(BusName,"CEM_LIN3",elcount(BusName));
        strncpy(BusType,"LIN",elcount(BusType));
        break;
    case 2:
        strncpy(BusName,"CEM_LIN2",elcount(BusName));
        strncpy(BusType,"LIN",elcount(BusType));
        break;
    case 3:
        strncpy(BusName,"CEM_LIN6",elcount(BusName));
        strncpy(BusType,"LIN",elcount(BusType));
        break;
    case 4:
        strncpy(BusName,"CEM_LIN1",elcount(BusName));
        strncpy(BusType,"LIN",elcount(BusType));
        break;
    case 5:
        strncpy(BusName,"CEM_LIN4",elcount(BusName));
        strncpy(BusType,"LIN",elcount(BusType));
        break;
    case 6:
        strncpy(BusName,"ZCUD_LIN2",elcount(BusName));
        strncpy(BusType,"LIN",elcount(BusType));
        break;
    case 7:
        strncpy(BusName,"ZCUD_LIN3",elcount(BusName));
        strncpy(BusType,"LIN",elcount(BusType));
        break;
    case 8:
        strncpy(BusName,"CEM_LIN7",elcount(BusName));
        strncpy(BusType,"LIN",elcount(BusType));
        break;
    case 9:
        strncpy(BusName,"PropulsionCAN",elcount(BusName));
        strncpy(BusType,"CAN",elcount(BusType));
        break;
    case 10:
        strncpy(BusName,"ChassisCAN1",elcount(BusName));
        strncpy(BusType,"CAN",elcount(BusType));
        break;
    case 11:
        strncpy(BusName,"ZCU_CANFD1",elcount(BusName));
        strncpy(BusType,"CAN",elcount(BusType));
        break;
    case 12:
        strncpy(BusName,"ZCUD_CANFD3",elcount(BusName));
        strncpy(BusType,"CAN",elcount(BusType));
        break;
    case 13:
        strncpy(BusName,"ChassisCANFD2",elcount(BusName));
        strncpy(BusType,"CAN",elcount(BusType));
        break;
    case 14:
        strncpy(BusName,"ZCUD_CAN1",elcount(BusName));
        strncpy(BusType,"CAN",elcount(BusType));
        break;
    case 15:
        strncpy(BusName,"ZCUD_CANFD4",elcount(BusName));
        strncpy(BusType,"CAN",elcount(BusType));
        break;
    case 16:
        strncpy(BusName,"ZCU_CANFD2",elcount(BusName));
        strncpy(BusType,"CAN",elcount(BusType));
        break;
    case 17:
        strncpy(BusName,"BodyExposedCAN",elcount(BusName));
        strncpy(BusType,"CAN",elcount(BusType));
        break;
    Default:
        testStepFail("step","Bus context channel number is wrong!");
        break;
  }
}

void CANFD_switch_HighLoad(char souce_network[])
{
    if(strstr(souce_network,"CANFD")>0)
    {
        HighPriority_Msg1.FDF=1;
        LowPriority_Msg1.FDF=1;
    }
    else
    {
        HighPriority_Msg1.FDF=0;
        LowPriority_Msg1.FDF=0;
    }
}
        
void CANFD_switch(char souce_network[])
{
    if(strncmp(souce_network,"CANFD",10)==0)
    {
        temp_message.FDF = 1;
    }
    else
    {
        temp_message.FDF = 0;
    }
}


void Loggingfilenameset(int num, char testcaseid[], char group[], char caseid[], char sub[])
{
    char name[100];
    char network[20];
    switch(num)
    {

    case 0:
        strncpy(network,"ZCUD_LIN1",20);
        break;
    
    case 1:
        strncpy(network,"CEM_LIN3",20);
        break;
    
    case 2:
        strncpy(network,"CEM_LIN2",20);
        break;
    
    case 3:
        strncpy(network,"CEM_LIN6",20);
        break;
    
    case 4:
        strncpy(network,"CEM_LIN1",20);
        break;
    
    case 5:
        strncpy(network,"CEM_LIN4",20);
        break;
    
    case 6:
        strncpy(network,"ZCUD_LIN2",20);
        break;
    
    case 7:
        strncpy(network,"ZCUD_LIN3",20);
        break;
    
    case 8:
        strncpy(network,"CEM_LIN7",20);
        break;
    
    case 9:
        strncpy(network,"PropulsionCAN",20);
        break;
    
    case 10:
        strncpy(network,"ChassisCAN1",20);
        break;
    
    case 11:
        strncpy(network,"ZCU_CANFD1",20);
        break;
    
    case 12:
        strncpy(network,"ZCUD_CANFD3",20);
        break;
    
    case 13:
        strncpy(network,"ChassisCANFD2",20);
        break;
    
    case 14:
        strncpy(network,"ZCUD_CAN1",20);
        break;
    
    case 15:
        strncpy(network,"ZCUD_CANFD4",20);
        break;
    
    case 16:
        strncpy(network,"ZCU_CANFD2",20);
        break;
    
    case 17:
        strncpy(network,"BodyExposedCAN",20);
        break;
    
  Default:
      strncpy(network,"Default",20);
      testStepFail("step","logging channel number is wrong!");
      break;
  }

    strncpy(name,"\\per_testcase\\TC_GW_xx_yy_Vzz_net",100);
    str_replace_regex(name,"TC",testcaseid);
    str_replace_regex(name,"xx",group);
    str_replace_regex(name,"yy",caseid);
    str_replace_regex(name,"zz",sub);
    str_replace_regex(name,"net",network);
    //setLogFileName(name);
    SetLogPath_sig(name, 1);
}

void LIN_Init()
{

    linConfigureResponse(des_DdsZCUD_Lin1Fr01);
    linConfigureResponse(des_AdcZcud_Lin1Fr02);
    linConfigureResponse(des_MdmZCUD_Lin1Fr01);
    linConfigureResponse(des_AdcZcud_Lin1Fr01);
    linConfigureResponse(des_MmdZCUD_Lin1Fr01);
    linConfigureResponse(des_OhcCem_Lin3Fr01);
    linConfigureResponse(des_Srm2Cem_Lin3Fr02);
    linConfigureResponse(des_SigCem_Lin3Fr01);
    linConfigureResponse(des_Srm2Cem_Lin3Fr01);
    linConfigureResponse(des_AwmCem_Lin3Fr01);
    linConfigureResponse(des_OhcCem_Lin3Fr05);
    linConfigureResponse(des_Awm2Cem_Lin3SertNrFr01);
    linConfigureResponse(des_OhcCem_Lin3Fr06);
    linConfigureResponse(des_OhcCem_Lin3Fr04);
    linConfigureResponse(des_OhcCem_Lin3Fr10);
    linConfigureResponse(des_BmsCem_Lin6Fr06);
    linConfigureResponse(des_BmsCem_Lin6Fr10);
    linConfigureResponse(des_BmsCem_Lin6Fr01);
    linConfigureResponse(des_BmsCem_Lin6Fr12);
    linConfigureResponse(des_FmdmCem_Lin6Fr01);
    linConfigureResponse(des_BmsCem_Lin6Fr13);
    linConfigureResponse(des_FdmlCem_Lin6Fr01);
    linConfigureResponse(des_BmsCem_Lin6Fr02);
    linConfigureResponse(des_BmsCem_Lin6Fr16);
    linConfigureResponse(des_BmsCem_Lin6Fr03);
    linConfigureResponse(des_BmsCem_Lin6Fr08);
    linConfigureResponse(des_BmsCem_Lin6Fr11);
    linConfigureResponse(des_BmsCem_Lin6Fr04);
    linConfigureResponse(des_BmsCem_Lin6Fr05);
    linConfigureResponse(des_BmsCem_Lin6Fr09);
    linConfigureResponse(des_BmsCem_Lin6Fr07);
    linConfigureResponse(des_BmsCem_Lin6Fr14);
    linConfigureResponse(des_BmsCem_Lin6Fr15);
    linConfigureResponse(des_BmsCem_Lin6Fr17);
    linConfigureResponse(des_RlsmCem_Lin1Fr02);
    linConfigureResponse(des_RlsmCem_Lin1Fr03);
    linConfigureResponse(des_WmmCem_Lin1Fr01);
    linConfigureResponse(des_RlsmCem_Lin1Fr01);
    linConfigureResponse(des_RlsmCem_Lin1Fr04);
    linConfigureResponse(des_IrmmCem_Lin1Fr01);
    linConfigureResponse(des_IrmmCem_Lin1Fr02);
    linConfigureResponse(des_FtksCem_Lin4Fr01);
    linConfigureResponse(des_LsmCem_Lin4Fr01);
    linConfigureResponse(des_HcmlZcud_Lin2Fr01);
    linConfigureResponse(des_HcmrZcud_Lin2Fr01);
    linConfigureResponse(des_PosmCem_Lin7Fr01);
    linConfigureResponse(des_TCSCem_Lin7Fr03);
    linConfigureResponse(des_TCSCem_Lin7Fr02);
    
}

void messageUpdate(char net_num[], int id, Byte data[])
{
    int k;
    // 按网络通道处理LIN报文数据更新
    if (0) {}  // 用于后续的else if链
    else if (strncmp(net_num, "ZCUD_LIN1", strlen(net_num)) == 0) {
        switch(id) {
            case 0x36:
                for (k = 0; k < des_DdsZCUD_Lin1Fr01.dlc; k++) {
                    des_DdsZCUD_Lin1Fr01.byte(k) = data[k];
                }
                linUpdateResponse(des_DdsZCUD_Lin1Fr01);
                break;
            case 0x39:
                for (k = 0; k < des_AdcZcud_Lin1Fr02.dlc; k++) {
                    des_AdcZcud_Lin1Fr02.byte(k) = data[k];
                }
                linUpdateResponse(des_AdcZcud_Lin1Fr02);
                break;
            case 0x13:
                for (k = 0; k < des_MdmZCUD_Lin1Fr01.dlc; k++) {
                    des_MdmZCUD_Lin1Fr01.byte(k) = data[k];
                }
                linUpdateResponse(des_MdmZCUD_Lin1Fr01);
                break;
            case 0x3b:
                for (k = 0; k < des_AdcZcud_Lin1Fr01.dlc; k++) {
                    des_AdcZcud_Lin1Fr01.byte(k) = data[k];
                }
                linUpdateResponse(des_AdcZcud_Lin1Fr01);
                break;
            case 0x1:
                for (k = 0; k < des_MmdZCUD_Lin1Fr01.dlc; k++) {
                    des_MmdZCUD_Lin1Fr01.byte(k) = data[k];
                }
                linUpdateResponse(des_MmdZCUD_Lin1Fr01);
                break;
            default:
                break;
        }
    }
    else if (strncmp(net_num, "CEM_LIN3", strlen(net_num)) == 0) {
        switch(id) {
            case 0x20:
                for (k = 0; k < des_OhcCem_Lin3Fr01.dlc; k++) {
                    des_OhcCem_Lin3Fr01.byte(k) = data[k];
                }
                linUpdateResponse(des_OhcCem_Lin3Fr01);
                break;
            case 0x23:
                for (k = 0; k < des_Srm2Cem_Lin3Fr02.dlc; k++) {
                    des_Srm2Cem_Lin3Fr02.byte(k) = data[k];
                }
                linUpdateResponse(des_Srm2Cem_Lin3Fr02);
                break;
            case 0x8:
                for (k = 0; k < des_SigCem_Lin3Fr01.dlc; k++) {
                    des_SigCem_Lin3Fr01.byte(k) = data[k];
                }
                linUpdateResponse(des_SigCem_Lin3Fr01);
                break;
            case 0x11:
                for (k = 0; k < des_Srm2Cem_Lin3Fr01.dlc; k++) {
                    des_Srm2Cem_Lin3Fr01.byte(k) = data[k];
                }
                linUpdateResponse(des_Srm2Cem_Lin3Fr01);
                break;
            case 0x1a:
                for (k = 0; k < des_AwmCem_Lin3Fr01.dlc; k++) {
                    des_AwmCem_Lin3Fr01.byte(k) = data[k];
                }
                linUpdateResponse(des_AwmCem_Lin3Fr01);
                break;
            case 0x16:
                for (k = 0; k < des_OhcCem_Lin3Fr05.dlc; k++) {
                    des_OhcCem_Lin3Fr05.byte(k) = data[k];
                }
                linUpdateResponse(des_OhcCem_Lin3Fr05);
                break;
            case 0xe:
                for (k = 0; k < des_Awm2Cem_Lin3SertNrFr01.dlc; k++) {
                    des_Awm2Cem_Lin3SertNrFr01.byte(k) = data[k];
                }
                linUpdateResponse(des_Awm2Cem_Lin3SertNrFr01);
                break;
            case 0x1c:
                for (k = 0; k < des_OhcCem_Lin3Fr06.dlc; k++) {
                    des_OhcCem_Lin3Fr06.byte(k) = data[k];
                }
                linUpdateResponse(des_OhcCem_Lin3Fr06);
                break;
            case 0x14:
                for (k = 0; k < des_OhcCem_Lin3Fr04.dlc; k++) {
                    des_OhcCem_Lin3Fr04.byte(k) = data[k];
                }
                linUpdateResponse(des_OhcCem_Lin3Fr04);
                break;
            case 0x6:
                for (k = 0; k < des_OhcCem_Lin3Fr10.dlc; k++) {
                    des_OhcCem_Lin3Fr10.byte(k) = data[k];
                }
                linUpdateResponse(des_OhcCem_Lin3Fr10);
                break;
            default:
                break;
        }
    }
    else if (strncmp(net_num, "CEM_LIN6", strlen(net_num)) == 0) {
        switch(id) {
            case 0x28:
                for (k = 0; k < des_BmsCem_Lin6Fr06.dlc; k++) {
                    des_BmsCem_Lin6Fr06.byte(k) = data[k];
                }
                linUpdateResponse(des_BmsCem_Lin6Fr06);
                break;
            case 0x20:
                for (k = 0; k < des_BmsCem_Lin6Fr10.dlc; k++) {
                    des_BmsCem_Lin6Fr10.byte(k) = data[k];
                }
                linUpdateResponse(des_BmsCem_Lin6Fr10);
                break;
            case 0x2:
                for (k = 0; k < des_BmsCem_Lin6Fr01.dlc; k++) {
                    des_BmsCem_Lin6Fr01.byte(k) = data[k];
                }
                linUpdateResponse(des_BmsCem_Lin6Fr01);
                break;
            case 0x29:
                for (k = 0; k < des_BmsCem_Lin6Fr12.dlc; k++) {
                    des_BmsCem_Lin6Fr12.byte(k) = data[k];
                }
                linUpdateResponse(des_BmsCem_Lin6Fr12);
                break;
            case 0x16:
                for (k = 0; k < des_FmdmCem_Lin6Fr01.dlc; k++) {
                    des_FmdmCem_Lin6Fr01.byte(k) = data[k];
                }
                linUpdateResponse(des_FmdmCem_Lin6Fr01);
                break;
            case 0x2a:
                for (k = 0; k < des_BmsCem_Lin6Fr13.dlc; k++) {
                    des_BmsCem_Lin6Fr13.byte(k) = data[k];
                }
                linUpdateResponse(des_BmsCem_Lin6Fr13);
                break;
            case 0x18:
                for (k = 0; k < des_FdmlCem_Lin6Fr01.dlc; k++) {
                    des_FdmlCem_Lin6Fr01.byte(k) = data[k];
                }
                linUpdateResponse(des_FdmlCem_Lin6Fr01);
                break;
            case 0x3:
                for (k = 0; k < des_BmsCem_Lin6Fr02.dlc; k++) {
                    des_BmsCem_Lin6Fr02.byte(k) = data[k];
                }
                linUpdateResponse(des_BmsCem_Lin6Fr02);
                break;
            case 0x26:
                for (k = 0; k < des_BmsCem_Lin6Fr16.dlc; k++) {
                    des_BmsCem_Lin6Fr16.byte(k) = data[k];
                }
                linUpdateResponse(des_BmsCem_Lin6Fr16);
                break;
            case 0x4:
                for (k = 0; k < des_BmsCem_Lin6Fr03.dlc; k++) {
                    des_BmsCem_Lin6Fr03.byte(k) = data[k];
                }
                linUpdateResponse(des_BmsCem_Lin6Fr03);
                break;
            case 0x7:
                for (k = 0; k < des_BmsCem_Lin6Fr08.dlc; k++) {
                    des_BmsCem_Lin6Fr08.byte(k) = data[k];
                }
                linUpdateResponse(des_BmsCem_Lin6Fr08);
                break;
            case 0x21:
                for (k = 0; k < des_BmsCem_Lin6Fr11.dlc; k++) {
                    des_BmsCem_Lin6Fr11.byte(k) = data[k];
                }
                linUpdateResponse(des_BmsCem_Lin6Fr11);
                break;
            case 0x9:
                for (k = 0; k < des_BmsCem_Lin6Fr04.dlc; k++) {
                    des_BmsCem_Lin6Fr04.byte(k) = data[k];
                }
                linUpdateResponse(des_BmsCem_Lin6Fr04);
                break;
            case 0x6:
                for (k = 0; k < des_BmsCem_Lin6Fr05.dlc; k++) {
                    des_BmsCem_Lin6Fr05.byte(k) = data[k];
                }
                linUpdateResponse(des_BmsCem_Lin6Fr05);
                break;
            case 0x10:
                for (k = 0; k < des_BmsCem_Lin6Fr09.dlc; k++) {
                    des_BmsCem_Lin6Fr09.byte(k) = data[k];
                }
                linUpdateResponse(des_BmsCem_Lin6Fr09);
                break;
            case 0x8:
                for (k = 0; k < des_BmsCem_Lin6Fr07.dlc; k++) {
                    des_BmsCem_Lin6Fr07.byte(k) = data[k];
                }
                linUpdateResponse(des_BmsCem_Lin6Fr07);
                break;
            case 0x24:
                for (k = 0; k < des_BmsCem_Lin6Fr14.dlc; k++) {
                    des_BmsCem_Lin6Fr14.byte(k) = data[k];
                }
                linUpdateResponse(des_BmsCem_Lin6Fr14);
                break;
            case 0x25:
                for (k = 0; k < des_BmsCem_Lin6Fr15.dlc; k++) {
                    des_BmsCem_Lin6Fr15.byte(k) = data[k];
                }
                linUpdateResponse(des_BmsCem_Lin6Fr15);
                break;
            case 0x27:
                for (k = 0; k < des_BmsCem_Lin6Fr17.dlc; k++) {
                    des_BmsCem_Lin6Fr17.byte(k) = data[k];
                }
                linUpdateResponse(des_BmsCem_Lin6Fr17);
                break;
            default:
                break;
        }
    }
    else if (strncmp(net_num, "CEM_LIN1", strlen(net_num)) == 0) {
        switch(id) {
            case 0x2c:
                for (k = 0; k < des_RlsmCem_Lin1Fr02.dlc; k++) {
                    des_RlsmCem_Lin1Fr02.byte(k) = data[k];
                }
                linUpdateResponse(des_RlsmCem_Lin1Fr02);
                break;
            case 0x2:
                for (k = 0; k < des_RlsmCem_Lin1Fr03.dlc; k++) {
                    des_RlsmCem_Lin1Fr03.byte(k) = data[k];
                }
                linUpdateResponse(des_RlsmCem_Lin1Fr03);
                break;
            case 0x25:
                for (k = 0; k < des_WmmCem_Lin1Fr01.dlc; k++) {
                    des_WmmCem_Lin1Fr01.byte(k) = data[k];
                }
                linUpdateResponse(des_WmmCem_Lin1Fr01);
                break;
            case 0x15:
                for (k = 0; k < des_RlsmCem_Lin1Fr01.dlc; k++) {
                    des_RlsmCem_Lin1Fr01.byte(k) = data[k];
                }
                linUpdateResponse(des_RlsmCem_Lin1Fr01);
                break;
            case 0x3:
                for (k = 0; k < des_RlsmCem_Lin1Fr04.dlc; k++) {
                    des_RlsmCem_Lin1Fr04.byte(k) = data[k];
                }
                linUpdateResponse(des_RlsmCem_Lin1Fr04);
                break;
            case 0x10:
                for (k = 0; k < des_IrmmCem_Lin1Fr01.dlc; k++) {
                    des_IrmmCem_Lin1Fr01.byte(k) = data[k];
                }
                linUpdateResponse(des_IrmmCem_Lin1Fr01);
                break;
            case 0x13:
                for (k = 0; k < des_IrmmCem_Lin1Fr02.dlc; k++) {
                    des_IrmmCem_Lin1Fr02.byte(k) = data[k];
                }
                linUpdateResponse(des_IrmmCem_Lin1Fr02);
                break;
            default:
                break;
        }
    }
    else if (strncmp(net_num, "CEM_LIN4", strlen(net_num)) == 0) {
        switch(id) {
            case 0xc:
                for (k = 0; k < des_FtksCem_Lin4Fr01.dlc; k++) {
                    des_FtksCem_Lin4Fr01.byte(k) = data[k];
                }
                linUpdateResponse(des_FtksCem_Lin4Fr01);
                break;
            case 0x20:
                for (k = 0; k < des_LsmCem_Lin4Fr01.dlc; k++) {
                    des_LsmCem_Lin4Fr01.byte(k) = data[k];
                }
                linUpdateResponse(des_LsmCem_Lin4Fr01);
                break;
            default:
                break;
        }
    }
    else if (strncmp(net_num, "ZCUD_LIN2", strlen(net_num)) == 0) {
        switch(id) {
            case 0x1:
                for (k = 0; k < des_HcmlZcud_Lin2Fr01.dlc; k++) {
                    des_HcmlZcud_Lin2Fr01.byte(k) = data[k];
                }
                linUpdateResponse(des_HcmlZcud_Lin2Fr01);
                break;
            case 0x2:
                for (k = 0; k < des_HcmrZcud_Lin2Fr01.dlc; k++) {
                    des_HcmrZcud_Lin2Fr01.byte(k) = data[k];
                }
                linUpdateResponse(des_HcmrZcud_Lin2Fr01);
                break;
            default:
                break;
        }
    }
    else if (strncmp(net_num, "CEM_LIN7", strlen(net_num)) == 0) {
        switch(id) {
            case 0x11:
                for (k = 0; k < des_PosmCem_Lin7Fr01.dlc; k++) {
                    des_PosmCem_Lin7Fr01.byte(k) = data[k];
                }
                linUpdateResponse(des_PosmCem_Lin7Fr01);
                break;
            case 0xf:
                for (k = 0; k < des_TCSCem_Lin7Fr03.dlc; k++) {
                    des_TCSCem_Lin7Fr03.byte(k) = data[k];
                }
                linUpdateResponse(des_TCSCem_Lin7Fr03);
                break;
            case 0xa:
                for (k = 0; k < des_TCSCem_Lin7Fr02.dlc; k++) {
                    des_TCSCem_Lin7Fr02.byte(k) = data[k];
                }
                linUpdateResponse(des_TCSCem_Lin7Fr02);
                break;
            default:
                break;
        }
    }
}


on timer SimHighLoadTimer_HighPriority
{
  int burst[network_quantity],busload[network_quantity],testchannel,buschannel,h;
  char busaname[20],bustype[20];
  for(testchannel=0;testchannel<network_quantity;testchannel++)
  {
    getbusbytestchannel(busaname,bustype,testchannel);
    if((strncmp(bustype,"CANFD",strlen("CANFD"))==0)||(strncmp(bustype,"CAN",strlen("CAN"))==0))
    {
      buschannel=GetBusNameContext(busaname);
      CANFD_switch_HighLoad(busaname);
      for(h=0; h<burst[testchannel] ;h++)
      { 

         HighPriority_Msg1.can=buschannel;
         output(HighPriority_Msg1);

      }
      
      busload[testchannel] = canGetBusLoad(buschannel);
      if(busload[testchannel]<80)
        burst[testchannel]++; 
    }      
  }
}

on timer SimHighLoadTimer_LowPriority
{
  int burst[network_quantity],busload[network_quantity],testchannel,buschannel,h;
  char busaname[20],bustype[20];
  for(testchannel=0;testchannel<network_quantity;testchannel++)
  {
    getbusbytestchannel(busaname,bustype,testchannel);
    if((strncmp(bustype,"CANFD",strlen("CANFD"))==0)||(strncmp(bustype,"CAN",strlen("CAN"))==0))
    {
      buschannel=GetBusNameContext(busaname);
      CANFD_switch_HighLoad(busaname);
      for(h=0; h<burst[testchannel] ;h++)
      { 

         LowPriority_Msg1.can=buschannel;
         output(LowPriority_Msg1);

      }
      
      busload[testchannel] = canGetBusLoad(buschannel);
      if(busload[testchannel]<80)
        burst[testchannel]++; 
    }      
  }
}
