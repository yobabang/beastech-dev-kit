/*@!Encoding:936*/

variables
{
//  int terminalFlag=0;
}

void ENV_CAN_InitConfig()
{
  ENV_Reset();
  testWaitForTimeout(100);

}

void ENV_LIN_InitConfig()
{
  ENV_Reset();
}
