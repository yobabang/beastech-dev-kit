/*@!Encoding:936*/
includes
{
  #include "VH1150.cin"
  
}

variables
{
  enum T_mode{T_off,T_on};
}

void SetBatteryVoltage(float V)
{
  VH1150_VoltageSet(V);
}



/// <FaultOnLIN>
void LINBusFaultSet(enum LinFaultType fault)
{
  switch(fault)
  {
    case LIN_BAT:
//      LIN2BAT(T_on);
      VHDevSetBusFaults(gDevHandle,0,2,0);
      break;
      
    case LIN_GND:
//      LIN2GND(T_on);
      VHDevSetBusFaults(gDevHandle,0,1,0);
      break;
    case LIN_FltRst:
      VHDevSetBusFaults(gDevHandle,0,0,0);
      break;
  }
}
/// <FaultOnLIN>
void LINBusFaultConnect(int chanl)
{
  switch(chanl)
  {
    case 1:
//      ENV_CAN_Connect();// connect ENV to DRB1
//      testWaitForTimeout(100);
//      LIN1_Connect();
//      testWaitForTimeout(200);
      testStep("Info","Connect LIN1.");
      break;
    case 2:
//      ENV_CAN_Connect();// connect ENV to DRB1
//      testWaitForTimeout(100);
//      LIN2_Connect();
//      testWaitForTimeout(200);
      testStep("Info","Connect LIN2.");
      break;
    case 3:
//      ENV_CAN_Connect();// connect ENV to DRB1
//      testWaitForTimeout(100);
//      LIN3_Connect();
//      testWaitForTimeout(200);
      testStep("Info","Connect LIN3.");
      break;
    case 4:
//      ENV_CAN_Connect();// connect ENV to DRB1
//      testWaitForTimeout(100);
//      LIN4_Connect();
//      testWaitForTimeout(200);
      testStep("Info","Connect LIN4.");
      break;
    case 5:
//      ENV_FR_Connect();// connect ENV to DRB2
//      testWaitForTimeout(100);
//      LIN5_Connect();
//      testWaitForTimeout(200);
      testStep("Info","Connect LIN5.");
      break;
    case 6:
//      ENV_FR_Connect();// connect ENV to DRB2
//      testWaitForTimeout(100);
//      LIN6_Connect();
//      testWaitForTimeout(200);
      testStep("Info","Connect LIN6.");
      break;
    case 7:
//      ENV_FR_Connect();// connect ENV to DRB2
//      testWaitForTimeout(100);
//      LIN7_Connect();
//      testWaitForTimeout(200);
      testStep("Info","Connect LIN7.");
      break;
    case 8:
//      ENV_FR_Connect();// connect ENV to DRB2
//      testWaitForTimeout(100);
//      LIN8_Connect();
//      testWaitForTimeout(200);
      testStep("Info","Connect LIN8.");
      break;
    default:
      testStep("Info","Unknown channel.");
      break;
  }
}

/// <FaultOnLIN>
void LINBusFaultReset()
{
//  ENV_Reset();
//  testWaitForTimeout(100);
//  DRB_ALL_RESET();
//  testWaitForTimeout(500);
}

void AllDeviceInit()
{
  VH1150_InitConfig();
  
}

/// <FaultOnFR>
void FRBusFaultSet(enum FRFaultType fault)
{
  switch(fault)
  {
    case BP_ShortTo_BM:      
      StopKeySlot();
      resetFlexRayCCEx(gresumFrmChnl_FR,1,50,180,60,"");
      testWaitForTimeout(100);
      testStep("Info","Stop the keyslot");
//      BP2BM(T_on);
      break;
      
    case BP_BAT:
      
      break;
      
    case BP_GND:
//      CANH2G(T_on);
      break;
      
    case BM_BAT:
      break;
      
    case BM_GND:
      break;
      
    case BP_Open:
      
      break;
      
    case BM_Open:
      break;
      
    case FrFlt_Rst:
      if(gresumFrmChnl_FR==1)
      {
        frSetKeySlot(1,1,1,KeySlot1,3);//RXQ, 
        frSetKeySlot(1,1,2,KeySlot2,1);
        resetFlexRayCCEx(gresumFrmChnl_FR,1,50,180,60,"");
        NetwrkRequestOnTPBus();
        TRC();
        SimVehBat(gUbat12);
      }
      testStep("Info","Reset FR Fault.");      
      break;
    
    Default:
      testStepFail("Fail","Set fail -> Unknown type of VH6501_CANBusFaultSet!");
      break;
  }
}
/// <FaultOnFR>
void FRBusFaultReset()
{
//  AllDeviceInit();
  testWaitForTimeout(100);
  resetFlexRayCCEx(gresumFrmChnl_FR,1,50,180,60,"");
  TRC();
  SimVehBat(0x82);
}

/// <FaultOnFR>
void FRBusFaultConnect(int chanl)
{
  testWaitForTimeout(100);
}
/// <FaultOnCAN>
void CANBusFaultConnect(int chanl)
{
  switch(chanl)
  {
    case 1:
//      CAN1_Connect();
//      testWaitForTimeout(200);
      testStep("Info","Connect CAN1.");
      break;
    case 2:
//      CAN2_Connect();
//      testWaitForTimeout(200);
      testStep("Info","Connect CAN2.");
      break;
    case 3:
//      CAN3_Connect();
//      testWaitForTimeout(200);
      testStep("Info","Connect CAN3.");
      break;
    case 4:
//      CAN4_Connect();
//      testWaitForTimeout(200);
      testStep("Info","Connect CAN4.");
      break;
    default:
      testStep("Info","Unknown channel.");
      break;
  }
//  ENV_CAN_Connect();
//  testWaitForTimeout(100);
}

/// <FaultOnCAN>
void CANBusFaultSet(enum FRFaultType fault)
{
  switch(fault)
  {
    case BP_ShortTo_BM:
//      ENV_CANH_CANL();
//      testWaitForTimeout(100);
      testStep("Info","Short CANH to CANL");
      break;
      
    case BP_BAT:
//      ENV_CANH_VB();
//      testWaitForTimeout(100);
      testStep("Info","Short CANH to BAT");
      break;
      
    case BP_GND:
//      ENV_CANH_GND();
//      testWaitForTimeout(100);
      testStep("Info","Short CANH to GND");
      break;
      
    case BM_BAT:
//      ENV_CANL_VB();
//      testWaitForTimeout(100);
      testStep("Info","Short CANL to BAT");
      break;
      
    case BM_GND:
//      ENV_CANL_GND();
//      testWaitForTimeout(100);
      testStep("Info","Short CANL to GND");
      break;
      
    case BP_Open:
//      CANHIN_CANHOUT();
//      testWaitForTimeout(100);
      VHDevSetBusFaults(gDevHandle,1,0,0);
      testStep("Info","Open CANH");
      break;
    case BM_Open:
//      CANLIN_CANLOUT();
//      testWaitForTimeout(100);
      VHDevSetBusFaults(gDevHandle,2,0,0);
      testStep("Info","Open CANL");
      break;
    case FrFlt_Rst:
//      ENV_Reset();
//      testWaitForTimeout(100);
      VHDevSetBusFaults(gDevHandle,0,0,0);
      testStep("Info","Reset CAN Bus Fault.");
      break;
    Default:
      testStepFail("Fail","Unknown type of CAN bus Fault!");
      break;
  }
}
/// <FaultOnCAN>
void CANBusFaultReset()
{
  
//  testStep("Info","Reset all channel.");
//  testwaitfortimeout(500);
}

void TestWaitForCurInRange(float current,long time)
{
  int i;
  float Cur[1];
  for(i=0;i<(time/1000);i++)
  {
    VH1150_CurrentGet(Cur);
    testWaitForTimeout(1000);
    if(Cur[0]<=current)
    {
      testStepPass("Pass","The current is %5.3fmA",Cur[0]);
      break;
    }
    
  }
  if(i==(time/1000))
  {
    testStepWarning("Warning","Time out! The current is %5.3fmA, expected is %5.3fmA",Cur[0],current);
  }
  testWaitForTimeout(2000);

}

float GetVolt()
{
  float volt[1];
  VH1150_VoltageGet(volt);
  return volt[0];
}