
/*@!Encoding:936*/

variables
{

  const int gMsgCont=79;

  struct NetwrkMsg
  {
    char cluster[50];
    int gAllMsgOfDut[gMsgCont];
  };
  struct NetwrkMsg NetwrkMsgTemp[9]=
  {
  
    {
      "ZCU_CANFD2",
      {0x504,0x5a,0x80,0x130,0x132,0x141,0x170,0x180,0x1c5,0x1c6,0x1cf,0x1e5,0x220,0x25f,0x264,0x281,0x2d1,0x2d8,0x2e0,0x2e2,0x2e3,0x2e4,0x2e5,0x322,0x323,0x331,0x361,0x362,0x363,0x364,0x365,0x366,0x367,0x368,0x371,0x380,0x390,0x3b5,0x3d0,0x40a,0x489,0x4b1,0x4b5,0x4bb,0x4c1,0x4c2,0x4c3,0x4c4,0x4c5,0x4c6,0x4d1,0x4ee,0x544}
    },
    {
      "ZCU_CANFD1",
      {0x503,0x61,0x81,0x106,0x134,0x16f,0x1c8,0x1f1,0x221,0x243,0x345,0x353,0x363,0x3a3,0x485,0x543}
    },
    {
      "ChassisCANFD2",
      {0x507,0x4f,0x59,0x86,0xdf,0xe5,0x121,0x13c,0x159,0x16f,0x23d,0x2a4,0x335,0x35c,0x3f5,0x547}
    },
    {
      "ZCUD_CAN1",
      {0x501,0x1b,0x20,0x24,0x40,0x50,0x51,0x54,0x5b,0x76,0x78,0x80,0x83,0x85,0x99,0xe0,0xea,0xf0,0x105,0x106,0x110,0x118,0x11a,0x121,0x122,0x124,0x125,0x126,0x127,0x128,0x129,0x12a,0x12c,0x12d,0x12f,0x131,0x135,0x13a,0x140,0x143,0x180,0x196,0x1a3,0x1af,0x206,0x209,0x210,0x214,0x215,0x228,0x235,0x264,0x271,0x310,0x314,0x320,0x323,0x325,0x32f,0x330,0x333,0x334,0x345,0x351,0x366,0x370,0x371,0x378,0x384,0x388,0x390,0x394,0x398,0x399,0x39c,0x471,0x48c,0x490,0x541}
    },
    {
      "PropulsionCAN",
      {0x505,0x41,0x54,0x57,0x76,0x11a,0x12e,0x139,0x160,0x162,0x198,0x19d,0x238,0x24d,0x255,0x25d,0x285,0x297,0x3a3,0x4a3,0x4b3,0x545}
    },
    {
      "ChassisCAN1",
      {0x506,0x1a,0x51,0x57,0x65,0x79,0xa0,0x10e,0x156,0x169,0x171,0x1b0,0x1f0,0x208,0x241,0x244,0x266,0x290,0x2ae,0x2d0,0x2e0,0x310,0x360,0x380,0x3a0,0x463,0x491,0x546}
    },
    {
      "BodyExposedCAN",
      {0x502,0x110,0x111,0x112,0x113,0x114,0x115,0x117,0x118,0x119,0x11a,0x11b,0x11c,0x11d,0x11e,0x11f,0x120,0x121,0x122,0x123,0x124,0x125,0x126,0x127,0x128,0x129,0x12a,0x12b,0x12c,0x12d,0x12e,0x12f,0x130,0x131,0x132,0x133,0x134,0x135,0x136,0x137,0x138,0x139,0x13a,0x13b,0x13c,0x13d,0x13e,0x13f,0x140,0x141,0x142,0x143,0x145,0x147,0x149,0x14b,0x14d,0x14f,0x3a1,0x3c1,0x542}
    },
    {
      "ZCUD_CANFD3",
      {0x501,0x55,0x66,0x121,0x153,0x239,0x271,0x2f0,0x495,0x541}
    },
	{
      "ZCUD_CANFD4",
      {0x501,0x50,0x140,0x100,0x1c0,0x2c0,0x300,0x4c0,0x541}
    }
  };

}
