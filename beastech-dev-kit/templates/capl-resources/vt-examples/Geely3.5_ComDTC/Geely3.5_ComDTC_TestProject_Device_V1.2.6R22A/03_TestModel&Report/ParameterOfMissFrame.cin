
/*@!Encoding:936*/
includes
{

  
}
variables
{
  /*---------------Node Lost DTC related Var-------------------*/
  struct misMsgSignal
  {
    char sigName[100];
    int sigLength;
    int startBit;
    int sigValue;
  };
  struct misMsg
  {
    dword msgID;
    int baseCycle;
    int RepetitionCycle;
    
    dword msgCycTime;
    int msgDataLgth;
    struct misMsgSignal misMsgSignalList[20];
    int ubBit;

  };

  const int MSG_MAX_NUM=1;

  struct misMsgDTC
  {
    char node[100];
    char cluster[100];
    char busType[100];
    dword dtc;
    struct misMsg misMsgList[MSG_MAX_NUM];
    
    int testProd;
    int SUValue;
    int SDValue;
    int UnCofrmLmt;
    int CofrmLmt;
    int agdLmt;
    int usgmod;
    int fdFlg;
    int simMsgFlg;
    int simMsgImtFlg;
    int tstRsltFlg;
    int failTime;
    int passTime;
    int CCPPsn[20];
    int CCPValue[20];
    int CCPValueNotMet[20];
  };
  const int MISMSG_DTC_NUM=34;
  struct misMsgDTC misMsgDTCList[MISMSG_DTC_NUM]=
  {
    {
      "SUM","ZCUD_CANFD3","CAN",0xD11D87,
      {
        {
          528,0,0,10,64,
          {
            {"SUMMissingSlaveSignal",0,0,0}
          },
          14
        }
      },
      160,9,9,18,3,255,0xD,0,0,0,1,5000,5000,
      {1080},{0x2},{0x1}
    },
	{
      "PSCM","ChassisCAN1","CAN",0xD15187,
      {
        {
          246,0,0,10,8,
          {
            {"UBoostReqBySteerFrnt",0,0,0}
          },
          57
        }
      },
      160,9,9,18,3,255,0xD,0,0,0,1,5000,5000,
      {1052},{0x2},{0x1}
    },
    {
      "SRS","ZCUD_CAN1","CAN",0xD10E87,
      {
        {
          33,0,0,10,8,
          {
            {"CrashSts2",0,0,0}
          },
          30
        }
      },
      160,9,9,18,3,255,0xD,0,0,0,1,5000,5000,
      {1045},{0x2},{0x1}
    },
    {
      "POT","ZCUD_CAN1","CAN",0xD16B87,
      {
        {
          149,0,0,10,8,
          {
            {"TrOpenerSts",0,0,0}
          },
          4
        }
      },
      160,9,9,18,3,255,0xD,0,0,0,1,5000,5000,
      {1047},{0x2},{0x1}
    },
    {
      "TRM","ZCUD_CAN1","CAN",0xD16C87,
      {
        {
          208,0,0,10,4,
          {
            {"TrlrPrsnt",0,0,0}
          },
          20
        }
      },
      160,9,9,18,3,255,0xD,0,0,0,1,5000,5000,
      {1083},{0x2},{0x1}
    },
//    {
//      "IHU","ZCU_CANFD2","CAN",0x984F87,
//      {
//        {
//          512,0,0,10,64,
//          {
//            {"SoftLiBtnSwtSetReq",0,0,0}
//          },
//          177
//        }
//      },
//      160,9,9,18,3,255,0xD,0,0,0,1,5000,5000,
//      {629},{0x7},{0x1}
//    },
    {
      "RML","ZCUD_CAN1","CAN",0xD11687,
      {
        {
          339,0,0,10,8,
          {
            {"StsForRtrctrRvsbLe",0,0,0}
          },
          8
        }
      },
      160,9,9,18,3,255,0xD,0,0,0,1,5000,5000,
      {1063},{0x2},{0x1}
    },
    {
      "RMR","ZCUD_CAN1","CAN",0xD11787,
      {
        {
          373,0,0,10,8,
          {
            {"StsForRtrctrRvsbRi",0,0,0}
          },
          8
        }
      },
      160,9,9,18,3,255,0xD,0,0,0,1,5000,5000,
      {1064},{0x2},{0x1}
    },
//    {
//      "RBCM","BodyExposedCAN","CAN",0xD11887,
//      {
//      },
//      160,9,9,18,3,255,0xD,0,0,0,1,5000,5000,
//      {1011},{0x2},{0x1}
//    },
    {
      "SAS","ChassisCAN1","CAN",0xD11B87,
      {
        {
          64,0,0,10,8,
          {
            {"SteerWhlSnsr",0,0,0}
          },
          7
        }
      },
      160,9,9,18,3,255,0xD,0,0,0,1,5000,5000,
      {1075},{0x2},{0x1}
    },
    {
      "SCL","ChassisCAN1","CAN",0xD11C87,
      {
        {
          608,0,0,10,8,
          {
            {"SteerLockSts",0,0,0}
          },
          14
        }
      },
      160,9,9,18,3,255,0xD,0,0,0,1,5000,5000,
      {1076},{0x2},{0x1}
    },
//    {
//      "SUM","BodyExposedCAN","CAN",0xD11D87,
//      {
//      },
//      160,9,9,18,3,255,0xD,0,0,0,1,5000,5000,
//      {1080},{0x2},{0x1}
//    },
    {
      "HCML","BodyExposedCAN","CAN",0xD13087,
      {
        {
          257,0,0,10,8,
          {
            {"HiLoBeamLePixelQnty",0,0,0}
          },
          24
        }
      },
      160,9,9,18,3,255,0xD,0,0,0,1,5000,5000,
      {274},{0x86},{0x1}
    },
    {
      "HCMR","BodyExposedCAN","CAN",0xD13187,
      {
        {
          258,0,0,10,8,
          {
            {"HiLoBeamRiPixelQnty",0,0,0}
          },
          24
        }
      },
      160,9,9,18,3,255,0xD,0,0,0,1,5000,5000,
      {274},{0x86},{0x1}
    },
    {
      "SMB","ZCUD_CAN1","CAN",0xD15787,
      {
        {
          587,0,0,10,8,
          {
            {"RowSecLeInclPosAngle",0,0,0}
          },
          13
        }
      },
      160,9,9,18,3,255,0xD,0,0,0,1,5000,5000,
      {1172},{0x2},{0x1}
    },
    {
      "DPOD","ZCUD_CANFD4","CAN",0xD15D87,
      {
        {
          464,0,0,10,64,
          {
            {"DPODMissingSlaveSignal",0,0,0}
          },
          0
        }
      },
      160,9,9,18,3,255,0xD,0,0,0,1,5000,5000,
      {1239},{0x2},{0x1}
    },
    {
      "LPOD","ZCUD_CANFD4","CAN",0xD16087,
      {
        {
          469,0,0,10,64,
          {
            {"LPODMissingSlaveSignal",0,0,0}
          },
          2
        }
      },
      160,9,9,18,3,255,0xD,0,0,0,1,5000,5000,
      {1237},{0x2},{0x1}
    },
    {
      "SDL","ZCUD_CAN1","CAN",0xD17487,
      {
        {
          302,0,0,10,8,
          {
            {"DoorSldngLeReSts",0,0,0}
          },
          32
        }
      },
      160,9,9,18,3,255,0xD,0,0,0,1,5000,5000,
      {1233},{0x2},{0x1}
    },
    {
      "SDR","ZCUD_CAN1","CAN",0xD17587,
      {
        {
          307,0,0,10,8,
          {
            {"DoorSldngRiReSts",0,0,0}
          },
          32
        }
      },
      160,9,9,18,3,255,0xD,0,0,0,1,5000,5000,
      {1234},{0x2},{0x1}
    },
    {
      "SMBL","ZCUD_CAN1","CAN",0xD17687,
      {
        {
          587,0,0,10,8,
          {
            {"RowSecLeInclPosAngle",0,0,0}
          },
          13
        }
      },
      160,9,9,18,3,255,0xD,0,0,0,1,5000,5000,
      {1231},{0x2},{0x1}
    },
    {
      "SMBR","ZCUD_CAN1","CAN",0xD17787,
      {
        {
          586,0,0,10,8,
          {
            {"RowSecRiInclPosAngle",0,0,0}
          },
          13
        }
      },
      160,9,9,18,3,255,0xD,0,0,0,1,5000,5000,
      {1232},{0x2},{0x1}
    },
    {
      "CMD","ZCUD_CAN1","CAN",0xD19187,
      {
        {
          265,0,0,10,8,
          {
            {"SeatMassgRunngDrvr2",0,0,0}
          },
          1
        }
      },
      160,9,9,18,3,255,0xD,0,0,0,1,5000,5000,
      {239},{0x2},{0x1}
    },
//    {
//      "CMP","BodyExposedCAN","CAN",0xD19287,
//      {
//      },
//      160,9,9,18,3,255,0xD,0,0,0,1,5000,5000,
//      {239\243},{0x2\0x85},{0x1}
//    },
    {
      "TCMB","ZCUD_CAN1","CAN",0xD19387,
      {
        {
          597,0,0,10,8,
          {
            {"TCMBMissingSlaveSignal",0,0,0}
          },
          6
        }
      },
      160,9,9,18,3,255,0xD,0,0,0,1,5000,5000,
      {92},{0x82},{0x1}
    },
    {
      "TCMT","ZCUD_CAN1","CAN",0xD19487,
      {
        {
          149,0,0,10,8,
          {
            {"LowrTailgSts",0,0,0}
          },
          19
        }
      },
      160,9,9,18,3,255,0xD,0,0,0,1,5000,5000,
      {98},{0x82},{0x1}
    },
//    {
//      "RCM","ZCU_CANFD2","CAN",0xDA9387,
//      {
//        {
//          722,0,0,10,64,
//          {
//            {"StsOfLedStopLampLe1",0,0,0}
//          },
//          253
//        }
//      },
//      160,9,9,18,3,255,0xD,0,0,0,1,5000,5000,
//      {1177},{0x2},{0x1}
//    },
    {
      "RASM","ChassisCAN1","CAN",0xDCD187,
      {
        {
          69,0,0,10,8,
          {
            {"SteerActReGroup",0,0,0}
          },
          7
        }
      },
      160,9,9,18,3,255,0xD,0,0,0,1,5000,5000,
      {540},{0x2},{0x1}
    },
    {
      "HWAM","ZCUD_CANFD3","CAN",0xDCD287,
      {
        {
          256,0,0,10,64,
          {
            {"HWAMMissingSlaveSignal",0,0,0}
          },
          21
        }
      },
      160,9,9,18,3,255,0xD,0,0,0,1,5000,5000,
      {733},{0x3},{0x1}
    },
    {
      "RWAM","ZCUD_CANFD3","CAN",0xDCD387,
      {
        {
          272,0,0,10,64,
          {
            {"RWAMMissingSlaveSignal",0,0,0}
          },
          21
        }
      },
      160,9,9,18,3,255,0xD,0,0,0,1,5000,5000,
      {733},{0x3},{0x1}
    },
//    {
//      "SMTL","BodyExposedCAN","CAN",0xDCE187,
//      {
//      },
//      160,9,9,18,3,255,0xD,0,0,0,1,5000,5000,
//     {1167},{0x2},{0x1}
//    },
//    {
//      "SMTR","BodyExposedCAN","CAN",0xDCE287,
//      {
//      },
//      160,9,9,18,3,255,0xD,0,0,0,1,5000,5000,
//      {1168},{0x2},{0x1}
//    },
    {
      "CSTM","ChassisCAN1","CAN",0xDCE887,
      {
        {
          64,0,0,10,8,
          {
            {"SteerWhlSnsr",0,0,0}
          },
          7
        }
      },
      160,9,9,18,3,255,0xD,0,0,0,1,5000,5000,
      {1},{0x2},{0x1}
    },
    {
      "OGM","ZCUD_CAN1","CAN",0xDCE987,
      {
        {
          769,0,0,10,8,
          {
            {"OGMMissingSlaveSignal",0,0,0}
          },
          6
        }
      },
      160,9,9,18,3,255,0xD,0,0,0,1,5000,5000,
      {842},{0x2},{0x1}
    },
    {
      "WPRL","ZCUD_CAN1","CAN",0xDCEB87,
      {
        {
          512,0,0,10,8,
          {
            {"WPRL2MissingSlaveSignal",0,0,0}
          },
          14
        }
      },
      160,9,9,18,3,255,0xD,0,0,0,1,5000,5000,
      {366},{0x85},{0x1}
    },
    {
      "WPRR","ZCUD_CAN1","CAN",0xDCEC87,
      {
        {
          535,0,0,10,8,
          {
            {"WPRR2MissingSlaveSignal",0,0,0}
          },
          14
        }
      },
      160,9,9,18,3,255,0xD,0,0,0,1,5000,5000,
      {366},{0x85},{0x1}
    },
    {
      "RDRM","ZCUD_CANFD4","CAN",0xDCEF87,
      {
        {
          112,0,0,10,64,
          {
            {"RDRMMissingSlaveSignal",0,0,0}
          },
          57
        }
      },
      160,9,9,18,3,255,0xD,0,0,0,1,5000,5000,
      {1240},{0x2},{0x1}
    },
    {
      "DDRM","ZCUD_CANFD4","CAN",0xDCF087,
      {
        {
          96,0,0,10,64,
          {
            {"DDRMMissingSlaveSignal",0,0,0}
          },
          57
        }
      },
      160,9,9,18,3,255,0xD,0,0,0,1,5000,5000,
      {1240},{0x2},{0x1}
    },
    {
      "HRM","ZCUD_CAN1","CAN",0xDCF187,
      {
        {
          517,0,0,10,8,
          {
            {"HRMMissingSlaveSignal",0,0,0}
          },
          2
        }
      },
      160,9,9,18,3,255,0xD,0,0,0,1,5000,5000,
      {507},{0x81},{0x1}
    },
    {
      "RWAS","ChassisCAN1","CAN",0xDCF287,
      {
        {
          348,0,0,10,8,
          {
            {"RWASMissingSlaveSignal",0,0,0}
          },
          30
        }
      },
      160,9,9,18,3,255,0xD,0,0,0,1,5000,5000,
      {733},{0x3},{0x1}
    },
//    {
//     "HVFM","ZCUD_CANFD3","CAN",0xDCFF87,
//      {
//        {
//          769,0,0,10,64,
//          {
//            {"HVFMMissingSlaveSignal",0,0,0}
//          },
//          217
//       }
//      },
//      160,9,9,18,3,255,0xD,0,0,0,1,5000,5000,
//      {38},{0x4},{0x1}
//    },
    {
      "CRPM","ZCUD_CAN1","CAN",0xDD0087,
      {
        {
          762,0,0,10,8,
          {
            {"CRPMMissingSlaveSignal",0,0,0}
          },
          6
        }
     },
      160,9,9,18,3,255,0xD,0,0,0,1,5000,5000,
      {1043},{0x2},{0x1}
    },
    {
      "POT3","ZCUD_CAN1","CAN",0xDD0187,
      {
        {
          149,0,0,10,8,
          {
            {"TrInsdOpenSwtSts",0,0,0}
          },
          50
        }
      },
      160,9,9,18,3,255,0xD,0,0,0,1,5000,5000,
      {99},{0x81},{0x1}
    }
  };
}
