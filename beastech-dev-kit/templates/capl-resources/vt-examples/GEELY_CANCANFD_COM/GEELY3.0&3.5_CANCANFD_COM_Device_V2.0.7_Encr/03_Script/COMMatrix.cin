
/*@!Encoding:936*/
includes
{

}
variables
{
  #pragma warning(disable: 2058)
  int txMsgNum=0;
  int rxMsgNum=0;
  struct DUTMatrix TxCommMatrix[long];
  struct DUTMatrix RxCommMatrix[long];
  const int MsgNum_ZCUD5=979;
  struct DUTMatrix CommMatrix_ZCUD5[MsgNum_ZCUD5]=
	{
		{
			"PropulsionCAN","ZcudPropFr02","Out",0x4a3,8,1000,0,0,0,13,2,
			{
				{"isTiDrvgCycOff_1",16,23,11},
				{"isWiprFrntLvrStsFrntWiprLvrCmd1_0",3,47,-1},
				{"isDrvrPrsntStsDrvrPrsnt_1",2,51,-1},
				{"isRainDetected_1",1,7,13},
				{"isDrvrSeatSts_1",2,10,8},
				{"isRainLi_1",1,15,14},
				{"isDrvrPrsntStsDrvrPrsntQf_1",2,49,-1},
				{"isWiprFrntLvrStsFrntWiprLvrQf_0",2,42,-1},
				{"isWiprFrntLvrStsFrntWiprLvrCrc_0",8,39,-1},
				{"isDrvrPrsntStsDrvrPrsntChks_1",8,63,-1},
				{"isWiprFrntLvrStsFrntWiprLvrCntr_0",2,44,-1},
				{"isAutWinWipgCmd_1",3,6,3},
				{"isDrvrPrsntStsDrvrPrsntCntr_1",4,55,-1}
			},
			{
				{"igWiprFrntLvrSts_0","ZcudPropSignalIPdu02",40},
				{"igDrvrPrsntSts_1","ZcudPropSignalIPdu02",12}
			}
		},
		{
			"PropulsionCAN","ZcudPropFr27","Out",0x238,8,160,0,0,0,4,0,
			{
				{"isBattTRaw_1",9,0,1},
				{"isBattURaw_2",9,16,17},
				{"isActvnOfSymIllmn_1",1,7,6},
				{"isRlyPwrDistbnCmd1WdPreBattSaveCmd_0",1,23,22}
			},
			{
				{"","",-1}
			}
		},
		{
			"PropulsionCAN","ZcudPropFr08","Out",0x3a3,8,400,0,0,0,7,1,
			{
				{"isVehTiAndDataHr1_1",5,39,-1},
				{"isVehTiAndDataSec1_1",6,23,-1},
				{"isVehTiAndDataDay_1",5,31,-1},
				{"isVehTiAndDataYr1_1",7,6,-1},
				{"isVehTiAndDataMth1_1",4,47,-1},
				{"isVehTiAndDataMins1_1",6,15,-1},
				{"isVehTiAndDataDataValid_1",1,7,-1}
			},
			{
				{"igVehTiAndData_1","ZcudPropSignalIPdu08",43}
			}
		},
		{"PropulsionCAN","SrsPropPduR200Fr02","Out",0x35,4,0,0,1,0},
		{
			"PropulsionCAN","ZcudPropFr29","Out",0x24d,8,120,0,0,0,18,2,
			{
				{"isLeReTireMsgP_1",8,31,-1},
				{"isLeReTireMsgTireFillgAssiPSts_1",1,41,-1},
				{"isLeReTireMsgTWarnFlg_1",1,40,-1},
				{"isLeFrntTireMsgT_1",8,15,-1},
				{"isLeFrntTireMsgTWarnFlg_1",1,16,-1},
				{"isLeReTireMsgFastLoseWarnFlg_1",1,44,-1},
				{"isLeFrntTireMsgP_1",8,7,-1},
				{"isLeFrntTireMsgFastLoseWarnFlg_1",1,20,-1},
				{"isLeFrntTireMsgPWarnFlg_1",2,23,-1},
				{"isLeReTireMsgBattLoSt_1",1,45,-1},
				{"isLeFrntTireMsgTireFillgAssiPSts_1",1,17,-1},
				{"isLeReTireMsgT_1",8,39,-1},
				{"isLeFrntTireMsgBattLoSt_1",1,21,-1},
				{"isLeFrntTireMsgSysWarnFlg_1",1,18,-1},
				{"isLeReTireMsgSysWarnFlg_1",1,42,-1},
				{"isLeFrntTireMsgMsgOldFlg_1",1,19,-1},
				{"isLeReTireMsgMsgOldFlg_1",1,43,-1},
				{"isLeReTireMsgPWarnFlg_1",2,47,-1}
			},
			{
				{"igLeFrntTireMsg_1","ZcudPropSignalIPdu29",54},
				{"igLeReTireMsg_1","ZcudPropSignalIPdu29",55}
			}
		},
		{
			"PropulsionCAN","ZcudPropFr16","Out",0x76,8,15,0,0,0,12,3,
			{
				{"isVehSpdLgtQf_4",2,59,-1},
				{"isVehSpdLgtA_4",15,38,-1},
				{"isVehMtnStChks_1",8,31,-1},
				{"isBrkPedlPsdChks_1",8,15,-1},
				{"isBrkPedlPsdCntr_1",4,3,-1},
				{"isBrkPedlPsdBrkPedlNotPsdSafe_1",1,7,-1},
				{"isBrkPedlPsdQf_1",2,5,-1},
				{"isVehSpdLgtCntr_4",4,63,-1},
				{"isBrkPedlPsdBrkPedlPsd_1",1,6,-1},
				{"isVehMtnStVehMtnSt_1",3,18,-1},
				{"isVehSpdLgtChks_4",8,55,-1},
				{"isVehMtnStCntr_1",4,22,-1}
			},
			{
				{"igBrkPedlPsd_1","ZcudPropSignalIPdu16",23},
				{"igVehMtnSt_1","ZcudPropSignalIPdu16",57},
				{"igVehSpdLgt_4","ZcudPropSignalIPdu16",39}
			}
		},
		{
			"PropulsionCAN","ZcudPropFr11","Out",0x4b3,8,1000,0,0,0,7,1,
			{
				{"isTiAndDateIndcnMth1_2",4,35,-1},
				{"isTiAndDateIndcnMins1_2",6,13,-1},
				{"isTiAndDateIndcnDataValid_2",1,6,-1},
				{"isTiAndDateIndcnSec1_2",6,5,-1},
				{"isTiAndDateIndcnDay_2",5,28,-1},
				{"isTiAndDateIndcnYr1_2",7,46,-1},
				{"isTiAndDateIndcnHr1_2",5,20,-1}
			},
			{
				{"igTiAndDateIndcn_2","ZcudPropSignalIPdu11",7}
			}
		},
		{
			"PropulsionCAN","ZCUDPropCANVFCVectorFr","Out",0x545,8,1000,0,0,0,63,1,
			{
				{"isVFCVectorZCUDMVFCid58_4",1,60,-1},
				{"isVFCVectorZCUDMVFCid31_4",1,33,-1},
				{"isVFCVectorZCUDMVFCid9_4",1,11,-1},
				{"isVFCVectorZCUDMVFCid59_4",1,61,-1},
				{"isVFCVectorZCUDMVFCid39_4",1,41,-1},
				{"isVFCVectorZCUDMVFCid17_4",1,19,-1},
				{"isVFCVectorZCUDMVFCid43_4",1,45,-1},
				{"isVFCVectorZCUDMVFCid24_4",1,26,-1},
				{"isVFCVectorZCUDMVFCid15_4",1,17,-1},
				{"isVFCVectorZCUDMVFCid41_4",1,43,-1},
				{"isVFCVectorZCUDMVFCid25_4",1,27,-1},
				{"isVFCVectorZCUDMVFCid53_4",1,55,-1},
				{"isVFCVectorZCUDMVFCid50_4",1,52,-1},
				{"isVFCVectorZCUDMVFCid4_4",1,6,-1},
				{"isVFCVectorZCUDMVFCid19_4",1,21,-1},
				{"isVFCVectorZCUDMVFCid60_4",1,62,-1},
				{"isVFCVectorZCUDMVFCid12_4",1,14,-1},
				{"isVFCVectorZCUDMVFCid47_4",1,49,-1},
				{"isVFCVectorZCUDMVFCid11_4",1,13,-1},
				{"isVFCVectorZCUDMVFCid45_4",1,47,-1},
				{"isVFCVectorZCUDMVFCid29_4",1,31,-1},
				{"isVFCVectorZCUDMVFCid49_4",1,51,-1},
				{"isVFCVectorZCUDMVFCid51_4",1,53,-1},
				{"isVFCVectorZCUDMVFCid42_4",1,44,-1},
				{"isVFCVectorZCUDMVFCid28_4",1,30,-1},
				{"isVFCVectorZCUDMVFCid6_4",1,8,-1},
				{"isVFCVectorZCUDMVFCid52_4",1,54,-1},
				{"isVFCVectorZCUDMVFCid55_4",1,57,-1},
				{"isVFCVectorZCUDMVFCid48_4",1,50,-1},
				{"isVFCVectorZCUDMVFCid2_4",1,4,-1},
				{"isVFCVectorZCUDMVFCid61_4",1,63,-1},
				{"isVFCVectorZCUDMVFCid32_4",1,34,-1},
				{"isVFCVectorZCUDMVFCid20_4",1,22,-1},
				{"isVFCVectorZCUDMVFCid26_4",1,28,-1},
				{"isVFCVectorZCUDMVFCid40_4",1,42,-1},
				{"isVFCVectorZCUDMVFCid56_4",1,58,-1},
				{"isVFCVectorZCUDMVFCid57_4",1,59,-1},
				{"isVFCVectorZCUDMVFCid5_4",1,7,-1},
				{"isVFCVectorZCUDMVFCid37_4",1,39,-1},
				{"isVFCVectorZCUDMVFCid7_4",1,9,-1},
				{"isVFCVectorZCUDMVFCid23_4",1,25,-1},
				{"isVFCVectorZCUDMVFCid8_4",1,10,-1},
				{"isVFCVectorZCUDMVFCid36_4",1,38,-1},
				{"isVFCVectorZCUDMBlockID_4",2,1,-1},
				{"isVFCVectorZCUDMVFCid21_4",1,23,-1},
				{"isVFCVectorZCUDMVFCid0_4",1,2,-1},
				{"isVFCVectorZCUDMVFCid14_4",1,16,-1},
				{"isVFCVectorZCUDMVFCid44_4",1,46,-1},
				{"isVFCVectorZCUDMVFCid27_4",1,29,-1},
				{"isVFCVectorZCUDMVFCid54_4",1,56,-1},
				{"isVFCVectorZCUDMVFCid46_4",1,48,-1},
				{"isVFCVectorZCUDMVFCid1_4",1,3,-1},
				{"isVFCVectorZCUDMVFCid13_4",1,15,-1},
				{"isVFCVectorZCUDMVFCid3_4",1,5,-1},
				{"isVFCVectorZCUDMVFCid34_4",1,36,-1},
				{"isVFCVectorZCUDMVFCid33_4",1,35,-1},
				{"isVFCVectorZCUDMVFCid10_4",1,12,-1},
				{"isVFCVectorZCUDMVFCid22_4",1,24,-1},
				{"isVFCVectorZCUDMVFCid18_4",1,20,-1},
				{"isVFCVectorZCUDMVFCid35_4",1,37,-1},
				{"isVFCVectorZCUDMVFCid30_4",1,32,-1},
				{"isVFCVectorZCUDMVFCid16_4",1,18,-1},
				{"isVFCVectorZCUDMVFCid38_4",1,40,-1}
			},
			{
				{"igVFCVectorZCUDM_4","ZCUDPropVFCVectorSignalIPdu",-1}
			}
		},
		{
			"PropulsionCAN","ZcudPropFr30","Out",0x25d,8,120,0,0,0,18,2,
			{
				{"isRiReTireMsgBattLoSt_1",1,45,-1},
				{"isRiFrntTireMsgT_1",8,15,-1},
				{"isRiReTireMsgTWarnFlg_1",1,40,-1},
				{"isRiReTireMsgTireFillgAssiPSts_1",1,41,-1},
				{"isRiFrntTireMsgFastLoseWarnFlg_1",1,20,-1},
				{"isRiFrntTireMsgTireFillgAssiPSts_1",1,17,-1},
				{"isRiReTireMsgFastLoseWarnFlg_1",1,44,-1},
				{"isRiFrntTireMsgPWarnFlg_1",2,23,-1},
				{"isRiFrntTireMsgSysWarnFlg_1",1,18,-1},
				{"isRiReTireMsgSysWarnFlg_1",1,42,-1},
				{"isRiReTireMsgP_1",8,31,-1},
				{"isRiFrntTireMsgTWarnFlg_1",1,16,-1},
				{"isRiFrntTireMsgBattLoSt_1",1,21,-1},
				{"isRiReTireMsgT_1",8,39,-1},
				{"isRiReTireMsgPWarnFlg_1",2,47,-1},
				{"isRiFrntTireMsgMsgOldFlg_1",1,19,-1},
				{"isRiFrntTireMsgP_1",8,7,-1},
				{"isRiReTireMsgMsgOldFlg_1",1,43,-1}
			},
			{
				{"igRiReTireMsg_1","ZcudPropSignalIPdu30",55},
				{"igRiFrntTireMsg_1","ZcudPropSignalIPdu30",54}
			}
		},
		{
			"PropulsionCAN","ZcudPropFr26","Out",0x198,8,50,0,0,0,8,2,
			{
				{"isChrgnUReqCntr_0",4,39,-1},
				{"isBattSocRawChks_1",8,53,-1},
				{"isBattIRaw_1",16,7,34},
				{"isBattSocRawCntr_1",4,61,-1},
				{"isBattSocRawSoc_1",10,47,-1},
				{"isEscCtrlIndcn_1",2,57,33},
				{"isChrgnUReqChks_0",8,23,-1},
				{"isChrgnUReqChrgnUReq_0",8,31,-1}
			},
			{
				{"igBattSocRaw_1","ZcudPropSignalIPdu26",32},
				{"igChrgnUReq_0","ZcudPropSignalIPdu26",35}
			}
		},
		{
			"PropulsionCAN","ZcudPropFr19","Out",0x139,8,25,0,0,0,6,1,
			{
				{"isLockgCenStsTrigSrc_3",4,55,-1},
				{"isLockgCenStsUpdEve_3",1,49,-1},
				{"isPtActvnReq1WdPtActvnReq_0",2,63,61},
				{"isLockgCenStsLockSt_3",2,51,-1},
				{"isSpdRotlForWhlsAtAxleRe_1",15,38,39},
				{"isEngTracCtrlActvFrntMax_1",1,60,59}
			},
			{
				{"igLockgCenSts_3","ZcudPropSignalIPdu19",48}
			}
		},
		{
			"PropulsionCAN","ZcudPropFr12","Out",0x160,8,100,0,0,0,7,1,
			{
				{"isHydPmpReRiU_1",10,33,13},
				{"isHydPmpFrntRiU_1",10,9,11},
				{"isChrgLidAcSts",2,37,35},
				{"isHydPmpFrntLeU_1",10,7,10},
				{"isHydPmpReLeU_1",10,31,12},
				{"isAmbTEstimdQf_1",1,60,-1},
				{"isAmbTEstimdAmbTEstimd_1",11,55,-1}
			},
			{
				{"igAmbTEstimd_1","ZcudPropSignalIPdu12",59}
			}
		},
		{"PropulsionCAN","ZcudPropNMFr","Out",0x505,8,0,0,3,0},
		{
			"PropulsionCAN","ZcudPropFr17","Out",0x41,8,10,0,0,0,4,1,
			{
				{"isPtTqAtAxleMaxReqCntr_1",4,19,-1},
				{"isPtTqAtAxleMaxReqPtTqAtAxleFrntReq_1",16,39,-1},
				{"isPtTqAtAxleMaxReqChks_1",8,31,-1},
				{"isPtTqAtAxleMaxReqPtTqAtAxleReReq_1",16,55,-1}
			},
			{
				{"igPtTqAtAxleMaxReq_1","ZcudPropSignalIPdu17",20}
			}
		},
		{
			"PropulsionCAN","ZcudPropFr28","Out",0x54,8,10,0,0,0,6,1,
			{
				{"isStcStsMinToDmcEngRotTarSpdDMCRear_1",16,23,-1},
				{"isStcStsMinToDmcEngRotTarSpdDMCFrnt_1",16,7,-1},
				{"isStcStsMinToDmcCntr_1",4,63,-1},
				{"isStcStsMinToDmcStcStsToDmcFrnt_1",8,47,-1},
				{"isStcStsMinToDmcChks_1",8,39,-1},
				{"isStcStsMinToDmcStcStsToDmcRear_1",8,55,-1}
			},
			{
				{"igStcStsMinToDmc_1","ZcudPropSignalIPdu28",59}
			}
		},
		{
			"PropulsionCAN","ZcudPropFr14","Out",0x12e,8,20,0,0,0,4,1,
			{
				{"isEscVariantToDmcCntr_1",4,3,-1},
				{"isEscVariantToDmcChks_1",8,15,-1},
				{"isEscVariantToDmcEscVariantToDmc_1",8,23,-1},
				{"isPtActrReModReq_1",2,7,5}
			},
			{
				{"igEscVariantToDmc_1","ZcudPropSignalIPdu14",4}
			}
		},
		{
			"PropulsionCAN","ZcudPropFr22","Out",0x57,8,15,0,0,0,12,1,
			{
				{"isVehModMngtGlbSafe1UsgModSts_5",4,11,-1},
				{"isVehModMngtGlbSafe1Cntr_5",4,15,-1},
				{"isVehModMngtGlbSafe1PwrLvlElecSubtyp_5",4,23,-1},
				{"isTwliBriSts_2",1,47,46},
				{"isVehModMngtGlbSafe1CarModSts1_5",3,39,-1},
				{"isVehModMngtGlbSafe1PwrLvlElecMai_5",4,19,-1},
				{"isVehModMngtGlbSafe1FltEgyCnsWdSts_5",1,33,-1},
				{"isVehModMngtGlbSafe1CarModSubtypWdCarModSubtyp_5",3,36,-1},
				{"isIntrBriSts_2",4,44,45},
				{"isVehModMngtGlbSafe1Chks_5",8,7,-1},
				{"isVehModMngtGlbSafe1EgyLvlElecMai_5",4,27,-1},
				{"isVehModMngtGlbSafe1EgyLvlElecSubtyp_5",4,31,-1}
			},
			{
				{"igVehModMngtGlbSafe1_5","ZcudPropSignalIPdu22",32}
			}
		},
		{
			"PropulsionCAN","ZcudPropFr20","Out",0x255,8,170,0,0,0,8,1,
			{
				{"isImobEngMgrReq2ImobEngDataMgrReq4",8,47,-1},
				{"isImobEngMgrReq2ImobEngDataMgrReq5",8,55,-1},
				{"isImobEngMgrReq2ImobEngMgrCmdTar1",2,1,-1},
				{"isImobEngMgrReq2ImobEngDataMgrReq1",8,23,-1},
				{"isImobEngMgrReq2ImobEngDataMgrReq2",8,31,-1},
				{"isImobEngMgrReq2ImobEngDataMgrReq0",8,15,-1},
				{"isImobEngMgrReq2ImobEngDataMgrReq3",8,39,-1},
				{"isImobEngMgrReq2ImobEngDataMgrReq6",8,63,-1}
			},
			{
				{"igImobEngMgrReq2","ZcudPropSignalIPdu20",2}
			}
		},
		{
			"PropulsionCAN","ZcudPropFr15","Out",0x11a,8,20,0,0,0,6,1,
			{
				{"isStcStsToDmcEngRotTarSpdDMCRear_1",16,39,-1},
				{"isStcStsToDmcEngRotTarSpdDMCFrnt_1",16,23,-1},
				{"isStcStsToDmcChks_1",8,15,-1},
				{"isStcStsToDmcCntr_1",4,3,-1},
				{"isStcStsToDmcFrnt_1",8,55,-1},
				{"isStcStsToDmcRear_1",8,63,-1}
			},
			{
				{"igStcStsToDmc_1","ZcudPropSignalIPdu15",4}
			}
		},
		{
			"PropulsionCAN","ZcudPropFr03","Out",0x19d,8,50,0,0,0,11,2,
			{
				{"isEngTracCtrlActvReMax_1",1,37,36},
				{"isChrgLidDCorAcDcSts_0",2,58,56},
				{"isSecBattSocSoc_1",10,15,-1},
				{"isEpbStsCntr_1",4,55,-1},
				{"isYawStabyCtrlActv_1",1,62,61},
				{"isSecBattSoh_1",10,17,39},
				{"isSecBattSocChks_1",8,7,-1},
				{"isEpbStsChks_1",8,47,-1},
				{"isHVfault_1",1,60,59},
				{"isSecBattSocCntr_1",4,21,-1},
				{"isEpbStsEpbSts_1",4,51,-1}
			},
			{
				{"igSecBattSoc_1","ZcudPropSignalIPdu03",38},
				{"igEpbSts_1","ZcudPropSignalIPdu03",63}
			}
		},
		{
			"PropulsionCAN","ZcudPropFr13","Out",0x297,8,300,0,0,0,4,0,
			{
				{"isHydPmpReRiCurr_1",10,33,13},
				{"isHydPmpReLeCurr_1",10,31,12},
				{"isHydPmpFrntLeCurr_1",10,7,10},
				{"isHydPmpFrntRiCurr_1",10,9,11}
			},
			{
				{"","",-1}
			}
		},
		{
			"PropulsionCAN","ZcudPropFr21","Out",0x162,8,100,0,0,0,5,1,
			{
				{"isChrgModReq",3,38,35},
				{"isCmptmtAirTEstimdExtdComptmtT_2",11,55,-1},
				{"isCmptmtAirTEstimdExtdQlyFlg_2",2,60,-1},
				{"isCarTiGlb_2",32,7,39},
				{"isBattSohRaw_1",10,33,34}
			},
			{
				{"igCmptmtAirTEstimdExtd_2","ZcudPropSignalIPdu21",58}
			}
		},
		{
			"PropulsionCAN","ZcudPropFr23","Out",0x285,8,200,0,0,0,6,2,
			{
				{"isAmbTRawAmbTVal_4",11,42,-1},
				{"isVehBattUSysUQf_2",2,1,-1},
				{"isTrlrPrsnt_3",1,23,22},
				{"isVehBattUSysU_2",8,15,-1},
				{"isBkpOfDstTrvld_3",21,20,21},
				{"isAmbTRawQly_4",2,44,-1}
			},
			{
				{"igVehBattU_2","ZcudPropSignalIPdu23",2},
				{"igAmbTRaw_4","ZcudPropSignalIPdu23",45}
			}
		},
		{"PropulsionCAN","CddIgmPropFr01","In",0x14b,8,0,0,0,0},
		{"PropulsionCAN","DhuPropFr26","In",0x23c,8,0,0,0,0},
		{"PropulsionCAN","IemPropFr13","In",0x112,8,0,0,0,0},
		{"PropulsionCAN","DhuPropFr18","In",0x195,8,0,0,0,0},
		{"PropulsionCAN","BecmPropFr22","In",0x47c,8,0,0,0,0},
		{"PropulsionCAN","XcuPropFr09","In",0x26f,8,0,0,0,0},
		{"PropulsionCAN","XcmXcuPropFr06","In",0x295,8,0,0,0,0},
		{"PropulsionCAN","BecmPropFr13","In",0x177,8,0,0,0,0},
		{"PropulsionCAN","DhuPropFr20","In",0x26b,8,0,0,0,0},
		{"PropulsionCAN","DhuPropFr11","In",0x22f,8,0,0,0,0},
		{"PropulsionCAN","CddObcPropFr04","In",0x411,8,0,0,0,0},
		{"PropulsionCAN","IemXcupPropFr09","In",0x105,8,0,0,0,0},
		{"PropulsionCAN","IemXcupPropFr29","In",0x117,8,0,0,0,0},
		{"PropulsionCAN","EcmPropFr16","In",0x2a5,8,0,0,0,0},
		{"PropulsionCAN","BecmPropFr03","In",0x161,8,0,0,0,0},
		{"PropulsionCAN","BecmPropFr04","In",0x187,8,0,0,0,0},
		{"PropulsionCAN","BecmPropFr01","In",0x141,8,0,0,0,0},
		{"PropulsionCAN","XcmXcuPropFr42","In",0x17c,8,0,0,0,0},
		{"PropulsionCAN","XcmXcuPropFr47","In",0x28a,8,0,0,0,0},
		{"PropulsionCAN","CddObcPropFr01","In",0x218,8,0,0,0,0},
		{"PropulsionCAN","DhuPropFr16","In",0x53,8,0,0,0,0},
		{"PropulsionCAN","CddObcPropFr02","In",0x216,8,0,0,0,0},
		{"PropulsionCAN","EcmPropFr09","In",0x31d,8,0,0,0,0},
		{"PropulsionCAN","DhuPropFr07","In",0x165,8,0,0,0,0},
		{"PropulsionCAN","DemPropFr08","In",0x71,8,0,0,0,0},
		{"PropulsionCAN","CddObcPropFr03","In",0x12a,8,0,0,0,0},
		{"PropulsionCAN","DhuPropFr24","In",0x29b,8,0,0,0,0},
		{"PropulsionCAN","XcuPropFr07","In",0x10a,8,0,0,0,0},
		{"PropulsionCAN","XcmXcuPropFr02","In",0x211,8,0,0,0,0},
		{"PropulsionCAN","EcmPropFr06","In",0x171,8,0,0,0,0},
		{"PropulsionCAN","EcmPropFr01","In",0x27f,8,0,0,0,0},
		{"PropulsionCAN","XcmXcuPropFr46","In",0x22a,8,0,0,0,0},
		{"PropulsionCAN","EcmPropFr02","In",0x101,8,0,0,0,0},
		{"PropulsionCAN","IemXcupPropFr25","In",0x265,8,0,0,0,0},
		{"PropulsionCAN","IemXcupPropFr11","In",0x110,8,0,0,0,0},
		{"PropulsionCAN","IemXcupPropFr28","In",0x283,8,0,0,0,0},
		{"PropulsionCAN","DhuPropFr19","In",0x22b,8,0,0,0,0},
		{"PropulsionCAN","EgsmPropFr01","In",0x135,8,0,0,0,0},
		{"PropulsionCAN","CddIgmPropFr02","In",0x149,8,0,0,0,0},
		{"PropulsionCAN","DhuPropFr23","In",0x439,8,0,0,0,0},
		{"PropulsionCAN","EcmPropFr04","In",0x131,8,0,0,0,0},
		{"PropulsionCAN","BecmPropFr10","In",0x23b,8,0,0,0,0},
		{"PropulsionCAN","IemXcupPropFr30","In",0x61,8,0,0,0,0},
		{"PropulsionCAN","EcmPropFr11","In",0x4b,8,0,0,0,0},
		{"PropulsionCAN","EcmPropFr07","In",0x196,8,0,0,0,0},
		{"PropulsionCAN","EcmPropFr00","In",0x40,8,0,0,0,0},
		{"PropulsionCAN","EcmPropFr12","In",0x27a,8,0,0,0,0},
		{"PropulsionCAN","BecmPropFr19","In",0x451,8,0,0,0,0},
		{"PropulsionCAN","MgmPropFr01","In",0x142,8,0,0,0,0},
		{"PropulsionCAN","XcmXcuPropFr16","In",0x275,8,0,0,0,0},
		{"PropulsionCAN","DhuPropFr09","In",0x15e,8,0,0,0,0},
		{"PropulsionCAN","CddIgmPropFr05","In",0x455,8,0,0,0,0},
		{"PropulsionCAN","BecmPropFr02","In",0x14f,8,0,0,0,0},
		{"PropulsionCAN","AccmPropNMFr","In",0x52e,8,0,0,3,0},
		{"PropulsionCAN","DhuPropFr17","In",0x210,8,0,0,0,0},
		{"PropulsionCAN","EgsmPropFr02","In",0x136,8,0,0,0,0},
		{"PropulsionCAN","EcmPropFr13","In",0x401,8,0,0,0,0},
		{"PropulsionCAN","XcmPropFr07","In",0x154,8,0,0,0,0},
		{"PropulsionCAN","XcmPropFr11","In",0x111,8,0,0,0,0},
		{
			"ChassisCAN1","ZcudChas1Fr07","Out",0x65,8,15,0,0,0,2,0,
			{
				{"isLimnIndcnSecDcDc_1",16,7,20},
				{"isSecDcDcActvd_1",2,23,21}
			},
			{
				{"","",-1}
			}
		},
		{
			"ChassisCAN1","ZcudChas1Fr23","Out",0x310,8,170,0,0,0,3,1,
			{
				{"isCmptmtTFrntQf_2",2,26,-1},
				{"isCmptmtTFrntFanForCmptmtTRunng_2",1,24,-1},
				{"isCmptmtTFrntCmptmtTFrnt_2",11,21,-1}
			},
			{
				{"igCmptmtTFrnt_2","ZcudChas1SignalIPdu23",23}
			}
		},
		{
			"ChassisCAN1","ZcudChas1Fr01","Out",0x491,8,950,0,0,0,2,0,
			{
				{"isDstTrvldVldFromBodyBkp_0",1,17,16},
				{"isDstTrvldFromBodyBkp_0",21,7,18}
			},
			{
				{"","",-1}
			}
		},
		{"ChassisCAN1","ZcudChas1Fr02","Out",0x152,8,0,0,1,0},
		{
			"ChassisCAN1","ZcudChas1Fr22","Out",0x463,8,170,0,0,0,3,1,
			{
				{"isSteerSetgSteerMod_1",3,50,-1},
				{"isSteerSetgPen_1",4,59,-1},
				{"isSteerSetgSteerAsscLvl_1",3,62,-1}
			},
			{
				{"igSteerSetg_1","ZcudChas1SignalIPdu22",51}
			}
		},
		{"ChassisCAN1","ZcudChas1PduR200Fr01","Out",0x34,4,0,0,1,0},
		{"ChassisCAN1","ZcudToPscmChas1DiagReqFrame","Out",0x770,8,0,0,4,0},
		{
			"ChassisCAN1","ZcudChas1Fr09","Out",0x2d0,8,100,0,0,0,5,1,
			{
				{"isLockgCenStsUpdEve_2",1,9,-1},
				{"isSteerWhlHeatgOnCmd",2,2,0},
				{"isLockgCenStsLockSt_2",2,11,-1},
				{"isLockgCenStsTrigSrc_2",4,15,-1},
				{"isSteerWhlTTun",4,7,3}
			},
			{
				{"igLockgCenSts_2","ZcudChas1SignalIPdu09",8}
			}
		},
		{"ChassisCAN1","ZcudChas1Fr25","Out",0x3f7,8,0,0,1,0},
		{
			"ChassisCAN1","ZcudChas1Fr15","Out",0x51,8,10,0,0,0,8,1,
			{
				{"isAsyDataWithCmpSafeALatWithCmp_1",15,55,-1},
				{"isAsyDataWithCmpSafeCntr_1",4,47,-1},
				{"isAsyDataWithCmpSafeYawRateWithCmp_1",16,7,-1},
				{"isAsyDataWithCmpSafeALat1Qf_1",2,41,-1},
				{"isAsyDataWithCmpSafeYawRateQf_1",2,33,-1},
				{"isAsyDataWithCmpSafeChks_1",8,23,-1},
				{"isAsyDataWithCmpSafeALgt1Qf_1",2,43,-1},
				{"isAsyDataWithCmpSafeGrdtOfALgt_1",14,31,-1}
			},
			{
				{"igAsyDataWithCmpSafe_1","ZcudChas1SignalIPdu15",56}
			}
		},
		{
			"ChassisCAN1","ZcudChas1Fr14","Out",0x57,8,10,0,0,0,15,2,
			{
				{"isBMXSSysStsBMXSBlowoutLeFrntQf_0",2,6,-1},
				{"isGVMCSteerWhlAgReqReChks_0",8,47,-1},
				{"isBMXSSysStsBMXSBlowoutLeFrnt_0",1,7,-1},
				{"isBMXSSysStsChks_0",8,23,-1},
				{"isBMXSSysStsBMXSBlowoutRiReQf_0",2,13,-1},
				{"isBMXSSysStsCntr_0",4,11,-1},
				{"isGVMCSteerWhlAgReqReCntr_0",4,35,-1},
				{"isBMXSSysStsBMXSBlowoutRiFrnt_0",1,15,-1},
				{"isBMXSSysStsBMXSSts_0",3,31,-1},
				{"isGVMCSteerWhlAgReqReAgReqRe_0",15,55,-1},
				{"isBMXSSysStsBMXSBlowoutLeREQf_0",2,3,-1},
				{"isBMXSSysStsBMXSBlowoutLeRE_0",1,4,-1},
				{"isBMXSSysStsBMXSBlowoutRiRe_0",1,14,-1},
				{"isGVMCSteerWhlAgReqReCtrlModRe_0",3,38,-1},
				{"isBMXSSysStsBMXSBlowoutRiFrntQf_0",2,1,-1}
			},
			{
				{"igGVMCSteerWhlAgReqRe_0","ZcudChas1SignalIPdu14",56},
				{"igBMXSSysSts_0","ZcudChas1SignalIPdu14",28}
			}
		},
		{
			"ChassisCAN1","ZcudChas1Fr17","Out",0x3a0,8,320,0,0,0,3,1,
			{
				{"isAmbTIndcdWithUnitQF_1",2,21,-1},
				{"isAmbTIndcdWithUnitAmbTIndcd_1",12,19,-1},
				{"isAmbTIndcdWithUnitAmbTIndcdUnit_1",2,23,-1}
			},
			{
				{"igAmbTIndcdWithUnit_1","ZcudChas1SignalIPdu17",9}
			}
		},
		{"ChassisCAN1","ZcudChas1Fr24","Out",0x250,8,0,0,1,0},
		{
			"ChassisCAN1","ZcudChas1Fr34","Out",0x208,8,80,0,0,0,8,1,
			{
				{"isRWASteerLockReq2SteerLockDataReq5_0",8,55,-1},
				{"isRWASteerLockReq2SteerLockDataReq2_0",8,31,-1},
				{"isRWASteerLockReq2Command_0",2,1,-1},
				{"isRWASteerLockReq2SteerLockDataReq0_0",8,15,-1},
				{"isRWASteerLockReq2SteerLockDataReq6_0",8,63,-1},
				{"isRWASteerLockReq2SteerLockDataReq3_0",8,39,-1},
				{"isRWASteerLockReq2SteerLockDataReq1_0",8,23,-1},
				{"isRWASteerLockReq2SteerLockDataReq4_0",8,47,-1}
			},
			{
				{"igRWASteerLockReq2_0","ZcudChas1SignalIPdu34",2}
			}
		},
		{
			"ChassisCAN1","ZcudChas1Fr31","Out",0x244,8,200,0,0,0,5,2,
			{
				{"isIDcDcActLoSideIDcDcActLoSide_1",12,23,-1},
				{"isAmbTRawAmbTVal_2",11,26,-1},
				{"isAmbTRawQly_2",2,47,-1},
				{"isIDcDcActLoSideCntr_1",4,3,-1},
				{"isIDcDcActLoSideChks_1",8,15,-1}
			},
			{
				{"igAmbTRaw_2","ZcudChas1SignalIPdu31",27},
				{"igIDcDcActLoSide_1","ZcudChas1SignalIPdu31",4}
			}
		},
		{"ChassisCAN1","ZcudToSasChas1DiagReqFrame","Out",0x772,8,0,0,4,0},
		{"ChassisCAN1","ZcudChas1NMFr","Out",0x506,8,0,0,3,0},
		{
			"ChassisCAN1","ZcudChas1Fr29","Out",0x380,8,700,0,0,0,2,1,
			{
				{"isVehBattUSysU_0",8,63,-1},
				{"isVehBattUSysUQf_0",2,49,-1}
			},
			{
				{"igVehBattU_0","ZcudChas1SignalIPdu29",54}
			}
		},
		{"ChassisCAN1","ZcudToRwasChas1DiagReqFrame","Out",0x77e,8,0,0,4,0},
		{
			"ChassisCAN1","ZcudChas1Fr16","Out",0xa0,8,10,0,0,0,8,1,
			{
				{"isADataRawSafeALat_1",15,23,-1},
				{"isADataRawSafeAVertQf_1",2,24,-1},
				{"isADataRawSafeALgt_1",15,38,-1},
				{"isADataRawSafeChks_1",8,7,-1},
				{"isADataRawSafeAVert_1",15,55,-1},
				{"isADataRawSafeCntr_1",4,15,-1},
				{"isADataRawSafeALgt1Qf_1",2,9,-1},
				{"isADataRawSafeALat1Qf_1",2,11,-1}
			},
			{
				{"igADataRawSafe_1","ZcudChas1SignalIPdu16",56}
			}
		},
		{
			"ChassisCAN1","ZcudChas1Fr03","Out",0x79,8,10,0,0,0,5,1,
			{
				{"isGVMCSteerWhlAgReqFrntCntr_0",4,47,-1},
				{"isGVMCSteerWhlAgReqFrntSteerWhlTqCtrl_0",14,31,-1},
				{"isGVMCSteerWhlAgReqFrntSteerWhlAgCtrl_0",15,6,-1},
				{"isGVMCSteerWhlAgReqFrntSteerWhlCtrlSts_0",2,33,-1},
				{"isGVMCSteerWhlAgReqFrntChks_0",8,23,-1}
			},
			{
				{"igGVMCSteerWhlAgReqFrnt_0","ZcudChas1SignalIPdu03",7}
			}
		},
		{
			"ChassisCAN1","ZcudChas1Fr13","Out",0x156,8,1000,0,0,0,7,1,
			{
				{"isTiAndDateIndcnYr1_0",7,46,-1},
				{"isTiAndDateIndcnHr1_0",5,20,-1},
				{"isTiAndDateIndcnMins1_0",6,13,-1},
				{"isTiAndDateIndcnSec1_0",6,5,-1},
				{"isTiAndDateIndcnDataValid_0",1,6,-1},
				{"isTiAndDateIndcnMth1_0",4,35,-1},
				{"isTiAndDateIndcnDay_0",5,28,-1}
			},
			{
				{"igTiAndDateIndcn_0","ZcudChas1SignalIPdu13",7}
			}
		},
		{"ChassisCAN1","ZcudToScl2Chas1DiagReqFrame","Out",0x715,8,0,0,4,0},
		{
			"ChassisCAN1","ZcudChas1Fr12","Out",0x169,8,50,0,0,0,6,1,
			{
				{"isISecDcDcActLoSideIDcDcActLoSide_1",12,27,-1},
				{"isSteerEmergCtrlSwt_1",1,46,45},
				{"isISecDcDcActLoSideCntr_1",4,31,-1},
				{"isISecDcDcActLoSideChks_1",8,23,-1},
				{"isSecBattRemainTimeToEmpty_1",15,7,8},
				{"isCnvnReq_0",3,44,41}
			},
			{
				{"igISecDcDcActLoSide_1","ZcudChas1SignalIPdu12",47}
			}
		},
		{
			"ChassisCAN1","ZcudChas1Fr21","Out",0x171,8,60,0,0,0,5,1,
			{
				{"isSecULoWarnLvPwrErrULoWarn_1",2,41,-1},
				{"isSecULoWarnLvPwrErrLVPwrSplyErrSts_1",4,51,-1},
				{"isSecULoWarnLvPwrErrCntr_1",4,55,-1},
				{"isPVMCSteerAst_0",3,2,15},
				{"isSecULoWarnLvPwrErrChks_1",8,63,-1}
			},
			{
				{"igSecULoWarnLvPwrErr_1","ZcudChas1SignalIPdu21",42}
			}
		},
		{
			"ChassisCAN1","ZcudChas1Fr35","Out",0x266,8,200,0,0,0,8,1,
			{
				{"isTrsmLockMgrReq2Data0",8,7,-1},
				{"isTrsmLockMgrReq2Cmd",2,63,-1},
				{"isTrsmLockMgrReq2Data2",8,23,-1},
				{"isTrsmLockMgrReq2Data1",8,15,-1},
				{"isTrsmLockMgrReq2Data4",8,39,-1},
				{"isTrsmLockMgrReq2Data6",8,55,-1},
				{"isTrsmLockMgrReq2Data3",8,31,-1},
				{"isTrsmLockMgrReq2Data5",8,47,-1}
			},
			{
				{"igTrsmLockMgrReq2","ZcudChas1SignalIPdu35",61}
			}
		},
		{
			"ChassisCAN1","ZcudChas1Fr05","Out",0x241,8,200,0,0,0,8,1,
			{
				{"isTrsmLockMgrReqData6",8,63,-1},
				{"isTrsmLockMgrReqCmd",2,1,-1},
				{"isTrsmLockMgrReqData0",8,15,-1},
				{"isTrsmLockMgrReqData1",8,23,-1},
				{"isTrsmLockMgrReqData5",8,55,-1},
				{"isTrsmLockMgrReqData4",8,47,-1},
				{"isTrsmLockMgrReqData2",8,31,-1},
				{"isTrsmLockMgrReqData3",8,39,-1}
			},
			{
				{"igTrsmLockMgrReq","ZcudChas1SignalIPdu05",2}
			}
		},
		{
			"ChassisCAN1","ZcudChas1Fr26","Out",0x2ae,8,120,0,0,0,1,0,
			{
				{"isDrvModReq_1",5,61,62}
			},
			{
				{"","",-1}
			}
		},
		{
			"ChassisCAN1","ZcudChas1Fr18","Out",0x1b0,8,10,0,0,0,6,1,
			{
				{"isAgDataRawSafeRollRateQf_1",2,43,-1},
				{"isAgDataRawSafeChks_1",8,39,-1},
				{"isAgDataRawSafeYawRate_1",16,23,-1},
				{"isAgDataRawSafeYawRateQf_1",2,41,-1},
				{"isAgDataRawSafeRollRate_1",16,7,-1},
				{"isAgDataRawSafeCntr_1",4,47,-1}
			},
			{
				{"igAgDataRawSafe_1","ZcudChas1SignalIPdu18",55}
			}
		},
		{
			"ChassisCAN1","ZcudChas1Fr28","Out",0x360,8,80,0,0,0,5,1,
			{
				{"isCmptmtAirTEstimdExtdComptmtT_1",11,39,-1},
				{"isCarTiGlb_0",32,7,57},
				{"isProfPenSts1_1",4,63,41},
				{"isCmptmtAirTEstimdExtdQlyFlg_1",2,44,-1},
				{"isSaveSetgToMemPrmnt_1",2,59,56}
			},
			{
				{"igCmptmtAirTEstimdExtd_1","ZcudChas1SignalIPdu28",42}
			}
		},
		{
			"ChassisCAN1","ZcudChas1Fr20","Out",0x10e,8,20,0,0,0,15,3,
			{
				{"isVehDynCtrlStsForALgtCmftVehDynCtrlStsForStandStillMgrForPark_0",3,63,-1},
				{"isLatCtrlReqSafeSteerWhlHptcWarnReq_0",1,25,-1},
				{"isVehDynCtrlStsForALgtCmftVehDynCtrlStsNotEna_0",1,56,-1},
				{"isVehDynCtrlStsForALgtCmftVehDynCtrlStsCntr_0",4,43,-1},
				{"isLatCtrlReqSafeSteerTqReq_0",14,23,-1},
				{"isVehDynCtrlStsForALgtCmftVehDynCtrlStsForWhlBrkWrm_0",1,57,-1},
				{"isFricEstimnFromVehDynFricEstimnFromVehDyn_0",8,39,-1},
				{"isVehDynCtrlStsForALgtCmftVehDynCtrlStsForBrkPrecActv_0",1,58,-1},
				{"isVehDynCtrlStsForALgtCmftVehDynCtrlStsDend_0",1,60,-1},
				{"isLatCtrlReqSafeLatCtrlModReq_0",4,11,-1},
				{"isFricEstimnFromVehDynQly_0",3,47,-1},
				{"isLatCtrlReqSafeCntr_0",4,15,-1},
				{"isVehDynCtrlStsForALgtCmftVehDynCtrlStsForBrkActv_0",1,59,-1},
				{"isVehDynCtrlStsForALgtCmftVehDynCtrlStsChks_0",8,55,-1},
				{"isLatCtrlReqSafeChks_0",8,7,-1}
			},
			{
				{"igLatCtrlReqSafe_0","ZcudChas1SignalIPdu20",24},
				{"igFricEstimnFromVehDyn_0","ZcudChas1SignalIPdu20",-1},
				{"igVehDynCtrlStsForALgtCmft_0","ZcudChas1SignalIPdu20",44}
			}
		},
		{
			"ChassisCAN1","ZcudChas1Fr27","Out",0x1a,8,100,0,0,0,3,1,
			{
				{"isAgDataCmpQualityYawRateCmpQuality_1",8,23,-1},
				{"isAgDataCmpQualityPitchRateCmpQuality_1",8,7,-1},
				{"isAgDataCmpQualityRollRateCmpQuality_1",8,15,-1}
			},
			{
				{"igAgDataCmpQuality_1","ZcudChas1SignalIPdu27",43}
			}
		},
		{
			"ChassisCAN1","ZcudChas1Fr30","Out",0x1f0,8,30,0,0,0,6,1,
			{
				{"isStandStillMgrStsForHldChks_0",8,39,-1},
				{"isStandStillMgrStsForHld1_0",3,30,-1},
				{"isDrvModReqForChampnMod_1",3,18,52},
				{"isRlyPwrDistbnCmd1WdIgnRlyCmd_1",1,55,54},
				{"isBkpOfDstTrvld_1",21,7,53},
				{"isStandStillMgrStsForHldCntr_0",4,27,-1}
			},
			{
				{"igStandStillMgrStsForHld_0","ZcudChas1SignalIPdu30",31}
			}
		},
		{"ChassisCAN1","ZcudToRasmChas1DiagReqFrame","Out",0x771,8,0,0,4,0},
		{
			"ChassisCAN1","ZcudChas1Fr33","Out",0x290,8,80,0,0,0,8,1,
			{
				{"isSteerLockReqSteerLockDataReq2_0",8,31,-1},
				{"isSteerLockReqSteerLockDataReq1_0",8,23,-1},
				{"isSteerLockReqCommand_0",2,1,-1},
				{"isSteerLockReqSteerLockDataReq6_0",8,63,-1},
				{"isSteerLockReqSteerLockDataReq4_0",8,47,-1},
				{"isSteerLockReqSteerLockDataReq5_0",8,55,-1},
				{"isSteerLockReqSteerLockDataReq3_0",8,39,-1},
				{"isSteerLockReqSteerLockDataReq0_0",8,15,-1}
			},
			{
				{"igSteerLockReq_0","ZcudChas1SignalIPdu33",2}
			}
		},
		{
			"ChassisCAN1","ZCUDChas1VFCVectorFr","Out",0x546,8,1000,0,0,0,63,1,
			{
				{"isVFCVectorZCUDMVFCid53_1",1,55,-1},
				{"isVFCVectorZCUDMVFCid12_1",1,14,-1},
				{"isVFCVectorZCUDMVFCid25_1",1,27,-1},
				{"isVFCVectorZCUDMVFCid7_1",1,9,-1},
				{"isVFCVectorZCUDMVFCid0_1",1,2,-1},
				{"isVFCVectorZCUDMVFCid11_1",1,13,-1},
				{"isVFCVectorZCUDMVFCid57_1",1,59,-1},
				{"isVFCVectorZCUDMVFCid5_1",1,7,-1},
				{"isVFCVectorZCUDMVFCid46_1",1,48,-1},
				{"isVFCVectorZCUDMVFCid21_1",1,23,-1},
				{"isVFCVectorZCUDMVFCid3_1",1,5,-1},
				{"isVFCVectorZCUDMVFCid61_1",1,63,-1},
				{"isVFCVectorZCUDMVFCid41_1",1,43,-1},
				{"isVFCVectorZCUDMVFCid35_1",1,37,-1},
				{"isVFCVectorZCUDMVFCid16_1",1,18,-1},
				{"isVFCVectorZCUDMVFCid19_1",1,21,-1},
				{"isVFCVectorZCUDMVFCid23_1",1,25,-1},
				{"isVFCVectorZCUDMVFCid31_1",1,33,-1},
				{"isVFCVectorZCUDMVFCid32_1",1,34,-1},
				{"isVFCVectorZCUDMVFCid47_1",1,49,-1},
				{"isVFCVectorZCUDMVFCid1_1",1,3,-1},
				{"isVFCVectorZCUDMVFCid29_1",1,31,-1},
				{"isVFCVectorZCUDMVFCid59_1",1,61,-1},
				{"isVFCVectorZCUDMVFCid4_1",1,6,-1},
				{"isVFCVectorZCUDMVFCid15_1",1,17,-1},
				{"isVFCVectorZCUDMVFCid55_1",1,57,-1},
				{"isVFCVectorZCUDMVFCid24_1",1,26,-1},
				{"isVFCVectorZCUDMVFCid6_1",1,8,-1},
				{"isVFCVectorZCUDMVFCid18_1",1,20,-1},
				{"isVFCVectorZCUDMVFCid9_1",1,11,-1},
				{"isVFCVectorZCUDMVFCid49_1",1,51,-1},
				{"isVFCVectorZCUDMVFCid52_1",1,54,-1},
				{"isVFCVectorZCUDMVFCid58_1",1,60,-1},
				{"isVFCVectorZCUDMVFCid43_1",1,45,-1},
				{"isVFCVectorZCUDMVFCid60_1",1,62,-1},
				{"isVFCVectorZCUDMVFCid8_1",1,10,-1},
				{"isVFCVectorZCUDMVFCid40_1",1,42,-1},
				{"isVFCVectorZCUDMVFCid38_1",1,40,-1},
				{"isVFCVectorZCUDMVFCid50_1",1,52,-1},
				{"isVFCVectorZCUDMVFCid20_1",1,22,-1},
				{"isVFCVectorZCUDMVFCid44_1",1,46,-1},
				{"isVFCVectorZCUDMVFCid30_1",1,32,-1},
				{"isVFCVectorZCUDMVFCid56_1",1,58,-1},
				{"isVFCVectorZCUDMVFCid42_1",1,44,-1},
				{"isVFCVectorZCUDMBlockID_1",2,1,-1},
				{"isVFCVectorZCUDMVFCid27_1",1,29,-1},
				{"isVFCVectorZCUDMVFCid17_1",1,19,-1},
				{"isVFCVectorZCUDMVFCid45_1",1,47,-1},
				{"isVFCVectorZCUDMVFCid54_1",1,56,-1},
				{"isVFCVectorZCUDMVFCid10_1",1,12,-1},
				{"isVFCVectorZCUDMVFCid37_1",1,39,-1},
				{"isVFCVectorZCUDMVFCid14_1",1,16,-1},
				{"isVFCVectorZCUDMVFCid39_1",1,41,-1},
				{"isVFCVectorZCUDMVFCid22_1",1,24,-1},
				{"isVFCVectorZCUDMVFCid51_1",1,53,-1},
				{"isVFCVectorZCUDMVFCid26_1",1,28,-1},
				{"isVFCVectorZCUDMVFCid33_1",1,35,-1},
				{"isVFCVectorZCUDMVFCid28_1",1,30,-1},
				{"isVFCVectorZCUDMVFCid2_1",1,4,-1},
				{"isVFCVectorZCUDMVFCid48_1",1,50,-1},
				{"isVFCVectorZCUDMVFCid36_1",1,38,-1},
				{"isVFCVectorZCUDMVFCid13_1",1,15,-1},
				{"isVFCVectorZCUDMVFCid34_1",1,36,-1}
			},
			{
				{"igVFCVectorZCUDM_1","ZCUDChas1VFCVectorSignalIPdu",-1}
			}
		},
		{
			"ChassisCAN1","ZcudChas1Fr19","Out",0x2e0,8,70,0,0,0,10,1,
			{
				{"isVehModMngtGlbSafe1CarModSts1_3",3,39,-1},
				{"isVehModMngtGlbSafe1FltEgyCnsWdSts_3",1,33,-1},
				{"isVehModMngtGlbSafe1PwrLvlElecMai_3",4,19,-1},
				{"isVehModMngtGlbSafe1EgyLvlElecSubtyp_3",4,23,-1},
				{"isVehModMngtGlbSafe1EgyLvlElecMai_3",4,27,-1},
				{"isVehModMngtGlbSafe1UsgModSts_3",4,11,-1},
				{"isVehModMngtGlbSafe1Chks_3",8,7,-1},
				{"isVehModMngtGlbSafe1Cntr_3",4,15,-1},
				{"isVehModMngtGlbSafe1PwrLvlElecSubtyp_3",4,31,-1},
				{"isVehModMngtGlbSafe1CarModSubtypWdCarModSubtyp_3",3,36,-1}
			},
			{
				{"igVehModMngtGlbSafe1_3","ZcudChas1SignalIPdu19",32}
			}
		},
		{"ChassisCAN1","ZcudToAllFuncChas1DiagReqFrame","Out",0x7ff,8,0,0,4,0},
		{"ChassisCAN1","ZcudChas1Fr10","Out",0x2f,8,0,0,1,0},
		{"ChassisCAN1","RasmChas1Fr01","In",0x45,8,0,0,0,0},
		{"ChassisCAN1","PscmChas1Fr02","In",0x46,8,0,0,0,0},
		{"ChassisCAN1","PscmToZcudChas1DiagResFrame","In",0x670,8,0,0,4,0},
		{"ChassisCAN1","PscmChas1Fr03","In",0x1bc,8,0,0,0,0},
		{"ChassisCAN1","XcmXcuChas1Fr01","In",0x76,8,0,0,0,0},
		{"ChassisCAN1","Ecm1Chas1Fr01","In",0x133,8,0,0,0,0},
		{"ChassisCAN1","AsdmChas1Fr06","In",0x131,8,0,0,0,0},
		{"ChassisCAN1","RwasChas1Fr03","In",0x18e,8,0,0,0,0},
		{"ChassisCAN1","BcmChas1Fr02","In",0xb9,8,0,0,0,0},
		{"ChassisCAN1","RbcmChas1Fr02","In",0xfd,8,0,0,0,0},
		{"ChassisCAN1","Tcm1Chas1Fr08","In",0x1e0,8,0,0,0,0},
		{"ChassisCAN1","AsdmChas1Fr29","In",0xf5,8,0,0,0,0},
		{"ChassisCAN1","XcmXcuChas1Fr04","In",0x5b,8,0,0,0,0},
		{"ChassisCAN1","Tcm1Chas1Fr07","In",0x80,8,0,0,0,0},
		{"ChassisCAN1","AsdmChas1Fr01","In",0x93,8,0,0,0,0},
		{"ChassisCAN1","PscmChas1Fr06","In",0x3bb,8,0,0,0,0},
		{"ChassisCAN1","AsdmChas1Fr07","In",0x117,8,0,0,0,0},
		{"ChassisCAN1","RasmChas1Fr02","In",0x61,8,0,0,0,0},
		{"ChassisCAN1","RwasChas1Fr02","In",0x15c,8,0,0,0,0},
		{"ChassisCAN1","EcmChas1Fr08","In",0x108,8,0,0,0,0},
		{"ChassisCAN1","AsdmChas1Fr10","In",0x54,8,0,0,0,0},
		{"ChassisCAN1","CstmChas1Fr02","In",0x187,8,0,0,0,0},
		{"ChassisCAN1","CstmChas1VFCVectorFr","In",0x567,8,0,0,0,0},
		{"ChassisCAN1","PasChas1Fr02","In",0xeb,8,0,0,0,0},
		{"ChassisCAN1","CstmChas1Fr03","In",0x2e6,8,0,0,0,0},
		{"ChassisCAN1","AsdmChas1NMFr","In",0x529,8,0,0,3,0},
		{"ChassisCAN1","Tcm1Tcm8Chas1Fr02","In",0x154,8,0,0,0,0},
		{"ChassisCAN1","EcmChas1Fr09","In",0x129,8,0,0,0,0},
		{"ChassisCAN1","Tcm1Chas1Fr09","In",0x24a,8,0,0,0,0},
		{"ChassisCAN1","RwasChas1Fr01","In",0x13b,8,0,0,0,0},
		{"ChassisCAN1","Bcm11Chas1Fr01","In",0xff,8,0,0,0,0},
		{"ChassisCAN1","SasChas1Fr01","In",0x40,8,0,0,0,0},
		{"ChassisCAN1","SclChas1Fr01","In",0x260,8,0,0,0,0},
		{"ChassisCAN1","Tcm1Chas1Fr01","In",0x13a,8,0,0,0,0},
		{"ChassisCAN1","RwasToZcudChas1DiagResFrame","In",0x67e,8,0,0,4,0},
		{"ChassisCAN1","Ecm1Chas1Fr02","In",0x138,8,0,0,0,0},
		{"ChassisCAN1","EcmChas1Fr07","In",0x2f0,8,0,0,0,0},
		{"ChassisCAN1","Tcm1Chas1Fr03","In",0x15a,8,0,0,0,0},
		{"ChassisCAN1","EcmChas1Fr06","In",0x1c7,8,0,0,0,0},
		{"ChassisCAN1","CstmChas1Fr01","In",0x2e5,8,0,0,0,0},
		{"ChassisCAN1","BcmChas1Fr11","In",0x14b,8,0,0,0,0},
		{"ChassisCAN1","Scl2ToZcudChas1DiagResFrame","In",0x615,8,0,0,4,0},
		{"ChassisCAN1","RbcmChas1Fr01","In",0x7d,8,0,0,0,0},
		{"ChassisCAN1","AsdmChas1Fr23","In",0x2a5,8,0,0,0,0},
		{"ChassisCAN1","SclChas1Fr02","In",0x2a0,8,0,0,0,0},
		{"ChassisCAN1","RwasChas1Fr04","In",0x177,8,0,0,0,0},
		{"ChassisCAN1","Tcm1Chas1Fr02","In",0x30,8,0,0,0,0},
		{"ChassisCAN1","Bcm11Chas1Fr02","In",0x7e,8,0,0,0,0},
		{"ChassisCAN1","PscmChas1Fr01","In",0xf6,8,0,0,0,0},
		{"ChassisCAN1","Tcm2Chas1Fr01","In",0x25e,8,0,0,0,0},
		{"ChassisCAN1","EcmChas1Fr03","In",0x220,8,0,0,0,0},
		{"ChassisCAN1","RasmToVddmChas1DiagResFrame","In",0x671,8,0,0,4,0},
		{"ChassisCAN1","XcmXcuChas1Fr02","In",0x161,8,0,0,0,0},
		{"ChassisCAN1","BcmChas1Fr03","In",0x2e,8,0,0,0,0},
		{"ChassisCAN1","SasToZcudChas1DiagResFrame","In",0x672,8,0,0,4,0},
		{"ChassisCAN1","PscmChas1Fr07","In",0x4e,8,0,0,0,0},
		{"ZCU_CANFD1","ZcudAwmToDhuZCUCANFD1DiagResFr","Out",0x625,64,0,1,4,0},
		{"ZCU_CANFD1","ZcudFmdmToDhuZCUCANFD1DiagResFr","Out",0x662,64,0,1,4,0},
		{"ZCU_CANFD1","ZcudSasToDhuZCUCANFD1DiagResFr","Out",0x672,64,0,1,4,0},
		{"ZCU_CANFD1","ZcudHcml2ToDhuZCUCANFD1DiagResFr","Out",0x62a,64,0,1,4,0},
		{
			"ZCU_CANFD1","ZcudZCUCANFD1Fr07","Out",0x1f1,64,40,1,0,0,107,15,
			{
				{"isEngTQf_1",2,63,-1},
				{"isWipgInfoWipgSpdInfo_1",3,239,-1},
				{"isVehMNomVehM_1",14,351,-1},
				{"isKeyReadStsToAsmKey7",2,45,-1},
				{"isExtrLtgStsFrntFog_0",2,89,-1},
				{"isExtrLtgStsDRL_0",2,93,-1},
				{"isVehTiAndDataDataValid_2",1,302,-1},
				{"isTurnIndcrMonostableChks_1",8,207,-1},
				{"isVehTiAndDataMins1_2",6,264,-1},
				{"isSwtIndcrIndcrTypExtReqCntr_1",2,181,-1},
				{"isExtrLtgStsHWL_0",2,97,-1},
				{"isTankFlapSts_1",2,18,16},
				{"isWipgInfoWiprInWipgAr_1",1,235,-1},
				{"isRcwmLiActvd",1,59,58},
				{"isExtrLtgStsAFS_0",2,71,-1},
				{"isTurnIndcrSwtIndcrTypExtReqToUpdQf_1",2,467,-1},
				{"isLockgCenStsTrigSrc_4",4,159,-1},
				{"isExtrLtgStsTurnIndrLe_0",2,113,-1},
				{"isWipgInfoWiprActv_1",1,236,-1},
				{"isExtrLtgStsHomeSafe_0",2,99,-1},
				{"isPtTqAtWhlReActPtTqAtWhlsReQly_1",3,443,-1},
				{"isExtrLtgStsCntr_0",4,77,-1},
				{"isTurnIndcrSwtIndcrTypExtReqCntr_1",2,469,-1},
				{"isSuspPosnVertLe1Re_1",15,317,-1},
				{"isExtrLtgStsAHL_0",2,67,-1},
				{"isTurnIndcrSwtIndcrTypExtReqChks_1",8,463,-1},
				{"isExtrLtgStsDBL_0",2,95,-1},
				{"isSuspPosnVertLe1FrntQf_1",2,342,-1},
				{"isSwtFogLiRe_1",1,121,120},
				{"isSuspPosnVertLe1Frnt_1",15,300,-1},
				{"isVehTiAndDataDay_2",5,284,-1},
				{"isKeyReadStsToAsmKey3",2,37,-1},
				{"isPtTqAtWhlReActCntr_1",4,447,-1},
				{"isKeyReadStsToAsmKey8",2,43,-1},
				{"isHoodSts_1",2,130,128},
				{"isTwliBriRawQf_1",2,223,-1},
				{"isActvnOfWelcomeLi_2",1,22,21},
				{"isSwtIndcrIndcrTypExtReq_1",2,183,-1},
				{"isVehTiAndDataYr1_2",7,271,-1},
				{"isActvReSplrIceBreakFaild_1",1,455,454},
				{"isTrLockSts",2,1,2},
				{"isExtrLtgStsChks_0",8,87,-1},
				{"isExtrLtgStsApproach_0",2,79,-1},
				{"isExtrLtgStsLtgShow_0",2,109,-1},
				{"isWinPosnStsAtDrvr_0",5,167,177},
				{"isAD4HeatingCircTestSts_1",2,7,3},
				{"isTurnIndcrMonostableCntr_1",2,215,-1},
				{"isSwtIndcrIndcrTypExtReqToUpdQf_1",2,179,-1},
				{"isSuspPosnVertLe1ReQf_1",2,340,-1},
				{"isExtrLtgStsPosLiRe_0",2,105,-1},
				{"isPtTqAtWhlReActPtTqAtAxleReAct_1",16,391,-1},
				{"isExtrLtgStsStopLi_0",2,115,-1},
				{"isExtrLtgStsLoBeam_0",2,111,-1},
				{"isGVMCVehCtrlrStsCtrlrSts_0",8,373,-1},
				{"isKeyReadStsToAsmKey6",2,47,-1},
				{"isExtrLtgStsReFog_0",2,119,-1},
				{"isKeyReadStsToAsmKey10",2,27,-1},
				{"isVehTiAndDataHr1_2",5,295,-1},
				{"isChrgLidDCorAcDcSts_1",2,9,23},
				{"isGVMCVehCtrlrStsChks_0",8,365,-1},
				{"isExtrLtgStsHiBeam_0",2,101,-1},
				{"isExtrLtgStsGoodbye_0",2,103,-1},
				{"isTurnIndcrMonostableQf_1",2,213,-1},
				{"isSwtIndcrIndcrTypExtReqChks_1",8,175,-1},
				{"isPtTqAtWhlReActChks_1",8,439,-1},
				{"isKeyReadStsToAsmKey0",2,31,-1},
				{"isActvReSplrMotBlk_1",1,453,452},
				{"isKeyReadStsToAsmKey2",2,39,-1},
				{"isSteerWhlPosnX",12,251,-1},
				{"isKeyReadStsToAsmKey5",2,33,-1},
				{"isSuspPosnVertLe1Chks_1",8,334,-1},
				{"isExtrLtgStsCornrgLi_0",2,73,-1},
				{"isKeyReadStsToAsmKey4",2,35,-1},
				{"isExtrLtgStsWelcome_0",2,125,-1},
				{"isPtTqAtWhlReActPtTqAtWhlReLeAct_1",16,407,-1},
				{"isExtrLtgStsPosLiFrnt_0",2,107,-1},
				{"isActvReSplrPosn_1",3,451,448},
				{"isTurnIndcrMonostableTurnIndcrMonostable_1",3,211,-1},
				{"isExtrLtgStsTurnIndrRi_0",2,127,-1},
				{"isVehTiAndDataMth1_2",4,290,-1},
				{"isActvnStsOfRtrctrRvsbRi_1",1,135,134},
				{"isVehParkNotActvd",1,5,4},
				{"isSwtFogLiFr_1",1,123,122},
				{"isTrSts_2",2,133,131},
				{"isExtrLtgStsAllWL_0",2,65,-1},
				{"isAdjSpdLimnFusnTrfcSgn_1",1,57,56},
				{"isActvnStsOfRtrctrRvsbLe_1",1,20,19},
				{"isVehMNomTrlrM_1",2,353,-1},
				{"isVehTiAndDataSec1_2",6,274,-1},
				{"isExtrLtgStsFlash_0",2,91,-1},
				{"isGVMCVehCtrlrStsCntr_0",4,381,-1},
				{"isVehMNomVehMQly_1",2,367,-1},
				{"isRainfallAmnt_3",4,15,11},
				{"isKeyReadStsToAsmKey1",2,29,-1},
				{"isBodyHei",15,143,144},
				{"isExtrLtgStsReverseLi_0",2,117,-1},
				{"isTwliBriRawTwliBriRaw_1",14,221,-1},
				{"isLockgCenStsUpdEve_4",1,153,-1},
				{"isKeyReadStsToAsmKey9",2,41,-1},
				{"isLockgCenStsLockSt_4",2,155,-1},
				{"isTurnIndcrSwtIndcrTypExtReq_1",2,471,-1},
				{"isSteerWhlPosnAng",12,247,-1},
				{"isWinPosnStsAtReLe_0",5,191,186},
				{"isEngTEngT_1",8,55,-1},
				{"isKeyReadStsToAsmKey11",2,25,-1},
				{"isPtTqAtWhlReActPtTqAtWhlReRiAct_1",16,423,-1},
				{"isExtrLtgStsAHBC_0",2,69,-1}
			},
			{
				{"igSuspPosnVertLe1_1","ZcudZCUCANFD1SignalIPdu07",338},
				{"igVehTiAndData_2","ZcudZCUCANFD1SignalIPdu07",301},
				{"igPtTqAtWhlReAct_1","ZcudZCUCANFD1SignalIPdu07",440},
				{"igEngT_1","ZcudZCUCANFD1SignalIPdu07",61},
				{"igVehMNom_1","ZcudZCUCANFD1SignalIPdu07",337},
				{"igTurnIndcrSwt_1","ZcudZCUCANFD1SignalIPdu07",465},
				{"igSteerWhlPosn","ZcudZCUCANFD1SignalIPdu07",232},
				{"igTwliBriRaw_1","ZcudZCUCANFD1SignalIPdu07",233},
				{"igSwtIndcr_1","ZcudZCUCANFD1SignalIPdu07",176},
				{"igLockgCenSts_4","ZcudZCUCANFD1SignalIPdu07",152},
				{"igWipgInfo_1","ZcudZCUCANFD1SignalIPdu07",234},
				{"igTurnIndcrMonostable_1","ZcudZCUCANFD1SignalIPdu07",208},
				{"igGVMCVehCtrlrSts_0","ZcudZCUCANFD1SignalIPdu07",336},
				{"igExtrLtgSts_0","ZcudZCUCANFD1SignalIPdu07",60},
				{"igKeyReadStsToAsm","ZcudZCUCANFD1SignalIPdu07",10}
			}
		},
		{"ZCU_CANFD1","ZcudTcsToDhuZCUCANFD1DiagResFr","Out",0x669,64,0,1,4,0},
		{"ZCU_CANFD1","ZcudFdmlToDhuZCUCANFD1DiagResFr","Out",0x664,64,0,1,4,0},
		{"ZCU_CANFD1","ZcudPosmToDhuZCUCANFD1DiagResFr","Out",0x667,64,0,1,4,0},
		{"ZCU_CANFD1","ZcudRasmToDhuZCUCANFD1DiagResFr","Out",0x671,64,0,1,4,0},
		{"ZCU_CANFD1","ZcudSrmToDhuZCUCANFD1DiagResFr","Out",0x624,64,0,1,4,0},
		{
			"ZCU_CANFD1","ZcudZCUCANFD1Fr04","Out",0x81,64,10,1,0,0,65,11,
			{
				{"isGVMCYawTqReqTqReq",16,255,-1},
				{"isBMXSSysStsBMXSBlowoutRiReQf_1",2,114,-1},
				{"isALgtCtrlStsToBrkCntr",4,11,-1},
				{"isVDSWVehCtrlStsChks",8,231,-1},
				{"isGVMCVehDecelReqCntr",4,223,-1},
				{"isBMXSSysStsCntr_1",4,111,-1},
				{"isPinionSteerAgGroupR1SteerWhlTqQf_1",2,92,-1},
				{"isGVMCYawTqReqChks",8,247,-1},
				{"isPVMCVehCtrlSts3VehRollStabyFctSts_1",3,328,-1},
				{"isRecOfPostImpctBrkgSuspcCntr_1",4,199,-1},
				{"isPVMCVehCtrlSts1SideWindPreFctSts_1",3,311,-1},
				{"isALgtCtrlStsToBrkChks",8,7,-1},
				{"isVDSWVehCtrlStsPilotFctSts",3,239,-1},
				{"isBMXSSysStsChks_1",8,103,-1},
				{"isPVMCVehCtrlSts1PwrAssiDriftModFctSts_1",3,301,-1},
				{"isPVMCVehCtrlSts1E2EFctSts_1",3,294,-1},
				{"isPVMCVehCtrlSts3GetOutOfStuckFctSts_1",3,324,-1},
				{"isBMXSSysStsBMXSBlowoutLeREQf_1",2,118,-1},
				{"isPVMCVehCtrlSts1ManDriftModFctSts_1",3,291,-1},
				{"isPVMCVehCtrlSts1OffTrackInhbnInAFctSts_1",3,288,-1},
				{"isPinionSteerAgGroupR1PinionSteerAg1_1",15,39,-1},
				{"isPVMCVehCtrlSts1BMxSFctSts_1",3,284,-1},
				{"isPVMCVehCtrlSts1AEBFctSts_1",3,287,-1},
				{"isGVMCVehDecelReqDecelReq",8,215,-1},
				{"isPinionSteerAgGroupR1Cntr_1",4,84,-1},
				{"isSuspPosnVertRi1SuspPosnVertRiChks_1",8,157,-1},
				{"isIsgSpdActSgn_1",16,175,160},
				{"isRecOfPostImpctBrkgSuspcSuspcPostImpctBrkg_1",2,195,-1},
				{"isPVMCVehCtrlSts1TrackModFctSts_1",3,315,-1},
				{"isPVMCVehCtrlSts1SideWindStabyFctSts_1",3,308,-1},
				{"isPVMCVehCtrlSts1SplitMueFctSts_1",3,305,-1},
				{"isBMXSSysStsBMXSBlowoutLeFrnt_1",1,112,-1},
				{"isSuspPosnVertRi1SuspPosnVertRiRe_1",15,140,-1},
				{"isPinionSteerAgGroupR1PinionSteerAgSpd1Qf_1",2,94,-1},
				{"isBMXSSysStsBMXSBlowoutLeFrntQf_1",2,104,-1},
				{"isPVMCVehCtrlSts3TVCPrpsnDistbnFrntReFctSts_1",3,331,-1},
				{"isPinionSteerAgGroupR1PinionSteerAgSpd1_1",14,40,-1},
				{"isPinionSteerAgGroupR1Chks_1",8,76,-1},
				{"isPVMCVehCtrlSts3OffRoadCrsCtrlFctSts_1",3,321,-1},
				{"isGVMCYawTqReqCntr",4,271,-1},
				{"isPVMCVehCtrlSts1Cntr_1",4,267,-1},
				{"isAsyALgtCtrlModCfmdCntr",4,27,-1},
				{"isRecOfPostImpctBrkgSuspcChks_1",8,191,-1},
				{"isPinionSteerAgGroupR1PinionSteerAg1Qf_1",2,80,-1},
				{"isVDSWVehCtrlStsCntr",4,219,-1},
				{"isPVMCVehCtrlSts1CoreFctSts_1",3,281,-1},
				{"isVDSWVehCtrlStsPrkgFctSts",3,236,-1},
				{"isBMXSSysStsBMXSBlowoutRiRe_1",1,125,-1},
				{"isPVMCVehCtrlSts1RWSAgActrSts_1",3,298,-1},
				{"isGVMCVehDecelReqChks",8,207,-1},
				{"isBMXSSysStsBMXSBlowoutRiFrntQf_1",2,116,-1},
				{"isPVMCVehCtrlSts3EarlyWarnAndDynCtrlFctSts_1",3,327,-1},
				{"isBMXSSysStsBMXSBlowoutLeRE_1",1,127,-1},
				{"isPVMCVehCtrlSts1SteerAssiDriftModFctSts_1",3,318,-1},
				{"isPinionSteerAgGroupR1SteerWhlTq_1",14,58,-1},
				{"isPVMCVehCtrlSts1Chks_1",8,279,-1},
				{"isPVMCVehCtrlSts3RoadTypAndFricDetnFctSts_1",3,334,-1},
				{"isALgtCtrlStsToBrkALgtCtrlStsToBrk",4,15,-1},
				{"isAsyALgtCtrlModCfmdAsyALgtCtrlMod1",4,31,-1},
				{"isSuspPosnVertRi1SuspPosnVertRiReQf_1",2,163,-1},
				{"isBMXSSysStsBMXSSts_1",3,107,-1},
				{"isSuspPosnVertRi1SuspPosnVertRiFrntQf_1",2,165,-1},
				{"isBMXSSysStsBMXSBlowoutRiFrnt_1",1,126,-1},
				{"isSuspPosnVertRi1SuspPosnVertRiFrnt_1",15,123,-1},
				{"isAsyALgtCtrlModCfmdChks",8,23,-1}
			},
			{
				{"igBMXSSysSts_1","ZcudZCUCANFD1SignalIPdu04",124},
				{"igAsyALgtCtrlModCfmd","ZcudZCUCANFD1SignalIPdu04",89},
				{"igGVMCVehDecelReq","ZcudZCUCANFD1SignalIPdu04",192},
				{"igVDSWVehCtrlSts","ZcudZCUCANFD1SignalIPdu04",233},
				{"igSuspPosnVertRi1_1","ZcudZCUCANFD1SignalIPdu04",161},
				{"igPVMCVehCtrlSts3_1","ZcudZCUCANFD1SignalIPdu04",341},
				{"igGVMCYawTqReq","ZcudZCUCANFD1SignalIPdu04",232},
				{"igRecOfPostImpctBrkgSuspc_1","ZcudZCUCANFD1SignalIPdu04",193},
				{"igPinionSteerAgGroupR1_1","ZcudZCUCANFD1SignalIPdu04",90},
				{"igPVMCVehCtrlSts1_1","ZcudZCUCANFD1SignalIPdu04",312},
				{"igALgtCtrlStsToBrk","ZcudZCUCANFD1SignalIPdu04",88}
			}
		},
		{"ZCU_CANFD1","ZcudBmsToDhuZCUCANFD1DiagResFr","Out",0x661,64,0,1,4,0},
		{"ZCU_CANFD1","ZcudScl2ToDhuZCUCANFD1DiagResFr","Out",0x615,64,0,1,4,0},
		{"ZCU_CANFD1","ZcudRwasToDhuZCUCANFD1DiagResFr","Out",0x67e,64,0,1,4,0},
		{
			"ZCU_CANFD1","ZcudZCUCANFD1Fr05","Out",0x221,64,100,1,0,0,29,7,
			{
				{"isAlrmStsAlrmFailr",1,135,-1},
				{"isAlrmStsSnsrIntrScanrFailr",1,133,-1},
				{"isHvBattTMax_1",13,162,-1},
				{"isMsgReqForRtrctrRvsbRi_1",1,73,87},
				{"isKeyDistncStsKey1",10,23,-1},
				{"isKeyDistncStsKey4",10,49,-1},
				{"isKeyDistncStsKey2",10,25,-1},
				{"isOtaModVMMRsp",2,199,197},
				{"isHvBattTMin_1",13,181,-1},
				{"isAMBStsQF_1",2,127,-1},
				{"isAMBStsFWLiIllmn_1",12,107,-1},
				{"isAMBStsAMBLiIllmn_1",12,103,-1},
				{"isKeyDistncStsKey5",10,71,-1},
				{"isLeFrntTireBlowoutMsgLvl",3,143,-1},
				{"isTDcDcCoolt_1",8,95,80},
				{"isAlrmStsAlrmTrgSrc",4,125,-1},
				{"isAlrmStsAlrmSt",2,121,-1},
				{"isKeyDistncStsKey0",10,1,-1},
				{"isLeFrntTireBlowoutMsgSts",3,140,-1},
				{"isMsgReqForRtrctrRvsbLe_1",1,74,72},
				{"isLeReTireBlowoutMsgSts",3,148,-1},
				{"isAlrmStsSnsrInclnFailr",1,134,-1},
				{"isLeReTireBlowoutMsgLvl",3,151,-1},
				{"isKeyDistncStsKey3",10,47,-1},
				{"isBltLockStAtPassBltLockSts_2",1,3,-1},
				{"isSeatOccptAtRowSecDrSide2_0",2,86,84},
				{"isBltLockStAtPassBltLockSt1_2",1,4,-1},
				{"isHvBattTAvg_1",13,159,-1},
				{"isTwliBriSts_3",1,76,75}
			},
			{
				{"igAMBSts_1","ZcudZCUCANFD1SignalIPdu05",5},
				{"igLeReTireBlowoutMsg","ZcudZCUCANFD1SignalIPdu05",145},
				{"igAlrmSts","ZcudZCUCANFD1SignalIPdu05",132},
				{"igHvBattT_1","ZcudZCUCANFD1SignalIPdu05",184},
				{"igBltLockStAtPass_2","ZcudZCUCANFD1SignalIPdu05",2},
				{"igLeFrntTireBlowoutMsg","ZcudZCUCANFD1SignalIPdu05",137},
				{"igKeyDistncSts","ZcudZCUCANFD1SignalIPdu05",77}
			}
		},
		{"ZCU_CANFD1","ZcudXcuToDhuZCUCANFD1DiagResFr","Out",0x612,64,0,1,4,0},
		{"ZCU_CANFD1","ZcudZCUDCANFD1NMFr","Out",0x503,8,0,1,3,0},
		{"ZCU_CANFD1","ZcudEcmToDhuZCUCANFD1DiagResFr","Out",0x610,64,0,1,4,0},
		{"ZCU_CANFD1","ZcudZCUDCANFD1SycnReqFr","Out",0x161,1,0,1,1,0},
		{"ZCU_CANFD1","ZcudZCUCANFD1ResdFr02","Out",0x139,64,0,1,1,0},
		{"ZCU_CANFD1","ZcudRbcmToDhuZCUCANFD1DiagResFr","Out",0x613,64,0,1,4,0},
		{
			"ZCU_CANFD1","ZcudZCUCANFD1Fr09","Out",0x3a3,64,400,1,0,0,5,1,
			{
				{"isPassAirbSts_1",1,7,6},
				{"isVehBattUSysUQf_3",2,1,-1},
				{"isVehBattUSysU_3",8,15,-1},
				{"isEngTiOn_1",16,39,5},
				{"isDispHvBattLvlOfChrg_1",10,55,61}
			},
			{
				{"igVehBattU_3","ZcudZCUCANFD1SignalIPdu09",59}
			}
		},
		{
			"ZCU_CANFD1","ZcudZCUCANFD1ResdFr03","Out",0x1c8,64,40,1,0,0,36,9,
			{
				{"isVDCUChassisResdSig4SafetyChks_1",8,247,-1},
				{"isVDCUChassisResdSig4SafetyCntr_1",4,255,-1},
				{"isVDCUChassisResdSig3SafetyCntr_1",4,223,-1},
				{"isVDCUChassisCANFD2ResdSig3SafetyChks_1",8,87,-1},
				{"isVDCUChassisCANFD2ResdSig4SafetyUInt16_1",16,103,-1},
				{"isVDCUChassisCANFD2ResdSig3SafetyUInt4_1",4,91,-1},
				{"isVDCUChassisCANFD2ResdSig4SafetyCntr_1",4,127,-1},
				{"isVDCUChassisCANFD2ResdSig4SafetyChks_1",8,119,-1},
				{"isVDCUChassisResdSig4SafetyUInt4_1",4,251,-1},
				{"isVDCUChassisResdSig3SafetyUInt16_1",16,199,-1},
				{"isVDCUChassisResdSig2SafetyChks_1",8,183,-1},
				{"isVDCUChassisResdSig5SafetyUInt16_1",16,263,-1},
				{"isVDCUChassisCANFD2ResdSig2SafetyUInt4_1",4,59,-1},
				{"isVDCUChassisResdSig1SafetyCntr_1",4,159,-1},
				{"isVDCUChassisResdSig3SafetyUInt4_1",4,219,-1},
				{"isVDCUChassisResdSig2SafetyUInt16_1",16,167,-1},
				{"isVDCUChassisCANFD2ResdSig2SafetyCntr_1",4,63,-1},
				{"isVDCUChassisResdSig5SafetyCntr_1",4,287,-1},
				{"isVDCUChassisResdSig2SafetyUInt4_1",4,187,-1},
				{"isVDCUChassisResdSig3SafetyChks_1",8,215,-1},
				{"isVDCUChassisCANFD2ResdSig1SafetyUInt4_1",4,27,-1},
				{"isVDCUChassisCANFD2ResdSig2SafetyChks_1",8,55,-1},
				{"isVDCUChassisCANFD2ResdSig2SafetyUInt16_1",16,39,-1},
				{"isVDCUChassisResdSig2SafetyCntr_1",4,191,-1},
				{"isVDCUChassisResdSig1SafetyUInt4_1",4,155,-1},
				{"isVDCUChassisResdSig5SafetyUInt4_1",4,283,-1},
				{"isVDCUChassisResdSig5SafetyChks_1",8,279,-1},
				{"isVDCUChassisCANFD2ResdSig4SafetyUInt4_1",4,123,-1},
				{"isVDCUChassisResdSig4SafetyUInt16_1",16,231,-1},
				{"isVDCUChassisCANFD2ResdSig1SafetyUInt16_1",16,7,-1},
				{"isVDCUChassisResdSig1SafetyChks_1",8,151,-1},
				{"isVDCUChassisCANFD2ResdSig3SafetyCntr_1",4,95,-1},
				{"isVDCUChassisResdSig1SafetyUInt16_1",16,135,-1},
				{"isVDCUChassisCANFD2ResdSig1SafetyCntr_1",4,31,-1},
				{"isVDCUChassisCANFD2ResdSig3SafetyUInt16_1",16,71,-1},
				{"isVDCUChassisCANFD2ResdSig1SafetyChks_1",8,23,-1}
			},
			{
				{"igVDCUChassisCANFD2ResdSig3Safety_1","ZcudZCUCANFD1ResdSignalIPdu03",293},
				{"igVDCUChassisResdSig1Safety_1","ZcudZCUCANFD1ResdSignalIPdu03",291},
				{"igVDCUChassisCANFD2ResdSig1Safety_1","ZcudZCUCANFD1ResdSignalIPdu03",295},
				{"igVDCUChassisResdSig2Safety_1","ZcudZCUCANFD1ResdSignalIPdu03",290},
				{"igVDCUChassisCANFD2ResdSig4Safety_1","ZcudZCUCANFD1ResdSignalIPdu03",292},
				{"igVDCUChassisResdSig5Safety_1","ZcudZCUCANFD1ResdSignalIPdu03",303},
				{"igVDCUChassisResdSig3Safety_1","ZcudZCUCANFD1ResdSignalIPdu03",289},
				{"igVDCUChassisCANFD2ResdSig2Safety_1","ZcudZCUCANFD1ResdSignalIPdu03",294},
				{"igVDCUChassisResdSig4Safety_1","ZcudZCUCANFD1ResdSignalIPdu03",288}
			}
		},
		{"ZCU_CANFD1","ZcudZCUCANFD1Fr10","Out",0x47f,64,0,1,1,0},
		{"ZCU_CANFD1","ZcudPscmToDhuZCUCANFD1DiagResFr","Out",0x670,64,0,1,4,0},
		{"ZCU_CANFD1","ZcudRbcmToDhuJ1979OBDZCUCanFD1DiagResFr","Out",0x7ee,8,0,1,4,0},
		{
			"ZCU_CANFD1","ZcudZCUCANFD1Fr12","Out",0x16f,64,50,1,0,0,24,5,
			{
				{"isRollRes_1",16,143,20},
				{"isVehDynCtrlStsForALgtCmftVehDynCtrlStsForStandStillMgrForPark_1",3,175,-1},
				{"isRoadInclnQly_1",2,119,-1},
				{"isVehDynCtrlStsForALgtCmftVehDynCtrlStsDend_1",1,157,-1},
				{"isLcmaLedStsDrvrSide",1,0,19},
				{"isVehDynCtrlStsForALgtCmftVehDynCtrlStsForBrkPrecActv_1",1,172,-1},
				{"isRollAgGlbVal_1",16,127,-1},
				{"isRoadInclnRoadIncln_1",16,103,-1},
				{"isIndcrSts_1",2,7,5},
				{"isVehDynCtrlStsForALgtCmftVehDynCtrlStsCntr_1",4,155,-1},
				{"isBrkRelsWarnReq",1,22,21},
				{"isPitchAgGlbVal_1",16,31,-1},
				{"isMobDevAVPReq",1,11,10},
				{"isRollAgGlbQf_1",2,113,-1},
				{"isVehDynCtrlStsForALgtCmftVehDynCtrlStsNotEna_1",1,170,-1},
				{"isMirrFoldStsAtDrvr",3,15,12},
				{"isVehDynCtrlStsForALgtCmftVehDynCtrlStsChks_1",8,167,-1},
				{"isGearLvrIndcn_1",3,4,1},
				{"isVehDynCtrlStsForALgtCmftVehDynCtrlStsForWhlBrkWrm_1",1,171,-1},
				{"isSeatBackAngleRowFirstDrvrQf1",2,191,-1},
				{"isAsyActrActvForLgtCtrl",2,116,114},
				{"isSeatBackAngleRowFirstDrvrAngleDeg180",8,183,-1},
				{"isVehDynCtrlStsForALgtCmftVehDynCtrlStsForBrkActv_1",1,156,-1},
				{"isPitchAgGlbQf_1",2,17,-1}
			},
			{
				{"igSeatBackAngleRowFirstDrvr","ZcudZCUCANFD1SignalIPdu12",189},
				{"igRollAgGlb_1","ZcudZCUCANFD1SignalIPdu12",88},
				{"igRoadIncln_1","ZcudZCUCANFD1SignalIPdu12",117},
				{"igVehDynCtrlStsForALgtCmft_1","ZcudZCUCANFD1SignalIPdu12",169},
				{"igPitchAgGlb_1","ZcudZCUCANFD1SignalIPdu12",18}
			}
		},
		{
			"ZCU_CANFD1","ZcudZCUCANFD1Fr08","Out",0x363,64,300,1,0,0,11,1,
			{
				{"isDrvrSeatSnsrSts_0",2,87,85},
				{"isJIDByte3_1",8,39,-1},
				{"isJIDByte6_1",8,63,-1},
				{"isJIDByte4_1",8,47,-1},
				{"isJIDByte0_1",8,15,-1},
				{"isJIDByte1_1",8,23,-1},
				{"isJIDByte5_1",8,55,-1},
				{"isOnBdChrgrCooltT_1",8,79,2},
				{"isJIDByte2_1",8,31,-1},
				{"isDrvrSeatSts_2",2,84,82},
				{"isJIDByte7_1",8,71,-1}
			},
			{
				{"igJID_1","ZcudZCUCANFD1SignalIPdu08",3}
			}
		},
		{
			"ZCU_CANFD1","ZcudZCUCANFD1Fr11","Out",0x345,64,200,1,0,0,17,2,
			{
				{"isTiAndDateIndcnDay_3",5,28,-1},
				{"isTiAndDateIndcnHr1_3",5,20,-1},
				{"isEPBLockMgrReqCmd",2,111,-1},
				{"isRWSDrvrModAct_1",2,108,106},
				{"isTiAndDateIndcnDataValid_3",1,6,-1},
				{"isGVMCTrjctyDriftFlg",2,105,119},
				{"isEPBLockMgrReqData4",8,87,-1},
				{"isEPBLockMgrReqData0",8,55,-1},
				{"isEPBLockMgrReqData3",8,79,-1},
				{"isTiAndDateIndcnMth1_3",4,35,-1},
				{"isEPBLockMgrReqData6",8,103,-1},
				{"isEPBLockMgrReqData2",8,71,-1},
				{"isTiAndDateIndcnMins1_3",6,13,-1},
				{"isEPBLockMgrReqData1",8,63,-1},
				{"isTiAndDateIndcnYr1_3",7,46,-1},
				{"isEPBLockMgrReqData5",8,95,-1},
				{"isTiAndDateIndcnSec1_3",6,5,-1}
			},
			{
				{"igEPBLockMgrReq","ZcudZCUCANFD1SignalIPdu11",109},
				{"igTiAndDateIndcn_3","ZcudZCUCANFD1SignalIPdu11",7}
			}
		},
		{
			"ZCU_CANFD1","ZcudZCUCANFD1ResdFr01","Out",0x134,64,50,1,0,0,30,1,
			{
				{"isZCUDMResdSig27_1",24,7,460},
				{"isZCUDMResdSig2_1",16,207,452},
				{"isZCUDMResdSig24_1",16,287,463},
				{"isZCUDMResdSig26_1",16,319,461},
				{"isZCUDMResdSig28SafetyChks_1",8,479,-1},
				{"isZCUDMResdSig25_1",16,303,462},
				{"isZCUDMResdSig9_1",16,431,469},
				{"isZCUDMResdSig16_1",16,143,440},
				{"isZCUDMResdSig10_1",16,47,446},
				{"isZCUDMResdSig1_1",16,31,447},
				{"isZCUDMResdSig14_1",16,111,442},
				{"isZCUDMResdSig22_1",16,255,449},
				{"isZCUDMResdSig5_1",16,367,457},
				{"isZCUDMResdSig15_1",16,127,441},
				{"isZCUDMResdSig8_1",16,415,470},
				{"isZCUDMResdSig20_1",16,223,451},
				{"isZCUDMResdSig13_1",16,95,443},
				{"isZCUDMResdSig6_1",16,383,456},
				{"isZCUDMResdSig4_1",16,351,458},
				{"isZCUDMResdSig7_1",16,399,471},
				{"isZCUDMResdSig23_1",16,271,448},
				{"isZCUDMResdSig11_1",16,63,445},
				{"isZCUDMResdSig18_1",16,175,454},
				{"isZCUDMResdSig3_1",16,335,459},
				{"isZCUDMResdSig12_1",16,79,444},
				{"isZCUDMResdSig21_1",16,239,450},
				{"isZCUDMResdSig19_1",16,191,453},
				{"isZCUDMResdSig28SafetyCntr_1",4,467,-1},
				{"isZCUDMResdSig28SafetyUInt32_1",32,487,-1},
				{"isZCUDMResdSig17_1",16,159,455}
			},
			{
				{"igZCUDMResdSig28Safety_1","ZcudZCUCANFD1ResdSignalIPdu01",468}
			}
		},
		{
			"ZCU_CANFD1","ZCUDZCUCANFD1VFCVectorFr","Out",0x543,8,1000,1,0,0,63,1,
			{
				{"isVFCVectorZCUDMVFCid47_2",1,49,-1},
				{"isVFCVectorZCUDMVFCid56_2",1,58,-1},
				{"isVFCVectorZCUDMVFCid51_2",1,53,-1},
				{"isVFCVectorZCUDMVFCid37_2",1,39,-1},
				{"isVFCVectorZCUDMVFCid7_2",1,9,-1},
				{"isVFCVectorZCUDMVFCid21_2",1,23,-1},
				{"isVFCVectorZCUDMVFCid1_2",1,3,-1},
				{"isVFCVectorZCUDMVFCid53_2",1,55,-1},
				{"isVFCVectorZCUDMVFCid29_2",1,31,-1},
				{"isVFCVectorZCUDMVFCid26_2",1,28,-1},
				{"isVFCVectorZCUDMVFCid43_2",1,45,-1},
				{"isVFCVectorZCUDMVFCid0_2",1,2,-1},
				{"isVFCVectorZCUDMVFCid50_2",1,52,-1},
				{"isVFCVectorZCUDMVFCid48_2",1,50,-1},
				{"isVFCVectorZCUDMVFCid5_2",1,7,-1},
				{"isVFCVectorZCUDMVFCid17_2",1,19,-1},
				{"isVFCVectorZCUDMVFCid6_2",1,8,-1},
				{"isVFCVectorZCUDMVFCid54_2",1,56,-1},
				{"isVFCVectorZCUDMVFCid31_2",1,33,-1},
				{"isVFCVectorZCUDMVFCid4_2",1,6,-1},
				{"isVFCVectorZCUDMVFCid58_2",1,60,-1},
				{"isVFCVectorZCUDMVFCid38_2",1,40,-1},
				{"isVFCVectorZCUDMVFCid46_2",1,48,-1},
				{"isVFCVectorZCUDMVFCid18_2",1,20,-1},
				{"isVFCVectorZCUDMVFCid44_2",1,46,-1},
				{"isVFCVectorZCUDMVFCid52_2",1,54,-1},
				{"isVFCVectorZCUDMVFCid30_2",1,32,-1},
				{"isVFCVectorZCUDMVFCid28_2",1,30,-1},
				{"isVFCVectorZCUDMVFCid16_2",1,18,-1},
				{"isVFCVectorZCUDMVFCid20_2",1,22,-1},
				{"isVFCVectorZCUDMVFCid9_2",1,11,-1},
				{"isVFCVectorZCUDMVFCid15_2",1,17,-1},
				{"isVFCVectorZCUDMVFCid24_2",1,26,-1},
				{"isVFCVectorZCUDMVFCid10_2",1,12,-1},
				{"isVFCVectorZCUDMVFCid60_2",1,62,-1},
				{"isVFCVectorZCUDMVFCid22_2",1,24,-1},
				{"isVFCVectorZCUDMVFCid59_2",1,61,-1},
				{"isVFCVectorZCUDMVFCid11_2",1,13,-1},
				{"isVFCVectorZCUDMVFCid27_2",1,29,-1},
				{"isVFCVectorZCUDMVFCid49_2",1,51,-1},
				{"isVFCVectorZCUDMVFCid34_2",1,36,-1},
				{"isVFCVectorZCUDMVFCid2_2",1,4,-1},
				{"isVFCVectorZCUDMVFCid25_2",1,27,-1},
				{"isVFCVectorZCUDMVFCid33_2",1,35,-1},
				{"isVFCVectorZCUDMVFCid3_2",1,5,-1},
				{"isVFCVectorZCUDMVFCid36_2",1,38,-1},
				{"isVFCVectorZCUDMVFCid32_2",1,34,-1},
				{"isVFCVectorZCUDMVFCid8_2",1,10,-1},
				{"isVFCVectorZCUDMVFCid12_2",1,14,-1},
				{"isVFCVectorZCUDMVFCid35_2",1,37,-1},
				{"isVFCVectorZCUDMVFCid19_2",1,21,-1},
				{"isVFCVectorZCUDMVFCid61_2",1,63,-1},
				{"isVFCVectorZCUDMVFCid14_2",1,16,-1},
				{"isVFCVectorZCUDMVFCid23_2",1,25,-1},
				{"isVFCVectorZCUDMVFCid42_2",1,44,-1},
				{"isVFCVectorZCUDMVFCid13_2",1,15,-1},
				{"isVFCVectorZCUDMBlockID_2",2,1,-1},
				{"isVFCVectorZCUDMVFCid55_2",1,57,-1},
				{"isVFCVectorZCUDMVFCid39_2",1,41,-1},
				{"isVFCVectorZCUDMVFCid57_2",1,59,-1},
				{"isVFCVectorZCUDMVFCid45_2",1,47,-1},
				{"isVFCVectorZCUDMVFCid40_2",1,42,-1},
				{"isVFCVectorZCUDMVFCid41_2",1,43,-1}
			},
			{
				{"igVFCVectorZCUDM_2","ZCUDChasCANFD1VFCVectorSignalIPdu",-1}
			}
		},
		{
			"ZCU_CANFD1","ZcudZCUCANFD1Fr01","Out",0x61,64,10,1,0,0,91,17,
			{
				{"isDrvrGearShiftDirReq1Chks_1",8,185,-1},
				{"isADL3LgtCtrlStsChks",8,7,-1},
				{"isSapaVehMtnStVehMtnSt",3,467,-1},
				{"isPtTqSetSafeChks_1",8,173,-1},
				{"isDrvrGearShiftDirReq1DwnDwnTipAut_1",1,205,-1},
				{"isWhlMotSysSpdActSafeChks_1",8,447,-1},
				{"isPinionSteerAgGroupSteerWhlTq_2",14,311,-1},
				{"isSapaVehMtnStVehMtnStChks",8,463,-1},
				{"isDrvrGearShiftDirReq2Cntr_1",4,208,-1},
				{"isTrsmStAxleReActr_1",2,187,478},
				{"isBrkPrecActvForACB",1,485,484},
				{"isDrvrGearShiftDirReq2PosnAut_1",1,218,-1},
				{"isDrvrGearShiftParkReqSts_2",2,235,-1},
				{"isVehModMngtGlbSafe1CarModSubtypWdCarModSubtyp_6",3,108,-1},
				{"isAsyLatCtrlModReqGroupCfmdLatCtrlMod",4,51,-1},
				{"isDrvrPrsntStsDrvrPrsntChks_2",8,247,-1},
				{"isPinionSteerAgGroupPinionSteerAg1Qf_2",2,333,-1},
				{"isPinionSteerAgGroupPinionSteerAg1_2",15,276,-1},
				{"isVehModMngtGlbSafe1Chks_6",8,79,-1},
				{"isDrvrPrsntStsDrvrPrsntQf_2",2,249,-1},
				{"isDrvrGearShiftParkReq1_2",1,233,-1},
				{"isDrvrGearShiftParkReqCntr_2",4,239,-1},
				{"isPtBrkTqRgnAtAxleReAct_1",15,391,-1},
				{"isVehModMngtGlbSafe1PwrLvlElecSubtyp_6",4,103,-1},
				{"isDrvrGearShiftDirReq2DwnTipAut_1",1,219,-1},
				{"isRWATarPinionAgR1RefPinionAg_1",15,407,-1},
				{"isDrvrPrsntStsDrvrPrsntCntr_2",4,255,-1},
				{"isPtBrkTqQf_1",2,345,-1},
				{"isVehModMngtGlbSafe1Cntr_6",4,87,-1},
				{"isPtBrkTqChks_1",8,343,-1},
				{"isCrabMovModStsCntr_1",4,71,-1},
				{"isVdswSlopEstimate",16,495,486},
				{"isWhlMotSysSpdActSafeIsgSpdActSgn800_1",16,431,-1},
				{"isPtTqSetSafeGrdtNeg_1",13,151,-1},
				{"isADL3LgtCtrlStsSts",2,19,-1},
				{"isPtTqSetSafeGrdtPos_1",13,154,-1},
				{"isRWATarPinionAgR1Qf_1",2,423,-1},
				{"isDrvrGearShiftDirReq1UpUpTipAut_1",1,201,-1},
				{"isAsyLatCtrlModReqGroupCfmdChks",8,47,-1},
				{"isPrkLatLgtFailrPrkLatLgtFailr_1",3,123,-1},
				{"isDrvrGearShiftDirReq2UpUpTipAut_1",1,216,-1},
				{"isAmbTRawAmbTVal_5",11,31,-1},
				{"isVehModMngtGlbSafe1CarModSts1_6",3,111,-1},
				{"isDrvrGearShiftDirReq2Chks_1",8,200,-1},
				{"isDrvrGearShiftDirReq2DwnDwnTipAut_1",1,220,-1},
				{"isExtrLiRlyPwrDwn",1,16,449},
				{"isVehModMngtGlbSafe1PwrLvlElecMai_6",4,91,-1},
				{"isDrvrPrsntStsDrvrPrsnt_2",2,251,-1},
				{"isPinionSteerAgGroupSteerWhlTqQf_2",2,329,-1},
				{"isPinionSteerAgGroupCntr_2",4,321,-1},
				{"isSapaVehMtnStVehMtnStCntr",4,471,-1},
				{"isPtBrkTqActTotQf_1",2,351,-1},
				{"isADL3LgtCtrlStsADMod",2,23,-1},
				{"isPinionSteerAgGroupPinionSteerAgSpd1Qf_2",2,331,-1},
				{"isWhlMotSysSpdActSafeQF_1",2,451,-1},
				{"isEngSt1WdStsCntr_1",4,271,-1},
				{"isPtBrkTqCntr_1",4,349,-1},
				{"isEpbActrStSec_1",3,279,421},
				{"isDoorRiReSts_1",2,34,392},
				{"isSysModAvt_1",4,191,476},
				{"isPinionSteerAgGroupPinionSteerAgSpd1_2",14,293,-1},
				{"isPtBrkTqReqForBrkSys_1",15,375,-1},
				{"isPrkLatLgtFailrChks_1",8,119,-1},
				{"isVehModMngtGlbSafe1UsgModSts_6",4,99,-1},
				{"isDrvrGearShiftDirReq1UpTipAut_1",1,202,-1},
				{"isDrvrGearShiftDirReq2UpTipAut_1",1,217,-1},
				{"isAmbTRawQly_5",2,36,-1},
				{"isDrvrGearShiftParkReqChks_2",8,231,-1},
				{"isBrkPedlSts_2",1,64,176},
				{"isTrlrPrsnt_4",1,32,477},
				{"isPrkLatLgtFailrCntr_1",4,127,-1},
				{"isVehModMngtGlbSafe1EgyLvlElecMai_6",4,83,-1},
				{"isDrvrGearShiftDirReq1DwnTipAut_1",1,204,-1},
				{"isADL3LgtCtrlStsQf",2,21,-1},
				{"isWhlMotSysSpdActSafeCntr_1",4,455,-1},
				{"isEngSt1WdStsEngSt1WdSts_1",4,267,-1},
				{"isADL3LgtCtrlStsDegraded",4,11,-1},
				{"isDrvrGearShiftDirReq1Cntr_1",4,193,-1},
				{"isADL3LgtCtrlStsCntr",4,15,-1},
				{"isPtTqSetSafeReq_1",16,135,-1},
				{"isVehModMngtGlbSafe1FltEgyCnsWdSts_6",1,105,-1},
				{"isPtTqSetSafeCntr_1",4,181,-1},
				{"isVehModMngtGlbSafe1EgyLvlElecSubtyp_6",4,95,-1},
				{"isADL3LgtCtrlStsCtrlStatus",1,17,-1},
				{"isCrabMovModStsTankTurnModSts_1",3,67,-1},
				{"isEngSt1WdStsChks_1",8,263,-1},
				{"isPtBrkTqActTot_1",15,359,-1},
				{"isAsyLatCtrlModReqGroupCfmdCntr",4,55,-1},
				{"isPinionSteerAgGroupChks_2",8,313,-1},
				{"isDrvrGearShiftDirReq1PosnAut_1",1,203,-1},
				{"isCrabMovModStsChks_1",8,63,-1}
			},
			{
				{"igADL3LgtCtrlSts","ZcudZCUCANFD1SignalIPdu01",104},
				{"igRWATarPinionAgR1_1","ZcudZCUCANFD1SignalIPdu01",474},
				{"igWhlMotSysSpdActSafe_1","ZcudZCUCANFD1SignalIPdu01",487},
				{"igDrvrGearShiftDirReq1_1","ZcudZCUCANFD1SignalIPdu01",416},
				{"igPtBrkTq_1","ZcudZCUCANFD1SignalIPdu01",472},
				{"igPrkLatLgtFailr_1","ZcudZCUCANFD1SignalIPdu01",464},
				{"igCrabMovModSts_1","ZcudZCUCANFD1SignalIPdu01",232},
				{"igVehModMngtGlbSafe1_6","ZcudZCUCANFD1SignalIPdu01",479},
				{"igDrvrPrsntSts_2","ZcudZCUCANFD1SignalIPdu01",419},
				{"igSapaVehMtnSt","ZcudZCUCANFD1SignalIPdu01",475},
				{"igDrvrGearShiftParkReq_2","ZcudZCUCANFD1SignalIPdu01",418},
				{"igAmbTRaw_5","ZcudZCUCANFD1SignalIPdu01",120},
				{"igPtTqSetSafe_1","ZcudZCUCANFD1SignalIPdu01",473},
				{"igPinionSteerAgGroup_2","ZcudZCUCANFD1SignalIPdu01",448},
				{"igEngSt1WdSts_1","ZcudZCUCANFD1SignalIPdu01",420},
				{"igAsyLatCtrlModReqGroupCfmd","ZcudZCUCANFD1SignalIPdu01",177},
				{"igDrvrGearShiftDirReq2_1","ZcudZCUCANFD1SignalIPdu01",417}
			}
		},
		{"ZCU_CANFD1","ZcudWmmToDhuZCUCANFD1DiagResFr","Out",0x623,64,0,1,4,0},
		{
			"ZCU_CANFD1","ZcudZCUCANFD1Fr13","Out",0x485,64,1000,1,0,0,32,7,
			{
				{"isPtTqSoftMaxGenn2AllwdCntr_1",4,199,-1},
				{"isPtTqSoftMaxReq_1",13,90,-1},
				{"isPtTqSoftMaxGenn2AllwdChks_1",8,175,-1},
				{"isPtTqCntr_1",4,109,-1},
				{"isLatCtrlReqSafeCntr_1",4,31,-1},
				{"isPtTqSoftMaxGenn2Allwd_1",13,183,-1},
				{"isPtTqHardMaxChks_1",8,159,-1},
				{"isLatCtrlReqSafeChks_1",8,23,-1},
				{"isPtTqMinReq_1",13,87,-1},
				{"isPtTqHardMaxGrdtNeg_1",13,119,-1},
				{"isRoadLoadNomCoeffSts_1",1,224,-1},
				{"isPtTqChks_1",8,79,-1},
				{"isLgtCtrlModReqSafeCntr_1",4,47,-1},
				{"isPtTqHardMaxGrdtPos_1",13,122,-1},
				{"isLgtCtrlModReqSafeChks_1",8,39,-1},
				{"isLgtCtrlModReqSafeLgtCtrlModReqSafe_1",4,43,-1},
				{"isRoadLoadNomCoeff2_1",10,218,-1},
				{"isRoadLoadNomCoeff0_1",11,207,-1},
				{"isPrpsnTqForBrkRels_1",15,63,64},
				{"isADModCtrlInhbnCntr_1",4,255,-1},
				{"isADModCtrlInhbnChks_1",8,247,-1},
				{"isPtTqHardMaxCntr_1",4,167,-1},
				{"isLatCtrlReqSafeLatCtrlModReq_1",4,27,-1},
				{"isLatCtrlReqSafeSteerTqReq_1",14,5,-1},
				{"isWhlAFrntMax_1",8,239,49},
				{"isRoadLoadNomCoeff1_1",10,212,-1},
				{"isBrkTqAtWhlsReq_1",12,293,297},
				{"isTqRednDurgCllsnMtgtnByBrkg_1",2,162,160},
				{"isLgtCtrlModReqSafeLgtFctFailr_1",3,55,-1},
				{"isPtTqHardMaxReq_1",13,141,-1},
				{"isLatCtrlReqSafeSteerWhlHptcWarnReq_1",1,6,-1},
				{"isADModCtrlInhbnADModCtrlInhbn_1",3,251,-1}
			},
			{
				{"igLatCtrlReqSafe_1","ZcudZCUCANFD1SignalIPdu13",7},
				{"igPtTqHardMax_1","ZcudZCUCANFD1SignalIPdu13",163},
				{"igPtTq_1","ZcudZCUCANFD1SignalIPdu13",105},
				{"igLgtCtrlModReqSafe_1","ZcudZCUCANFD1SignalIPdu13",52},
				{"igADModCtrlInhbn_1","ZcudZCUCANFD1SignalIPdu13",248},
				{"igPtTqSoftMaxGenn2_1","ZcudZCUCANFD1SignalIPdu13",51},
				{"igRoadLoadNom_1","ZcudZCUCANFD1SignalIPdu13",50}
			}
		},
		{
			"ZCU_CANFD1","ZcudZCUCANFD1Fr02","Out",0x106,64,20,1,0,0,75,13,
			{
				{"isDoorDrvrSts_2",2,103,117},
				{"isDrvrDecelReqChks",8,167,-1},
				{"isStsForRtrctrRvsbLe_1",2,259,257},
				{"isBltLockStSafeAtDrvrChks_2",8,47,-1},
				{"isDoorLeReLockSts_0",2,99,119},
				{"isBltLockStAtDrvrBltLockSts_2",1,33,-1},
				{"isStandStillMgrStsForHldCntr_1",4,199,-1},
				{"isAccrPedlRatCntr_1",4,16,-1},
				{"isGearMov_1",2,263,405},
				{"isAbsCtrlActvCtrlSts1_1",1,395,-1},
				{"isDoorDrvrLockSts_1",2,154,116},
				{"isRecOfPostImpctBrkgCfmdCrashSideRi_1",2,301,-1},
				{"isRecOfPostImpctBrkgCfmdCrashRe_1",2,291,-1},
				{"isAsyALgtActvAftLim",10,28,106},
				{"isSBWSysDegradationStsR1Cntr_1",4,367,-1},
				{"isRecOfPostImpctBrkgCfmdCrashOz_1",2,295,-1},
				{"isSBWSysDegradationStsR1Chks_1",8,359,-1},
				{"isBltLockStSafeAtDrvrBltLockSt1_2",1,51,-1},
				{"isSBWSysDegradationStsR1DegradationSts_1",4,363,-1},
				{"isRecOfPostImpctBrkgCfmdCrashFrnt_1",2,275,-1},
				{"isVehVLgtQf_1",2,239,-1},
				{"isBltLockStSafeAtDrvrCntr_2",4,55,-1},
				{"isTireRdEstimd_1",10,404,410},
				{"isReqForAsyDataStorgFromRestrntSys_1",1,112,418},
				{"isDrvrDecelReqFloat8",8,175,-1},
				{"isCrsCtrlOvrdn_1",1,32,111},
				{"isRecOfPostImpctBrkgCfmdCrashOffroadA_1",2,287,-1},
				{"isCrsCtrlrMsg_1",3,95,113},
				{"isRecOfPostImpctBrkgCfmdCntr_1",4,279,-1},
				{"isBltLockStSafeAtDrvrBltLockStErrSts_2",1,50,-1},
				{"isDoorLeReSts_1",2,97,152},
				{"isBltLockStAtDrvrBltLockSt1_2",1,34,-1},
				{"isSpdCtrlLgtGroupCntr",4,138,-1},
				{"isAccrPedlRatChks_1",8,8,-1},
				{"isSBWSysDegradationStsH1Chks_1",8,343,-1},
				{"isRecOfPostImpctBrkgCfmdCrashLargeAnimal_1",2,273,-1},
				{"isSpdCtrlLgtGroupSpdCtrlActLgt",13,127,-1},
				{"isSBWSysDegradationStsH1Cntr_1",4,351,-1},
				{"isLvlgDirMovmtIndcr",2,101,409},
				{"isVehVLat_1",14,223,-1},
				{"isSteerAgLimnRe_1",15,375,376},
				{"isRecOfPostImpctBrkgCfmdChks_1",8,271,-1},
				{"isRecOfPostImpctBrkgCfmdCrashPed_1",2,293,-1},
				{"isEasyLoadModIndcn",3,235,328},
				{"isStandStillMgrStsForHld1_1",3,195,-1},
				{"isRecOfPostImpctBrkgCfmdCrashOffroadD_1",2,285,-1},
				{"isRecOfPostImpctBrkgCfmdCrashRollovr_1",2,289,-1},
				{"isAbsCtrlActvCntr_1",4,399,-1},
				{"isDoorPassSts_2",2,237,192},
				{"isCrsCtrlrStbOk_1",1,92,114},
				{"isAbsCtrlActvChks_1",8,391,-1},
				{"isCouplFltSts_1",2,49,110},
				{"isDoorDrvrStsWithFacQlyFacQly_1",2,177,-1},
				{"isRecOfPostImpctBrkgCfmdCrashOffroadRT_1",2,283,-1},
				{"isStandStillMgrStsForHldChks_1",8,191,-1},
				{"isCarTiGlb_3",32,63,109},
				{"isDrvrDecelReqCntr",4,183,-1},
				{"isVehVLgt_1",16,207,-1},
				{"isAccrPedlRatAccrPedlRat_1",15,7,-1},
				{"isRecOfPostImpctBrkgCfmdCrashSideLe_1",2,303,-1},
				{"isRecOfPostImpctBrkgCfmdCrashOffroadRTsevere_1",2,281,-1},
				{"isVehVLatQf_1",2,225,-1},
				{"isSpdCtrlLgtGroupSpdCtrlSts",2,150,-1},
				{"isSBWSysDegradationStsH1DegradationSts_1",4,347,-1},
				{"isIndcrDisp",2,261,104},
				{"isStsForRtrctrRvsbRi_1",2,393,407},
				{"isDoorDrvrLockCmd",4,91,115},
				{"isSuspHeiLvlIndcn_1",3,158,155},
				{"isDoorDrvrStsWithFacQlyDoorSts_1",2,179,-1},
				{"isSusUpDwnCtrlReq_1",2,423,421},
				{"isRWATarPinionAgR2Qf_1",2,313,-1},
				{"isRecOfPostImpctBrkgCfmdPostImpctBrkgCfmd_1",2,299,-1},
				{"isSunRoofPosnSts_0",5,148,159},
				{"isSpdCtrlLgtGroupChks",8,130,-1},
				{"isRWATarPinionAgR2RefPinionAg_1",15,327,-1}
			},
			{
				{"igBltLockStSafeAtDrvr_2","ZcudZCUCANFD1SignalIPdu02",108},
				{"igSpdCtrlLgtGroup","ZcudZCUCANFD1SignalIPdu02",314},
				{"igAbsCtrlActv_1","ZcudZCUCANFD1SignalIPdu02",394},
				{"igSBWSysDegradationStsR1_1","ZcudZCUCANFD1SignalIPdu02",315},
				{"igBltLockStAtDrvr_2","ZcudZCUCANFD1SignalIPdu02",107},
				{"igStandStillMgrStsForHld_1","ZcudZCUCANFD1SignalIPdu02",406},
				{"igVehV_1","ZcudZCUCANFD1SignalIPdu02",256},
				{"igDrvrDecelReq","ZcudZCUCANFD1SignalIPdu02",232},
				{"igRWATarPinionAgR2_1","ZcudZCUCANFD1SignalIPdu02",419},
				{"igDoorDrvrStsWithFacQly_1","ZcudZCUCANFD1SignalIPdu02",118},
				{"igAccrPedlRat_1","ZcudZCUCANFD1SignalIPdu02",105},
				{"igRecOfPostImpctBrkgCfmd_1","ZcudZCUCANFD1SignalIPdu02",416},
				{"igSBWSysDegradationStsH1_1","ZcudZCUCANFD1SignalIPdu02",420}
			}
		},
		{
			"ZCU_CANFD1","ZcudZCUCANFD1Fr03","Out",0x353,64,150,1,0,0,33,10,
			{
				{"isBltLockStAtRowThrdRiBltLockSt1_2",1,19,-1},
				{"isBltLockStAtRowSecRiBltLockSts_2",1,10,-1},
				{"isSuspFailrStsTypQf_1",2,49,-1},
				{"isBtnUnlckSts1BtnSts2",3,47,-1},
				{"isFullElecTwbrPosn_1",3,52,79},
				{"isULoWarnLvPwrErrChks_1",8,87,-1},
				{"isTwbrLockdPosn_1",2,4,64},
				{"isULoWarnLvPwrErrULoWarn_1",2,73,-1},
				{"isPVMCDriftWinRmn",3,90,17},
				{"isSuspFailrStsCntr_1",4,71,-1},
				{"isBltLockStAtRowSecLeBltLockSt1_2",1,6,-1},
				{"isSuspFailrStsChks_1",8,63,-1},
				{"isBltLockStAtRowSecRiBltLockEquid_2",1,12,-1},
				{"isULoWarnLvPwrErrLVPwrSplyErrSts_1",4,95,-1},
				{"isULoWarnLvPwrErrCntr_1",4,77,-1},
				{"isBtnTrSts1BtnSts2",3,35,-1},
				{"isBtnLockSts1KeyId",4,28,-1},
				{"isBtnUnlckSts1KeyId",4,44,-1},
				{"isBltLockStAtRowSecMidBltLockEquid_2",1,15,-1},
				{"isBltLockStAtRowSecRiBltLockSt1_2",1,11,-1},
				{"isBltLockStAtRowSecLeBltLockSts_2",1,5,-1},
				{"isBtnTrSts1KeyId",4,39,-1},
				{"isBtnLockSts1BtnSts2",3,31,-1},
				{"isBltLockStAtRowSecMidBltLockSt1_2",1,14,-1},
				{"isBltLockStAtRowThrdRiBltLockEquid_2",1,20,-1},
				{"isSuspFailrStsSuspFailrSts_1",3,67,-1},
				{"isBltLockStAtRowThrdLeBltLockEquid_2",1,23,-1},
				{"isBltLockStAtRowThrdLeBltLockSt1_2",1,22,-1},
				{"isDCChrgnHndlSts_1",3,55,16},
				{"isBltLockStAtRowSecMidBltLockSts_2",1,13,-1},
				{"isBltLockStAtRowThrdRiBltLockSts_2",1,18,-1},
				{"isBltLockStAtRowThrdLeBltLockSts_2",1,21,-1},
				{"isBltLockStAtRowSecLeBltLockEquid_2",1,7,-1}
			},
			{
				{"igBltLockStAtRowThrdRi_2","ZcudZCUCANFD1SignalIPdu03",9},
				{"igBltLockStAtRowSecRi_2","ZcudZCUCANFD1SignalIPdu03",1},
				{"igBltLockStAtRowThrdLe_2","ZcudZCUCANFD1SignalIPdu03",8},
				{"igBtnTrSts1","ZcudZCUCANFD1SignalIPdu03",32},
				{"igBltLockStAtRowSecMid_2","ZcudZCUCANFD1SignalIPdu03",0},
				{"igULoWarnLvPwrErr_1","ZcudZCUCANFD1SignalIPdu03",91},
				{"igSuspFailrSts_1","ZcudZCUCANFD1SignalIPdu03",78},
				{"igBtnLockSts1","ZcudZCUCANFD1SignalIPdu03",24},
				{"igBltLockStAtRowSecLe_2","ZcudZCUCANFD1SignalIPdu03",2},
				{"igBtnUnlckSts1","ZcudZCUCANFD1SignalIPdu03",40}
			}
		},
		{"ZCU_CANFD1","ZcudHcmr2ToDhuZCUCANFD1DiagResFr","Out",0x62b,64,0,1,4,0},
		{
			"ZCU_CANFD1","ZcudZCUCANFD1Fr06","Out",0x243,64,70,1,0,0,78,8,
			{
				{"isDcDcActvd_3",1,29,24},
				{"isPVMCVehCtrlSts4PCASFctSts_1",3,346,-1},
				{"isRiFrntTireMsgMsgOldFlg_2",1,101,-1},
				{"isPVMCVehCtrlSts2VDSWFctSts_1",3,282,-1},
				{"isLeReTireMsgMsgOldFlg_2",1,77,-1},
				{"isPVMCVehCtrlSts4FWSAgActrSts_1",3,336,-1},
				{"isPVMCVehCtrlSts2LowSpdStrFctSts_1",3,272,-1},
				{"isLeReTireMsgPWarnFlg_2",2,73,-1},
				{"isPVMCVehCtrlSts4BrkTqFrntLeActrSts_1",3,312,-1},
				{"isRiReTireMsgFastLoseWarnFlg_2",1,126,-1},
				{"isLeReTireMsgTireFillgAssiPSts_2",1,75,-1},
				{"isPVMCVehCtrlSts2BbWBackUpFctSts_1",3,285,-1},
				{"isRiFrntTireMsgTireFillgAssiPSts_2",1,99,-1},
				{"isDrvrDesDirDrvrDesDir_1",3,155,-1},
				{"isLeReTireMsgT_2",8,71,-1},
				{"isPVMCVehCtrlSts2Chks_1",8,251,-1},
				{"isPVMCVehCtrlSts4BrkTqFrntRiActrSts_1",3,325,-1},
				{"isPVMCVehCtrlSts4BrkTqReRiActrSts_1",3,335,-1},
				{"isRiFrntTireMsgPWarnFlg_2",2,97,-1},
				{"isActvReSplrStsNotAvlEve",4,195,-1},
				{"isPVMCVehCtrlSts4BrkTqReLeActrSts_1",3,322,-1},
				{"isLeFrntTireMsgMsgOldFlg_2",1,53,-1},
				{"isPVMCVehCtrlSts2DecelReqActrSts_1",3,278,-1},
				{"isHvBattSoc_1",14,15,17},
				{"isPVMCVehCtrlSts2CrabMovgFctSts_1",3,268,-1},
				{"isDoorSwtTrigSig",2,31,28},
				{"isRiFrntTireMsgT_2",8,95,-1},
				{"isDrvrDesDirCntr_1",4,159,-1},
				{"isPVMCVehCtrlSts2Cntr_1",4,259,-1},
				{"isRiReTireMsgTWarnFlg_2",1,122,-1},
				{"isLeReTireMsgSysWarnFlg_2",1,76,-1},
				{"isRiFrntTireMsgBattLoSt_2",1,103,-1},
				{"isOnBdChrgrHndlSts1_1",4,7,3},
				{"isPVMCVehCtrlSts4Cntr_1",4,319,-1},
				{"isRiReTireMsgMsgOldFlg_2",1,125,-1},
				{"isLeFrntTireMsgFastLoseWarnFlg_2",1,54,-1},
				{"isLeFrntTireMsgSysWarnFlg_2",1,52,-1},
				{"isPVMCVehCtrlSts4EmgyBrkActrSts_1",3,342,-1},
				{"isLeFrntTireMsgTWarnFlg_2",1,50,-1},
				{"isLeReTireMsgTWarnFlg_2",1,74,-1},
				{"isPVMCVehCtrlSts4EpbActrSts_1",3,339,-1},
				{"isPVMCVehCtrlSts2BrkTqDeltaFctSts_1",3,302,-1},
				{"isLeReTireMsgFastLoseWarnFlg_2",1,78,-1},
				{"isPVMCVehCtrlSts4ACCFctSts_1",3,315,-1},
				{"isPVMCVehCtrlSts2TankTurnFctSts_1",3,289,-1},
				{"isLeFrntTireMsgP_2",8,39,-1},
				{"isPVMCVehCtrlSts2ViolentModFctSts_1",3,299,-1},
				{"isActvReSplrStsAvlStsForVDM",1,198,-1},
				{"isActvReSplrStsAvlStsForHMI",1,199,-1},
				{"isDrvrDesDirChks_1",8,151,-1},
				{"isPVMCVehCtrlSts2SbWBackUpLatFctSts_1",3,265,-1},
				{"isPVMCVehCtrlSts4BrkTqTotActrSts_1",3,332,-1},
				{"isRiFrntTireMsgFastLoseWarnFlg_2",1,102,-1},
				{"isRiReTireMsgBattLoSt_2",1,127,-1},
				{"isAD4HeatingCircTestStsZCU",2,2,0},
				{"isRiReTireMsgT_2",8,119,-1},
				{"isRiReTireMsgPWarnFlg_2",2,121,-1},
				{"isPVMCVehCtrlSts4Chks_1",8,311,-1},
				{"isActvReSplrStsCtrldSts",2,197,-1},
				{"isLeFrntTireMsgT_2",8,47,-1},
				{"isPVMCVehCtrlSts4FWSTqActrSts_1",3,349,-1},
				{"isRiReTireMsgSysWarnFlg_2",1,124,-1},
				{"isLeFrntTireMsgTireFillgAssiPSts_2",1,51,-1},
				{"isLeReTireMsgP_2",8,63,-1},
				{"isLeFrntTireMsgPWarnFlg_2",2,49,-1},
				{"isRiReTireMsgP_2",8,111,-1},
				{"isLeReTireMsgBattLoSt_2",1,79,-1},
				{"isPVMCVehCtrlSts4PCASPreFctSts_1",3,329,-1},
				{"isRiReTireMsgTireFillgAssiPSts_2",1,123,-1},
				{"isPVMCVehCtrlSts4SpdLimFctSts_1",3,359,-1},
				{"isLeFrntTireMsgBattLoSt_2",1,55,-1},
				{"isPVMCVehCtrlSts2FloatingDrvgFctSts_1",3,275,-1},
				{"isRiFrntTireMsgTWarnFlg_2",1,98,-1},
				{"isPVMCVehCtrlSts2ActrTarFctSts_1",3,271,-1},
				{"isRiFrntTireMsgP_2",8,87,-1},
				{"isPVMCVehCtrlSts2SbWBackUpLgtFctSts_1",3,292,-1},
				{"isPVMCVehCtrlSts2BrkDiscClngFctSts_1",3,295,-1},
				{"isRiFrntTireMsgSysWarnFlg_2",1,100,-1}
			},
			{
				{"igDrvrDesDir_1","ZcudZCUCANFD1SignalIPdu06",152},
				{"igRiReTireMsg_2","ZcudZCUCANFD1SignalIPdu06",167},
				{"igLeReTireMsg_2","ZcudZCUCANFD1SignalIPdu06",164},
				{"igPVMCVehCtrlSts2_1","ZcudZCUCANFD1SignalIPdu06",296},
				{"igLeFrntTireMsg_2","ZcudZCUCANFD1SignalIPdu06",163},
				{"igPVMCVehCtrlSts4_1","ZcudZCUCANFD1SignalIPdu06",356},
				{"igActvReSplrSts","ZcudZCUCANFD1SignalIPdu06",166},
				{"igRiFrntTireMsg_2","ZcudZCUCANFD1SignalIPdu06",165}
			}
		},
		{"ZCU_CANFD1","DhuToZcudPosmZCUCANFD1DiagReqFr","In",0x767,64,0,1,4,0},
		{"ZCU_CANFD1","AdcuZCUCANFD1Fr04","In",0x109,64,0,1,0,0},
		{"ZCU_CANFD1","ZcupZCUCANFD1Fr01","In",0x212,64,0,1,0,0},
		{"ZCU_CANFD1","ZcupZCUCANFD1ResdFr01","In",0x136,64,0,1,0,0},
		{"ZCU_CANFD1","DhuToZcudBmsZCUCANFD1DiagReqFr","In",0x761,64,0,1,4,0},
		{"ZCU_CANFD1","AdcuZCUCANFD1Fr19","In",0x226,64,0,1,0,0},
		{"ZCU_CANFD1","DhuToZcudRwasZCUCANFD1DiagReqFr","In",0x77e,64,0,1,4,0},
		{"ZCU_CANFD1","DhuZCUCANFD1Fr08","In",0x2ef,64,0,1,0,0},
		{"ZCU_CANFD1","BcmZCUCANFD1Fr18","In",0x82,64,0,1,0,0},
		{"ZCU_CANFD1","DHUZCUDCANFD1SecOCSyncFr02","In",0x491,16,0,1,0,0},
		{"ZCU_CANFD1","AdcuZCUCANFD1Fr27","In",0x33a,64,0,1,0,0},
		{"ZCU_CANFD1","AdcuZCUCANFD1Fr13","In",0x190,64,0,1,0,0},
		{"ZCU_CANFD1","DhuToZcudRbcmJ1979OBDZCUCanFD1ReqFr","In",0x7e6,8,0,1,4,0},
		{"ZCU_CANFD1","PASZCUCANFD1Fr18","In",0x310,64,0,1,0,0},
		{"ZCU_CANFD1","DhuToZcudFdmlZCUCANFD1DiagReqFr","In",0x764,64,0,1,4,0},
		{"ZCU_CANFD1","DhuToAllFuncZCUCANFD1DiagReqFr","In",0x7ff,8,0,1,4,0},
		{"ZCU_CANFD1","BcmZCUCANFD1Fr17","In",0x10a,64,0,1,0,0},
		{"ZCU_CANFD1","DhuZCUCANFD1Fr06","In",0x340,64,0,1,0,0},
		{"ZCU_CANFD1","DhuZCUCANFD1Fr09","In",0x1f5,64,0,1,0,0},
		{"ZCU_CANFD1","AdcuZCUCANFD1ResdFr01","In",0x137,64,0,1,0,0},
		{"ZCU_CANFD1","DhuToZcudRasmZCUCANFD1DiagReqFr","In",0x771,64,0,1,4,0},
		{"ZCU_CANFD1","AdcuZCUCANFD1Fr16","In",0x308,64,0,1,0,0},
		{"ZCU_CANFD1","AdcuZCUCANFD1Fr07","In",0x280,64,0,1,0,0},
		{"ZCU_CANFD1","AdcuZCUCANFD1Fr24","In",0x300,64,0,1,0,0},
		{"ZCU_CANFD1","DhuToZcudHcml2ZCUCANFD1DiagReqFr","In",0x72a,64,0,1,4,0},
		{"ZCU_CANFD1","AdcuZCUCANFD1Fr29","In",0x350,64,0,1,0,0},
		{"ZCU_CANFD1","AdcuZCUCANFD1Fr01","In",0x1c0,64,0,1,0,0},
		{"ZCU_CANFD1","AdcuZCUCANFD1Fr23","In",0x116,64,0,1,0,0},
		{"ZCU_CANFD1","AdcuZCUCANFD1Fr36","In",0x135,64,0,1,0,0},
		{"ZCU_CANFD1","DhuZCUCANFD1Fr02","In",0x307,64,0,1,0,0},
		{"ZCU_CANFD1","DhuToZcudSasZCUCANFD1DiagReqFr","In",0x772,64,0,1,4,0},
		{"ZCU_CANFD1","DhuToZcudPscmZCUCANFD1DiagReqFr","In",0x770,64,0,1,4,0},
		{"ZCU_CANFD1","AdcuZCUCANFD1Fr22","In",0x1ca,64,0,1,0,0},
		{"ZCU_CANFD1","AdcuZCUCANFD1Fr14","In",0x220,64,0,1,0,0},
		{"ZCU_CANFD1","AdcuZCUCANFD1Fr34","In",0x1c2,64,0,1,0,0},
		{"ZCU_CANFD1","DhuToZcudTcsZCUCANFD1DiagReqFr","In",0x769,64,0,1,4,0},
		{"ZCU_CANFD1","AdcuZCUCANFD1Fr02","In",0x1f0,64,0,1,0,0},
		{"ZCU_CANFD1","PASZCUCANFD1Fr20","In",0x112,64,0,1,0,0},
		{"ZCU_CANFD1","DhuToZcudWmmZCUCANFD1DiagReqFr","In",0x723,64,0,1,4,0},
		{"ZCU_CANFD1","AdcuZCUCANFD1Fr26","In",0x327,64,0,1,0,0},
		{"ZCU_CANFD1","DhuToZcudHcmr2ZCUCANFD1DiagReqFr","In",0x72b,64,0,1,4,0},
		{"ZCU_CANFD1","PASZCUCANFD1Fr04","In",0x211,64,0,1,0,0},
		{"ZCU_CANFD1","PASZCUCANFD1Fr02","In",0x311,64,0,1,0,0},
		{"ZCU_CANFD1","DhuToZcudRbcmZCUCANFD1DiagReqFr","In",0x713,64,0,1,4,0},
		{"ZCU_CANFD1","AdcuZCUCANFD1Fr09","In",0x241,64,0,1,0,0},
		{"ZCU_CANFD1","DhuToZcudXcuZCUCANFD1DiagReqFr","In",0x712,64,0,1,4,0},
		{"ZCU_CANFD1","DhuToZcudScl2ZCUCANFD1DiagReqFr","In",0x715,64,0,1,4,0},
		{"ZCU_CANFD1","AdcuToDhuSecOCFr01","In",0x132,64,0,1,0,0},
		{"ZCU_CANFD1","ZcupZCUDCANFD1NMFr","In",0x505,8,0,1,3,0},
		{"ZCU_CANFD1","PASZCUCANFD1Fr08","In",0x83,16,0,1,0,0},
		{"ZCU_CANFD1","DhuZCUCANFD1Fr04","In",0x105,64,0,1,0,0},
		{"ZCU_CANFD1","DhuToZcudEcmZCUCANFD1DiagReqFr","In",0x710,64,0,1,4,0},
		{"ZCU_CANFD1","BcmZCUCANFD1Fr02","In",0x401,64,0,1,0,0},
		{"ZCU_CANFD1","DhuZCUCANFD1Fr14","In",0x1f8,64,0,1,0,0},
		{"ZCU_CANFD1","IhuHudZCUCANFD1Fr02","In",0x318,64,0,1,0,0},
		{"ZCU_CANFD1","AdcuZCUCANFD1Fr25","In",0x321,64,0,1,0,0},
		{"ZCU_CANFD1","PASZCUCANFD1Fr07","In",0x60,64,0,1,0,0},
		{"ZCU_CANFD1","DhuZCUCANFD1Fr18","In",0x270,64,0,1,0,0},
		{"ZCU_CANFD1","PASZCUCANFD1Fr01","In",0x1c3,64,0,1,0,0},
		{"ZCU_CANFD1","DhuZCUCANFD1ResdFr02","In",0x185,64,0,1,0,0},
		{"ZCU_CANFD1","BcmZCUCANFD1Fr13","In",0x455,64,0,1,0,0},
		{"ZCU_CANFD1","AdcuZCUCANFD1Fr21","In",0x1c6,64,0,1,0,0},
		{"ZCU_CANFD1","PASZCUCANFD1Fr15","In",0x24b,64,0,1,0,0},
		{"ZCU_CANFD1","DhuZCUCANFD1Fr10","In",0x338,64,0,1,0,0},
		{"ZCU_CANFD1","DhuToZcudSrmZCUCANFD1DiagReqFr","In",0x724,64,0,1,4,0},
		{"ZCU_CANFD1","DhuZCUCANFD1Fr03","In",0x56,64,0,1,0,0},
		{"ZCU_CANFD1","DhuZCUCANFD1Fr01","In",0x1e8,64,0,1,0,0},
		{"ZCU_CANFD1","ZcuTZCUCANFD1Fr02","In",0x177,64,0,1,0,0},
		{"ZCU_CANFD1","AdcuZCUCANFD1Fr28","In",0x343,64,0,1,0,0},
		{"ZCU_CANFD1","AdcuZCUCANFD1Fr33","In",0x476,64,0,1,0,0},
		{"ZCU_CANFD1","BcmZCUCANFD1Fr08","In",0x317,64,0,1,0,0},
		{"ZCU_CANFD1","AdcuZCUCANFD1Fr08","In",0x71,64,0,1,0,0},
		{"ZCU_CANFD1","AdcuZCUCANFD1Fr10","In",0x1b5,64,0,1,0,0},
		{"ZCU_CANFD1","BcmZCUCANFD1Fr11","In",0x240,64,0,1,0,0},
		{"ZCU_CANFD1","AdcuZCUCANFD1Fr30","In",0x306,64,0,1,0,0},
		{"ZCU_CANFD1","DhuZCUCANFD1Fr07","In",0x379,64,0,1,0,0},
		{"ZCU_CANFD1","DhuZCUCANFD1Fr16","In",0x160,64,0,1,0,0},
		{"ZCU_CANFD1","DhuZCUCANFD1Fr17","In",0x1c1,64,0,1,0,0},
		{"ZCU_CANFD1","AdcuZCUCANFD1Fr20","In",0x265,64,0,1,0,0},
		{"ZCU_CANFD1","DhuToAllFuncJ1979OBDZCUCanFD1ReqFr","In",0x7df,8,0,1,4,0},
		{"ZCU_CANFD1","DhuToZcudFmdmZCUCANFD1DiagReqFr","In",0x762,64,0,1,4,0},
		{"ZCU_CANFD1","DhuZCUCANFD1ResdFr01","In",0x181,64,0,1,0,0},
		{"ZCU_CANFD1","BcmZCUCANFD1Fr03","In",0x1e3,64,0,1,0,0},
		{"ZCU_CANFD1","AdcuZCUCANFD1Fr03","In",0x2f0,64,0,1,0,0},
		{"ZCU_CANFD1","DhuToZcudAwmZCUCANFD1DiagReqFr","In",0x725,64,0,1,4,0},
		{"ZCUD_CANFD3","ZcudZCUDCANFD3Fr08","Out",0x83,16,0,1,1,0},
		{"ZCUD_CANFD3","ZcudToSumZCUCANFD3DiagReqFr","Out",0x741,64,0,1,4,0},
		{
			"ZCUD_CANFD3","ZcudZCUDCANFD3Fr07","Out",0x271,64,200,1,0,0,8,1,
			{
				{"isDstToEmptyIndcdDstToEmpty1_2",13,71,74},
				{"isDstEstimdToEmptyForDynElec_1",11,55,60},
				{"isDstEstimdToEmptyForDrvgElecPredTyp2_2",11,35,40},
				{"isAmbTRawQly_6",2,20,-1},
				{"isAmbTRawAmbTVal_6",11,15,-1},
				{"isDstToEmptyIndcdDstToEmpty3_1",13,103,106},
				{"isDstToEmptyIndcdDstToEmpty2_2",13,87,90},
				{"isDstEstimdToEmptyForDrvgElec_2",11,31,36}
			},
			{
				{"igAmbTRaw_6","ZcudZCUDCANFD3SignalIPdu07",18}
			}
		},
		{
			"ZCUD_CANFD3","ZcudZCUDCANFD3Fr05","Out",0x495,64,1000,1,0,0,11,2,
			{
				{"isBkpOfDstTrvld_5",21,63,74},
				{"isTiAndDateIndcnMins1_5",6,181,-1},
				{"isCarTiGlb_5",32,7,39},
				{"isTiAndDateIndcnSec1_5",6,189,-1},
				{"isTiAndDateIndcnDataValid_5",1,175,-1},
				{"isTiAndDateIndcnHr1_5",5,204,-1},
				{"isVehBattUSysU_5",8,223,-1},
				{"isTiAndDateIndcnYr1_5",7,174,-1},
				{"isVehBattUSysUQf_5",2,231,-1},
				{"isTiAndDateIndcnMth1_5",4,211,-1},
				{"isTiAndDateIndcnDay_5",5,196,-1}
			},
			{
				{"igTiAndDateIndcn_5","ZcudZCUDCANFD3SignalIPdu05",73},
				{"igVehBattU_5","ZcudZCUDCANFD3SignalIPdu05",229}
			}
		},
		{
			"ZCUD_CANFD3","ZcudZCUDCANFD3Fr09","Out",0x66,64,10,1,0,0,57,9,
			{
				{"isWhlSpdCircumlReRiQf_2",2,235,-1},
				{"isSuspStfnVlvCtrlStsRR",2,297,-1},
				{"isGVMCSuspDampgCtrlReqGVMCSuspDampgCtrlMod_1",2,71,-1},
				{"isWhlSpdCircumlReRi_2",15,200,-1},
				{"isGVMCSuspDampgCtrlReqGVMCDampgCtrlReqRL_1",16,39,-1},
				{"isAbsCtrlActvCtrlSts1_3",1,139,-1},
				{"isWhlSpdCircumlFrntLe_2",15,151,-1},
				{"isWhlSpdCircumlReLeQf_2",2,237,-1},
				{"isVehSpdLimSrc",4,255,251},
				{"isPVMCVehCtrlSts2DecelReqActrSts_2",3,90,-1},
				{"isPVMCSuspHeiCtrlReqGVMCSuspPosnModReq_1",3,395,-1},
				{"isGVMCSuspDampgCtrlReqGVMCDampgCtrlReqRR_1",16,55,-1},
				{"isWhlSpdCircumlReCntr_2",4,225,-1},
				{"isPVMCVehCtrlSts2FloatingDrvgFctSts_2",3,103,-1},
				{"isGVMCPrpsnTqDistbnReqAtAxleReDistReq_2",18,311,-1},
				{"isPVMCVehCtrlSts2CrabMovgFctSts_2",3,80,-1},
				{"isWhlSpdCircumlReLe_2",15,199,-1},
				{"isPVMCVehCtrlSts2BrkTqDeltaFctSts_2",3,114,-1},
				{"isVehArbtSpdMax",8,247,64},
				{"isPVMCSuspHeiCtrlReqGVMCSuspPosnFLReq_1",15,343,-1},
				{"isGVMCSuspDampgCtrlReqGVMCSuspDampgModReq_1",2,69,-1},
				{"isWhlSpdCircumlFrntLeQf_2",2,189,-1},
				{"isPVMCSuspHeiCtrlReqGVMCSuspPosnRRReq_1",15,378,-1},
				{"isGVMCPrpsnTqDistbnReqAtAxleReChks_2",8,325,-1},
				{"isBrkTracCtrlActv_2",1,66,65},
				{"isPVMCVehCtrlSts2SbWBackUpLgtFctSts_2",3,104,-1},
				{"isWhlSpdCircumlFrntCntr_2",4,177,-1},
				{"isGVMCSuspDampgCtrlReqGVMCDampgCtrlReqFL_1",16,7,-1},
				{"isWhlSpdCircumlFrntChks_2",8,169,-1},
				{"isWhlSpdCircumlFrntRiQf_2",2,187,-1},
				{"isSuspStfnVlvCtrlStsRL",2,299,-1},
				{"isGVMCSuspDampgCtrlReqGVMCDampgCtrlReqFR_1",16,23,-1},
				{"isPVMCVehCtrlSts2VDSWFctSts_2",3,110,-1},
				{"isGVMCPrpsnTqDistbnReqAtAxleReCtrlMod_2",1,329,-1},
				{"isPVMCVehCtrlSts2BrkDiscClngFctSts_2",3,107,-1},
				{"isSuspStfnVlvCtrlStsFR",2,301,-1},
				{"isSuspDistbnVlvCtrlStsSuspDistbnVlvCtrlSts",12,263,-1},
				{"isPVMCVehCtrlSts2Cntr_2",4,87,-1},
				{"isPVMCVehCtrlSts2TankTurnFctSts_2",3,117,-1},
				{"isPVMCSuspHeiCtrlReqGVMCSuspPosnRLReq_1",15,361,-1},
				{"isPVMCVehCtrlSts2ViolentModFctSts_2",3,127,-1},
				{"isSuspCmprSpd",9,287,294},
				{"isPVMCVehCtrlSts2SbWBackUpLatFctSts_2",3,93,-1},
				{"isSuspDistbnVlvCtrlStsCntr",4,275,-1},
				{"isPVMCVehCtrlSts2Chks_2",8,79,-1},
				{"isWhlSpdCircumlReChks_2",8,217,-1},
				{"isPVMCSuspHeiCtrlReqGVMCSuspPosnCtrlMod_1",2,392,-1},
				{"isSuspStfnVlvCtrlStsFL",2,303,-1},
				{"isPVMCSuspHeiCtrlReqGVMCSuspPosnFRReq_1",15,344,-1},
				{"isAbsCtrlActvChks_3",8,135,-1},
				{"isPVMCVehCtrlSts2BbWBackUpFctSts_2",3,97,-1},
				{"isAbsCtrlActvCntr_3",4,143,-1},
				{"isSuspDistbnVlvCtrlStsChks",8,267,-1},
				{"isPVMCVehCtrlSts2LowSpdStrFctSts_2",3,100,-1},
				{"isGVMCPrpsnTqDistbnReqAtAxleReCntr_2",4,333,-1},
				{"isWhlSpdCircumlFrntWhlSpdCircumlFrntRi_2",15,152,-1},
				{"isPVMCVehCtrlSts2ActrTarFctSts_2",3,83,-1}
			},
			{
				{"igGVMCSuspDampgCtrlReq_1","ZcudZCUDCANFD3SignalIPdu09",67},
				{"igPVMCSuspHeiCtrlReq_1","ZcudZCUDCANFD3SignalIPdu09",406},
				{"igWhlSpdCircumlRe_2","ZcudZCUDCANFD3SignalIPdu09",233},
				{"igWhlSpdCircumlFrnt_2","ZcudZCUDCANFD3SignalIPdu09",185},
				{"igGVMCPrpsnTqDistbnReqAtAxleRe_2","ZcudZCUDCANFD3SignalIPdu09",328},
				{"igSuspDistbnVlvCtrlSts","ZcudZCUDCANFD3SignalIPdu09",123},
				{"igPVMCVehCtrlSts2_2","ZcudZCUDCANFD3SignalIPdu09",124},
				{"igAbsCtrlActv_3","ZcudZCUDCANFD3SignalIPdu09",138},
				{"igSuspStfnVlvCtrlSts","ZcudZCUDCANFD3SignalIPdu09",122}
			}
		},
		{
			"ZCUD_CANFD3","ZcudZCUDCANFD3Fr02","Out",0x153,64,50,1,0,0,30,5,
			{
				{"isRWASteerLockReqSteerLockDataReq3_1",8,159,-1},
				{"isSteerEmergCtrlSwt_2",1,127,126},
				{"isRWASteerLockReqSteerLockDataReq1_1",8,143,-1},
				{"isDrvrGearShiftDirReq2DwnDwnTipAut_2",1,49,-1},
				{"isDrvrGearShiftDirReq2DwnTipAut_2",1,48,-1},
				{"isRWASteerLockReqSteerLockDataReq2_1",8,151,-1},
				{"isSteerSetgSteerAsscLvl_2",3,86,-1},
				{"isDrvrGearShiftDirReq1UpUpTipAut_2",1,47,-1},
				{"isRWASteerLockReqSteerLockDataReq0_1",8,135,-1},
				{"isZCAirSuspCtrlStsZCAirSuspCtrlSts",2,203,-1},
				{"isDrvrGearShiftDirReq1PosnAut_2",1,33,-1},
				{"isDrvrGearShiftDirReq2UpUpTipAut_2",1,61,-1},
				{"isRWASteerLockReqSteerLockDataReq6_1",8,183,-1},
				{"isDrvrGearShiftDirReq2UpTipAut_2",1,62,-1},
				{"isSteerSetgSteerMod_2",3,83,-1},
				{"isDrvrGearShiftDirReq1Chks_2",8,31,-1},
				{"isZCAirSuspCtrlStsChks",8,199,-1},
				{"isDrvrGearShiftDirReq2Chks_2",8,45,-1},
				{"isDrvrGearShiftDirReq2PosnAut_2",1,63,-1},
				{"isDrvrGearShiftDirReq1DwnTipAut_2",1,34,-1},
				{"isDrvrGearShiftDirReq1UpTipAut_2",1,32,-1},
				{"isRWASteerLockReqSteerLockDataReq4_1",8,167,-1},
				{"isDrvrGearShiftDirReq1Cntr_2",4,39,-1},
				{"isSteerSetgPen_2",4,74,-1},
				{"isDrvrGearShiftDirReq2Cntr_2",4,53,-1},
				{"isDrvrGearShiftDirReq1DwnDwnTipAut_2",1,35,-1},
				{"isZCAirSuspCtrlStsCntr",4,207,-1},
				{"isRWASteerLockReqCommand_1",2,191,-1},
				{"isSteerRatModReq_1",5,101,96},
				{"isRWASteerLockReqSteerLockDataReq5_1",8,175,-1}
			},
			{
				{"igRWASteerLockReq_1","ZcudZCUDCANFD3SignalIPdu02",189},
				{"igDrvrGearShiftDirReq1_2","ZcudZCUDCANFD3SignalIPdu02",46},
				{"igSteerSetg_2","ZcudZCUDCANFD3SignalIPdu02",80},
				{"igDrvrGearShiftDirReq2_2","ZcudZCUDCANFD3SignalIPdu02",60},
				{"igZCAirSuspCtrlSts","ZcudZCUDCANFD3SignalIPdu02",201}
			}
		},
		{
			"ZCUD_CANFD3","ZcudZCUDCANFD3Fr12","Out",0x2f0,64,150,1,0,0,9,2,
			{
				{"isLiBattInPWLock_1",1,23,22},
				{"isULoWarnLvPwrErrULoWarn_2",2,45,-1},
				{"isULoWarnLvPwrErrChks_2",8,29,-1},
				{"isCmptmtTFrntFanForCmptmtTRunng_4",1,10,-1},
				{"isULoWarnLvPwrErrLVPwrSplyErrSts_2",4,33,-1},
				{"isRlyPwrDistbnCmd1WdIgnRlyCmd_4",1,31,30},
				{"isULoWarnLvPwrErrCntr_2",4,37,-1},
				{"isCmptmtTFrntQf_4",2,12,-1},
				{"isCmptmtTFrntCmptmtTFrnt_4",11,7,-1}
			},
			{
				{"igULoWarnLvPwrErr_2","ZcudZCUDCANFD3SignalIPdu12",43},
				{"igCmptmtTFrnt_4","ZcudZCUDCANFD3SignalIPdu12",9}
			}
		},
		{"ZCUD_CANFD3","ZcudZCUDCANFD3Fr10","Out",0x225,64,0,1,1,0},
		{"ZCUD_CANFD3","ZCUDZCUDCANFD3NmFr01","Out",0x501,8,0,1,3,0},
		{"ZCUD_CANFD3","ZcudToHwasZCUCANFD3DiagReqFr","Out",0x742,64,0,1,4,0},
		{"ZCUD_CANFD3","ZcudToHwamZCUCANFD3DiagReqFr","Out",0x740,64,0,1,4,0},
		{"ZCUD_CANFD3","ZcudToHvfmZCUCANFD3DiagReqFr","Out",0x744,64,0,1,4,0},
		{
			"ZCUD_CANFD3","ZcudZCUDCANFD3Fr06","Out",0x239,64,100,1,0,0,16,2,
			{
				{"isPtTqAtWhlFrntActPtTqAtWhlFrntLeAct_2",16,23,-1},
				{"isDrvrSeatSts_4",2,140,138},
				{"isDrvModReq_3",5,127,122},
				{"isLockgCenStsUpdEve_5",1,153,-1},
				{"isLockgCenStsTrigSrc_5",4,159,-1},
				{"isLockgCenStsLockSt_5",2,155,-1},
				{"isIAMSMod_1",1,121,120},
				{"isPVMCSteerAst_2",3,135,132},
				{"isBattIRaw_2",16,95,128},
				{"isBattRemainTimeToEmpty_1",15,111,112},
				{"isPtTqAtWhlFrntActPtTqAtAxleFrntAct_2",16,7,-1},
				{"isPtTqAtWhlFrntActCntr_2",4,63,-1},
				{"isDrvrSeatSnsrSts_2",2,143,141},
				{"isPtTqAtWhlFrntActPtTqAtWhlsFrntQly_2",3,59,-1},
				{"isPtTqAtWhlFrntActChks_2",8,55,-1},
				{"isPtTqAtWhlFrntActPtTqAtWhlFrntRiAct_2",16,39,-1}
			},
			{
				{"igLockgCenSts_5","ZcudZCUDCANFD3SignalIPdu06",152},
				{"igPtTqAtWhlFrntAct_2","ZcudZCUDCANFD3SignalIPdu06",56}
			}
		},
		{
			"ZCUD_CANFD3","ZcudZCUDCANFD3Fr01","Out",0x55,64,10,1,0,0,60,13,
			{
				{"isWhlFastSpdSafeA_1",15,423,-1},
				{"isWhlRotToothCntrCntr_1",4,415,-1},
				{"isGVMCPrpsnTqDistReqDistReq_1",15,455,-1},
				{"isVehModMngtGlbSafe1Cntr_8",4,63,-1},
				{"isGVMCPrpsnTqDistReqCtrlMod_1",1,456,-1},
				{"isGVMCVehVActLatAct",16,95,-1},
				{"isWhlFastSpdSafeQF_1",2,444,-1},
				{"isVehModMngtGlbSafe1PwrLvlElecSubtyp_8",4,79,-1},
				{"isWhlRotToothCntrReLe_1",8,399,-1},
				{"isLatCtrlReqSafeSteerWhlHptcWarnReq_2",1,337,-1},
				{"isSteerWhlSnsrAgSpd_4",14,8,-1},
				{"isGearLvrIndcn_3",3,43,40},
				{"isGVMCYawRateCOGActQf",2,183,-1},
				{"isGVMCPrpsnTqDistReqCntr_1",4,479,-1},
				{"isGVMCSteerWhlAgReqFrntSteerWhlCtrlSts_2",2,278,-1},
				{"isVehModMngtGlbSafe1EgyLvlElecMai_8",4,59,-1},
				{"isWhlFastSpdSafeCntr_1",4,432,-1},
				{"isLatCtrlReqSafeCntr_2",4,329,-1},
				{"isEscStCntr_2",4,199,-1},
				{"isLatCtrlReqSafeChks_2",8,321,-1},
				{"isVehModMngtGlbSafe1PwrLvlElecMai_8",4,67,-1},
				{"isGVMCSteerWhlAgReqFrntSteerWhlTqCtrl_2",14,240,-1},
				{"isGVMCVehCtrlrStsCntr_1",4,367,-1},
				{"isEscStChks_2",8,191,-1},
				{"isLatCtrlReqSafeLatCtrlModReq_2",4,341,-1},
				{"isSteerWhlSnsrChks_4",8,26,-1},
				{"isVehModMngtGlbSafe1FltEgyCnsWdSts_8",1,81,-1},
				{"isVehModMngtGlbSafe1Chks_8",8,55,-1},
				{"isVehModMngtGlbSafe1EgyLvlElecSubtyp_8",4,71,-1},
				{"isLatCtrlReqSafeSteerTqReq_2",14,319,-1},
				{"isVehMtnStChks_3",8,207,-1},
				{"isGVMCSteerWhlAgReqFrntChks_2",8,258,-1},
				{"isVehSpdLgtChks_6",8,136,-1},
				{"isGVMCYawRateCOGActAct",16,167,-1},
				{"isWhlRotToothCntrFrntRi_1",8,391,-1},
				{"isYawRateReqdByDrvr_1",16,223,124},
				{"isVehModMngtGlbSafe1CarModSts1_8",3,87,-1},
				{"isSteerWhlSnsrAg_4",15,7,-1},
				{"isGVMCPrpsnTqDistReqChks_1",8,471,-1},
				{"isVehSpdLgtA_6",15,135,-1},
				{"isGVMCVehCtrlrStsChks_1",8,351,-1},
				{"isGVMCVehYawRateTar",32,287,123},
				{"isGVMCSteerWhlAgReqFrntSteerWhlAgCtrl_2",15,239,-1},
				{"isEscStEscSt_2",3,195,-1},
				{"isGVMCVehVActQf",2,127,-1},
				{"isVehSpdLgtCntr_6",4,144,-1},
				{"isGVMCVehCtrlrStsCtrlrSts_1",8,359,-1},
				{"isVehMtnStCntr_3",4,215,-1},
				{"isWhlRotToothCntrFrntLe_1",8,383,-1},
				{"isVehSpdLgtQf_6",2,156,-1},
				{"isSteerWhlSnsrQf_4",2,46,-1},
				{"isWhlFastSpdSafeChks_1",8,424,-1},
				{"isWhlRotToothCntrReRi_1",8,407,-1},
				{"isVehMtnStVehMtnSt_3",3,211,-1},
				{"isWhlRotToothCntrChks_1",8,375,-1},
				{"isSteerWhlSnsrCntr_4",4,34,-1},
				{"isGVMCVehVActLgtAct",16,111,-1},
				{"isVehModMngtGlbSafe1CarModSubtypWdCarModSubtyp_8",3,84,-1},
				{"isGVMCSteerWhlAgReqFrntCntr_2",4,266,-1},
				{"isVehModMngtGlbSafe1UsgModSts_8",4,75,-1}
			},
			{
				{"igVehModMngtGlbSafe1_8","ZcudZCUDCANFD3SignalIPdu01",80},
				{"igVehSpdLgt_6","ZcudZCUDCANFD3SignalIPdu01",154},
				{"igGVMCSteerWhlAgReqFrnt_2","ZcudZCUDCANFD3SignalIPdu01",276},
				{"igWhlRotToothCntr_1","ZcudZCUDCANFD3SignalIPdu01",411},
				{"igGVMCVehVAct","ZcudZCUDCANFD3SignalIPdu01",125},
				{"igWhlFastSpdSafe_1","ZcudZCUDCANFD3SignalIPdu01",442},
				{"igVehMtnSt_3","ZcudZCUDCANFD3SignalIPdu01",208},
				{"igLatCtrlReqSafe_2","ZcudZCUDCANFD3SignalIPdu01",336},
				{"igGVMCVehCtrlrSts_1","ZcudZCUDCANFD3SignalIPdu01",363},
				{"igGVMCPrpsnTqDistReq_1","ZcudZCUDCANFD3SignalIPdu01",475},
				{"igEscSt_2","ZcudZCUDCANFD3SignalIPdu01",192},
				{"igSteerWhlSnsr_4","ZcudZCUDCANFD3SignalIPdu01",44},
				{"igGVMCYawRateCOGAct","ZcudZCUDCANFD3SignalIPdu01",181}
			}
		},
		{"ZCUD_CANFD3","ZcudToAllFuncZCUDCANFD3DiagReqFr","Out",0x7ff,8,0,1,4,0},
		{"ZCUD_CANFD3","ZcudToRwamZCUCANFD3DiagReqFr","Out",0x743,64,0,1,4,0},
		{
			"ZCUD_CANFD3","ZcudZCUDCANFD3Fr03","Out",0x121,64,30,1,0,0,9,1,
			{
				{"isBrkPedlPsdBrkPedlNotPsdSafe_3",1,49,-1},
				{"isHeiLimModIncn_1",2,71,69},
				{"isBBWPullOverReq",1,67,66},
				{"isBrkPedlPsdChks_3",8,47,-1},
				{"isChassisObstclCrsModIncn_1",2,34,32},
				{"isBrkPedlPsdCntr_3",4,55,-1},
				{"isPTALgtLimnlnd",12,79,83},
				{"isBrkPedlPsdQf_3",2,51,-1},
				{"isBrkPedlPsdBrkPedlPsd_3",1,48,-1}
			},
			{
				{"igBrkPedlPsd_3","ZcudZCUDCANFD3SignalIPdu03",68}
			}
		},
		{
			"ZCUD_CANFD3","ZcudZCUDCANFD3VFCVectorFr","Out",0x541,8,1000,1,0,0,63,1,
			{
				{"isVFCVectorZCUDMVFCid3_7",1,2,-1},
				{"isVFCVectorZCUDMVFCid34_7",1,35,-1},
				{"isVFCVectorZCUDMVFCid44_7",1,41,-1},
				{"isVFCVectorZCUDMVFCid53_7",1,48,-1},
				{"isVFCVectorZCUDMVFCid31_7",1,38,-1},
				{"isVFCVectorZCUDMVFCid12_7",1,9,-1},
				{"isVFCVectorZCUDMVFCid5_7",1,0,-1},
				{"isVFCVectorZCUDMVFCid6_7",1,15,-1},
				{"isVFCVectorZCUDMVFCid26_7",1,27,-1},
				{"isVFCVectorZCUDMVFCid17_7",1,20,-1},
				{"isVFCVectorZCUDMVFCid38_7",1,47,-1},
				{"isVFCVectorZCUDMVFCid0_7",1,5,-1},
				{"isVFCVectorZCUDMVFCid60_7",1,57,-1},
				{"isVFCVectorZCUDMVFCid8_7",1,13,-1},
				{"isVFCVectorZCUDMVFCid47_7",1,54,-1},
				{"isVFCVectorZCUDMVFCid9_7",1,12,-1},
				{"isVFCVectorZCUDMVFCid28_7",1,25,-1},
				{"isVFCVectorZCUDMVFCid59_7",1,58,-1},
				{"isVFCVectorZCUDMVFCid22_7",1,31,-1},
				{"isVFCVectorZCUDMVFCid27_7",1,26,-1},
				{"isVFCVectorZCUDMVFCid4_7",1,1,-1},
				{"isVFCVectorZCUDMVFCid14_7",1,23,-1},
				{"isVFCVectorZCUDMVFCid7_7",1,14,-1},
				{"isVFCVectorZCUDMVFCid2_7",1,3,-1},
				{"isVFCVectorZCUDMVFCid40_7",1,45,-1},
				{"isVFCVectorZCUDMVFCid58_7",1,59,-1},
				{"isVFCVectorZCUDMVFCid11_7",1,10,-1},
				{"isVFCVectorZCUDMVFCid55_7",1,62,-1},
				{"isVFCVectorZCUDMVFCid19_7",1,18,-1},
				{"isVFCVectorZCUDMVFCid46_7",1,55,-1},
				{"isVFCVectorZCUDMVFCid1_7",1,4,-1},
				{"isVFCVectorZCUDMVFCid21_7",1,16,-1},
				{"isVFCVectorZCUDMVFCid52_7",1,49,-1},
				{"isVFCVectorZCUDMVFCid61_7",1,56,-1},
				{"isVFCVectorZCUDMVFCid20_7",1,17,-1},
				{"isVFCVectorZCUDMVFCid13_7",1,8,-1},
				{"isVFCVectorZCUDMVFCid16_7",1,21,-1},
				{"isVFCVectorZCUDMVFCid39_7",1,46,-1},
				{"isVFCVectorZCUDMVFCid25_7",1,28,-1},
				{"isVFCVectorZCUDMVFCid54_7",1,63,-1},
				{"isVFCVectorZCUDMVFCid57_7",1,60,-1},
				{"isVFCVectorZCUDMVFCid48_7",1,53,-1},
				{"isVFCVectorZCUDMVFCid56_7",1,61,-1},
				{"isVFCVectorZCUDMVFCid36_7",1,33,-1},
				{"isVFCVectorZCUDMVFCid50_7",1,51,-1},
				{"isVFCVectorZCUDMVFCid15_7",1,22,-1},
				{"isVFCVectorZCUDMVFCid35_7",1,34,-1},
				{"isVFCVectorZCUDMVFCid29_7",1,24,-1},
				{"isVFCVectorZCUDMVFCid30_7",1,39,-1},
				{"isVFCVectorZCUDMVFCid45_7",1,40,-1},
				{"isVFCVectorZCUDMVFCid32_7",1,37,-1},
				{"isVFCVectorZCUDMVFCid41_7",1,44,-1},
				{"isVFCVectorZCUDMVFCid51_7",1,50,-1},
				{"isVFCVectorZCUDMVFCid42_7",1,43,-1},
				{"isVFCVectorZCUDMVFCid43_7",1,42,-1},
				{"isVFCVectorZCUDMVFCid37_7",1,32,-1},
				{"isVFCVectorZCUDMVFCid23_7",1,30,-1},
				{"isVFCVectorZCUDMVFCid33_7",1,36,-1},
				{"isVFCVectorZCUDMVFCid18_7",1,19,-1},
				{"isVFCVectorZCUDMVFCid49_7",1,52,-1},
				{"isVFCVectorZCUDMBlockID_7",2,7,-1},
				{"isVFCVectorZCUDMVFCid24_7",1,29,-1},
				{"isVFCVectorZCUDMVFCid10_7",1,11,-1}
			},
			{
				{"igVFCVectorZCUDM_7","ZcudZCUDCANFD3VFCVectorSignalIPdu",-1}
			}
		},
		{"ZCUD_CANFD3","HwamZCUDCANFD3Fr03","In",0x211,64,0,1,0,0},
		{"ZCUD_CANFD3","RwamZCUDCANFD3Fr03","In",0x50,64,0,1,0,0},
		{"ZCUD_CANFD3","HwamZCUDCANFD3Fr04","In",0x21,32,0,1,0,0},
		{"ZCUD_CANFD3","IemZCUDCANFD3Fr03","In",0x101,64,0,1,0,0},
		{"ZCUD_CANFD3","HwamToZcudZCUDCANFD3DiagResFr","In",0x640,64,0,1,4,0},
		{"ZCUD_CANFD3","HvfmZCUDCANFD3Fr01","In",0x301,64,0,1,0,0},
		{"ZCUD_CANFD3","HwamZCUDCANFD3Fr02","In",0x2c2,64,0,1,0,0},
		{"ZCUD_CANFD3","SumZCUDCANFD3Fr01","In",0x53,64,0,1,0,0},
		{"ZCUD_CANFD3","SrsZCUDCANFD3Fr01","In",0x32,64,0,1,0,0},
		{"ZCUD_CANFD3","HwasToZcudZCUDCANFD3DiagResFr","In",0x642,64,0,1,4,0},
		{"ZCUD_CANFD3","RwamToZcudZCUDCANFD3DiagResFr","In",0x643,64,0,1,4,0},
		{"ZCUD_CANFD3","RwamZCUDCANFD3Fr04","In",0x31,32,0,1,0,0},
		{"ZCUD_CANFD3","ZCUTZCUDCANFD3Fr02","In",0x65,64,0,1,0,0},
		{"ZCUD_CANFD3","IemZCUDCANFD3Fr02","In",0x51,64,0,1,0,0},
		{"ZCUD_CANFD3","HwamZCUDCANFD3Fr01","In",0x100,64,0,1,0,0},
		{"ZCUD_CANFD3","SumZCUDCANFD3Fr04","In",0x1c0,64,0,1,0,0},
		{"ZCUD_CANFD3","RwamZCUDCANFD3Fr02","In",0x200,64,0,1,0,0},
		{"ZCUD_CANFD3","RwamZCUDCANFD3Fr01","In",0x110,64,0,1,0,0},
		{"ZCUD_CANFD3","ZCUTZCUDCANFD3NmFr01","In",0x502,8,0,1,3,0},
		{"ZCUD_CANFD3","SumToZcudZCUDCANFD3DiagResFr","In",0x641,64,0,1,4,0},
		{"ZCUD_CANFD3","HvfmToZcudZCUDCANFD3DiagResFr","In",0x644,64,0,1,4,0},
		{"ZCUD_CANFD3","HvfmZCUDCANFD3VFCVectorFr","In",0x549,8,0,1,0,0},
		{"ZCUD_CANFD3","SumZCUDCANFD3Fr05","In",0x210,64,0,1,0,0},
		{"ZCUD_CANFD3","ZCUTZCUDCANFD3Fr01","In",0x217,64,0,1,0,0},
		{"ZCUD_CANFD3","HwamZCUDCANFD3VFCVectorFr","In",0x54a,8,0,1,0,0},
		{"ZCUD_CANFD3","SumZCUDCANFD3VFCVectorFr","In",0x565,8,0,1,0,0},
		{"ChassisCANFD2","ZcudChassisCANFD2PduR100Fr002","Out",0x2c8,64,0,1,1,0},
		{"ChassisCANFD2","ZcudChassisCANFD2ResdFr03","Out",0x155,64,0,1,1,0},
		{"ChassisCANFD2","ZcudChasCANFD2NMFr","Out",0x507,8,0,1,3,0},
		{
			"ChassisCANFD2","ZcudChassisCANFD2Fr004","Out",0x13c,64,40,1,0,0,82,13,
			{
				{"isHznProfShoDistance1_1",10,322,-1},
				{"isHoodSts_0",2,145,393},
				{"isHznEdgeFunctionalRoadClass_1",3,293,-1},
				{"isBltLockStAtRowSecLeBltLockEquid_1",1,7,-1},
				{"isSocInFoOfCommChargn_1",3,87,394},
				{"isTrlrModSwtReq_1",1,211,210},
				{"isBltLockStAtRowThrdLeBltLockSts_1",1,9,-1},
				{"isBltLockStAtRowThrdMidBltLockEquid_1",1,23,-1},
				{"isEngRunngReqByVehModMgrClimate_0",1,398,-1},
				{"isTankFlapSts_0",2,220,218},
				{"isBltLockStAtRowSecRiBltLockEquid_1",1,15,-1},
				{"isHznProfShoValue1_1",10,350,-1},
				{"isChrgHndlStrtEna_0",1,84,83},
				{"isHznProfShoUpdate_1",1,368,-1},
				{"isHznEdgeTurnAngle_1",8,258,-1},
				{"isHznProfShoPathIndex_1",6,356,-1},
				{"isBltLockStAtRowThrdRiBltLockEquid_1",1,19,-1},
				{"isHznProfShoRetransmission_1",1,369,-1},
				{"isHznProfShoMessageType_1",3,361,-1},
				{"isHznProfShoAccuracy_1",2,374,-1},
				{"isHznEdgeFormOfWay_1",4,281,-1},
				{"isHWASyncStsGroupH1SyncOvrdIndcn_1",3,231,-1},
				{"isProfPenSts1_2",4,247,243},
				{"isHvActvForVehModReq_0",1,82,81},
				{"isHmiMovgObj1DstLgtOfMovgobj_1",8,50,-1},
				{"isBltLockStAtDrvrBltLockSt1_1",1,31,-1},
				{"isHznProfShoControlPoint_1",1,370,-1},
				{"isTiDrvgCycOff_0",16,191,24},
				{"isBltLockStAtRowThrdMidBltLockSts_1",1,21,-1},
				{"isBltLockStAtRowThrdLeBltLockSt1_1",1,10,-1},
				{"isBltLockStAtRowThrdRiBltLockSt1_1",1,18,-1},
				{"isBltLockStAtRowSecLeBltLockSt1_1",1,6,-1},
				{"isHznEdgeNumberOfLanesInDrivingDirection_1",3,303,-1},
				{"isHznEdgeSubPathIndex_1",6,276,-1},
				{"isBltLockStAtRowThrdMidBltLockSt1_1",1,22,-1},
				{"isEngActvnMod1WdReq_0",2,223,221},
				{"isHznProfShoOffset_1",13,319,-1},
				{"isBltLockStAtRowThrdLeBltLockEquid_1",1,11,-1},
				{"isLeSolarData_1",8,383,233},
				{"isHznEdgeNumberOfLanesInOppositeDirection_1",2,296,-1},
				{"isHznEdgeRelativeProbability_1",5,286,-1},
				{"isRiSolarData_1",8,391,240},
				{"isHznEdgeRetransmission_1",1,305,-1},
				{"isBltLockStAtRowSecLeBltLockSts_1",1,5,-1},
				{"isHmiMovgObj1HdDirOfMovgObj_1",12,39,-1},
				{"isHznProfShoValue0_1",10,328,-1},
				{"isHznEdgePartOfCalculatedRoute_1",2,310,-1},
				{"isSocOfCommChargn_1",1,217,395},
				{"isHvacFanSts3HvacFanSpdFd_1",8,79,25},
				{"isHznProfShoCyclicCounter_1",2,372,-1},
				{"isBltLockStAtPassBltLockSt1_1",1,28,-1},
				{"isEngRunngReqByVehModMgrElectricalSystem_0",1,397,-1},
				{"isBltLockStAtRowSecMidBltLockEquid_1",1,3,-1},
				{"isHznEdgeRightofWay_1",2,308,-1},
				{"isBltLockStAtRowSecMidBltLockSt1_1",1,2,-1},
				{"isBltLockStAtPassBltLockSts_1",1,27,-1},
				{"isHznEdgeMessageType_1",3,290,-1},
				{"isBltLockStAtDrvrBltLockSts_1",1,30,-1},
				{"isTelmStrtEngForChrgnReq_1",2,66,64},
				{"isHznProfShoProfileType_1",5,366,-1},
				{"isSiteOfcommCharn_1",1,80,242},
				{"isHznEdgeComplexIntersection_1",2,300,-1},
				{"isHznEdgeOffset_1",13,255,-1},
				{"isTankFlapReqFromSwtIntrFild_0",1,225,406},
				{"isHznEdgePathIndex_1",6,266,-1},
				{"isHznEdgeCyclicCounter_1",2,298,-1},
				{"isBltLockStAtRowSecRiBltLockSt1_1",1,14,-1},
				{"isDrvrPfmncAlrmReqFromDHU_1",3,95,92},
				{"isBltLockStAtRowSecMidBltLockSts_1",1,1,-1},
				{"isSetLimReq_1",2,209,241},
				{"isBltLockStAtRowThrdRiBltLockSts_1",1,17,-1},
				{"isOutlSovActvSts_1",1,91,90},
				{"isEngRunngReqByVehModMgrChassie_0",1,399,-1},
				{"isHznEdgeUpdate_1",1,304,-1},
				{"isHznEdgeLastStubAtOffset_1",1,306,-1},
				{"isHWASyncStsGroupH1SyncSts_1",2,228,-1},
				{"isHmiMovgObj1ColorOfHmiMovgObj_1",3,70,-1},
				{"isSpdLimUnit_1",1,216,407},
				{"isBltLockStAtRowSecRiBltLockSts_1",1,13,-1},
				{"isHmiMovgObj1DstLatOfMovgObj_1",9,43,-1},
				{"isEngRunngReqByVehModMgrTrailerPrsnt_0",1,396,-1},
				{"isHmiMovgObj1HmiMovgObjTyp_1",4,58,-1}
			},
			{
				{"igHznProfSho_1","ZcudChassisCANFD2SignalIPdu004",232},
				{"igHWASyncStsGroupH1_1","ZcudChassisCANFD2SignalIPdu004",226},
				{"igBltLockStAtDrvr_1","ZcudChassisCANFD2SignalIPdu004",29},
				{"igBltLockStAtRowSecLe_1","ZcudChassisCANFD2SignalIPdu004",4},
				{"igHznEdge_1","ZcudChassisCANFD2SignalIPdu004",224},
				{"igBltLockStAtRowThrdMid_1","ZcudChassisCANFD2SignalIPdu004",20},
				{"igBltLockStAtRowSecRi_1","ZcudChassisCANFD2SignalIPdu004",12},
				{"igHmiMovgObj1_1","ZcudChassisCANFD2SignalIPdu004",67},
				{"igBltLockStAtPass_1","ZcudChassisCANFD2SignalIPdu004",26},
				{"igBltLockStAtRowSecMid_1","ZcudChassisCANFD2SignalIPdu004",0},
				{"igBltLockStAtRowThrdLe_1","ZcudChassisCANFD2SignalIPdu004",8},
				{"igBltLockStAtRowThrdRi_1","ZcudChassisCANFD2SignalIPdu004",16},
				{"igEngRunngReqByVehModMgr_0","ZcudChassisCANFD2SignalIPdu004",392}
			}
		},
		{
			"ChassisCANFD2","ZcudChassisCANFD2Fr006","Out",0x16f,64,60,1,0,0,90,14,
			{
				{"isLeFrntTireMsgTWarnFlg_0",1,96,-1},
				{"isVehCfgPrmExt2CCPBytePosn8_2",8,471,-1},
				{"isLeReTireMsgTireFillgAssiPSts_0",1,121,-1},
				{"isRiReTireMsgSysWarnFlg_0",1,170,-1},
				{"isRiReTireMsgP_0",8,159,-1},
				{"isRiFrntTireMsgP_0",8,135,-1},
				{"isPwrSplyRdyForCrkCntr",4,239,-1},
				{"isRiFrntTireMsgMsgOldFlg_0",1,147,-1},
				{"isDoorDrvrStsWithFacQlyDoorSts_0",2,76,-1},
				{"isReHvacBlowerSts_1",2,244,242},
				{"isRiReTireMsgMsgOldFlg_0",1,171,-1},
				{"isDrvrPrsntStsDrvrPrsntChks_0",8,183,-1},
				{"isVehCfgPrmBlkIDBytePosn1_3",8,287,-1},
				{"isPwrSplyRdyForCrkPwrSplyRdyForCrk",1,235,-1},
				{"isLeFrntTireMsgP_0",8,87,-1},
				{"isVehVLatQf_0",2,65,-1},
				{"isVehCfgPrmCCPBytePosn3_3",8,303,-1},
				{"isVehCfgPrmCCPBytePosn7_3",8,335,-1},
				{"isVehCfgPrmCCPBytePosn8_3",8,343,-1},
				{"isVehVLat_0",14,63,-1},
				{"isVehCfgPrmExt2CCPBytePosn7_2",8,463,-1},
				{"isVehCfgPrmExt2CCPBytePosn4_2",8,439,-1},
				{"isRiFrntTireMsgFastLoseWarnFlg_0",1,148,-1},
				{"isRiFrntTireMsgBattLoSt_0",1,149,-1},
				{"isLeReTireMsgFastLoseWarnFlg_0",1,124,-1},
				{"isLeFrntTireMsgMsgOldFlg_0",1,99,-1},
				{"isVehCfgPrmExtCCPBytePosn7_3",8,399,-1},
				{"isAmbTRawAmbTVal_3",11,199,-1},
				{"isLeFrntTireMsgTireFillgAssiPSts_0",1,97,-1},
				{"isDrvrSeatSts_0",2,219,217},
				{"isChrgnUReqSecCntr_1",4,495,-1},
				{"isPlannedPahDe_1",2,247,245},
				{"isRiReTireMsgTWarnFlg_0",1,168,-1},
				{"isVehCfgPrmCCPBytePosn6_3",8,327,-1},
				{"isLeFrntTireMsgSysWarnFlg_0",1,98,-1},
				{"isRiReTireMsgBattLoSt_0",1,173,-1},
				{"isSteerLockEnagOfPrpsn_0",2,210,208},
				{"isLeReTireMsgBattLoSt_0",1,125,-1},
				{"isDrvrPrsntStsDrvrPrsnt_0",2,187,-1},
				{"isRiReTireMsgPWarnFlg_0",2,175,-1},
				{"isVehCfgPrmExtBlkIDBytePosn1_3",8,351,-1},
				{"isPwrSplyRdyForCrkChks",8,231,-1},
				{"isRiReTireMsgT_0",8,167,-1},
				{"isLeReTireMsgTWarnFlg_0",1,120,-1},
				{"isLeReTireMsgPWarnFlg_0",2,127,-1},
				{"isSTDcDcCoolt_1",8,279,220},
				{"isVehVLgt_0",16,47,-1},
				{"isSTDcDc_1",8,271,221},
				{"isDoorDrvrStsWithFacQlyFacQly_0",2,74,-1},
				{"isRiFrntTireMsgPWarnFlg_0",2,151,-1},
				{"isVehCfgPrmExt2CCPBytePosn2_2",8,423,-1},
				{"isVehCfgPrmExt2CCPBytePosn3_2",8,431,-1},
				{"isVehCfgPrmCCPBytePosn5_3",8,319,-1},
				{"isLeFrntTireMsgFastLoseWarnFlg_0",1,100,-1},
				{"isDrvrPrsntStsDrvrPrsntQf_0",2,185,-1},
				{"isRiFrntTireMsgTWarnFlg_0",1,144,-1},
				{"isLeReTireMsgMsgOldFlg_0",1,123,-1},
				{"isVehCfgPrmExt2BlkIDBytePosn1_2",8,415,-1},
				{"isChrgnUReqSecChks_1",8,479,-1},
				{"isVehVLgtQf_0",2,79,-1},
				{"isAmbTRawQly_3",2,204,-1},
				{"isRiReTireMsgTireFillgAssiPSts_0",1,169,-1},
				{"isRiFrntTireMsgSysWarnFlg_0",1,146,-1},
				{"isVehCfgPrmExtCCPBytePosn8_3",8,407,-1},
				{"isSDcDcCoolgReq_1",3,255,252},
				{"isSDcDcMinCooltFlow_1",7,263,256},
				{"isChrgnUReqSecChrgnUReq_1",8,487,-1},
				{"isLeFrntTireMsgT_0",8,95,-1},
				{"isLeFrntTireMsgBattLoSt_0",1,101,-1},
				{"isPtTqMinReq_0",13,7,-1},
				{"isPtTqCntr_0",4,37,-1},
				{"isVehCfgPrmExtCCPBytePosn4_3",8,375,-1},
				{"isPtTqChks_0",8,29,-1},
				{"isLeReTireMsgT_0",8,119,-1},
				{"isVehCfgPrmExtCCPBytePosn5_3",8,383,-1},
				{"isVehCfgPrmExt2CCPBytePosn6_2",8,455,-1},
				{"isRiFrntTireMsgT_0",8,143,-1},
				{"isVehCfgPrmCCPBytePosn4_3",8,311,-1},
				{"isVehCfgPrmExt2CCPBytePosn5_2",8,447,-1},
				{"isDrvrPrsntStsDrvrPrsntCntr_0",4,191,-1},
				{"isRiReTireMsgFastLoseWarnFlg_0",1,172,-1},
				{"isLeFrntTireMsgPWarnFlg_0",2,103,-1},
				{"isVehCfgPrmExtCCPBytePosn3_3",8,367,-1},
				{"isVehCfgPrmExtCCPBytePosn6_3",8,391,-1},
				{"isLeReTireMsgP_0",8,111,-1},
				{"isPtTqSoftMaxReq_0",13,10,-1},
				{"isVehCfgPrmCCPBytePosn2_3",8,295,-1},
				{"isLeReTireMsgSysWarnFlg_0",1,122,-1},
				{"isVehCfgPrmExtCCPBytePosn2_3",8,359,-1},
				{"isRiFrntTireMsgTireFillgAssiPSts_0",1,145,-1}
			},
			{
				{"igPtTq_0","ZcudChassisCANFD2SignalIPdu006",33},
				{"igChrgnUReqSec_1","ZcudChassisCANFD2SignalIPdu006",491},
				{"igRiFrntTireMsg_0","ZcudChassisCANFD2SignalIPdu006",223},
				{"igPwrSplyRdyForCrk","ZcudChassisCANFD2SignalIPdu006",234},
				{"igRiReTireMsg_0","ZcudChassisCANFD2SignalIPdu006",222},
				{"igVehCfgPrmExt_3","ZcudChassisCANFD2SignalIPdu006",232},
				{"igLeFrntTireMsg_0","ZcudChassisCANFD2SignalIPdu006",201},
				{"igDrvrPrsntSts_0","ZcudChassisCANFD2SignalIPdu006",32},
				{"igVehCfgPrmExt2_2","ZcudChassisCANFD2SignalIPdu006",233},
				{"igVehV_0","ZcudChassisCANFD2SignalIPdu006",77},
				{"igLeReTireMsg_0","ZcudChassisCANFD2SignalIPdu006",200},
				{"igDoorDrvrStsWithFacQly_0","ZcudChassisCANFD2SignalIPdu006",72},
				{"igVehCfgPrm_3","ZcudChassisCANFD2SignalIPdu006",216},
				{"igAmbTRaw_3","ZcudChassisCANFD2SignalIPdu006",202}
			}
		},
		{
			"ChassisCANFD2","ZcudChassisCANFD2ResdFr04","Out",0x159,64,50,1,0,0,30,1,
			{
				{"isZCUDMResdSig13_0",16,95,443},
				{"isZCUDMResdSig20_0",16,223,451},
				{"isZCUDMResdSig3_0",16,335,459},
				{"isZCUDMResdSig8_0",16,415,470},
				{"isZCUDMResdSig28SafetyChks_0",8,479,-1},
				{"isZCUDMResdSig23_0",16,271,448},
				{"isZCUDMResdSig7_0",16,399,471},
				{"isZCUDMResdSig4_0",16,351,458},
				{"isZCUDMResdSig5_0",16,367,457},
				{"isZCUDMResdSig17_0",16,159,455},
				{"isZCUDMResdSig22_0",16,255,449},
				{"isZCUDMResdSig28SafetyCntr_0",4,467,-1},
				{"isZCUDMResdSig2_0",16,207,452},
				{"isZCUDMResdSig27_0",24,7,460},
				{"isZCUDMResdSig10_0",16,47,446},
				{"isZCUDMResdSig18_0",16,175,454},
				{"isZCUDMResdSig19_0",16,191,453},
				{"isZCUDMResdSig26_0",16,319,461},
				{"isZCUDMResdSig16_0",16,143,440},
				{"isZCUDMResdSig28SafetyUInt32_0",32,487,-1},
				{"isZCUDMResdSig24_0",16,287,463},
				{"isZCUDMResdSig25_0",16,303,462},
				{"isZCUDMResdSig11_0",16,63,445},
				{"isZCUDMResdSig12_0",16,79,444},
				{"isZCUDMResdSig14_0",16,111,442},
				{"isZCUDMResdSig21_0",16,239,450},
				{"isZCUDMResdSig15_0",16,127,441},
				{"isZCUDMResdSig6_0",16,383,456},
				{"isZCUDMResdSig9_0",16,431,469},
				{"isZCUDMResdSig1_0",16,31,447}
			},
			{
				{"igZCUDMResdSig28Safety_0","ZcudChassisCANFD2ResdSignalIpdu04",468}
			}
		},
		{
			"ChassisCANFD2","ZcudChassisCANFD2Fr014","Out",0x59,64,10,1,0,0,27,4,
			{
				{"isPosnFromSatltPosnLgt_1",31,7,-1},
				{"isPosnFromSatltTiForMins_1",6,165,-1},
				{"isPosnFromSatltPosnSpd_1",17,72,-1},
				{"isCrashStsSafeSts_2",1,219,-1},
				{"isPosnFromSatltUTCForMth_1",4,195,-1},
				{"isPosnFromSatltPosnLat_1",30,24,-1},
				{"isPosnFromSatltUTCForHr_1",5,184,-1},
				{"isPosnFromSatltPosnVHozl_1",17,103,-1},
				{"isMAIAccInhitReqCntr_1",4,239,-1},
				{"isGVMCPrpsnTqDistbnReqAtAxleReChks_0",8,247,-1},
				{"isPosnFromSatltUTCForMins_1",6,169,-1},
				{"isGVMCPrpsnTqDistbnReqAtAxleReCtrlMod_0",1,265,-1},
				{"isPosnFromSatltPosnAlti_1",16,118,-1},
				{"isPosnFromSatltPosnDir_1",16,134,-1},
				{"isPosnFromSatltUTCForYr_1",7,156,-1},
				{"isPosnFromSatltUTCForSec_1",6,179,-1},
				{"isPosnFromSatltTiForMsec_1",10,150,-1},
				{"isGVMCPrpsnTqDistbnReqAtAxleReDistReq_0",18,255,-1},
				{"isPosnFromSatltTiForSec_1",6,175,-1},
				{"isPosnFromSatltCntr_1",3,207,-1},
				{"isPosnFromSatltPosnVVert_1",18,58,-1},
				{"isPosnFromSatltUTCForDay_1",5,189,-1},
				{"isCrashStsSafeCntr_2",4,223,-1},
				{"isMAIAccInhitReqChks_1",8,231,-1},
				{"isGVMCPrpsnTqDistbnReqAtAxleReCntr_0",4,269,-1},
				{"isCrashStsSafeChks_2",8,215,-1},
				{"isMAIAccInhitReqMAIAccInhitReq_1",1,235,-1}
			},
			{
				{"igPosnFromSatlt_1","ZcudChassisCANFD2SignalIPdu014",204},
				{"igMAIAccInhitReq_1","ZcudChassisCANFD2SignalIPdu014",217},
				{"igGVMCPrpsnTqDistbnReqAtAxleRe_0","ZcudChassisCANFD2SignalIPdu014",264},
				{"igCrashStsSafe_2","ZcudChassisCANFD2SignalIPdu014",218}
			}
		},
		{
			"ChassisCANFD2","ZcudChassisCANFD2Fr010","Out",0x23d,64,100,1,0,0,72,11,
			{
				{"isImobEngMgrReq1ImobEngDataMgrReq5_0",8,47,-1},
				{"isHznProfLongLRControlPoint_1",1,410,-1},
				{"isDoorLeReCinhIntFailInfCinchFlt1_0",1,204,-1},
				{"isWinFailrStsAtDrvr_0",1,113,112},
				{"isVehTiAndDataDay_0",5,140,-1},
				{"isHznPosnLRCurrentLane_1",3,341,-1},
				{"isHznPosnLRPositionProbability_1",5,330,-1},
				{"isBDCstCntr_0",4,463,-1},
				{"isVehTiAndDataDataValid_0",1,158,-1},
				{"isOxygenSplyReq_1",2,181,179},
				{"isBDCstChks_0",8,455,-1},
				{"isHznPosnLRPositionIndex_1",2,346,-1},
				{"isImobEngMgrReq3ImobEngMgrCmdTar1_0",2,116,-1},
				{"isVehTiAndDataSec1_0",6,130,-1},
				{"isDoorLeReCinhIntFailInfCinchRestFlt_0",1,203,-1},
				{"isImobEngMgrReq3ImobEngDataMgrReq5_0",8,100,-1},
				{"isVehTiAndDataMins1_0",6,120,-1},
				{"isShowTypOfDTESet_1",2,423,421},
				{"isImobEngMgrReq1ImobEngDataMgrReq3_0",8,31,-1},
				{"isImobEngMgrReq3ImobEngDataMgrReq2_0",8,76,-1},
				{"isHznPosnLRPositionConfidence_1",3,351,-1},
				{"isHmiAirDistbnRow1_1",3,268,265},
				{"isHznPosnLRMessageType_1",3,338,-1},
				{"isHznPosnLRSpeed_1",9,305,-1},
				{"isHznPosnLRRelativeHeading_1",8,312,-1},
				{"isTCSDcdcactvdReq_0",2,271,269},
				{"isHznPosnLRCyclicCounter_1",2,348,-1},
				{"isVehTiAndDataMth1_0",4,146,-1},
				{"isULoWarnLvPwrErrULoWarn_0",2,183,-1},
				{"isImobEngMgrReq1ImobEngDataMgrReq2_0",8,23,-1},
				{"isImobEngMgrReq1ImobEngDataMgrReq0_0",8,7,-1},
				{"isSuspStabyCritFailrDetdChks_0",8,231,-1},
				{"isPwrCnsForHvacFanRe_1",11,439,444},
				{"isImobEngMgrReq1ImobEngDataMgrReq6_0",8,55,-1},
				{"isVehTiAndDataYr1_0",7,127,-1},
				{"isSuspStabyCritFailrDetdSts_0",1,235,-1},
				{"isPVMCToBrkReqChks_0",8,191,-1},
				{"isULoWarnLvPwrErrLVPwrSplyErrSts_0",4,171,-1},
				{"isTireRdEstimd_0",10,250,256},
				{"isPwrCnsForHvacFanFrnt_1",11,418,419},
				{"isULoWarnLvPwrErrCntr_0",4,175,-1},
				{"isVehTiAndDataHr1_0",5,151,-1},
				{"isHznProfLongLRUpdate_1",1,408,-1},
				{"isBDCstBDCst_0",3,442,-1},
				{"isImobEngMgrReq3ImobEngDataMgrReq4_0",8,92,-1},
				{"isImobEngMgrReq3ImobEngDataMgrReq1_0",8,68,-1},
				{"isHznProfLongLROffset_1",13,391,-1},
				{"isDoorDrvrCinhIntFailInfCinchRestFlt_0",1,155,-1},
				{"isHznProfLongLRCyclicCounter_1",2,412,-1},
				{"isHznPosnLRPositionAge_1",9,298,-1},
				{"isSuspStabyCritFailrDetdCntr_0",4,239,-1},
				{"isDoorDrvrCinhIntFailInfCinchFlt1_0",1,156,-1},
				{"isHznProfLongLRRetransmission_1",1,409,-1},
				{"isHznProfLongLRPathIndex_1",6,394,-1},
				{"isRollRes_0",16,215,177},
				{"isHznPosnLRPathIndex_1",6,320,-1},
				{"isULoWarnLvPwrErrChks_0",8,167,-1},
				{"isImobEngMgrReq3ImobEngDataMgrReq3_0",8,84,-1},
				{"isImobEngMgrReq1ImobEngDataMgrReq4_0",8,39,-1},
				{"isAmbTURaw_0",12,247,251},
				{"isHznProfLongLRMessageType_1",3,415,-1},
				{"isPVMCToBrkReqCntr_0",4,199,-1},
				{"isImobEngMgrReq3ImobEngDataMgrReq0_0",8,60,-1},
				{"isHznPosnLROffset_1",13,295,-1},
				{"isPVMCToBrkReqPVMCTrctnCtrlLvlReq_0",3,192,-1},
				{"isImobEngMgrReq1ImobEngDataMgrReq1_0",8,15,-1},
				{"isHznProfLongLRValue_1",32,359,-1},
				{"isImobEngMgrReq3ImobEngDataMgrReq6_0",8,108,-1},
				{"isImobEngMgrReq1ImobEngMgrCmdTar1_0",2,63,-1},
				{"isWinFailrStsAtReLe_0",1,153,152},
				{"isHznProfLongLRProfileType_1",5,404,-1},
				{"isPVMCToBrkReqPVMCStbltyCtrlLvlReq_0",3,195,-1}
			},
			{
				{"igDoorDrvrCinhIntFailInf_0","ZcudChassisCANFD2SignalIPdu010",154},
				{"igPVMCToBrkReq_0","ZcudChassisCANFD2SignalIPdu010",205},
				{"igImobEngMgrReq3_0","ZcudChassisCANFD2SignalIPdu010",114},
				{"igHznProfLongLR_1","ZcudChassisCANFD2SignalIPdu010",176},
				{"igBDCst_0","ZcudChassisCANFD2SignalIPdu010",443},
				{"igSuspStabyCritFailrDetd_0","ZcudChassisCANFD2SignalIPdu010",234},
				{"igVehTiAndData_0","ZcudChassisCANFD2SignalIPdu010",157},
				{"igDoorLeReCinhIntFailInf_0","ZcudChassisCANFD2SignalIPdu010",202},
				{"igULoWarnLvPwrErr_0","ZcudChassisCANFD2SignalIPdu010",264},
				{"igImobEngMgrReq1_0","ZcudChassisCANFD2SignalIPdu010",61},
				{"igHznPosnLR_1","ZcudChassisCANFD2SignalIPdu010",344}
			}
		},
		{"ChassisCANFD2","ZcudToRbcmJ1979OBDChasCanFD2ReqFr","Out",0x7e6,8,0,1,4,0},
		{"ChassisCANFD2","ZcudToEcmChasCanFD2DiagReqFrame","Out",0x710,64,0,1,4,0},
		{
			"ChassisCANFD2","ZcudChassisCANFD2Fr018","Out",0x335,64,450,1,0,0,19,2,
			{
				{"isPinionSteerAgGroupForBkpSteerWhlTqForBkp_1",14,109,-1},
				{"isSteerWhlTqAddl_1",14,135,137},
				{"isPinionSteerAgGroupSteerWhlTq_1",14,45,-1},
				{"isPinionSteerAgGroupForBkpPinionSteerAgQfForBkp_1",2,95,-1},
				{"isPinionSteerAgGroupPinionSteerAgSpd1_1",14,29,-1},
				{"isPinionSteerAgGroupForBkpPinionSteerAgSpdQfForBkp_1",2,111,-1},
				{"isPinionSteerAgGroupPinionSteerAg1Qf_1",2,31,-1},
				{"isPinionSteerAgGroupPinionSteerAgSpd1Qf_1",2,47,-1},
				{"isPinionSteerAgGroupChks_1",8,23,-1},
				{"isTqAssAddl_1",14,175,177},
				{"isPinionSteerAgGroupForBkpPinionSteerAgSpdForBkp_1",14,93,-1},
				{"isPinionSteerAgGroupForBkpCntr_1",4,127,-1},
				{"isPinionSteerAgGroupForBkpPinionSteerAgForBkp_1",15,70,-1},
				{"isPinionSteerAgGroupForBkpChks_1",8,87,-1},
				{"isPinionSteerAgGroupSteerWhlTqQf_1",2,59,-1},
				{"isPinionSteerAgGroupPinionSteerAg1_1",15,6,-1},
				{"isPinionSteerAgGroupForBkpSteerWhlTqQfForBkp_1",2,123,-1},
				{"isPinionSteerAgGroupCntr_1",4,63,-1},
				{"isTotDstTrvld_1",25,136,121}
			},
			{
				{"igPinionSteerAgGroupForBkp_1","ZcudChassisCANFD2SignalIPdu018",71},
				{"igPinionSteerAgGroup_1","ZcudChassisCANFD2SignalIPdu018",7}
			}
		},
		{
			"ChassisCANFD2","ZcudChassisCANFD2Fr002","Out",0x4f,64,10,1,0,0,69,13,
			{
				{"isBBWEpbActnReqEpbActnReq",2,491,-1},
				{"isBDSLvlCntr",4,475,-1},
				{"isADataRawSafeALgt_2",15,8,-1},
				{"isADataRawSafeAVert_2",15,25,-1},
				{"isGVMCBrkTqReqFrntLeCtrlMod_0",2,275,-1},
				{"isAgDataRawSafeRollRateQf_2",2,139,-1},
				{"isADataRawSafeAVertQf_2",2,58,-1},
				{"isAgDataRawSafeYawRateQf_2",2,137,-1},
				{"isSteerWhlSnsrAg_1",15,383,-1},
				{"isRainfallAmnt_2",4,324,320},
				{"isDrvrGearShiftParkReqSts_1",2,339,-1},
				{"isDrvrGearShiftParkReq1_1",1,337,-1},
				{"isGVMCBrkTqReqWhlVAgrMinReqReLe_0",16,191,-1},
				{"isAgDataRawSafeChks_2",8,135,-1},
				{"isSteerWhlSnsrCntr_1",4,410,-1},
				{"isGVMCBrkTqReqFrntRi_0",12,227,-1},
				{"isADataRawSafeChks_2",8,42,-1},
				{"isBBWEpbActnReqCntr",4,495,-1},
				{"isBDSLvlBDSLvl",4,479,-1},
				{"isAgDataRaw2SafePitchRateQf_1",2,91,-1},
				{"isAgDataRawSafeRollRate_2",16,103,-1},
				{"isAgDataRaw2SafePitchRate_1",16,71,-1},
				{"isGVMCBrkTqDeltaReqPtBrkTqRgnAtAxleReAct_0",15,455,-1},
				{"isAgDataRawSafeCntr_2",4,143,-1},
				{"isADataRawSafeALat_2",15,7,-1},
				{"isTrlrPrsnt_2",1,354,353},
				{"isGVMCBrkTqReqReRiCtrlMod_0",2,285,-1},
				{"isRollAgGlbVal_0",16,311,-1},
				{"isGVMCBrkTqDeltaReqQf_0",2,433,-1},
				{"isPitchAgGlbVal_0",16,282,-1},
				{"isGVMCBrkTqReqFrntLe_0",12,223,-1},
				{"isAgDataRaw2SafeChks_1",8,87,-1},
				{"isGVMCBrkTqReqChks_0",8,271,-1},
				{"isGVMCBrkTqReqWhlVAgrMinReqReRi_0",16,207,-1},
				{"isGVMCBrkTqReqReRi_0",12,251,-1},
				{"isSteerWhlSnsrAgSpd_1",14,384,-1},
				{"isPitchAgGlbQf_0",2,298,-1},
				{"isRollAgGlbQf_0",2,327,-1},
				{"isGVMCBrkTqDeltaReqCntr_0",4,437,-1},
				{"isAutnmsLgtCtrlActv",1,439,438},
				{"isGearPrkgAssiReqGroupGearPrkgAssiReq1_1",2,371,-1},
				{"isGVMCBrkTqReqReLe_0",12,247,-1},
				{"isCrashSts2_2",2,505,488},
				{"isGVMCBrkTqDeltaReqChks_0",8,447,-1},
				{"isADataRawSafeALgt1Qf_2",2,60,-1},
				{"isDrvrGearShiftParkReqChks_1",8,335,-1},
				{"isGearPrkgAssiReqGroupChks_1",8,367,-1},
				{"isGVMCBrkTqReqReLeCtrlMod_0",2,287,-1},
				{"isADataRawSafeCntr_2",4,50,-1},
				{"isSteerWhlSnsrChks_1",8,402,-1},
				{"isGVMCBrkTqReqWhlVAgrMinReqFrntLe_0",16,159,-1},
				{"isSuspHeiLvlIndcn_0",3,151,148},
				{"isAgDataRaw2SafeCntr_1",4,95,-1},
				{"isBDSLvlChks",8,471,-1},
				{"isBBWEpbInhbRelsReqOnOff",1,507,-1},
				{"isGVMCBrkTqReqWhlVAgrMinReqFrntRi_0",16,175,-1},
				{"isSuspHeiLvlSet_1",3,147,144},
				{"isADataRawSafeALat1Qf_2",2,62,-1},
				{"isDrvrGearShiftParkReqCntr_1",4,343,-1},
				{"isGVMCBrkTqReqFrntRiCtrlMod_0",2,273,-1},
				{"isGearPrkgAssiReqGroupCntr_1",4,375,-1},
				{"isAutHldHandoverToBrk",1,352,368},
				{"isBBWEpbInhbRelsReqChks",8,503,-1},
				{"isBBWEpbActnReqChks",8,487,-1},
				{"isGVMCBrkTqReqCntr_0",4,279,-1},
				{"isAgDataRawSafeYawRate_2",16,119,-1},
				{"isBBWEpbInhbRelsReqCntr",4,511,-1},
				{"isSteerWhlSnsrQf_1",2,422,-1},
				{"isPrpsnHvBattUsgOfChrgTarSOC_1",10,419,425}
			},
			{
				{"igBBWEpbInhbRelsReq","ZcudChassisCANFD2SignalIPdu002",506},
				{"igADataRawSafe_2","ZcudChassisCANFD2SignalIPdu002",56},
				{"igDrvrGearShiftParkReq_1","ZcudChassisCANFD2SignalIPdu002",336},
				{"igAgDataRawSafe_2","ZcudChassisCANFD2SignalIPdu002",88},
				{"igGearPrkgAssiReqGroup_1","ZcudChassisCANFD2SignalIPdu002",369},
				{"igGVMCBrkTqDeltaReq_0","ZcudChassisCANFD2SignalIPdu002",456},
				{"igRollAgGlb_0","ZcudChassisCANFD2SignalIPdu002",325},
				{"igGVMCBrkTqReq_0","ZcudChassisCANFD2SignalIPdu002",283},
				{"igPitchAgGlb_0","ZcudChassisCANFD2SignalIPdu002",296},
				{"igBDSLvl","ZcudChassisCANFD2SignalIPdu002",424},
				{"igAgDataRaw2Safe_1","ZcudChassisCANFD2SignalIPdu002",89},
				{"igSteerWhlSnsr_1","ZcudChassisCANFD2SignalIPdu002",420},
				{"igBBWEpbActnReq","ZcudChassisCANFD2SignalIPdu002",489}
			}
		},
		{"ChassisCANFD2","ZcudChassisCANFD2PduR300Fr004","Out",0x340,64,0,1,1,0},
		{
			"ChassisCANFD2","ZcudChassisCANFD2Fr016","Out",0x2a4,64,200,1,0,0,21,1,
			{
				{"isCmptmtRelHum_0",8,111,84},
				{"isEPBLockMgrReq2Data2_0",8,47,-1},
				{"isEPBLockMgrReq2Data6_0",8,79,-1},
				{"isTCSCooltFlowReq_0",7,95,88},
				{"isEPBLockMgrReq2Data1_0",8,39,-1},
				{"isURateUpRampMax",6,127,121},
				{"isEPBLockMgrReq2Data5_0",8,71,-1},
				{"isChrgnUReqMax_0",8,23,9},
				{"isPwrLimnLampReq",1,15,14},
				{"isTCSCooltTReq_0",8,103,8},
				{"isSolarSnsrRiValue_1",8,143,0},
				{"isSolarSnsrVluQf_0",1,7,6},
				{"isEPBLockMgrReq2Data0_0",8,31,-1},
				{"isSolarSnsrLeValue_1",8,135,1},
				{"isChrgnUReqMin",8,119,83},
				{"isEPBLockMgrReq2Cmd_0",2,87,-1},
				{"isEPBLockMgrReq2Data3_0",8,55,-1},
				{"isEPBLockMgrReq2Data4_0",8,63,-1},
				{"isSecBattU_1",9,151,158},
				{"isRelHumSnsrQf_0",1,13,12},
				{"isGearShiftUnitSts_1",3,5,2}
			},
			{
				{"igEPBLockMgrReq2_0","ZcudChassisCANFD2SignalIPdu016",85}
			}
		},
		{
			"ChassisCANFD2","ZcudChassisCANFD2Fr009","Out",0x3f5,64,900,1,0,0,18,3,
			{
				{"isTiAndDateIndcnYr1_1",7,58,-1},
				{"isTiAndDateIndcnMth1_1",4,93,-1},
				{"isTiAndDateIndcnHr1_1",5,82,-1},
				{"isEngPwrAllwdDeltaWdCmd",12,38,42},
				{"isRoadLoadNomCoeff2_0",10,130,-1},
				{"isPtDrvrSetg_1",4,175,171},
				{"isTiAndDateIndcnMins1_1",6,67,-1},
				{"isPwrAvlRednWdSts",12,55,59},
				{"isVehBattUSysUQf_1",2,111,-1},
				{"isRoadLoadNomCoeff1_0",10,124,-1},
				{"isTiAndDateIndcnDataValid_1",1,89,-1},
				{"isRoadLoadNomCoeffSts_0",1,136,-1},
				{"isTiAndDateIndcnSec1_1",6,77,-1},
				{"isTiAndDateIndcnDay_1",5,87,-1},
				{"isCarTiGlb_1",32,7,39},
				{"isRoadLoadNomCoeff0_0",11,119,-1},
				{"isBkpOfDstTrvld_2",21,151,162},
				{"isVehBattUSysU_1",8,103,-1}
			},
			{
				{"igVehBattU_1","ZcudChassisCANFD2SignalIPdu009",109},
				{"igRoadLoadNom_0","ZcudChassisCANFD2SignalIPdu009",108},
				{"igTiAndDateIndcn_1","ZcudChassisCANFD2SignalIPdu009",88}
			}
		},
		{"ChassisCANFD2","ZcudChassisCANFD2ResdFr01","Out",0x150,64,0,1,1,0},
		{"ChassisCANFD2","ZcudChassisCANFD2PduR40Fr001","Out",0x15a,64,0,1,1,0},
		{
			"ChassisCANFD2","ZcudChassisCANFD2Fr015","Out",0x35c,64,450,1,0,0,40,3,
			{
				{"isListOfNodAv3_1",32,127,-1},
				{"isListOfNodAv1_1",32,63,-1},
				{"isIntgtIMUDataRawSafeCntr_1",4,435,-1},
				{"isTCSFltSts_0",4,13,9},
				{"isIntgtIMUDataRawSafeRollRate_1",16,351,-1},
				{"isTCSRadrTSts_0",8,39,52},
				{"isIntgtIMUDataRawSafeAvert_1",15,398,-1},
				{"isBltLockStSafeAtDrvrChks_1",8,463,-1},
				{"isIntgtIMUDataRawSafeChks_1",8,431,-1},
				{"isTCSTNowSts_0",8,47,51},
				{"isIntgtIMUDataRawSafeYawRate_1",16,367,-1},
				{"isListOfNodAv2_1",32,95,-1},
				{"isIntgtIMUDataRawSafeALat_1",15,383,-1},
				{"isTCSRadrTreq_0",8,31,8},
				{"isBrkPedlSts_1",1,320,464},
				{"isTCSnsrTSts_0",8,23,0},
				{"isListOfNodAv8_1",32,287,-1},
				{"isIntgtIMUDataRawSafeALgt1Qf_1",2,437,-1},
				{"isBltLockStSafeAtDrvrBltLockSt1_1",1,467,-1},
				{"isHMIAutoShowModSet_1",1,50,49},
				{"isIntgtIMUDataRawSafePitchRate_1",16,415,-1},
				{"isIntgtIMUDataRawSafeAVertQf_1",2,447,-1},
				{"isTCSModSwtSts_0",2,55,53},
				{"isLocalBookChrgnTarVal_1",10,315,321},
				{"isListOfNodAv6_1",32,223,-1},
				{"isIntgtIMUDataRawSafeALat1Qf_1",2,439,-1},
				{"isListOfNodAv7_1",32,255,-1},
				{"isActvnOfWelcomeLi_1",1,7,6},
				{"isTCSDoorSts_0",1,15,14},
				{"isBltLockStSafeAtDrvrCntr_1",4,471,-1},
				{"isListOfNodAv5_1",32,191,-1},
				{"isTCScoolgGrdReq_0",4,5,1},
				{"isListOfNodAv4_1",32,159,-1},
				{"isTelmBookChrgnTyp_1",3,319,316},
				{"isBattURaw_1",9,440,441},
				{"isIntgtIMUDataRawSafePitchRateQf_1",2,384,-1},
				{"isIntgtIMUDataRawSafeYawRateQf_1",2,443,-1},
				{"isIntgtIMUDataRawSafeALgt_1",15,334,-1},
				{"isBltLockStSafeAtDrvrBltLockStErrSts_1",1,466,-1},
				{"isIntgtIMUDataRawSafeRollRateQf_1",2,445,-1}
			},
			{
				{"igIntgtIMUDataRawSafe_1","ZcudChassisCANFD2SignalIPdu015",335},
				{"igListOfNodAv_1","ZcudChassisCANFD2SignalIPdu015",48},
				{"igBltLockStSafeAtDrvr_1","ZcudChassisCANFD2SignalIPdu015",465}
			}
		},
		{"ChassisCANFD2","ZcudToAllFuncJ1979OBDChasCanFD1ReqFr","Out",0x7df,8,0,1,4,0},
		{
			"ChassisCANFD2","ZcudChassisCANFD2Fr003","Out",0xdf,64,20,1,0,0,66,11,
			{
				{"isPVMCVehCtrlSts1Cntr_0",4,219,-1},
				{"isPVMCVehCtrlSts1PwrAssiDriftModFctSts_0",3,242,-1},
				{"isWipgInfoWiprActv_0",1,372,-1},
				{"isPVMCVehCtrlSts3RoadTypAndFricDetnFctSts_0",3,278,-1},
				{"isCRBSADError",4,383,256},
				{"isBrkPedlSnsrChks_0",8,127,-1},
				{"isVehMNomTrlrM_0",2,303,-1},
				{"isDoorDrvrSts_1",2,314,328},
				{"isPVMCVehCtrlSts1SteerAssiDriftModFctSts_0",3,262,-1},
				{"isBBWMaiEMFltStsEMFltSts",2,51,-1},
				{"isWipgInfoWiprInWipgAr_0",1,371,-1},
				{"isBattIShrtAvb_1",16,31,22},
				{"isPVMCVehCtrlSts1SplitMueFctSts_0",3,249,-1},
				{"isBrkPedlSnsrQf_0",2,131,-1},
				{"isBrkLiReqAcbBrkLiOnReqSts",1,351,-1},
				{"isBrkPedlValBrkPedlVal_0",15,299,-1},
				{"isPVMCVehCtrlSts3OffRoadCrsCtrlFctSts_0",3,265,-1},
				{"isPVMCVehCtrlSts3GetOutOfStuckFctSts_0",3,268,-1},
				{"isGearSapaToProReqGearPrkgAssiReq1",2,147,-1},
				{"isDiagcAllwd",1,170,169},
				{"isDoorRiReSts_0",2,370,368},
				{"isCRBSADSts",2,193,312},
				{"isTrSts_1",2,379,390},
				{"isSpdLimOfRoad_1",8,183,17},
				{"isVehMNomVehM_0",14,285,-1},
				{"isPVMCVehCtrlSts1OffTrackInhbnInAFctSts_0",3,235,-1},
				{"isManSyncnIndcnReqR1_1",2,159,157},
				{"isGearSapaToProReqCntr",4,151,-1},
				{"isPVMCVehCtrlSts1CoreFctSts_0",3,245,-1},
				{"isPVMCVehCtrlSts1SideWindStabyFctSts_0",3,252,-1},
				{"isPVMCVehCtrlSts1BMxSFctSts_0",3,228,-1},
				{"isBrkLiReqAcbChks",8,343,-1},
				{"isGearSapaToProReqChks",8,143,-1},
				{"isSuspFailrStsChks_0",8,98,-1},
				{"isDoorPassSts_1",2,362,360},
				{"isBrkLiReqAcbCntr",4,350,-1},
				{"isBBWMaiEMFltStsCntr",4,55,-1},
				{"isBrkPedlSnsrCntr_0",4,135,-1},
				{"isPVMCVehCtrlSts1TrackModFctSts_0",3,259,-1},
				{"isPVMCVehCtrlSts3VehRollStabyFctSts_0",3,272,-1},
				{"isVehMNomVehMQly_0",2,301,-1},
				{"isTankFlapLockSts_1",1,65,64},
				{"isUSecDcDcActHiSide_1",13,191,194},
				{"isDoorLeReSts_0",2,346,344},
				{"isSuspFailrStsCntr_0",4,106,-1},
				{"isSetSpdForCrsCtrlFct_1",12,167,171},
				{"isVehSpdIndcdVehSpdIndcd_1",9,207,-1},
				{"isPVMCVehCtrlSts1Chks_0",8,211,-1},
				{"isBattIMidAvb_1",16,7,23},
				{"isRWSDrvrModAct_0",2,21,19},
				{"isSuspFailrStsTypQf_0",2,115,-1},
				{"isPVMCVehCtrlSts1ManDriftModFctSts_0",3,238,-1},
				{"isSteerAgLimnRe_0",15,327,391},
				{"isBrkPedlValQf_0",2,316,-1},
				{"isPVMCVehCtrlSts1E2EFctSts_0",3,225,-1},
				{"isVehSpdIndcdVeSpdIndcdUnit_1",2,214,-1},
				{"isSuspFailrStsSuspFailrSts_0",3,118,-1},
				{"isBrkPedlSnsrSt_0",2,129,-1},
				{"isPVMCVehCtrlSts1SideWindPreFctSts_0",3,232,-1},
				{"isBBWMaiEMFltStsChks",8,47,-1},
				{"isPVMCVehCtrlSts1AEBFctSts_0",3,231,-1},
				{"isPVMCVehCtrlSts3TVCPrpsnDistbnFrntReFctSts_0",3,275,-1},
				{"isPVMCVehCtrlSts3EarlyWarnAndDynCtrlFctSts_0",3,271,-1},
				{"isSecCnvnReq_1",3,156,153},
				{"isPVMCVehCtrlSts1RWSAgActrSts_0",3,255,-1},
				{"isWipgInfoWipgSpdInfo_0",3,375,-1}
			},
			{
				{"igBBWMaiEMFltSts","ZcudChassisCANFD2SignalIPdu003",49},
				{"igVehSpdIndcd_1","ZcudChassisCANFD2SignalIPdu003",212},
				{"igBrkPedlSnsr_0","ZcudChassisCANFD2SignalIPdu003",18},
				{"igBrkPedlVal_0","ZcudChassisCANFD2SignalIPdu003",168},
				{"igBrkLiReqAcb","ZcudChassisCANFD2SignalIPdu003",16},
				{"igGearSapaToProReq","ZcudChassisCANFD2SignalIPdu003",145},
				{"igPVMCVehCtrlSts1_0","ZcudChassisCANFD2SignalIPdu003",376},
				{"igWipgInfo_0","ZcudChassisCANFD2SignalIPdu003",388},
				{"igVehMNom_0","ZcudChassisCANFD2SignalIPdu003",389},
				{"igPVMCVehCtrlSts3_0","ZcudChassisCANFD2SignalIPdu003",377},
				{"igSuspFailrSts_0","ZcudChassisCANFD2SignalIPdu003",113}
			}
		},
		{"ChassisCANFD2","ZcudToRbcmChasCanFD2DiagReqFrame","Out",0x713,64,0,1,4,0},
		{
			"ChassisCANFD2","ZcudChassisCANFD2Fr008","Out",0xe5,64,30,1,0,0,70,6,
			{
				{"isPVMCVehCtrlSts6SuspStfnReRiActrSts_0",3,294,-1},
				{"isPVMCVehCtrlSts2TankTurnFctSts_0",3,145,-1},
				{"isPVMCVehCtrlSts2Chks_0",8,107,-1},
				{"isPrpsnTqForBrkRels_0",15,383,384},
				{"isPVMCVehCtrlSts2DecelReqActrSts_0",3,134,-1},
				{"isPVMCVehCtrlSts4FWSAgActrSts_0",3,192,-1},
				{"isPVMCVehCtrlSts4FWSTqActrSts_0",3,205,-1},
				{"isPVMCVehCtrlSts6Chks_0",8,263,-1},
				{"isPVMCVehCtrlSts4EmgyBrkActrSts_0",3,198,-1},
				{"isWhlAFrntMax_0",8,415,248},
				{"isPVMCVehCtrlSts4BrkTqReLeActrSts_0",3,178,-1},
				{"isPVMCVehCtrlSts2BbWBackUpFctSts_0",3,141,-1},
				{"isPVMCVehCtrlSts2LowSpdStrFctSts_0",3,128,-1},
				{"isPtTqSoftMaxGenn2AllwdChks_0",8,338,-1},
				{"isPVMCVehCtrlSts5SuspDmpgFrntRiActrSts_0",3,314,-1},
				{"isFltTSecDcDc_1",1,447,446},
				{"isTqRednDurgCllsnMtgtnByBrkg_0",2,290,288},
				{"isPVMCVehCtrlSts5PrpsnTqLimnActrSts_0",3,310,-1},
				{"isFltElecSecDcDc_1",1,417,416},
				{"isPVMCVehCtrlSts6SuspStfnReLeActrSts_0",3,281,-1},
				{"isPVMCVehCtrlSts6SuspStfnFrntLeActrSts_0",3,287,-1},
				{"isPVMCVehCtrlSts2SbWBackUpLgtFctSts_0",3,148,-1},
				{"isEpbApplyAutSetg_1",1,401,400},
				{"isPtTqSoftMaxGenn2AllwdCntr_0",4,346,-1},
				{"isWhlTqDifMaxReGrdtMin_0",13,226,-1},
				{"isPVMCVehCtrlSts4Cntr_0",4,175,-1},
				{"isPVMCVehCtrlSts4SpdLimFctSts_0",3,215,-1},
				{"isPVMCVehCtrlSts4ACCFctSts_0",3,171,-1},
				{"isWhlTqDifMaxReCntr_0",4,253,-1},
				{"isPVMCVehCtrlSts5BrkTqDeltaActrSts_0",3,303,-1},
				{"isPVMCVehCtrlSts6SuspHeiFrntLeActrSts_0",3,267,-1},
				{"isPVMCVehCtrlSts2FloatingDrvgFctSts_0",3,131,-1},
				{"isSnsrCfg",4,357,353},
				{"isPVMCtoTVCTqFilMod",3,211,208},
				{"isPVMCVehCtrlSts2BrkDiscClngFctSts_0",3,151,-1},
				{"isPVMCVehCtrlSts2VDSWFctSts_0",3,138,-1},
				{"isHmiMaxEvMod_1",1,420,419},
				{"isEpbSoftSwtCtrlSt_1",3,428,425},
				{"isPVMCVehCtrlSts5PrpsnTqDistbnFrntReActrSts_0",3,300,-1},
				{"isPVMCVehCtrlSts5SplrReActvActrSts_0",3,304,-1},
				{"isPassSeatSts2_1",2,431,429},
				{"isPVMCVehCtrlSts5PrpsnTqTotActrSts_0",3,307,-1},
				{"isPVMCVehCtrlSts2CrabMovgFctSts_0",3,124,-1},
				{"isWhlTqDifMaxReGrdtMax_0",13,223,-1},
				{"isWhlTqDifMaxReChks_0",8,245,-1},
				{"isPVMCVehCtrlSts4Chks_0",8,167,-1},
				{"isPVMCVehCtrlSts4PCASFctSts_0",3,202,-1},
				{"isPVMCVehCtrlSts2Cntr_0",4,115,-1},
				{"isPVMCVehCtrlSts5SuspDmpgReLeActrSts_0",3,327,-1},
				{"isPVMCVehCtrlSts6SuspHeiFrntRiActrSts_0",3,264,-1},
				{"isPVMCVehCtrlSts4BrkTqTotActrSts_0",3,188,-1},
				{"isPVMCVehCtrlSts4BrkTqFrntRiActrSts_0",3,181,-1},
				{"isPVMCVehCtrlSts4BrkTqReRiActrSts_0",3,191,-1},
				{"isPVMCVehCtrlSts6Cntr_0",4,271,-1},
				{"isPVMCVehCtrlSts4PCASPreFctSts_0",3,185,-1},
				{"isPVMCVehCtrlSts6SuspHeiReRiActrSts_0",3,274,-1},
				{"isPVMCVehCtrlSts5PrpsnTqDistbnReAxleActrSts_0",3,297,-1},
				{"isPVMCVehCtrlSts2ViolentModFctSts_0",3,155,-1},
				{"isPtTqSoftMaxGenn2Allwd_0",13,335,-1},
				{"isPVMCVehCtrlSts4EpbActrSts_0",3,195,-1},
				{"isPVMCVehCtrlSts6SuspHeiReLeActrSts_0",3,277,-1},
				{"isPVMCVehCtrlSts4BrkTqFrntLeActrSts_0",3,168,-1},
				{"isPVMCVehCtrlSts5SuspDmpgFrntLeActrSts_0",3,317,-1},
				{"isPVMCVehCtrlSts2BrkTqDeltaFctSts_0",3,158,-1},
				{"isDoorDrvrLockSts_0",2,423,421},
				{"isPVMCVehCtrlSts2SbWBackUpLatFctSts_0",3,121,-1},
				{"isPVMCVehCtrlSts6SuspStfnFrntRiActrSts_0",3,284,-1},
				{"isISecDcDcActHiSide_1",13,445,448},
				{"isPVMCVehCtrlSts5SuspDmpgReRiActrSts_0",3,324,-1},
				{"isPVMCVehCtrlSts2ActrTarFctSts_0",3,127,-1}
			},
			{
				{"igWhlTqDifMaxRe_0","ZcudChassisCANFD2SignalIPdu008",249},
				{"igPVMCVehCtrlSts6_0","ZcudChassisCANFD2SignalIPdu008",291},
				{"igPtTqSoftMaxGenn2_0","ZcudChassisCANFD2SignalIPdu008",358},
				{"igPVMCVehCtrlSts2_0","ZcudChassisCANFD2SignalIPdu008",152},
				{"igPVMCVehCtrlSts5_0","ZcudChassisCANFD2SignalIPdu008",321},
				{"igPVMCVehCtrlSts4_0","ZcudChassisCANFD2SignalIPdu008",212}
			}
		},
		{"ChassisCANFD2","ZcudChassisCANFD2PduR100Fr006","Out",0x2c0,64,0,1,1,0},
		{
			"ChassisCANFD2","ZcudChassisCANFD2Fr001","Out",0x86,64,10,1,0,0,72,16,
			{
				{"isDrvModReq_2",5,220,231},
				{"isEpbRelsReqToBrkToBrk",1,331,-1},
				{"isPtTqHardMaxReq_0",13,476,-1},
				{"isLgtCtrlModReqSafeChks_0",8,287,-1},
				{"isVehModMngtGlbSafe1PwrLvlElecSubtyp_4",4,175,-1},
				{"isSftyDecelGroupSafeToBrkAsySftyDecelReq",8,191,-1},
				{"isVehModMngtGlbSafe1FltEgyCnsWdSts_4",1,177,-1},
				{"isVehModMngtGlbSafe1UsgModSts_4",4,171,-1},
				{"isLgtCtrlModReqSafeLgtCtrlModReqSafe_0",4,291,-1},
				{"isPrpsnHvBattUsgModReq_1",3,140,137},
				{"isRoadInclnRoadIncln_0",16,227,-1},
				{"isSftyDecelGroupSafeToBrkAsySftyEnaDecel",1,203,-1},
				{"isVehModMngtGlbSafe1EgyLvlElecSubtyp_4",4,167,-1},
				{"isLgtCtrlModReqSafeCntr_0",4,295,-1},
				{"isEpbRelsReqToBrkChks",8,327,-1},
				{"isPrkLatLgtFailrChks_0",8,255,-1},
				{"isPtTqHardMaxGrdtPos_0",13,457,-1},
				{"isPrkLatLgtFailrPrkLatLgtFailr_0",3,259,-1},
				{"isVehModMngtGlbSafe1Chks_4",8,151,-1},
				{"isPtTqSetSafeReq_0",16,359,-1},
				{"isBrkTqReqSafeBrkTqGrdtNegMinReq",10,23,-1},
				{"isRelsForDrvOffReqdForCmftToBrkToBrk",1,443,-1},
				{"isPtTqSetSafeGrdtPos_0",13,378,-1},
				{"isInhbForEscSptModCntr_0",4,351,-1},
				{"isSftyDecelGroupSafeToHADSafeSftyDecelGroupSafeCntr",4,431,-1},
				{"isBrkTqReqSafeBrkTqMinReq",16,7,-1},
				{"isRelsForDrvOffReqdForCmftToBrkChks",8,439,-1},
				{"isSuspPosnVertRi1SuspPosnVertRiFrntQf_0",2,129,-1},
				{"isSuspPosnVertLe1ReQf_0",2,92,-1},
				{"isSuspPosnVertLe1Frnt_0",15,52,-1},
				{"isPrkLatLgtFailrCntr_0",4,263,-1},
				{"isInhbForEscSptModChks_0",8,343,-1},
				{"isSuspPosnVertRi1SuspPosnVertRiReQf_0",2,143,-1},
				{"isPtTqSetSafeChks_0",8,397,-1},
				{"isEpbActvnReqToBrkCntr",4,319,-1},
				{"isIncSpdIdleElecReq",1,89,88},
				{"isSuspPosnVertRi1SuspPosnVertRiChks_0",8,121,-1},
				{"isVehModMngtGlbSafe1Cntr_4",4,159,-1},
				{"isRoadInclnQly_0",2,243,-1},
				{"isSftyDecelGroupSafeToHADSafeAsySftyDecelReq",8,415,-1},
				{"isVehModMngtGlbSafe1EgyLvlElecMai_4",4,155,-1},
				{"isSuspPosnVertLe1FrntQf_0",2,94,-1},
				{"isBrkTqReqSafeBrkTqMinReqCntr",4,43,-1},
				{"isPtTqSetSafeCntr_0",4,405,-1},
				{"isSftyDecelGroupSafeToBrkSftyDecelGroupSafeCntr",4,207,-1},
				{"isRelsForDrvOffReqdForCmftToBrkCntr",4,447,-1},
				{"isVehModMngtGlbSafe1CarModSubtypWdCarModSubtyp_4",3,180,-1},
				{"isDstFromDestination_1",10,215,221},
				{"isSuspPosnVertRi1SuspPosnVertRiFrnt_0",15,103,-1},
				{"isSftyDecelGroupSafeToHADSafeSftyDecelGroupSafeChks",8,423,-1},
				{"isEpbActvnReqToBrkToBrk",1,315,-1},
				{"isVehModMngtGlbSafe1CarModSts1_4",3,183,-1},
				{"isEpbRelsReqToBrkCntr",4,335,-1},
				{"isStandStillReqForCmftToBrkChks",8,271,-1},
				{"isBrkTqReqSafeBrkTqMinReqChks",8,35,-1},
				{"isSuspPosnVertLe1Chks_0",8,86,-1},
				{"isPtTqHardMaxChks_0",8,495,-1},
				{"isLgtCtrlModReqSafeLgtFctFailr_0",3,303,-1},
				{"isSuspPosnVertRi1SuspPosnVertRiRe_0",15,104,-1},
				{"isBrkTqReqSafeBrkActrCtrlModForMinTqReq",2,55,-1},
				{"isSuspPosnVertLe1Re_0",15,69,-1},
				{"isSftyDecelGroupSafeToHADSafeAsySftyEnaDecel",1,427,-1},
				{"isStandStillReqForCmftToBrkToBrk",1,275,-1},
				{"isPtTqHardMaxGrdtNeg_0",13,454,-1},
				{"isVehModMngtGlbSafe1PwrLvlElecMai_4",4,163,-1},
				{"isBrkTqReqSafeBrkTqGrdtPosMinReq",10,29,-1},
				{"isPtTqHardMaxCntr_0",4,503,-1},
				{"isStandStillReqForCmftToBrkCntr",4,279,-1},
				{"isEpbActvnReqToBrkChks",8,311,-1},
				{"isSftyDecelGroupSafeToBrkSftyDecelGroupSafeChks",8,199,-1},
				{"isPtTqSetSafeGrdtNeg_0",13,375,-1},
				{"isInhbForEscSptModSts_0",1,347,-1}
			},
			{
				{"igStandStillReqForCmftToBrk","ZcudChassisCANFD2SignalIPdu001",274},
				{"igRelsForDrvOffReqdForCmftToBrk","ZcudChassisCANFD2SignalIPdu001",442},
				{"igEpbRelsReqToBrk","ZcudChassisCANFD2SignalIPdu001",330},
				{"igInhbForEscSptMod_0","ZcudChassisCANFD2SignalIPdu001",346},
				{"igSftyDecelGroupSafeToHADSafe","ZcudChassisCANFD2SignalIPdu001",426},
				{"igRoadIncln_0","ZcudChassisCANFD2SignalIPdu001",241},
				{"igLgtCtrlModReqSafe_0","ZcudChassisCANFD2SignalIPdu001",300},
				{"igEpbActvnReqToBrk","ZcudChassisCANFD2SignalIPdu001",314},
				{"igPrkLatLgtFailr_0","ZcudChassisCANFD2SignalIPdu001",256},
				{"igPtTqHardMax_0","ZcudChassisCANFD2SignalIPdu001",455},
				{"igSftyDecelGroupSafeToBrk","ZcudChassisCANFD2SignalIPdu001",202},
				{"igPtTqSetSafe_0","ZcudChassisCANFD2SignalIPdu001",401},
				{"igBrkTqReqSafe","ZcudChassisCANFD2SignalIPdu001",53},
				{"igVehModMngtGlbSafe1_4","ZcudChassisCANFD2SignalIPdu001",176},
				{"igSuspPosnVertLe1_0","ZcudChassisCANFD2SignalIPdu001",90},
				{"igSuspPosnVertRi1_0","ZcudChassisCANFD2SignalIPdu001",141}
			}
		},
		{"ChassisCANFD2","ZcudChassisCANFD2PduR500Fr003","Out",0x3c7,64,0,1,1,0},
		{"ChassisCANFD2","ZcudChassisCANFD2PduR200Fr005","Out",0x2c2,64,0,1,1,0},
		{"ChassisCANFD2","ZcudChassisCANFD2ResdFr05","Out",0x15f,64,0,1,1,0},
		{"ChassisCANFD2","ZcudToAllFuncChasCanFD2DiagReqFrame","Out",0x7ff,8,0,1,4,0},
		{
			"ChassisCANFD2","VdcuChassisCANFD2ResdFr01","Out",0x121,64,10,1,0,0,36,9,
			{
				{"isVDCUChassisCANFD2ResdSig3SafetyUInt16_0",16,71,-1},
				{"isVDCUChassisCANFD2ResdSig4SafetyUInt16_0",16,103,-1},
				{"isVDCUChassisResdSig3SafetyChks_0",8,215,-1},
				{"isVDCUChassisCANFD2ResdSig2SafetyUInt4_0",4,59,-1},
				{"isVDCUChassisResdSig4SafetyUInt16_0",16,231,-1},
				{"isVDCUChassisCANFD2ResdSig1SafetyCntr_0",4,31,-1},
				{"isVDCUChassisResdSig5SafetyUInt4_0",4,283,-1},
				{"isVDCUChassisResdSig3SafetyCntr_0",4,223,-1},
				{"isVDCUChassisCANFD2ResdSig2SafetyUInt16_0",16,39,-1},
				{"isVDCUChassisCANFD2ResdSig3SafetyCntr_0",4,95,-1},
				{"isVDCUChassisResdSig1SafetyCntr_0",4,159,-1},
				{"isVDCUChassisCANFD2ResdSig1SafetyUInt4_0",4,27,-1},
				{"isVDCUChassisResdSig3SafetyUInt4_0",4,219,-1},
				{"isVDCUChassisResdSig1SafetyUInt4_0",4,155,-1},
				{"isVDCUChassisResdSig2SafetyChks_0",8,183,-1},
				{"isVDCUChassisResdSig2SafetyUInt16_0",16,167,-1},
				{"isVDCUChassisCANFD2ResdSig2SafetyChks_0",8,55,-1},
				{"isVDCUChassisResdSig4SafetyUInt4_0",4,251,-1},
				{"isVDCUChassisResdSig1SafetyChks_0",8,151,-1},
				{"isVDCUChassisResdSig2SafetyUInt4_0",4,187,-1},
				{"isVDCUChassisResdSig5SafetyUInt16_0",16,263,-1},
				{"isVDCUChassisCANFD2ResdSig4SafetyCntr_0",4,127,-1},
				{"isVDCUChassisResdSig3SafetyUInt16_0",16,199,-1},
				{"isVDCUChassisResdSig1SafetyUInt16_0",16,135,-1},
				{"isVDCUChassisResdSig2SafetyCntr_0",4,191,-1},
				{"isVDCUChassisResdSig5SafetyChks_0",8,279,-1},
				{"isVDCUChassisCANFD2ResdSig3SafetyChks_0",8,87,-1},
				{"isVDCUChassisResdSig4SafetyChks_0",8,247,-1},
				{"isVDCUChassisResdSig4SafetyCntr_0",4,255,-1},
				{"isVDCUChassisCANFD2ResdSig3SafetyUInt4_0",4,91,-1},
				{"isVDCUChassisCANFD2ResdSig1SafetyChks_0",8,23,-1},
				{"isVDCUChassisCANFD2ResdSig4SafetyChks_0",8,119,-1},
				{"isVDCUChassisCANFD2ResdSig4SafetyUInt4_0",4,123,-1},
				{"isVDCUChassisCANFD2ResdSig1SafetyUInt16_0",16,7,-1},
				{"isVDCUChassisResdSig5SafetyCntr_0",4,287,-1},
				{"isVDCUChassisCANFD2ResdSig2SafetyCntr_0",4,63,-1}
			},
			{
				{"igVDCUChassisCANFD2ResdSig1Safety_0","VdcuChassisCANFD2ResdSignalIpdu01",288},
				{"igVDCUChassisCANFD2ResdSig3Safety_0","VdcuChassisCANFD2ResdSignalIpdu01",290},
				{"igVDCUChassisResdSig2Safety_0","VdcuChassisCANFD2ResdSignalIpdu01",293},
				{"igVDCUChassisResdSig5Safety_0","VdcuChassisCANFD2ResdSignalIpdu01",303},
				{"igVDCUChassisResdSig3Safety_0","VdcuChassisCANFD2ResdSignalIpdu01",294},
				{"igVDCUChassisCANFD2ResdSig4Safety_0","VdcuChassisCANFD2ResdSignalIpdu01",291},
				{"igVDCUChassisResdSig4Safety_0","VdcuChassisCANFD2ResdSignalIpdu01",295},
				{"igVDCUChassisResdSig1Safety_0","VdcuChassisCANFD2ResdSignalIpdu01",292},
				{"igVDCUChassisCANFD2ResdSig2Safety_0","VdcuChassisCANFD2ResdSignalIpdu01",289}
			}
		},
		{"ChassisCANFD2","ZcudChassisCANFD2Fr24","Out",0x491,16,0,1,1,0},
		{
			"ChassisCANFD2","ZCUDChasCANFD2VFCVectorFr","Out",0x547,8,1000,1,0,0,63,1,
			{
				{"isVFCVectorZCUDMVFCid21_3",1,23,-1},
				{"isVFCVectorZCUDMVFCid31_3",1,33,-1},
				{"isVFCVectorZCUDMVFCid49_3",1,51,-1},
				{"isVFCVectorZCUDMVFCid10_3",1,12,-1},
				{"isVFCVectorZCUDMVFCid45_3",1,47,-1},
				{"isVFCVectorZCUDMVFCid28_3",1,30,-1},
				{"isVFCVectorZCUDMVFCid0_3",1,2,-1},
				{"isVFCVectorZCUDMVFCid39_3",1,41,-1},
				{"isVFCVectorZCUDMVFCid24_3",1,26,-1},
				{"isVFCVectorZCUDMVFCid56_3",1,58,-1},
				{"isVFCVectorZCUDMVFCid20_3",1,22,-1},
				{"isVFCVectorZCUDMBlockID_3",2,1,-1},
				{"isVFCVectorZCUDMVFCid35_3",1,37,-1},
				{"isVFCVectorZCUDMVFCid47_3",1,49,-1},
				{"isVFCVectorZCUDMVFCid51_3",1,53,-1},
				{"isVFCVectorZCUDMVFCid25_3",1,27,-1},
				{"isVFCVectorZCUDMVFCid23_3",1,25,-1},
				{"isVFCVectorZCUDMVFCid15_3",1,17,-1},
				{"isVFCVectorZCUDMVFCid8_3",1,10,-1},
				{"isVFCVectorZCUDMVFCid27_3",1,29,-1},
				{"isVFCVectorZCUDMVFCid61_3",1,63,-1},
				{"isVFCVectorZCUDMVFCid26_3",1,28,-1},
				{"isVFCVectorZCUDMVFCid18_3",1,20,-1},
				{"isVFCVectorZCUDMVFCid37_3",1,39,-1},
				{"isVFCVectorZCUDMVFCid29_3",1,31,-1},
				{"isVFCVectorZCUDMVFCid42_3",1,44,-1},
				{"isVFCVectorZCUDMVFCid60_3",1,62,-1},
				{"isVFCVectorZCUDMVFCid6_3",1,8,-1},
				{"isVFCVectorZCUDMVFCid9_3",1,11,-1},
				{"isVFCVectorZCUDMVFCid38_3",1,40,-1},
				{"isVFCVectorZCUDMVFCid55_3",1,57,-1},
				{"isVFCVectorZCUDMVFCid36_3",1,38,-1},
				{"isVFCVectorZCUDMVFCid44_3",1,46,-1},
				{"isVFCVectorZCUDMVFCid57_3",1,59,-1},
				{"isVFCVectorZCUDMVFCid12_3",1,14,-1},
				{"isVFCVectorZCUDMVFCid34_3",1,36,-1},
				{"isVFCVectorZCUDMVFCid40_3",1,42,-1},
				{"isVFCVectorZCUDMVFCid43_3",1,45,-1},
				{"isVFCVectorZCUDMVFCid7_3",1,9,-1},
				{"isVFCVectorZCUDMVFCid52_3",1,54,-1},
				{"isVFCVectorZCUDMVFCid33_3",1,35,-1},
				{"isVFCVectorZCUDMVFCid48_3",1,50,-1},
				{"isVFCVectorZCUDMVFCid32_3",1,34,-1},
				{"isVFCVectorZCUDMVFCid14_3",1,16,-1},
				{"isVFCVectorZCUDMVFCid41_3",1,43,-1},
				{"isVFCVectorZCUDMVFCid46_3",1,48,-1},
				{"isVFCVectorZCUDMVFCid58_3",1,60,-1},
				{"isVFCVectorZCUDMVFCid2_3",1,4,-1},
				{"isVFCVectorZCUDMVFCid54_3",1,56,-1},
				{"isVFCVectorZCUDMVFCid19_3",1,21,-1},
				{"isVFCVectorZCUDMVFCid53_3",1,55,-1},
				{"isVFCVectorZCUDMVFCid50_3",1,52,-1},
				{"isVFCVectorZCUDMVFCid17_3",1,19,-1},
				{"isVFCVectorZCUDMVFCid13_3",1,15,-1},
				{"isVFCVectorZCUDMVFCid3_3",1,5,-1},
				{"isVFCVectorZCUDMVFCid59_3",1,61,-1},
				{"isVFCVectorZCUDMVFCid22_3",1,24,-1},
				{"isVFCVectorZCUDMVFCid5_3",1,7,-1},
				{"isVFCVectorZCUDMVFCid16_3",1,18,-1},
				{"isVFCVectorZCUDMVFCid1_3",1,3,-1},
				{"isVFCVectorZCUDMVFCid11_3",1,13,-1},
				{"isVFCVectorZCUDMVFCid4_3",1,6,-1},
				{"isVFCVectorZCUDMVFCid30_3",1,32,-1}
			},
			{
				{"igVFCVectorZCUDM_3","ZCUDChasCANFD2VFCVectorSignalIPdu",-1}
			}
		},
		{"ChassisCANFD2","ZcudToXcuChasCanFD2DiagReqFr","Out",0x712,64,0,1,4,0},
		{"ChassisCANFD2","ZcudChassisCANFD2ResdFr02","Out",0x182,64,0,1,1,0},
		{"ChassisCANFD2","XXEVBDChassisCANFD2Fr02","In",0x3bf,64,0,1,0,0},
		{"ChassisCANFD2","XPEVBDChassisCANFD2Fr17","In",0x367,64,0,1,0,0},
		{"ChassisCANFD2","XPEVBDChassisCANFD2Fr23","In",0x33f,64,0,1,0,0},
		{"ChassisCANFD2","XPEVBDChassisCANFD2Fr21","In",0x495,64,0,1,0,0},
		{"ChassisCANFD2","XXEVBDChassisCANFD2Fr01","In",0x3ca,64,0,1,0,0},
		{"ChassisCANFD2","XXPhevBDChassisCANFD2Fr01","In",0x39f,64,0,1,0,0},
		{"ChassisCANFD2","RbcmChassisCANFD2Fr01","In",0x62,64,0,1,0,0},
		{"ChassisCANFD2","XXcuBDChassisCANFD2Fr06","In",0x36c,64,0,1,0,0},
		{"ChassisCANFD2","XXEVBDChassisCANFD2Fr06","In",0x35a,64,0,1,0,0},
		{"ChassisCANFD2","XPEVBDChassisCANFD2Fr22","In",0x490,64,0,1,0,0},
		{"ChassisCANFD2","XXPhevBDChassisCANFD2Fr03","In",0x47f,64,0,1,0,0},
		{"ChassisCANFD2","XXXEVChassisCANFD2Fr06","In",0x20e,64,0,1,0,0},
		{"ChassisCANFD2","BcmChassisCANFD2Fr13_11","In",0x20,16,0,1,0,0},
		{"ChassisCANFD2","XXEcmBDChassisCANFD2Fr01","In",0x29a,64,0,1,0,0},
		{"ChassisCANFD2","XXEVBDChassisCANFD2Fr10","In",0x28f,64,0,1,0,0},
		{"ChassisCANFD2","DsadChasCanFD2VFCVectorFr","In",0x559,8,0,1,0,0},
		{"ChassisCANFD2","XXPhevBDChassisCANFD2Fr02","In",0x3cf,64,0,1,0,0},
		{"ChassisCANFD2","XXPhevChassisCANFD2Fr03","In",0xe2,64,0,1,0,0},
		{"ChassisCANFD2","XPEVBDChassisCANFD2Fr19","In",0x3e6,64,0,1,0,0},
		{"ChassisCANFD2","XcuChassisCANFD2Fr13","In",0x4f0,64,0,1,0,0},
		{"ChassisCANFD2","EcmToZcudChasCanFD2DiagResFrame","In",0x610,64,0,1,4,0},
		{"ChassisCANFD2","XXPhevBDChassisCANFD2Fr04","In",0x36e,64,0,1,0,0},
		{"ChassisCANFD2","XPEVBDChassisCANFD2Fr13","In",0x4a0,64,0,1,0,0},
		{"ChassisCANFD2","XcuChassisCANFD2ResdFr01","In",0x152,64,0,1,0,0},
		{"ChassisCANFD2","XXXEVChassisCANFD2Fr07","In",0x287,64,0,1,0,0},
		{"ChassisCANFD2","EpbChassisCANFD2Fr03","In",0x22,16,0,1,0,0},
		{"ChassisCANFD2","XXEVBDChassisCANFD2Fr04","In",0x46e,64,0,1,0,0},
		{"ChassisCANFD2","XXEVBDChassisCANFD2Fr05","In",0x47c,64,0,1,0,0},
		{"ChassisCANFD2","XXEVBDChassisCANFD2Fr03","In",0x45f,64,0,1,0,0},
		{"ChassisCANFD2","XXcuBDChassisCANFD2Fr04","In",0x3a8,64,0,1,0,0},
		{"ChassisCANFD2","BbmChassisCANFD2Fr05_ALL","In",0x67,64,0,1,0,0},
		{"ChassisCANFD2","XPEVBDChassisCANFD2Fr12","In",0x492,64,0,1,0,0},
		{"ChassisCANFD2","XXXEVChassisCANFD2Fr08","In",0x48f,64,0,1,0,0},
		{"ChassisCANFD2","RbcmChasCanFD2VFCVectorFr","In",0x575,8,0,1,0,0},
		{"ChassisCANFD2","RbcmToZcudChasCanFD2DiagResFrame","In",0x613,64,0,1,4,0},
		{"ChassisCANFD2","BbmChassisCANFD2Fr01_89","In",0x55,64,0,1,0,0},
		{"ChassisCANFD2","BbmChassisCANFD2Fr03_ALL","In",0x9f,64,0,1,0,0},
		{"ChassisCANFD2","EcmChassisCANFD2Fr14","In",0x129,64,0,1,0,0},
		{"ChassisCANFD2","XXPhevChassisCANFD2Fr01","In",0xce,64,0,1,0,0},
		{"ChassisCANFD2","XXEVBDChassisCANFD2Fr07","In",0x35b,64,0,1,0,0},
		{"ChassisCANFD2","XXXEVChassisCANFD2Fr04","In",0xe4,64,0,1,0,0},
		{"ChassisCANFD2","XcuToZcudChasCanFD2DiagResFr","In",0x612,64,0,1,4,0},
		{"ChassisCANFD2","XXXEVChassisCANFD2Fr05","In",0x11e,64,0,1,0,0},
		{"ChassisCANFD2","XXcuBDChassisCANFD2Fr03","In",0x3a0,64,0,1,0,0},
		{"ChassisCANFD2","BbmChassisCANFD2Fr04_ALL","In",0xe3,64,0,1,0,0},
		{"ChassisCANFD2","BbmChassisCANFD2Fr02_ALL","In",0x5a,64,0,1,0,0},
		{"ChassisCANFD2","XXXEVChassisCANFD2Fr01","In",0xde,64,0,1,0,0},
		{"ChassisCANFD2","EpbChassisCANFD2Fr01","In",0x68,64,0,1,0,0},
		{"ChassisCANFD2","XXEVBDChassisCANFD2Fr09","In",0x28e,64,0,1,0,0},
		{"ChassisCANFD2","XXPhevChassisCANFD2Fr04","In",0x5f,64,0,1,0,0},
		{"ChassisCANFD2","XXcuBDChassisCANFD2Fr05","In",0x3af,64,0,1,0,0},
		{"ChassisCANFD2","XPEVBDChassisCANFD2Fr24","In",0x3e4,64,0,1,0,0},
		{"ChassisCANFD2","BbmChassisCANFD2Fr15_11","In",0x83,64,0,1,0,0},
		{"ChassisCANFD2","PcmChassisCANFD2Fr11_BD","In",0x365,64,0,1,0,0},
		{"ChassisCANFD2","XPEVBDChassisCANFD2Fr11","In",0x3f0,64,0,1,0,0},
		{"ChassisCANFD2","XPEVBDChassisCANFD2Fr16","In",0x35d,64,0,1,0,0},
		{"ChassisCANFD2","DsadChassisCANFD2Fr01","In",0x251,64,0,1,0,0},
		{"ChassisCANFD2","XPEVBDChassisCANFD2Fr15","In",0x245,64,0,1,0,0},
		{"ChassisCANFD2","RbcmToZcudJ1979OBDChasCanFD2ResFrame","In",0x7ee,8,0,1,4,0},
		{"ChassisCANFD2","XXEVBDChassisCANFD2Fr08","In",0x300,64,0,1,0,0},
		{"ChassisCANFD2","BbmChassisCANFD2Fr13_89","In",0x36b,64,0,1,0,0},
		{"ChassisCANFD2","XXXEVChassisCANFD2Fr02","In",0x7c,64,0,1,0,0},
		{"ChassisCANFD2","XPEVBDChassisCANFD2Fr18","In",0x4f3,64,0,1,0,0},
		{"ChassisCANFD2","EpbChassisCANFD2Fr02","In",0x250,64,0,1,0,0},
		{"ChassisCANFD2","BcmChasCanFD2NMFr","In",0x510,8,0,1,3,0},
		{"ChassisCANFD2","XXcmBDChassisCANFD2Fr01","In",0x3ce,64,0,1,0,0},
		{"ChassisCANFD2","XPEVBDChassisCANFD2Fr20","In",0x3e8,64,0,1,0,0},
		{
			"ZCUD_CAN1","ZCUDZCUDCAN1Fr65","Out",0x215,8,60,0,0,0,12,0,
			{
				{"isSecRowSeatRiChildLockSet_1",1,50,49},
				{"isChrgnOrDisChrgnStsFb_2",5,7,2},
				{"isUpperLowerTrSelnSwt_1",1,1,0},
				{"isThrdRowSeatLeChildLockSet_1",1,63,62},
				{"isThrdRowSeatRiChildLockSet_1",1,61,60},
				{"isDrvrPfmncAlrmReqFromDHU_2",3,15,12},
				{"isThrdRowRiSeatVentnPwrAllwd_1",8,47,53},
				{"isThrdRowLeSeatVentnPwrAllwd_1",8,31,55},
				{"isThrdRowLeSeatHeatgPwrAllwd_1",8,23,8},
				{"isSecRowSeatLeChildLockSet_1",1,52,51},
				{"isOxygenSplyReq_2",2,11,9},
				{"isThrdRowRiSeatHeatgPwrAllwd_1",8,39,54}
			},
			{
				{"","",-1}
			}
		},
		{
			"ZCUD_CAN1","ZCUDZCUDCAN1Fr21","Out",0x398,8,800,0,0,0,7,1,
			{
				{"isPassSeatPosPercSeatPosHeiPerc_1",10,17,-1},
				{"isPassSeatPosPercSeatPosSldPerc_1",10,39,-1},
				{"isPinionSteerAgMax1_2",15,55,56},
				{"isPassSeatPosPercSeatPosFrntHeiQF_1",2,1,-1},
				{"isPassSeatPosPercSeatPosSldQF_1",2,21,-1},
				{"isPassSeatPosPercSeatPosFrntHeiPerc_1",10,15,-1},
				{"isPassSeatPosPercSeatPosHeiQF_1",2,19,-1}
			},
			{
				{"igPassSeatPosPerc_1","ZCUDZCUDCAN1SignalIPDU21",2}
			}
		},
		{
			"ZCUD_CAN1","ZCUDZCUDCAN1Fr81","Out",0x11a,8,15,0,0,0,7,1,
			{
				{"isWhlSpdCircumlReLe_1",15,6,-1},
				{"isTrCrashUnlckCmd_1",1,40,55},
				{"isWhlSpdCircumlReCntr_1",4,31,-1},
				{"isWhlSpdCircumlReRiQf_1",2,25,-1},
				{"isWhlSpdCircumlReChks_1",8,23,-1},
				{"isWhlSpdCircumlReLeQf_1",2,27,-1},
				{"isWhlSpdCircumlReRi_1",15,39,-1}
			},
			{
				{"igWhlSpdCircumlRe_1","ZCUDZCUDCAN1SignalIPdu81",7}
			}
		},
		{
			"ZCUD_CAN1","ZCUDZCUDCAN1Fr22","Out",0x378,8,150,0,0,0,8,1,
			{
				{"isPinionSteerAgGroupChks_3",8,7,-1},
				{"isPinionSteerAgGroupPinionSteerAg1_3",15,46,-1},
				{"isPinionSteerAgGroupCntr_3",4,63,-1},
				{"isPinionSteerAgGroupSteerWhlTq_3",14,29,-1},
				{"isPinionSteerAgGroupPinionSteerAg1Qf_3",2,15,-1},
				{"isPinionSteerAgGroupPinionSteerAgSpd1_3",14,13,-1},
				{"isPinionSteerAgGroupPinionSteerAgSpd1Qf_3",2,31,-1},
				{"isPinionSteerAgGroupSteerWhlTqQf_3",2,59,-1}
			},
			{
				{"igPinionSteerAgGroup_3","ZCUDZCUDCAN1SignalIPDU22",57}
			}
		},
		{
			"ZCUD_CAN1","ZCUDZCUDCAN1Fr60","Out",0x5b,8,15,0,0,0,5,1,
			{
				{"isWhlDirRotlReRi_1",2,57,-1},
				{"isWhlDirRotlReCntr_1",4,63,-1},
				{"isHvBattLimnIndcn_3",16,23,11},
				{"isWhlDirRotlReLe_1",2,59,-1},
				{"isWhlDirRotlReChks_1",8,55,-1}
			},
			{
				{"igWhlDirRotlRe_1","ZCUDZCUDCAN1SignalIPDU60",43}
			}
		},
		{
			"ZCUD_CAN1","ZCUDZCUDCAN1Fr57","Out",0x264,8,120,0,0,0,12,1,
			{
				{"isSecLeDiagcStopReq_1",1,35,34},
				{"isSecRowRiHeatgLvl_1",2,63,61},
				{"isSecRowRiVentnLvl_1",2,60,58},
				{"isDrvrStuMonSts_1",4,20,16},
				{"isWinPosnStsAtDrvr_1",5,47,42},
				{"isThrdRiDiagcStopReq",1,48,41},
				{"isSecRiDiagcStopReq_1",1,33,32},
				{"isWinPosnStsAtReLe_1",5,55,40},
				{"isRollAgGlbVal_2",16,7,-1},
				{"isThrdLeDiagcStopReq",1,50,49},
				{"isRollAgGlbQf_2",2,23,-1},
				{"isChgFilElmRst_1",2,57,36}
			},
			{
				{"igRollAgGlb_2","ZCUDZCUDCAN1SignalIPDU57",21}
			}
		},
		{
			"ZCUD_CAN1","ZCUDZCUDCAN1Fr51","Out",0x333,8,250,0,0,0,6,3,
			{
				{"isSecRowRiInclPosQf1_1",2,51,-1},
				{"isSecRowRiInclPosAngleDeg180_1",8,43,-1},
				{"isSecRowLeInclPosAngleDeg180_1",8,38,-1},
				{"isSecRowLeInclPosQf1_1",2,46,-1},
				{"isIndcrPatCmd1WdTiOn_1",16,23,-1},
				{"isIndcrPatCmd1WdTiOff_1",16,7,-1}
			},
			{
				{"igSecRowLeInclPos_1","ZCUDZCUDCAN1SignalIPDU51",44},
				{"igIndcrPat_1","ZCUDZCUDCAN1SignalIPDU51",39},
				{"igSecRowRiInclPos_1","ZCUDZCUDCAN1SignalIPDU51",49}
			}
		},
		{
			"ZCUD_CAN1","ZCUDZCUDCAN1Fr10","Out",0x390,8,800,0,0,0,12,2,
			{
				{"isDrvrSeatPosPercSeatPosFrntHeiPerc_1",10,15,-1},
				{"isDispOfPrpsnMod_1",4,60,56},
				{"isDrvrSeatPosPercSeatPosSldQF_1",2,21,-1},
				{"isDrvrSeatPosPercSeatPosHeiPerc_1",10,17,-1},
				{"isDrvrSeatPosPercSeatPosSldPerc_1",10,39,-1},
				{"isDrvrSeatPosPercSeatPosHeiQF_1",2,19,-1},
				{"isPassAirbLampStsRecPassAirbLampStsChks_2",8,55,-1},
				{"isPassAirbLampStsRecPassAirbLampSts_2",2,45,-1},
				{"isDispOfPrpsnModForEv_1",4,7,3},
				{"isDrvrSeatPosPercSeatPosFrntHeiQF_1",2,1,-1},
				{"isPassAirbLampStsRecPassAirbLampStsCntr_2",4,43,-1},
				{"isRlyPwrDistbnCmd1WdIgnRlyExtCmd_1",1,62,61}
			},
			{
				{"igDrvrSeatPosPerc_1","ZCUDZCUDCAN1SignalIPDU10",2},
				{"igPassAirbLampStsRec_2","ZCUDZCUDCAN1SignalIPDU10",63}
			}
		},
		{
			"ZCUD_CAN1","ZCUDZCUDCAN1Fr97","Out",0x13a,8,30,0,0,0,4,1,
			{
				{"isEngNSafeEngNChks_2",8,24,-1},
				{"isEngNSafeEngNCntr_2",4,32,-1},
				{"isEngNSafeEngN_2",15,23,-1},
				{"isEngNSafeEngNGrdt_2",16,7,-1}
			},
			{
				{"igEngNSafe_2","ZCUDZCUDCAN1SignalIPdu97",44}
			}
		},
		{
			"ZCUD_CAN1","ZCUDZCUDCAN1Fr70","Out",0x99,8,70,0,0,0,9,2,
			{
				{"isBattFltStsPrimBattFltStsPrm_2",4,15,-1},
				{"isBattFltStsSecBattFltStsPrm_1",4,39,-1},
				{"isBattFltStsPrimCntr_2",4,11,-1},
				{"isBattFltStsSecCntr_1",4,35,-1},
				{"isSftyAirbRollovrSuppSwt_1",2,19,17},
				{"isWinPosnStsAtReRi_1",5,61,56},
				{"isBattFltStsPrimChks_2",8,7,-1},
				{"isPassAirbNotiConfirm_1",2,22,20},
				{"isBattFltStsSecChks_1",8,31,-1}
			},
			{
				{"igBattFltStsSec_1","ZCUDZCUDCAN1SignalIPDU70",16},
				{"igBattFltStsPrim_2","ZCUDZCUDCAN1SignalIPDU70",23}
			}
		},
		{
			"ZCUD_CAN1","ZCUDZCUDCAN1Fr49","Out",0x314,8,20,0,0,0,7,1,
			{
				{"isHoodOpenerReqCntr_1",4,12,-1},
				{"isHoodOpenerReqChks_1",8,4,-1},
				{"isHoodOpenerReqDoorOpenerReq_1",2,21,-1},
				{"isChdLockPassReSts_1",2,18,16},
				{"isHoodLatchPosn_1",2,7,5},
				{"isHoodOpenerReqTrigSrc_1",3,8,-1},
				{"isOverlap_1",8,47,28}
			},
			{
				{"igHoodOpenerReq_1","ZCUDZCUDCAN1SignalIPDU49",19}
			}
		},
		{
			"ZCUD_CAN1","ZCUDZCUDCAN1Fr19","Out",0x384,8,350,0,0,0,9,2,
			{
				{"isEscStCntr_1",4,35,-1},
				{"isDrvrCrsCtrlFctSeld_1",3,27,24},
				{"isBrkPedlrRatQf_1",2,23,-1},
				{"isEscStChks_1",8,47,-1},
				{"isCrsCtrlrSts_1",3,31,28},
				{"isEscStEscSt_1",3,38,-1},
				{"isBrkTracCtrlActv_1",1,21,20},
				{"isBrkPedlrRatPerc_1",15,6,-1},
				{"isCllsnMtgtnFctSts_1",3,19,16}
			},
			{
				{"igBrkPedlrRat_1","ZCUDZCUDCAN1SignalIPDU19",7},
				{"igEscSt_1","ZCUDZCUDCAN1SignalIPDU19",39}
			}
		},
		{
			"ZCUD_CAN1","SmblZcudCAN1Fr15","Out",0x323,8,250,0,0,0,2,0,
			{
				{"isSecRowLeVentnLvl_0",2,43,48},
				{"isSecRowLeHeatgLvl_0",2,45,49}
			},
			{
				{"","",-1}
			}
		},
		{"ZCUD_CAN1","ZcudToRmlZCUDCAN1DiagReqFrame","Out",0x710,8,0,0,4,0},
		{
			"ZCUD_CAN1","ZCUDZCUDCAN1Fr87","Out",0x128,8,30,0,0,0,8,3,
			{
				{"isSecRowRiArmRstMotPosReqTargPosReq",10,7,-1},
				{"isSecRowRiDiveMotPosReqSpeed",8,26,-1},
				{"isSecRowRiDiveMotPosReqTargPosReq",10,20,-1},
				{"isSecRowRiDiveMotMoveReq",2,44,42},
				{"isSecRowLeSldMotPosReqSpeed_1",8,63,-1},
				{"isSecRowRiArmRstMotMoveReq",2,47,45},
				{"isSecRowLeSldMotPosReqTargPosReq_1",10,41,-1},
				{"isSecRowRiArmRstMotPosReqSpeed",8,13,-1}
			},
			{
				{"igSecRowLeSldMotPosReq_1","ZCUDZCUDCAN1SignalIPdu87",33},
				{"igSecRowRiDiveMotPosReq","ZCUDZCUDCAN1SignalIPdu87",34},
				{"igSecRowRiArmRstMotPosReq","ZCUDZCUDCAN1SignalIPdu87",21}
			}
		},
		{
			"ZCUD_CAN1","ZCUDZCUDCAN1Fr25","Out",0x24,8,15,0,0,0,3,1,
			{
				{"isAccrpedlStsChks_2",8,55,-1},
				{"isAccrpedlStsFltSts_2",1,59,-1},
				{"isAccrpedlStsCntr_2",4,63,-1}
			},
			{
				{"igAccrpedlSts_2","ZCUDZCUDCAN1SignalIPDU25",58}
			}
		},
		{
			"ZCUD_CAN1","ZCUDZCUDCAN1Fr23","Out",0x345,8,420,0,0,0,4,1,
			{
				{"isAbsCtrlActvCtrlSts1_2",1,27,-1},
				{"isAbsCtrlActvChks_2",8,23,-1},
				{"isAbsSts_1",1,25,24},
				{"isAbsCtrlActvCntr_2",4,31,-1}
			},
			{
				{"igAbsCtrlActv_2","ZCUDZCUDCAN1SignalIPDU23",26}
			}
		},
		{
			"ZCUD_CAN1","SmtrZcudCAN1Fr01","Out",0x105,8,20,0,0,0,1,0,
			{
				{"isRowReRiModSwtSts_0",1,2,15}
			},
			{
				{"","",-1}
			}
		},
		{
			"ZCUD_CAN1","ZCUDZCUDCAN1Fr54","Out",0x127,8,100,0,0,0,3,0,
			{
				{"isSecRowRiSeatVentnPwrAllwd_1",8,39,63},
				{"isSecRowLeSeatVentnPwrAllwd_1",8,23,61},
				{"isSecRowRiSeatHeatgPwrAllwd_1",8,31,62}
			},
			{
				{"","",-1}
			}
		},
		{
			"ZCUD_CAN1","ZCUDZCUDCAN1Fr47","Out",0x50,8,10,0,0,0,6,1,
			{
				{"isPreCrashFrontDataChks_1",8,23,-1},
				{"isPreCrashFrontDataCntr_1",4,47,-1},
				{"isPreCrashFrontDataClosingVelocity_1",8,31,-1},
				{"isPreCrashFrontDataTimeToImpact_1",8,39,-1},
				{"isPreCrashFrontDataOverLap_1",8,15,-1},
				{"isPreCrashFrontDataObjectClass_1",3,43,-1}
			},
			{
				{"igPreCrashFrontData_1","ZCUDZCUDCAN1SignalIPDU47",40}
			}
		},
		{
			"ZCUD_CAN1","ZCUDZCUDCAN1Fr44","Out",0x85,8,25,0,0,0,3,0,
			{
				{"isRctaIndcnRi_1",2,55,53},
				{"isRctaIndcnLe_1",2,41,42},
				{"isCllsnWarnReIndcn_1",2,47,45}
			},
			{
				{"","",-1}
			}
		},
		{
			"ZCUD_CAN1","ZCUDZCUDCAN1Fr73","Out",0x334,8,200,0,0,0,26,1,
			{
				{"isExtrLtgStsAllWL_1",2,17,-1},
				{"isExtrLtgStsDBL_1",2,27,-1},
				{"isExtrLtgStsHomeSafe_1",2,47,-1},
				{"isExtrLtgStsTurnIndrRi_1",2,59,-1},
				{"isExtrLtgStsAHBC_1",2,21,-1},
				{"isExtrLtgStsLtgShow_1",2,41,-1},
				{"isExtrLtgStsWelcome_1",2,57,-1},
				{"isExtrLtgStsCntr_1",4,3,-1},
				{"isExtrLtgStsPosLiFrnt_1",2,55,-1},
				{"isExtrLtgStsHWL_1",2,45,-1},
				{"isExtrLtgStsPosLiRe_1",2,53,-1},
				{"isExtrLtgStsCornrgLi_1",2,29,-1},
				{"isExtrLtgStsGoodbye_1",2,35,-1},
				{"isExtrLtgStsDRL_1",2,25,-1},
				{"isExtrLtgStsFlash_1",2,39,-1},
				{"isExtrLtgStsFrntFog_1",2,37,-1},
				{"isExtrLtgStsAFS_1",2,23,-1},
				{"isExtrLtgStsAHL_1",2,19,-1},
				{"isExtrLtgStsTurnIndrLe_1",2,61,-1},
				{"isExtrLtgStsHiBeam_1",2,33,-1},
				{"isExtrLtgStsReverseLi_1",2,49,-1},
				{"isExtrLtgStsReFog_1",2,51,-1},
				{"isExtrLtgStsChks_1",8,15,-1},
				{"isExtrLtgStsLoBeam_1",2,43,-1},
				{"isExtrLtgStsApproach_1",2,31,-1},
				{"isExtrLtgStsStopLi_1",2,63,-1}
			},
			{
				{"igExtrLtgSts_1","ZCUDZCUDCAN1SignalIPDU73",4}
			}
		},
		{
			"ZCUD_CAN1","ZCUDZCUDCAN1Fr56","Out",0x325,8,135,0,0,0,7,0,
			{
				{"isPassStuMonSts_1",4,31,27},
				{"isEfuseKL15Req4",1,54,53},
				{"isHoodSts_2",2,21,19},
				{"isEfuseKL15Req5",1,52,51},
				{"isEfuseKL15Req3",1,40,55},
				{"isEfuseKL15Req1",1,43,23},
				{"isEfuseKL15Req2",1,42,41}
			},
			{
				{"","",-1}
			}
		},
		{
			"ZCUD_CAN1","ZCUDZCUDCAN1Fr76","Out",0x1a3,8,50,0,0,0,3,1,
			{
				{"isZCUDMResdSig1ToSRSSafetyUInt32_1",32,7,-1},
				{"isZCUDMResdSig1ToSRSSafetyChks_1",8,39,-1},
				{"isZCUDMResdSig1ToSRSSafetyCntr_1",4,47,-1}
			},
			{
				{"igZCUDMResdSig1ToSRSSafety_1","ZCUDZCUDCAN1SignalIPDU76",43}
			}
		},
		{
			"ZCUD_CAN1","ZCUDZCUDCAN1Fr46","Out",0x210,8,120,0,0,0,15,2,
			{
				{"isADTakeoverReqGroupADTakeoverAudio_1",2,23,-1},
				{"isADTakeoverReqGroupADTakeoverMsg_1",3,6,-1},
				{"isAsySftyFctStsToEDRACSFB2FctSts_1",3,31,-1},
				{"isSeatDownLumPosCtrlDrvr_2",7,63,56},
				{"isAsySftyFctStsToEDRAEBSFctSts_1",3,47,-1},
				{"isAsySftyFctStsToEDRLDWSFctSts_1",3,52,-1},
				{"isAsySftyFctStsToEDRACSFDFctSts_1",3,39,-1},
				{"isAsySftyFctStsToEDRACCFctSTs_1",3,21,-1},
				{"isAsySftyFctStsToEDRACSFB1FctSts_1",3,18,-1},
				{"isADTakeoverReqGroupCntr_1",4,3,-1},
				{"isAsySftyFctStsToEDRESFFctSts_1",3,55,-1},
				{"isAsySftyFctStsToEDRACSFEFctSts_1",3,36,-1},
				{"isAsySftyFctStsToEDRACSFCFctSts_1",3,28,-1},
				{"isADTakeoverReqGroupChks_1",8,15,-1},
				{"isAsySftyFctStsToEDRCSFFctSts_1",3,44,-1}
			},
			{
				{"igAsySftyFctStsToEDR_1","ZCUDZCUDCAN1SignalIPDU46",49},
				{"igADTakeoverReqGroup_1","ZCUDZCUDCAN1SignalIPDU46",7}
			}
		},
		{
			"ZCUD_CAN1","ZCUDZCUDCAN1Fr78","Out",0x1af,8,50,0,0,0,11,0,
			{
				{"isThrdRowLeSeatMotPosnCalReq_1",1,29,26},
				{"isThrdLeSeatSideSpprtDisSts_1",1,33,32},
				{"isThrdLeSeatMassDisSts_1",1,35,34},
				{"isThrdRowRiSeatMotPosnCalReq_1",1,28,27},
				{"isThrdRiSeatMassDisSts_1",1,45,44},
				{"isThrdRiSeatLumDisSts_1",1,47,46},
				{"isRadioFrqAM_1",11,7,12},
				{"isThrdLeSeatLumDisSts_1",1,37,36},
				{"isWPRRActvReqFromHmi_1",1,55,54},
				{"isThrdRiSeatSideSpprtDisSts_1",1,43,42},
				{"isWPRLActvReqFromHmi_1",1,41,40}
			},
			{
				{"","",-1}
			}
		},
		{
			"ZCUD_CAN1","ZCUDZCUDCAN1Fr01","Out",0x40,8,15,0,0,0,9,2,
			{
				{"isDoorDrvrSts_3",2,55,53},
				{"isTrOpenerReqTrOpenerReq_1",3,21,-1},
				{"isDoorLeReSts_2",2,43,44},
				{"isVehMtnStCntr_2",4,6,-1},
				{"isTwliBriSts_6",1,23,22},
				{"isVehMtnStVehMtnSt_2",3,2,-1},
				{"isTrNoKeyPrsntAcoustReq_1",1,41,40},
				{"isTrOpenerReqTrigSrc_1",3,18,-1},
				{"isVehMtnStChks_2",8,15,-1}
			},
			{
				{"igVehMtnSt_2","ZCUDZCUDCAN1SignalIPDU01",7},
				{"igTrOpenerReq_1","ZCUDZCUDCAN1SignalIPDU01",61}
			}
		},
		{"ZCUD_CAN1","ZcudToSrsZCUDCan1DiagReqFr","Out",0x739,8,0,0,4,0},
		{
			"ZCUD_CAN1","ZCUDZCUDCAN1Fr05","Out",0x370,8,620,0,0,0,5,1,
			{
				{"isEngSt1WdStsCntr_2",4,31,-1},
				{"isEngSt1WdStsChks_2",8,23,-1},
				{"isAD4DrvrBeltWarnForBkp_1",3,2,3},
				{"isEngSt1WdStsEngSt1WdSts_2",4,27,-1},
				{"isCarTiGlb_4",32,39,13}
			},
			{
				{"igEngSt1WdSts_2","ZCUDZCUDCAN1SignalIPDU05",8}
			}
		},
		{
			"ZCUD_CAN1","ZCUDZCUDCAN1Fr91","Out",0x12c,8,30,0,0,0,12,2,
			{
				{"isSecRowRiSldMotMoveReq_1",2,47,45},
				{"isSecRowLeInclMotMoveReq_1",2,54,52},
				{"isSecRowRiSideSldMotMoveReq",2,58,56},
				{"isSecRowLeHeiMotMoveReq",2,41,55},
				{"isSecRowLeZeroGrvyMotMoveReq",2,48,62},
				{"isSecRowLeSldMotMoveReq_1",2,51,49},
				{"isSecRowRiSldMotPosReqSpeed_1",8,13,-1},
				{"isSecRowRiZeroGrvyMotPosReqSpeed",8,26,-1},
				{"isSecRowRiSldMotPosReqTargPosReq_1",10,7,-1},
				{"isSecRowRiZeroGrvyMotMoveReq",2,44,42},
				{"isSecRowRiZeroGrvyMotPosReqTargPosReq",10,20,-1},
				{"isSecRowRiRotMotMoveReq",2,61,59}
			},
			{
				{"igSecRowRiSldMotPosReq_1","ZCUDZCUDCAN1SignalIPdu91",21},
				{"igSecRowRiZeroGrvyMotPosReq","ZCUDZCUDCAN1SignalIPdu91",34}
			}
		},
		{"ZCUD_CAN1","ZcudToRmrZCUDCAN1DiagReqFrame","Out",0x711,8,0,0,4,0},
		{"ZCUD_CAN1","ZcudToOgmZCUDCan1DiagReqFr","Out",0x73c,8,0,0,4,0},
		{
			"ZCUD_CAN1","ZCUDZCUDCAN1Fr74","Out",0x271,8,70,0,0,0,13,1,
			{
				{"isRcwmBeltReq_1",2,50,48},
				{"isSeatHeatRowThrdRiEna_1",1,61,60},
				{"isCmptmtTReCmptmtTFrnt_1",11,15,-1},
				{"isHmiSeatVentAutStrtRowThrdRi_1",1,1,0},
				{"isCmptmtTReFanForCmptmtTRunng_1",1,18,-1},
				{"isWinPosnStsAtPass_1",5,55,40},
				{"isCmptmtTReCmptmtTFrntQf_1",2,20,-1},
				{"isSeatVentnRowThrdLeEna_1",1,57,56},
				{"isActvnOfSymIllmn_4",1,5,4},
				{"isSeatVentnRowThrdRiEna_1",1,7,6},
				{"isSeatVentnRowSecLeEna_1",1,59,58},
				{"isSeatHeatRowThrdLeEna_1",1,63,62},
				{"isHmiSeatVentAutStrtRowThrdLe_1",1,3,2}
			},
			{
				{"igCmptmtTRe_1","ZCUDZCUDCAN1SignalIPDU74",17}
			}
		},
		{
			"ZCUD_CAN1","ZCUDZCUDCAN1Fr82","Out",0x122,8,30,0,0,0,8,3,
			{
				{"isSecRowLeArmRstMotPosReqSpeed",8,13,-1},
				{"isSecRowLeHeiMotPosReqTargPosReq",10,41,-1},
				{"isSecRowLeDiveMotMoveReq",2,44,42},
				{"isSecRowLeHeiMotPosReqSpeed",8,63,-1},
				{"isSecRowLeDiveMotPosReqSpeed",8,26,-1},
				{"isSecRowLeArmRstMotMoveReq",2,47,45},
				{"isSecRowLeDiveMotPosReqTargPosReq",10,20,-1},
				{"isSecRowLeArmRstMotPosReqTargPosReq",10,7,-1}
			},
			{
				{"igSecRowLeHeiMotPosReq","ZCUDZCUDCAN1SignalIPdu82",33},
				{"igSecRowLeArmRstMotPosReq","ZCUDZCUDCAN1SignalIPdu82",21},
				{"igSecRowLeDiveMotPosReq","ZCUDZCUDCAN1SignalIPdu82",34}
			}
		},
		{"ZCUD_CAN1","ZcudToPotZCUDCan1DiagReqFr","Out",0x715,8,0,0,4,0},
		{
			"ZCUD_CAN1","ZCUDZCUDCAN1Fr32","Out",0x143,8,25,0,0,0,2,1,
			{
				{"isPosnBriefPosnLgt_1",31,38,-1},
				{"isPosnBriefPosnLat_1",30,5,-1}
			},
			{
				{"igPosnBrief_1","ZCUDZCUDCAN1SignalIPDU32",6}
			}
		},
		{
			"ZCUD_CAN1","ZCUDZCUDCAN1Fr29","Out",0x83,8,40,0,0,0,8,1,
			{
				{"isFctaIndcnRi_1",2,17,18},
				{"isSftyDecelGroupSafeChks_1",8,39,-1},
				{"isSftyDecelGroupSafeCntr_1",4,43,-1},
				{"isSftyDecelGroupSafeAsySftyDecelReq_1",8,31,-1},
				{"isCllsnThreat_1",2,23,21},
				{"isFctaIndcnLe_1",2,59,50},
				{"isCllsnFwdWarn_1",3,15,12},
				{"isSftyDecelGroupSafeAsySftyEnaDecel_1",1,44,-1}
			},
			{
				{"igSftyDecelGroupSafe_1","ZCUDZCUDCAN1SignalIPDU29",51}
			}
		},
		{"ZCUD_CAN1","ZcudZCUDCAN1NMFr01","Out",0x501,8,0,0,3,0},
		{
			"ZCUD_CAN1","ZCUDZCUDCAN1Fr89","Out",0x12a,8,30,0,0,0,8,3,
			{
				{"isSecRowRiLegRotMotPosReqSpeed_1",8,26,-1},
				{"isSecRowRiLegRotMotMoveReq_1",2,44,42},
				{"isSecRowRiLegRotMotPosReqTargPosReq_1",10,20,-1},
				{"isSecRowRiLegExtMotPosReqTargPosReq_1",10,7,-1},
				{"isSecRowRiSideSldMotPosReqSpeed",8,63,-1},
				{"isSecRowRiSideSldMotPosReqTargPosReq",10,41,-1},
				{"isSecRowRiLegExtMotPosReqSpeed_1",8,13,-1},
				{"isSecRowRiLegExtMotMoveReq_1",2,47,45}
			},
			{
				{"igSecRowRiLegRotMotPosReq_1","ZCUDZCUDCAN1SignalIPdu89",34},
				{"igSecRowRiLegExtMotPosReq_1","ZCUDZCUDCAN1SignalIPdu89",21},
				{"igSecRowRiSideSldMotPosReq","ZCUDZCUDCAN1SignalIPdu89",33}
			}
		},
		{
			"ZCUD_CAN1","ZCUDZCUDCAN1Fr50","Out",0x471,8,800,0,0,0,2,0,
			{
				{"isCmptmtOxygenConcVluFrmClima_1",10,7,13},
				{"isVehHomePrkgSysSts_1",5,63,58}
			},
			{
				{"","",-1}
			}
		},
		{"ZCUD_CAN1","ZcudToHrmZCUDCan1DiagReqFr","Out",0x730,8,0,0,4,0},
		{"ZCUD_CAN1","ZCUDZCUDCAN1Fr18","Out",0x181,8,0,0,1,0},
		{
			"ZCUD_CAN1","ZcudZCUCAN1VFCVectorFr","Out",0x541,8,1000,0,0,0,63,1,
			{
				{"isVFCVectorZCUDMVFCid47_5",1,49,-1},
				{"isVFCVectorZCUDMVFCid28_5",1,30,-1},
				{"isVFCVectorZCUDMVFCid31_5",1,33,-1},
				{"isVFCVectorZCUDMBlockID_5",2,1,-1},
				{"isVFCVectorZCUDMVFCid44_5",1,46,-1},
				{"isVFCVectorZCUDMVFCid54_5",1,56,-1},
				{"isVFCVectorZCUDMVFCid52_5",1,54,-1},
				{"isVFCVectorZCUDMVFCid4_5",1,6,-1},
				{"isVFCVectorZCUDMVFCid57_5",1,59,-1},
				{"isVFCVectorZCUDMVFCid9_5",1,11,-1},
				{"isVFCVectorZCUDMVFCid33_5",1,35,-1},
				{"isVFCVectorZCUDMVFCid45_5",1,47,-1},
				{"isVFCVectorZCUDMVFCid3_5",1,5,-1},
				{"isVFCVectorZCUDMVFCid59_5",1,61,-1},
				{"isVFCVectorZCUDMVFCid12_5",1,14,-1},
				{"isVFCVectorZCUDMVFCid49_5",1,51,-1},
				{"isVFCVectorZCUDMVFCid60_5",1,62,-1},
				{"isVFCVectorZCUDMVFCid21_5",1,23,-1},
				{"isVFCVectorZCUDMVFCid56_5",1,58,-1},
				{"isVFCVectorZCUDMVFCid37_5",1,39,-1},
				{"isVFCVectorZCUDMVFCid30_5",1,32,-1},
				{"isVFCVectorZCUDMVFCid58_5",1,60,-1},
				{"isVFCVectorZCUDMVFCid36_5",1,38,-1},
				{"isVFCVectorZCUDMVFCid41_5",1,43,-1},
				{"isVFCVectorZCUDMVFCid61_5",1,63,-1},
				{"isVFCVectorZCUDMVFCid39_5",1,41,-1},
				{"isVFCVectorZCUDMVFCid42_5",1,44,-1},
				{"isVFCVectorZCUDMVFCid15_5",1,17,-1},
				{"isVFCVectorZCUDMVFCid53_5",1,55,-1},
				{"isVFCVectorZCUDMVFCid20_5",1,22,-1},
				{"isVFCVectorZCUDMVFCid25_5",1,27,-1},
				{"isVFCVectorZCUDMVFCid55_5",1,57,-1},
				{"isVFCVectorZCUDMVFCid48_5",1,50,-1},
				{"isVFCVectorZCUDMVFCid13_5",1,15,-1},
				{"isVFCVectorZCUDMVFCid5_5",1,7,-1},
				{"isVFCVectorZCUDMVFCid11_5",1,13,-1},
				{"isVFCVectorZCUDMVFCid7_5",1,9,-1},
				{"isVFCVectorZCUDMVFCid17_5",1,19,-1},
				{"isVFCVectorZCUDMVFCid16_5",1,18,-1},
				{"isVFCVectorZCUDMVFCid22_5",1,24,-1},
				{"isVFCVectorZCUDMVFCid46_5",1,48,-1},
				{"isVFCVectorZCUDMVFCid23_5",1,25,-1},
				{"isVFCVectorZCUDMVFCid50_5",1,52,-1},
				{"isVFCVectorZCUDMVFCid0_5",1,2,-1},
				{"isVFCVectorZCUDMVFCid10_5",1,12,-1},
				{"isVFCVectorZCUDMVFCid8_5",1,10,-1},
				{"isVFCVectorZCUDMVFCid18_5",1,20,-1},
				{"isVFCVectorZCUDMVFCid6_5",1,8,-1},
				{"isVFCVectorZCUDMVFCid19_5",1,21,-1},
				{"isVFCVectorZCUDMVFCid51_5",1,53,-1},
				{"isVFCVectorZCUDMVFCid24_5",1,26,-1},
				{"isVFCVectorZCUDMVFCid43_5",1,45,-1},
				{"isVFCVectorZCUDMVFCid29_5",1,31,-1},
				{"isVFCVectorZCUDMVFCid14_5",1,16,-1},
				{"isVFCVectorZCUDMVFCid32_5",1,34,-1},
				{"isVFCVectorZCUDMVFCid27_5",1,29,-1},
				{"isVFCVectorZCUDMVFCid2_5",1,4,-1},
				{"isVFCVectorZCUDMVFCid26_5",1,28,-1},
				{"isVFCVectorZCUDMVFCid40_5",1,42,-1},
				{"isVFCVectorZCUDMVFCid34_5",1,36,-1},
				{"isVFCVectorZCUDMVFCid35_5",1,37,-1},
				{"isVFCVectorZCUDMVFCid38_5",1,40,-1},
				{"isVFCVectorZCUDMVFCid1_5",1,3,-1}
			},
			{
				{"igVFCVectorZCUDM_5","ZcudZCUCAN1VFCVectorSignalIPdu",-1}
			}
		},
		{
			"ZCUD_CAN1","ZCUDZCUDCAN1Fr63","Out",0x1b,8,10,0,0,0,5,1,
			{
				{"isSteerWhlSnsrCntr_3",4,55,-1},
				{"isSteerWhlSnsrAgSpd_3",14,29,-1},
				{"isSteerWhlSnsrChks_3",8,47,-1},
				{"isSteerWhlSnsrQf_3",2,31,-1},
				{"isSteerWhlSnsrAg_3",15,14,-1}
			},
			{
				{"igSteerWhlSnsr_3","ZCUDZCUDCAN1SignalIPDU63",15}
			}
		},
		{
			"ZCUD_CAN1","ZCUDZCUDCAN1Fr26","Out",0x32f,8,85,0,0,0,12,3,
			{
				{"isThrdRowRiSeatDispMassgFctMassgProg_1",3,61,-1},
				{"isBrkPedlPsdBrkPedlNotPsdSafe_2",1,7,-1},
				{"isBrkPedlPsdCntr_2",4,3,-1},
				{"isThrdRowLeSeatDispMassgFctMassgInten_1",2,55,-1},
				{"isBrkPedlPsdBrkPedlPsd_2",1,6,-1},
				{"isDrvrMonrAlrmReqFromDHU_1",4,22,18},
				{"isThrdRowLeSeatDispMassgFctMassgProg_1",3,53,-1},
				{"isBrkPedlPsdChks_2",8,15,-1},
				{"isThrdRowRiSeatDispMassgFctMassgInten_1",2,63,-1},
				{"isBrkPedlPsdQf_2",2,5,-1},
				{"isThrdRowLeSeatDispMassgFctOnOffl2_1",2,50,-1},
				{"isThrdRowRiSeatDispMassgFctOnOffl2_1",2,58,-1}
			},
			{
				{"igThrdRowLeSeatDispMassgFct_1","ZCUDZCUDCAN1SignalIPDU26",48},
				{"igThrdRowRiSeatDispMassgFct_1","ZCUDZCUDCAN1SignalIPDU26",56},
				{"igBrkPedlPsd_2","ZCUDZCUDCAN1SignalIPDU26",23}
			}
		},
		{"ZCUD_CAN1","ZcudToCmdZCUDCan1DiagReqFr","Out",0x71c,8,0,0,4,0},
		{"ZCUD_CAN1","ZCUDZCUDCAN1Fr33","Out",0x340,8,0,0,1,0},
		{
			"ZCUD_CAN1","ZCUDZCUDCAN1Fr69","Out",0x310,8,175,0,0,0,7,2,
			{
				{"isWirelschrgActvReqFromHmi_1",1,7,6},
				{"isSeatRowThrdRiInclPosAngleAngleDeg180_1",8,36,-1},
				{"isSeatRowThrdRiInclPosAngleQf1_1",2,44,-1},
				{"isSeatRowThrdLeInclPosAngleAngleDeg180_1",8,31,-1},
				{"isSeatRowThrdLeInclPosAngleQf1_1",2,39,-1},
				{"isRlyPreCmdCmft",1,41,40},
				{"isBkpOfDstTrvld_4",21,4,5}
			},
			{
				{"igSeatRowThrdRiInclPosAngle_1","ZCUDZCUDCAN1SignalIPDU69",42},
				{"igSeatRowThrdLeInclPosAngle_1","ZCUDZCUDCAN1SignalIPDU69",37}
			}
		},
		{"ZCUD_CAN1","ZCUDZCUDCAN1Fr34","Out",0x132,8,0,0,1,0},
		{"ZCUD_CAN1","ZcudToSdrZCUDCan1DiagReqFr","Out",0x724,8,0,0,4,0},
		{"ZCUD_CAN1","ZcudToSrsISO26021ZCUDCAN1DiagResFrame11","Out",0x7f1,8,0,0,4,0},
		{
			"ZCUD_CAN1","ZCUDZCUDCAN1Fr12","Out",0x388,8,350,0,0,0,9,1,
			{
				{"isCrsCtrlrStbOk_2",1,5,4},
				{"isAsyAutDrvCtrlTyp_1",3,14,11},
				{"isBrkAndAbsWarnIndcnReqChks_1",8,23,-1},
				{"isSwtLiHzrdWarn_1",1,15,0},
				{"isCrsCtrlrActvnOk_1",1,7,6},
				{"isBrkAndAbsWarnIndcnReqBrkWarnIndcnReq_1",1,25,-1},
				{"isBrkAndAbsWarnIndcnReqCntr_1",4,31,-1},
				{"isEscCtrlIndcn_2",2,3,1},
				{"isBrkAndAbsWarnIndcnReqAbsWarnIndcnReq_1",2,27,-1}
			},
			{
				{"igBrkAndAbsWarnIndcnReq_1","ZCUDZCUDCAN1SignalIPDU12",24}
			}
		},
		{
			"ZCUD_CAN1","ZCUDZCUDCAN1Fr72","Out",0x135,8,200,0,0,0,3,1,
			{
				{"isSecRowRiDivePosSeatPosQf_1",2,49,-1},
				{"isEmgyBrkLiIndcrTurn_1",2,25,26},
				{"isSecRowRiDivePosSeatPosPerc_1",10,43,-1}
			},
			{
				{"igSecRowRiDivePos_1","ZCUDZCUDCAN1SignalIPDU72",31}
			}
		},
		{"ZCUD_CAN1","ZcudToWpcZCUDCan1DiagReqFr","Out",0x72b,8,0,0,4,0},
		{"ZCUD_CAN1","ZcudToAllFuncZcudCAN1DiagReqFr","Out",0x7ff,8,0,0,4,0},
		{
			"ZCUD_CAN1","ZCUDZCUDCAN1Fr24","Out",0x206,8,100,0,0,0,10,1,
			{
				{"isAccrPedlRatAccrPedlRat_2",15,6,-1},
				{"isCllsnAidPost_1",1,44,45},
				{"isSldngDoorLeReModSts_1",1,27,26},
				{"isAccrPedlRatGrdt_1",15,54,55},
				{"isThrPos_2",8,39,47},
				{"isAccrPedlRatCntr_2",4,31,-1},
				{"isTrlrLampChkAutReq_1",1,41,40},
				{"isAccrPedlRatChks_2",8,23,-1},
				{"isSldngDoorRiReModSts_1",1,25,24},
				{"isTwbrRelsReq_1",2,43,46}
			},
			{
				{"igAccrPedlRat_2","ZCUDZCUDCAN1SignalIPDU24",7}
			}
		},
		{
			"ZCUD_CAN1","ZCUDZCUDCAN1Fr95","Out",0x12f,8,30,0,0,0,12,2,
			{
				{"isThrdRowRiLegRotMotPosReqSpeed",8,13,-1},
				{"isThrdRowRiCushFldLckMotReq",2,60,58},
				{"isThrdRowRiLegRotMotPosReqTargPosReq",10,7,-1},
				{"isThrdRowRiLegRotMotMoveReq",2,47,45},
				{"isSecRowRiRotLckMotMoveReq",2,52,50},
				{"isThrdRowRiInclMotMoveReq",2,41,48},
				{"isThrdRowRiCushFldMotMoveReq",2,33,49},
				{"isSecRowLeRotLckMotMoveReq",2,55,53},
				{"isThrdRowRiSldMotPosReqSpeed",8,26,-1},
				{"isThrdRowLeCushFldLckMotReq",2,63,61},
				{"isThrdRowRiSldMotPosReqTargPosReq",10,20,-1},
				{"isThrdRowRiSldMotMoveReq",2,44,42}
			},
			{
				{"igThrdRowRiLegRotMotPosReq","ZCUDZCUDCAN1SignalIPdu95",21},
				{"igThrdRowRiSldMotPosReq","ZCUDZCUDCAN1SignalIPdu95",34}
			}
		},
		{"ZCUD_CAN1","ZcudToWprrZCUDCan1DiagReqFr","Out",0x737,8,0,0,4,0},
		{"ZCUD_CAN1","ZcudToSmrZCUDCAN1DiagReqFrame","Out",0x729,8,0,0,4,0},
		{
			"ZCUD_CAN1","ZCUDZCUDCAN1Fr92","Out",0x12d,8,30,0,0,0,8,3,
			{
				{"isThrdRowRiCushFldMotPosReqSpeed",8,63,-1},
				{"isThrdRowRiCushFldMotPosReqTargPosReq",10,41,-1},
				{"isThrdRowLeInclMotPosReqTargPosReq",10,20,-1},
				{"isThrdRowLeCushFldMotPosReqSpeed",8,13,-1},
				{"isThrdRowLeInclMotPosReqSpeed",8,26,-1},
				{"isThrdRowLeInclMotMoveReq",2,44,42},
				{"isThrdRowLeCushFldMotMoveReq",2,47,45},
				{"isThrdRowLeCushFldMotPosReqTargPosReq",10,7,-1}
			},
			{
				{"igThrdRowRiCushFldMotPosReq","ZCUDZCUDCAN1SignalIPdu92",33},
				{"igThrdRowLeCushFldMotPosReq","ZCUDZCUDCAN1SignalIPdu92",21},
				{"igThrdRowLeInclMotPosReq","ZCUDZCUDCAN1SignalIPdu92",34}
			}
		},
		{"ZCUD_CAN1","ZcudToSmblZCUDCAN1DiagReqFrame","Out",0x731,8,0,0,4,0},
		{
			"ZCUD_CAN1","ZCUDZCUDCAN1Fr13","Out",0x366,8,40,0,0,0,6,0,
			{
				{"isDrvgAstOnSysSts_1",4,36,32},
				{"isHvacAirMFlowEstimd_1",10,7,13},
				{"isHvacAirMFlowReEstimd_1",10,12,18},
				{"isRlyPwrDistbnCmd1WdIgnRlyCmd_3",1,53,52},
				{"isSumActv_1",1,47,46},
				{"isReqForPassAirbIndcnAckd_1",1,55,54}
			},
			{
				{"","",-1}
			}
		},
		{
			"ZCUD_CAN1","ZCUDZCUDCAN1Fr58","Out",0x20,8,200,0,0,0,7,1,
			{
				{"isOxygenCooltFlowSts_1",1,14,13},
				{"isSecRowLeDivePosSeatPosQf_1",2,53,-1},
				{"isSecRowLeDivePosSeatPosPerc_1",10,47,-1},
				{"isTrlrLiBrkActvt_1",1,60,59},
				{"isIndcrSts_3",2,58,56},
				{"isDrvrSeatSts_3",2,50,48},
				{"isTrlrLiTurnIndcrActvt_1",2,2,15}
			},
			{
				{"igSecRowLeDivePos_1","ZCUDZCUDCAN1SignalIPDU58",51}
			}
		},
		{
			"ZCUD_CAN1","ZCUDZCUDCAN1Fr27","Out",0x54,8,10,0,0,0,10,1,
			{
				{"isBrkSysCylPMstAct_1",10,23,-1},
				{"isDoorOpenwarnRiIndcn_1",2,50,48},
				{"isBrkSysCylPMstActQf_1",2,5,-1},
				{"isBrkSysCylPMstTar_1",10,29,-1},
				{"isBrkSysCylPMstVirtQf_1",2,41,-1},
				{"isLowrTailgOpenHmiReq_1",2,55,7},
				{"isBrkSysCylPMstVirt_1",10,35,-1},
				{"isBrkSysCylPMstCntr_1",4,3,-1},
				{"isDoorOpenwarnLeIndcn_1",2,53,51},
				{"isBrkSysCylPMstChks_1",8,15,-1}
			},
			{
				{"igBrkSysCylPMst_1","ZCUDZCUDCAN1SignalIPDU27",6}
			}
		},
		{
			"ZCUD_CAN1","ZCUDZCUDCAN1Fr40","Out",0x228,8,100,0,0,0,17,1,
			{
				{"isHmiSeatHeatgForRowSecLe_1",3,7,1},
				{"isKeyScanActv_1",1,63,62},
				{"isPrkgStsToEDRreserved2_1",3,43,-1},
				{"isHmiSeatVentnForRowSecRi_1",3,20,16},
				{"isHmiSeatVentnForRowSecLe_1",3,23,17},
				{"isPrkgStsToEDRHPATo_1",3,36,-1},
				{"isPrkgStsToEDRreserved1_1",3,46,-1},
				{"isPrkgStsToEDRLSDAandTBATo_1",3,33,-1},
				{"isHmiSeatVentnForRowThrdLe_1",3,31,25},
				{"isPrkgStsToEDRAPATo_1",3,39,-1},
				{"isHmiSeatHeatgForRowSecRi_1",3,4,0},
				{"isPrkgStsToEDRreserved3_1",3,40,-1},
				{"isHmiSeatHeatgForRowThrdLe_1",3,15,9},
				{"isDrvrSeatAdpvLumSetg_1",1,49,48},
				{"isHmiSeatVentnForRowThrdRi_1",3,28,24},
				{"isHmiSeatHeatgForRowThrdRi_1",3,12,8},
				{"isPrkgStsToEDRRPATo_1",3,53,-1}
			},
			{
				{"igPrkgStsToEDR_1","ZCUDZCUDCAN1SignalIPDU40",50}
			}
		},
		{
			"ZCUD_CAN1","ZCUDZCUDCAN1Fr37","Out",0x76,8,20,0,0,0,9,1,
			{
				{"isVehSpdLgtQf_5",2,43,-1},
				{"isDoorPassReRealLockSts_1",2,52,50},
				{"isVehSpdLgtCntr_5",4,47,-1},
				{"isVehSpdLgtChks_5",8,39,-1},
				{"isDoorSldngRiReRelsReq",2,57,40},
				{"isPassLockContnSts_1",1,49,48},
				{"isDoorPassRealLockSts_1",2,55,53},
				{"isDoorSldngLeReRelsReq",2,59,41},
				{"isVehSpdLgtA_5",15,22,-1}
			},
			{
				{"igVehSpdLgt_5","ZCUDZCUDCAN1SignalIPDU37",23}
			}
		},
		{
			"ZCUD_CAN1","CEMBodyFr139","Out",0x51,8,20,0,0,0,2,0,
			{
				{"isPwrSldgDoorLePosnReqFromHmi_1",7,31,24},
				{"isPwrSldgDoorRiPosnReqFromHmi_1",7,39,32}
			},
			{
				{"","",-1}
			}
		},
		{
			"ZCUD_CAN1","ZCUDZCUDCAN1Fr80","Out",0x110,8,15,0,0,0,10,2,
			{
				{"isWhlSpdCircumlFrntCntr_1",4,31,-1},
				{"isWhlDirRotlFrntCntr_1",4,63,-1},
				{"isWhlDirRotlFrntChks_1",8,55,-1},
				{"isWhlSpdCircumlFrntChks_1",8,23,-1},
				{"isWhlSpdCircumlFrntRiQf_1",2,25,-1},
				{"isWhlSpdCircumlFrntLe_1",15,6,-1},
				{"isWhlSpdCircumlFrntLeQf_1",2,27,-1},
				{"isWhlDirRotlFrntLe_1",2,59,-1},
				{"isWhlSpdCircumlFrntWhlSpdCircumlFrntRi_1",15,39,-1},
				{"isWhlDirRotlFrntRi_1",2,57,-1}
			},
			{
				{"igWhlSpdCircumlFrnt_1","ZCUDZCUDCAN1SignalIPdu80",7},
				{"igWhlDirRotlFrnt_1","ZCUDZCUDCAN1SignalIPdu80",40}
			}
		},
		{
			"ZCUD_CAN1","ZCUDZCUDCAN1Fr06","Out",0x330,8,215,0,0,0,5,2,
			{
				{"isChrgnUReqCntr_1",4,23,-1},
				{"isChrgnUReqChrgnUReq_1",8,15,-1},
				{"isVehBattUSysUQf_4",2,47,-1},
				{"isVehBattUSysU_4",8,39,-1},
				{"isChrgnUReqChks_1",8,7,-1}
			},
			{
				{"igVehBattU_4","ZCUDZCUDCAN1SignalIPDU06",45},
				{"igChrgnUReq_1","ZCUDZCUDCAN1SignalIPDU06",19}
			}
		},
		{
			"ZCUD_CAN1","CemBodyFr137","Out",0x196,8,55,0,0,0,4,0,
			{
				{"isSecRowLeSeatMotPosnCalReq_1",1,51,35},
				{"isDoorSldngLeReOpenEnaSts_0",1,15,14},
				{"isDoorSldngRiReOpenEnaSts_0",1,13,12},
				{"isSecRowRiSeatMotPosnCalReq_1",1,8,36}
			},
			{
				{"","",-1}
			}
		},
		{
			"ZCUD_CAN1","ZCUDZCUDCAN1Fr85","Out",0x125,8,30,0,0,0,8,3,
			{
				{"isSecRowLeSideSldMotMoveReq",2,44,42},
				{"isSecRowLeSideSldMotPosReqTargPosReq",10,20,-1},
				{"isSecRowLeRotMotPosReqSpeed",8,13,-1},
				{"isSecRowLeZeroGrvyMotPosReqSpeed",8,63,-1},
				{"isSecRowLeRotMotPosReqTargPosReq",10,7,-1},
				{"isSecRowLeRotMotMoveReq",2,47,45},
				{"isSecRowLeZeroGrvyMotPosReqTargPosReq",10,41,-1},
				{"isSecRowLeSideSldMotPosReqSpeed",8,26,-1}
			},
			{
				{"igSecRowLeZeroGrvyMotPosReq","ZCUDZCUDCAN1SignalIPdu85",33},
				{"igSecRowLeSideSldMotPosReq","ZCUDZCUDCAN1SignalIPdu85",34},
				{"igSecRowLeRotMotPosReq","ZCUDZCUDCAN1SignalIPdu85",21}
			}
		},
		{
			"ZCUD_CAN1","ZCUDZCUDCAN1Fr02","Out",0x48c,8,1000,0,0,0,8,1,
			{
				{"isListOfNodToSMx",8,55,63},
				{"isTiAndDateIndcnSec1_4",6,5,-1},
				{"isTiAndDateIndcnMins1_4",6,13,-1},
				{"isTiAndDateIndcnDay_4",5,28,-1},
				{"isTiAndDateIndcnDataValid_4",1,6,-1},
				{"isTiAndDateIndcnHr1_4",5,20,-1},
				{"isTiAndDateIndcnYr1_4",7,46,-1},
				{"isTiAndDateIndcnMth1_4",4,35,-1}
			},
			{
				{"igTiAndDateIndcn_4","ZCUDZCUDCAN1SignalIPDU02",7}
			}
		},
		{
			"ZCUD_CAN1","ZCUDZCUDCAN1Fr45","Out",0x351,8,420,0,0,0,8,1,
			{
				{"isCrsCtrlrMsg_2",3,15,12},
				{"isBrkTqAtWhlsReq_2",12,23,27},
				{"isAmbTIndcdWithUnitAmbTIndcdUnit_2",2,39,-1},
				{"isRMLCmftFctReq_1",1,4,3},
				{"isAmbTIndcdWithUnitQF_2",2,37,-1},
				{"isAmbTIndcdWithUnitAmbTIndcd_2",12,35,-1},
				{"isRMRCmftFctReq_1",1,2,1},
				{"isTurnIndcrAndHwlByDrvInt_1",2,7,5}
			},
			{
				{"igAmbTIndcdWithUnit_2","ZCUDZCUDCAN1SignalIPDU45",0}
			}
		},
		{
			"ZCUD_CAN1","ZCUDZCUDCAN1Fr09","Out",0x371,8,150,0,0,0,10,0,
			{
				{"isDrvrSeatSnsrSts_1",2,5,31},
				{"isSeatOccptAtRowSecDrSide2_1",2,27,25},
				{"isEngN2_1",15,14,15},
				{"isRlyPwrDistbnCmd1WdPreBattSaveCmd_2",1,50,49},
				{"isCarModCrashSaved",1,7,6},
				{"isPostImpctBrkgRdy_1",2,29,30},
				{"isHvBattPreChrgReq_3",1,52,51},
				{"isSeatOccptAtRowSecDrSideSnsSts2_1",2,55,24},
				{"isIsgSpdActSgn_2",16,39,53},
				{"isAD4DrvrBeltWarn_1",3,2,3}
			},
			{
				{"","",-1}
			}
		},
		{
			"ZCUD_CAN1","ZCUDZCUDCAN1Fr96","Out",0x235,8,70,0,0,0,4,1,
			{
				{"isBrkFricTqTotAtWhlsActCntr_1",4,31,-1},
				{"isBrkFricTqTotAtWhlsActBrkFricTqTotAtWhlsAct_1",15,6,-1},
				{"isOxygenSplyPwrAllwd_1",11,26,27},
				{"isBrkFricTqTotAtWhlsActChks_1",8,23,-1}
			},
			{
				{"igBrkFricTqTotAtWhlsAct_1","ZCUDZCUDCAN1SignalIPdu96",7}
			}
		},
		{"ZCUD_CAN1","ZcudToTrmZCUDCAN1DiagReqFrame","Out",0x717,8,0,0,4,0},
		{"ZCUD_CAN1","ZcudToCrpmZCUDCan1DiagReqFr","Out",0x726,8,0,0,4,0},
		{
			"ZCUD_CAN1","ZCUDZCUDCAN1Fr93","Out",0x126,8,30,0,0,0,8,3,
			{
				{"isThrdRowLeLegRotMotPosReqSpeed",8,13,-1},
				{"isThrdRowRiInclMotPosReqTargPosReq",10,41,-1},
				{"isThrdRowLeSldMotPosReqTargPosReq",10,20,-1},
				{"isThrdRowLeLegRotMotPosReqTargPosReq",10,7,-1},
				{"isThrdRowLeLegRotMotMoveReq",2,47,45},
				{"isThrdRowLeSldMotPosReqSpeed",8,26,-1},
				{"isThrdRowRiInclMotPosReqSpeed",8,63,-1},
				{"isThrdRowLeSldMotMoveReq",2,44,42}
			},
			{
				{"igThrdRowLeSldMotPosReq","ZCUDZCUDCAN1SignalIPdu93",34},
				{"igThrdRowRiInclMotPosReq","ZCUDZCUDCAN1SignalIPdu93",33},
				{"igThrdRowLeLegRotMotPosReq","ZCUDZCUDCAN1SignalIPdu93",21}
			}
		},
		{
			"ZCUD_CAN1","ZCUDZCUDCAN1Fr03","Out",0xe0,8,40,0,0,0,8,0,
			{
				{"isDoorPassSts_3",2,31,29},
				{"isTrPosnUpprProgmReq_1",1,28,27},
				{"isTrSts_3",2,47,45},
				{"isTrlrLiFogActvt_1",1,59,60},
				{"isTopPosTrFromHmi_1",3,58,15},
				{"isIntrBriSts_6",4,43,44},
				{"isDoorRiReSts_2",2,13,14},
				{"isTrlrLampChkReqFromHmi_1",2,63,61}
			},
			{
				{"","",-1}
			}
		},
		{
			"ZCUD_CAN1","ZCUDZCUDCAN1Fr59","Out",0xea,8,40,0,0,0,11,3,
			{
				{"isDoorSldngLeReReqChks",8,7,-1},
				{"isDoorSldngLeReReqDoorOpenerReq1",2,23,-1},
				{"isDoorSldngRiReReqCntr",4,39,-1},
				{"isTrsmParkLockdCntr_1",4,51,-1},
				{"isDoorSldngLeReReqCntr",4,15,-1},
				{"isDoorSldngRiReReqTrigSrc2",4,35,-1},
				{"isTrsmParkLockdTrsmParkLockd_1",2,53,-1},
				{"isDoorSldngRiReReqChks",8,31,-1},
				{"isDoorSldngLeReReqTrigSrc2",4,11,-1},
				{"isTrsmParkLockdChks_1",8,63,-1},
				{"isDoorSldngRiReReqDoorOpenerReq1",2,47,-1}
			},
			{
				{"igDoorSldngLeReReq","ZCUDZCUDCAN1SignalIPDU59",21},
				{"igTrsmParkLockd_1","ZCUDZCUDCAN1SignalIPDU59",54},
				{"igDoorSldngRiReReq","ZCUDZCUDCAN1SignalIPDU59",55}
			}
		},
		{
			"ZCUD_CAN1","ZCUDZCUDCAN1Fr68","Out",0x180,8,200,0,0,0,1,0,
			{
				{"isTrlrLiRvsgActvt_1",1,56,57}
			},
			{
				{"","",-1}
			}
		},
		{
			"ZCUD_CAN1","ZCUDZCUDCAN1Fr84","Out",0x124,8,30,0,0,0,8,3,
			{
				{"isSecRowLeLegExtMotMoveReq_1",2,47,45},
				{"isSecRowLeLegRotMotMoveReq_1",2,44,42},
				{"isSecRowLeLegRotMotPosReqSpeed_1",8,26,-1},
				{"isSecRowLeInclMotPosReqSpeed_1",8,63,-1},
				{"isSecRowLeLegRotMotPosReqTargPosReq_1",10,20,-1},
				{"isSecRowLeInclMotPosReqTargPosReq_1",10,41,-1},
				{"isSecRowLeLegExtMotPosReqSpeed_1",8,13,-1},
				{"isSecRowLeLegExtMotPosReqTargPosReq_1",10,7,-1}
			},
			{
				{"igSecRowLeLegRotMotPosReq_1","ZCUDZCUDCAN1SignalIPdu84",34},
				{"igSecRowLeLegExtMotPosReq_1","ZCUDZCUDCAN1SignalIPdu84",21},
				{"igSecRowLeInclMotPosReq_1","ZCUDZCUDCAN1SignalIPdu84",33}
			}
		},
		{"ZCUD_CAN1","ZcudToSdlZCUDCan1DiagReqFr","Out",0x723,8,0,0,4,0},
		{"ZCUD_CAN1","ZcudToSmbrZCUDCAN1DiagReqFrame","Out",0x732,8,0,0,4,0},
		{
			"ZCUD_CAN1","ZCUDZCUDCAN1Fr67","Out",0x140,8,200,0,0,0,3,1,
			{
				{"isHvSysRlyStsCntr_2",4,27,-1},
				{"isHvSysRlyStsChks_2",8,39,-1},
				{"isHvSysRlyStsHvSysRlySts_2",2,29,-1}
			},
			{
				{"igHvSysRlySts_2","ZCUDZCUDCAN1SignalIPDU67",30}
			}
		},
		{
			"ZCUD_CAN1","ZCUDZCUDCAN1Fr48","Out",0x209,8,100,0,0,0,20,0,
			{
				{"isSeatClimaDurgClimaHmiSeatHeatgForRowThrdRi_1",2,20,18},
				{"isHmiSeatHeatAutStrtRowSecRi_1",1,39,38},
				{"isSeatMassgLumExtnCtrlDrvr_1",2,57,16},
				{"isSeatMassgCushBlstrCtrlDrvr_1",2,50,48},
				{"isWhlMotSysSpdAct_1",16,7,17},
				{"isSeatClimaDurgClimaHmiSeatHeatgForRowThrdLe_1",2,23,21},
				{"isHmiSeatVentAutStrtRowSecLe_1",1,33,32},
				{"isSeatClimaDurgClimaHmiSeatVentnForRowThrdRi_1",2,28,26},
				{"isHmiSeatVentAutStrtRowSecRi_1",1,47,46},
				{"isHmiSeatHeatAutStrtRowSecLe_1",1,25,24},
				{"isSeatMassgBackBlstrCtrlDrvr_1",2,55,53},
				{"isSeatMassgCushLiftCtrlDrvr_1",1,61,60},
				{"isDrvrSeatAdpvSideSpprtSetg_1",2,45,43},
				{"isSeatClimaDurgClimaHmiSeatVentnForRowThrdLe_1",2,31,29},
				{"isSeatMassgCushLiftEnaDrvr_1",1,59,58},
				{"isDrvrSeatSideSpprtSetg_2",2,42,40},
				{"isHmiSeatHeatAutStrtRowThrdRi_1",1,35,34},
				{"isHmiSeatHeatAutStrtRowThrdLe_1",1,37,36},
				{"isSeatMassgBackBlstrEnaDrvr_1",1,52,51},
				{"isSeatMassgCushBlstrEnaDrvr_1",1,63,62}
			},
			{
				{"","",-1}
			}
		},
		{
			"ZCUD_CAN1","SmtlZcudCAN1Fr01","Out",0x106,8,20,0,0,0,1,0,
			{
				{"isRowReLeModSwtSts_0",1,2,15}
			},
			{
				{"","",-1}
			}
		},
		{
			"ZCUD_CAN1","ZCUDZCUDCAN1Fr52","Out",0x121,8,30,0,0,0,5,1,
			{
				{"isPassSeatUnfoldSwt_1",1,55,54},
				{"isCmptmtTFrntCmptmtTFrnt_3",11,34,-1},
				{"isCmptmtTFrntQf_3",2,37,-1},
				{"isPassSeatFoldSwt_1",1,21,20},
				{"isCmptmtTFrntFanForCmptmtTRunng_3",1,35,-1}
			},
			{
				{"igCmptmtTFrnt_3","ZCUDZCUDCAN1SignalIPDU52",38}
			}
		},
		{
			"ZCUD_CAN1","ZCUDZCUDCAN1Fr14","Out",0x320,8,180,0,0,0,7,1,
			{
				{"isAsyALgtStsAsyALgtSts_1",4,43,-1},
				{"isDoorRiReLockSts_1",2,25,61},
				{"isDoorLeReLockSts_1",2,19,58},
				{"isDoorPassLockSts_1",2,23,60},
				{"isAsyALgtStsCntr_1",4,47,-1},
				{"isDoorDrvrLockSts_2",2,17,57},
				{"isAsyALgtStsChks_1",8,39,-1}
			},
			{
				{"igAsyALgtSts_1","ZCUDZCUDCAN1SignalIPDU14",63}
			}
		},
		{
			"ZCUD_CAN1","ZCUDZCUDCAN1Fr38","Out",0x118,8,30,0,0,0,6,0,
			{
				{"isDoorDrvrReRealLockSts_1",2,20,18},
				{"isTrOpenPosnReqFromHmi_1",7,14,15},
				{"isTopPercTrFromHmi_1",7,6,7},
				{"isDoorDrvrRealLockSts_1",2,23,21},
				{"isTrRelsReq_1",2,28,26},
				{"isDrvrLockContnSts_1",1,17,16}
			},
			{
				{"","",-1}
			}
		},
		{"ZCUD_CAN1","ZCUDZCUDCAN1Fr43","Out",0x318,8,0,0,1,0},
		{
			"ZCUD_CAN1","ZCUDZCUDCAN1Fr20","Out",0x394,8,800,0,0,0,18,2,
			{
				{"isLeReTireMsgBattLoSt_3",1,47,-1},
				{"isLeFrntTireMsgP_3",8,15,-1},
				{"isLeFrntTireMsgMsgOldFlg_3",1,5,-1},
				{"isLeReTireMsgP_3",8,55,-1},
				{"isLeReTireMsgT_3",8,63,-1},
				{"isLeReTireMsgTireFillgAssiPSts_3",1,40,-1},
				{"isLeFrntTireMsgTireFillgAssiPSts_3",1,0,-1},
				{"isLeFrntTireMsgPWarnFlg_3",2,4,-1},
				{"isLeReTireMsgFastLoseWarnFlg_3",1,46,-1},
				{"isLeReTireMsgMsgOldFlg_3",1,45,-1},
				{"isLeFrntTireMsgTWarnFlg_3",1,1,-1},
				{"isLeReTireMsgSysWarnFlg_3",1,42,-1},
				{"isLeFrntTireMsgSysWarnFlg_3",1,2,-1},
				{"isLeFrntTireMsgFastLoseWarnFlg_3",1,6,-1},
				{"isLeFrntTireMsgT_3",8,23,-1},
				{"isLeFrntTireMsgBattLoSt_3",1,7,-1},
				{"isLeReTireMsgPWarnFlg_3",2,44,-1},
				{"isLeReTireMsgTWarnFlg_3",1,41,-1}
			},
			{
				{"igLeFrntTireMsg_3","ZCUDZCUDCAN1SignalIPDU20",31},
				{"igLeReTireMsg_3","ZCUDZCUDCAN1SignalIPDU20",30}
			}
		},
		{"ZCUD_CAN1","ZcudToWprlZCUDCan1DiagReqFr","Out",0x736,8,0,0,4,0},
		{
			"ZCUD_CAN1","ZCUDZCUDCAN1Fr53","Out",0x490,8,60,0,0,0,13,2,
			{
				{"isSeatClimaDurgClimaHmiSeatHeatgForRowSecRi_1",2,47,-1},
				{"isSeatClimaDurgClimaHmiSeatHeatgForRowFirstLe_1",2,41,-1},
				{"isSeatClimaDurgClimaHmiSeatVentnForRowFirstRi_1",2,51,-1},
				{"isSeatClimaDurgClimaHmiSeatVentnForRowFirstLe_1",2,49,-1},
				{"isSeatClimaDurgClimaHmiSeatHeatgForRowFirstRi_1",2,43,-1},
				{"isAmbTEstimdQf_2",1,3,-1},
				{"isSeatClimaDurgClimaHmiSeatHeatgForRowSecLe_1",2,45,-1},
				{"isAmbTEstimdAmbTEstimd_2",11,2,-1},
				{"isSeatClimaDurgClimaHmiSeatVentnForRowSecRi_1",2,55,-1},
				{"isChdLockDrvrReSts_1",2,7,4},
				{"isSecRowLeSeatHeatgPwrAllwd_1",8,39,62},
				{"isSeatClimaDurgClimaHmiSeatVentnForRowSecLe_1",2,53,-1},
				{"isAsyNoaBltFastn_1",2,58,56}
			},
			{
				{"igSeatClimaDurgClima_1","ZCUDZCUDCAN1SignalIPDU53",63},
				{"igAmbTEstimd_2","ZCUDZCUDCAN1SignalIPDU53",5}
			}
		},
		{
			"ZCUD_CAN1","ZCUDZCUDCAN1Fr30","Out",0x131,8,15,0,0,0,5,2,
			{
				{"isVehSpdIndcdVeSpdIndcdUnit_2",2,18,-1},
				{"isEpbStsEpbSts_2",4,15,-1},
				{"isEpbStsCntr_2",4,11,-1},
				{"isEpbStsChks_2",8,7,-1},
				{"isVehSpdIndcdVehSpdIndcd_2",9,16,-1}
			},
			{
				{"igVehSpdIndcd_2","ZCUDZCUDCAN1SignalIPDU30",19},
				{"igEpbSts_2","ZCUDZCUDCAN1SignalIPDU30",50}
			}
		},
		{"ZCUD_CAN1","ZcudToTcmbZCUDCan1DiagReqFr","Out",0x72a,8,0,0,4,0},
		{
			"ZCUD_CAN1","ZCUDZCUDCAN1Fr31","Out",0x78,8,40,0,0,0,15,2,
			{
				{"isOccupyMonStsThrdMidSts_1",2,47,-1},
				{"isSwtIndcrIndcrTypExtReq_2",2,5,-1},
				{"isGearLvrIndcn_2",3,54,55},
				{"isSwtIndcrIndcrTypExtReqToUpdQf_2",2,1,-1},
				{"isOccupyMonStsSecMidSts_1",2,37,-1},
				{"isSeatOccptAtRowSecPasSideSnsSts2_1",2,51,40},
				{"isSwtIndcrIndcrTypExtReqChks_2",8,15,-1},
				{"isOccupyMonStsThrdLeSts_1",2,33,-1},
				{"isOccupyMonStsPassSts_1",2,25,-1},
				{"isSwtIndcrIndcrTypExtReqCntr_2",2,3,-1},
				{"isOccupyMonStsSecRiSts_1",2,35,-1},
				{"isOccupyMonStsDrvrSts_1",2,27,-1},
				{"isOccupyMonStsThrdRiSts_1",2,45,-1},
				{"isOccupyMonStsSeccLeSts_1",2,39,-1},
				{"isSeatOccptAtRowSecPasSide2_1",2,43,41}
			},
			{
				{"igOccupyMonSts_1","ZCUDZCUDCAN1SignalIPDU31",28},
				{"igSwtIndcr_2","ZCUDZCUDCAN1SignalIPDU31",6}
			}
		},
		{
			"ZCUD_CAN1","ZCUDZCUDCAN1Fr11","Out",0x39c,8,800,0,0,0,18,2,
			{
				{"isRiFrntTireMsgTireFillgAssiPSts_3",1,0,-1},
				{"isRiFrntTireMsgSysWarnFlg_3",1,2,-1},
				{"isRiFrntTireMsgPWarnFlg_3",2,4,-1},
				{"isRiFrntTireMsgMsgOldFlg_3",1,5,-1},
				{"isRiFrntTireMsgBattLoSt_3",1,7,-1},
				{"isRiReTireMsgP_3",8,55,-1},
				{"isRiReTireMsgTWarnFlg_3",1,41,-1},
				{"isRiReTireMsgSysWarnFlg_3",1,42,-1},
				{"isRiFrntTireMsgT_3",8,23,-1},
				{"isRiReTireMsgMsgOldFlg_3",1,45,-1},
				{"isRiFrntTireMsgP_3",8,15,-1},
				{"isRiReTireMsgTireFillgAssiPSts_3",1,40,-1},
				{"isRiReTireMsgPWarnFlg_3",2,44,-1},
				{"isRiFrntTireMsgTWarnFlg_3",1,1,-1},
				{"isRiReTireMsgBattLoSt_3",1,47,-1},
				{"isRiReTireMsgFastLoseWarnFlg_3",1,46,-1},
				{"isRiReTireMsgT_3",8,63,-1},
				{"isRiFrntTireMsgFastLoseWarnFlg_3",1,6,-1}
			},
			{
				{"igRiFrntTireMsg_3","ZCUDZCUDCAN1SignalIPDU11",31},
				{"igRiReTireMsg_3","ZCUDZCUDCAN1SignalIPDU11",30}
			}
		},
		{
			"ZCUD_CAN1","ZCUDZCUDCAN1Fr04","Out",0xf0,8,30,0,0,0,11,1,
			{
				{"isVehModMngtGlbSafe1EgyLvlElecSubtyp_7",4,31,-1},
				{"isVehModMngtGlbSafe1CarModSts1_7",3,2,-1},
				{"isVehModMngtGlbSafe1Chks_7",8,39,-1},
				{"isTrlrLiPosnActvt_1",2,45,46},
				{"isVehModMngtGlbSafe1PwrLvlElecSubtyp_7",4,23,-1},
				{"isVehModMngtGlbSafe1PwrLvlElecMai_7",4,19,-1},
				{"isVehModMngtGlbSafe1FltEgyCnsWdSts_7",1,6,-1},
				{"isVehModMngtGlbSafe1EgyLvlElecMai_7",4,27,-1},
				{"isVehModMngtGlbSafe1Cntr_7",4,15,-1},
				{"isVehModMngtGlbSafe1CarModSubtypWdCarModSubtyp_7",3,5,-1},
				{"isVehModMngtGlbSafe1UsgModSts_7",4,11,-1}
			},
			{
				{"igVehModMngtGlbSafe1_7","ZCUDZCUDCAN1SignalIPDU04",7}
			}
		},
		{
			"ZCUD_CAN1","ZCUDZCUDCAN1Fr36","Out",0x80,8,90,0,0,0,8,1,
			{
				{"isVinVINSignalPos1_1",8,15,-1},
				{"isVinVINSignalPos7_1",8,63,-1},
				{"isVinVINSignalPos6_1",8,55,-1},
				{"isVinVINSignalPos4_1",8,39,-1},
				{"isVinVINSignalPos5_1",8,47,-1},
				{"isVinVINSignalPos2_1",8,23,-1},
				{"isVinBlockNr_1",8,7,-1},
				{"isVinVINSignalPos3_1",8,31,-1}
			},
			{
				{"igVin_1","ZCUDZCUDCAN1SignalIPDU36",-1}
			}
		},
		{
			"ZCUD_CAN1","ZCUDZCUDCAN1Fr88","Out",0x129,8,30,0,0,0,8,3,
			{
				{"isSecRowRiHeiMotPosReqTargPosReq",10,7,-1},
				{"isSecRowRiInclMotPosReqTargPosReq_1",10,20,-1},
				{"isSecRowRiRotMotPosReqTargPosReq",10,41,-1},
				{"isSecRowRiHeiMotMoveReq",2,47,45},
				{"isSecRowRiHeiMotPosReqSpeed",8,13,-1},
				{"isSecRowRiInclMotPosReqSpeed_1",8,26,-1},
				{"isSecRowRiRotMotPosReqSpeed",8,63,-1},
				{"isSecRowRiInclMotMoveReq_1",2,44,42}
			},
			{
				{"igSecRowRiHeiMotPosReq","ZCUDZCUDCAN1SignalIPdu88",21},
				{"igSecRowRiInclMotPosReq_1","ZCUDZCUDCAN1SignalIPdu88",34},
				{"igSecRowRiRotMotPosReq","ZCUDZCUDCAN1SignalIPdu88",33}
			}
		},
		{
			"ZCUD_CAN1","ZCUDZCUDCAN1Fr39","Out",0x399,8,1000,0,0,0,10,2,
			{
				{"isTrsmActrPosnSafeTrsmActrPosn_1",3,6,-1},
				{"isVehTiAndDataDay_3",5,36,-1},
				{"isVehTiAndDataHr1_3",5,47,-1},
				{"isTrsmActrPosnSafeTrsmActrPosnCntr_1",4,3,-1},
				{"isTrsmActrPosnSafeTrsmActrPosnChks_1",8,15,-1},
				{"isVehTiAndDataSec1_3",6,26,-1},
				{"isVehTiAndDataYr1_3",7,23,-1},
				{"isVehTiAndDataMth1_3",4,42,-1},
				{"isVehTiAndDataDataValid_3",1,54,-1},
				{"isVehTiAndDataMins1_3",6,16,-1}
			},
			{
				{"igVehTiAndData_3","ZCUDZCUDCAN1SignalIPDU39",53},
				{"igTrsmActrPosnSafe_1","ZCUDZCUDCAN1SignalIPDU39",7}
			}
		},
		{
			"ZCUD_CAN1","ZCUDZCUDCAN1Fr77","Out",0x214,8,100,0,0,0,12,2,
			{
				{"isSeatMassgFctDrvrOnOff_2",1,58,-1},
				{"isRoadInclnRoadIncln_2",16,31,-1},
				{"isSeatMassgFctDrvrMassgInten_2",2,60,-1},
				{"isRoadInclnQly_2",2,47,-1},
				{"isSeatHeatRowSecRiEna_1",1,42,41},
				{"isSeatVentnRowSecRiEna_1",1,55,54},
				{"isSeatUpLumPosCtrlDrvr_2",7,23,16},
				{"isSeatMassgLumMotrEnaDrvr_1",2,10,8},
				{"isSeatMassgLumHeiCtrlDrvr_1",2,15,13},
				{"isSeatMidLumPosCtrlDrvr_2",7,7,0},
				{"isSeatMassgFctDrvrMassgProg_2",3,63,-1},
				{"isSeatHeatRowSecLeEna_1",1,44,43}
			},
			{
				{"igRoadIncln_2","ZCUDZCUDCAN1SignalIPDU77",11},
				{"igSeatMassgFctDrvr_2","ZCUDZCUDCAN1SignalIPDU77",57}
			}
		},
		{"ZCUD_CAN1","RmrToZcudZCUDCAN1DiagResFrame","In",0x611,8,0,0,4,0},
		{"ZCUD_CAN1","OGMZCUDCAN1Fr03","In",0x2d0,8,0,0,0,0},
		{"ZCUD_CAN1","SrsZCUDCAN1Fr01","In",0x89,8,0,0,0,0},
		{"ZCUD_CAN1","PotToZcudZCUDCan1DiagResFr","In",0x615,8,0,0,4,0},
		{"ZCUD_CAN1","SmblZcudCAN1Fr18","In",0x104,8,0,0,0,0},
		{"ZCUD_CAN1","WPRRZCUDCAN1VFCVectorFr","In",0x573,8,0,0,0,0},
		{"ZCUD_CAN1","SmbrZcudCAN1Fr17","In",0x7d,8,0,0,0,0},
		{"ZCUD_CAN1","CrpmToZcudZCUDCan1DiagResFr","In",0x626,8,0,0,4,0},
		{"ZCUD_CAN1","SmblZcudCAN1Fr17","In",0x7a,8,0,0,0,0},
		{"ZCUD_CAN1","SmbToZcudZCUDCAN1DiagResFrame","In",0x629,8,0,0,4,0},
		{"ZCUD_CAN1","WprrZCUDCAN1Fr01","In",0x217,8,0,0,0,0},
		{"ZCUD_CAN1","PotZCUDCAN1Fr03","In",0x242,8,0,0,0,0},
		{"ZCUD_CAN1","WprlZCUDCAN1Fr01","In",0x200,8,0,0,0,0},
		{"ZCUD_CAN1","HrmZCUDCAN1Fr01","In",0x205,8,0,0,0,0},
		{"ZCUD_CAN1","RmlZcudCAN1Frame1","In",0x153,8,0,0,0,0},
		{"ZCUD_CAN1","WprrToZcudZCUDCAN1DiagResFrame","In",0x637,8,0,0,4,0},
		{"ZCUD_CAN1","TcmbZcudCAN1Fr01","In",0x255,8,0,0,0,0},
		{"ZCUD_CAN1","SrsZCUDCAN1Fr11","In",0x22f,8,0,0,0,0},
		{"ZCUD_CAN1","OgmZCUDCAN1NMFr01","In",0x531,8,0,0,3,0},
		{"ZCUD_CAN1","SrsZCUDCAN1Fr05","In",0x21,8,0,0,0,0},
		{"ZCUD_CAN1","OGMZCUDCAN1Fr02","In",0x301,8,0,0,0,0},
		{"ZCUD_CAN1","Wpc5ZCUDCAN1VFCVectorFr","In",0x567,8,0,0,0,0},
		{"ZCUD_CAN1","CrpmZcudCAN1Fr01","In",0x10a,8,0,0,0,0},
		{"ZCUD_CAN1","CrpmZcudCAN1Fr03","In",0x1f0,8,0,0,0,0},
		{"ZCUD_CAN1","CmdZcudCAN1Fr01","In",0x109,8,0,0,0,0},
		{"ZCUD_CAN1","ShmrSmtrZcudCAN1Fr01","In",0x151,8,0,0,0,0},
		{"ZCUD_CAN1","CrpmZcudCAN1Fr02","In",0x2fa,8,0,0,0,0},
		{"ZCUD_CAN1","SmbrZcudCAN1Fr01","In",0x7c,8,0,0,0,0},
		{"ZCUD_CAN1","WpcToZcudZCUDCan1DiagResFr","In",0x62b,8,0,0,4,0},
		{"ZCUD_CAN1","HrmToZcudZCUDCan1DiagResFr","In",0x630,8,0,0,4,0},
		{"ZCUD_CAN1","PotZCUDCAN1VFCVectorFr","In",0x547,8,0,0,0,0},
		{"ZCUD_CAN1","SrsZCUDCAN1Fr07","In",0x142,8,0,0,0,0},
		{"ZCUD_CAN1","SrsZCUDCAN1VFCVectorFr","In",0x55b,8,0,0,0,0},
		{"ZCUD_CAN1","SmblZcudCAN1Fr04","In",0x24b,8,0,0,0,0},
		{"ZCUD_CAN1","HRMZCUDCAN1VFCVectorFr","In",0x574,8,0,0,0,0},
		{"ZCUD_CAN1","WprlToZcudZCUDCAN1DiagResFrame","In",0x636,8,0,0,4,0},
		{"ZCUD_CAN1","SdlZcudCAN1Fr02","In",0x16a,8,0,0,0,0},
		{"ZCUD_CAN1","SmbrZcudCAN1Fr09","In",0x342,8,0,0,0,0},
		{"ZCUD_CAN1","SmbrZcudCAN1Fr12","In",0x219,8,0,0,0,0},
		{"ZCUD_CAN1","TrmZcudCAN1VFCVectorFr","In",0x54a,8,0,0,0,0},
		{"ZCUD_CAN1","SmtlZcudCAN1Fr03","In",0x208,8,0,0,0,0},
		{"ZCUD_CAN1","SdrToZcudZCUDCAN1DiagResFrame","In",0x624,8,0,0,4,0},
		{"ZCUD_CAN1","SmblZcudCAN1Fr03","In",0x298,8,0,0,0,0},
		{"ZCUD_CAN1","SmbrlZcudCAN1Fr10","In",0x166,8,0,0,0,0},
		{"ZCUD_CAN1","SmblZcudCAN1Fr16","In",0x32a,8,0,0,0,0},
		{"ZCUD_CAN1","SmbZcudCAN1VFCVectorFr","In",0x554,8,0,0,0,0},
		{"ZCUD_CAN1","SmblToZcudZCUDCAN1DiagResFrame","In",0x631,8,0,0,4,0},
		{"ZCUD_CAN1","SmbrZcudCAN1Fr18","In",0x185,8,0,0,0,0},
		{"ZCUD_CAN1","SmbSmbrZcudCAN1Fr01","In",0x115,8,0,0,0,0},
		{"ZCUD_CAN1","SmblZcudCAN1Fr07","In",0x335,8,0,0,0,0},
		{"ZCUD_CAN1","TrmZcudCAN1Fr02","In",0x91,8,0,0,0,0},
		{"ZCUD_CAN1","OGMZCUDCAN1Fr08","In",0x2c0,8,0,0,0,0},
		{"ZCUD_CAN1","SmblZcudCAN1Fr01","In",0x79,8,0,0,0,0},
		{"ZCUD_CAN1","WpcZCUDCAN1Fr01","In",0x30a,8,0,0,0,0},
		{"ZCUD_CAN1","SdlZcudCAN1VFCVectorFr","In",0x557,8,0,0,0,0},
		{"ZCUD_CAN1","TrmToZcudZCUDCAN1DiagResFrame","In",0x617,8,0,0,4,0},
		{"ZCUD_CAN1","OGMZCUDCAN1Fr07","In",0x2eb,8,0,0,0,0},
		{"ZCUD_CAN1","SdrZcudCAN1Fr02","In",0x16b,8,0,0,0,0},
		{"ZCUD_CAN1","CmdZcudCAN1VFCVectorFr","In",0x548,8,0,0,0,0},
		{"ZCUD_CAN1","SmbSmblZcudCAN1Fr01","In",0x100,8,0,0,0,0},
		{"ZCUD_CAN1","SrsZCUDCAN1Fr03","In",0x12,8,0,0,0,0},
		{"ZCUD_CAN1","SmbrZcudCAN1Fr04","In",0x24a,8,0,0,0,0},
		{"ZCUD_CAN1","SmblZcudCAN1Fr10","In",0x165,8,0,0,0,0},
		{"ZCUD_CAN1","SmblZcudCAN1VFCVectorFr","In",0x559,8,0,0,0,0},
		{"ZCUD_CAN1","SmbrZcudCAN1Fr06","In",0x329,8,0,0,0,0},
		{"ZCUD_CAN1","OGMZCUDCAN1Fr05","In",0x2da,8,0,0,0,0},
		{"ZCUD_CAN1","SrsZCUDCAN1Fr06","In",0x225,8,0,0,0,0},
		{"ZCUD_CAN1","OGMZCUDCAN1Fr04","In",0x2d4,8,0,0,0,0},
		{"ZCUD_CAN1","CrpmZcudCAN1VFCVectorFr","In",0x56d,8,0,0,0,0},
		{"ZCUD_CAN1","SmbrToZcudZCUDCAN1DiagResFrame","In",0x632,8,0,0,4,0},
		{"ZCUD_CAN1","TrmZcudCAN1Fr03","In",0x159,8,0,0,0,0},
		{"ZCUD_CAN1","OGMZCUDCAN1Fr06","In",0x2e5,8,0,0,0,0},
		{"ZCUD_CAN1","CrpmZcudCAN1Fr04","In",0x1fa,8,0,0,0,0},
		{"ZCUD_CAN1","SmblZcudCAN1Fr05","In",0x201,8,0,0,0,0},
		{"ZCUD_CAN1","RmlToZcudZCUDCAN1DiagResFrame","In",0x610,8,0,0,4,0},
		{"ZCUD_CAN1","SmbrZcudCAN1VFCVectorFr","In",0x55a,8,0,0,0,0},
		{"ZCUD_CAN1","OgmToZcudZCUDCAN1DiagResFrame","In",0x63c,8,0,0,4,0},
		{"ZCUD_CAN1","CmdToZcudZCUDCAN1DiagResFrame","In",0x61c,8,0,0,4,0},
		{"ZCUD_CAN1","SmbrZcudCAN1Fr07","In",0x336,8,0,0,0,0},
		{"ZCUD_CAN1","RmrZcudCAN1Fr01","In",0x175,8,0,0,0,0},
		{"ZCUD_CAN1","SrsZCUDCAN1Fr08","In",0x22a,8,0,0,0,0},
		{"ZCUD_CAN1","SmbZCUDCAN1Fr02","In",0x260,8,0,0,0,0},
		{"ZCUD_CAN1","TcmbToZcudZCUDCan1DiagResFr","In",0x62a,8,0,0,4,0},
		{"ZCUD_CAN1","SrsZCUDCAN1Fr14","In",0x274,8,0,0,0,0},
		{"ZCUD_CAN1","SrsToZcudZCUDCan1DiagResFr","In",0x639,8,0,0,4,0},
		{"ZCUD_CAN1","SdlToZcudZCUDCAN1DiagResFrame","In",0x623,8,0,0,4,0},
		{"ZCUD_CAN1","SrsZCUDCAN1Fr09","In",0x360,8,0,0,0,0},
		{"ZCUD_CAN1","SmblZcudCAN1Fr12","In",0x21a,8,0,0,0,0},
		{"ZCUD_CAN1","SmblZcudCAN1Fr06","In",0x331,8,0,0,0,0},
		{"ZCUD_CAN1","OGMZCUDCAN1VFCVectorFr","In",0x542,8,0,0,0,0},
		{"ZCUD_CAN1","TrmZcudCAN1Fr01","In",0xd0,4,0,0,0,0},
		{"ZCUD_CAN1","SdrZcudCAN1VFCVectorFr","In",0x558,8,0,0,0,0},
		{"ZCUD_CAN1","SmtrZcudCAN1Fr03","In",0x207,8,0,0,0,0},
		{"ZCUD_CAN1","SrsZCUDCAN1Fr15","In",0x230,8,0,0,0,0},
		{"ZCUD_CAN1","SmblZcudCAN1Fr09","In",0x341,8,0,0,0,0},
		{"ZCUD_CAN1","OGMZCUDCAN1Fr01","In",0x381,8,0,0,0,0},
		{"ZCUD_CAN1","SmblZcudCAN1Fr13","In",0x21d,8,0,0,0,0},
		{"ZCUD_CAN1","SrsToZcudISO26021ZCUCAN1DiagResFrame11","In",0x7f9,8,0,0,4,0},
		{"ZCUD_CAN1","PotZCUDCAN1Fr02","In",0x95,8,0,0,0,0},
		{"ZCUD_CAN1","SrsZCUDCAN1Fr12","In",0x148,8,0,0,0,0},
		{"ZCUD_CAN1","PotZCUDCAN1Fr01","In",0x1a0,8,0,0,0,0},
		{"ZCUD_CAN1","SmbrZcudCAN1Fr05","In",0x202,8,0,0,0,0},
		{"ZCUD_CAN1","ShmrSmtlZcudCAN1Fr01","In",0x155,8,0,0,0,0},
		{"ZCUD_CAN1","SmbrZcudCAN1Fr13","In",0x21c,8,0,0,0,0},
		{"ZCUD_CAN1","WPRLZCUDCAN1VFCVectorFr","In",0x572,8,0,0,0,0},
		{"ZCUD_CAN1","SrsZCUDCAN1Fr10","In",0x70,8,0,0,0,0},
		{"ZCUD_CAN1","SdlZcudCAN1Fr01","In",0x12e,8,0,0,0,0},
		{"ZCUD_CAN1","SrsZCUDCAN1Fr04","In",0x13,8,0,0,0,0},
		{"ZCUD_CAN1","SrsZCUDCAN1Fr02","In",0x10,4,0,0,0,0},
		{"ZCUD_CAN1","SdrZcudCAN1Fr01","In",0x133,8,0,0,0,0},
		{"ZCUD_CANFD4","ZcudToLpodZcudCanFD4DiagReqFrame","Out",0x74a,64,0,1,4,0},
		{
			"ZCUD_CANFD4","ZcudZCUDCANFD4Fr03","Out",0x4c0,64,1000,1,0,0,11,2,
			{
				{"isTiAndDateIndcnYr1_6",7,63,-1},
				{"isTiAndDateIndcnSec1_6",6,66,-1},
				{"isCarTiGlb_6",32,31,17},
				{"isTiAndDateIndcnHr1_6",5,87,-1},
				{"isVehBattUSysUQf_6",2,100,-1},
				{"isTiAndDateIndcnDataValid_6",1,94,-1},
				{"isBkpOfDstTrvld_6",21,7,18},
				{"isVehBattUSysU_6",8,92,-1},
				{"isTiAndDateIndcnDay_6",5,76,-1},
				{"isTiAndDateIndcnMins1_6",6,56,-1},
				{"isTiAndDateIndcnMth1_6",4,82,-1}
			},
			{
				{"igTiAndDateIndcn_6","ZcudZCUDCANFD4SignalIPdu03",93},
				{"igVehBattU_6","ZcudZCUDCANFD4SignalIPdu03",98}
			}
		},
		{"ZCUD_CANFD4","ZcudToDdrmZcudCanFD4DiagReqFrame","Out",0x748,64,0,1,4,0},
		{
			"ZCUD_CANFD4","ZcudZCUDCANFD4Fr04","Out",0x2c0,64,100,1,0,0,5,0,
			{
				{"isOpenDrvrSwt_1",1,3,2},
				{"isSunRoofPosnSts_1",5,31,26},
				{"isHmiFanLvlRow1_1",4,15,11},
				{"isSunCurtPosnSts_1",5,23,18},
				{"isCabPressPodCalc_1",3,7,4}
			},
			{
				{"","",-1}
			}
		},
		{"ZCUD_CANFD4","ZcudToAllFuncZcudCanFD4DiagReqFrame","Out",0x7ff,8,0,1,4,0},
		{
			"ZCUD_CANFD4","ZcudZCUDCANFD4Fr01","Out",0x300,64,200,1,0,0,6,1,
			{
				{"isWinPosnStsAtReLe_2",5,39,34},
				{"isAmbTRawQly_7",2,12,-1},
				{"isWinPosnStsAtReRi_2",5,47,42},
				{"isAmbTRawAmbTVal_7",11,7,-1},
				{"isWinPosnStsAtDrvr_2",5,23,18},
				{"isWinPosnStsAtPass_2",5,31,26}
			},
			{
				{"igAmbTRaw_7","ZcudZCUDCANFD4SignalIPdu01",10}
			}
		},
		{
			"ZCUD_CANFD4","ZcudZCUDCANFD4Fr06","Out",0x100,64,20,1,0,0,26,5,
			{
				{"isDoorOpenerRiReReqChks_1",8,92,-1},
				{"isVehSpdLgtChks_7",8,64,-1},
				{"isDoorPassAntiPnch2_1",1,81,80},
				{"isDoorOpenerLeReReqTrigSrc_1",3,25,-1},
				{"isDoorOpenerDrvrReqTrigSrc_1",3,11,-1},
				{"isDoorOpenerLeReReqCntr_1",4,29,-1},
				{"isDoorOpenerLeReReqDoorOpenerReq_1",2,38,-1},
				{"isDoorPassPosn2_1",7,119,112},
				{"isVehSpdLgtCntr_7",4,72,-1},
				{"isVehMtnStVehMtnSt_4",3,51,-1},
				{"isDoorOpenerRiReReqTrigSrc_1",3,96,-1},
				{"isDoorOpenerDrvrReqCntr_1",4,15,-1},
				{"isVehMtnStChks_4",8,47,-1},
				{"isDoorOpenerDrvrReqDoorOpenerReq_1",2,8,-1},
				{"isObstStrDetcnPassRe2_1",1,104,32},
				{"isObstStrDetcnPass2_1",1,106,105},
				{"isDoorOpenerDrvrReqChks_1",8,7,-1},
				{"isVehSpdLgtQf_7",2,84,-1},
				{"isDoorOpenerLeReReqChks_1",8,21,-1},
				{"isDoorDrvrReLatPawlSt_1",2,95,93},
				{"isVehSpdLgtA_7",15,63,-1},
				{"isHvacRecircAct_1",7,127,120},
				{"isDoorDrvrLatPawlSt_1",2,35,33},
				{"isVehMtnStCntr_4",4,55,-1},
				{"isDoorOpenerRiReReqCntr_1",4,100,-1},
				{"isDoorOpenerRiReReqDoorOpenerReq_1",2,109,-1}
			},
			{
				{"igDoorOpenerLeReReq_1","ZcudZCUDCANFD4SignalIPdu06",36},
				{"igVehMtnSt_4","ZcudZCUDCANFD4SignalIPdu06",48},
				{"igVehSpdLgt_7","ZcudZCUDCANFD4SignalIPdu06",82},
				{"igDoorOpenerDrvrReq_1","ZcudZCUDCANFD4SignalIPdu06",22},
				{"igDoorOpenerRiReReq_1","ZcudZCUDCANFD4SignalIPdu06",107}
			}
		},
		{"ZCUD_CANFD4","ZcudToRdrmZcudCanFD4DiagReqFrame","Out",0x74b,64,0,1,4,0},
		{
			"ZCUD_CANFD4","ZcudZCUDCANFD4Fr09","Out",0x140,64,30,1,0,0,18,1,
			{
				{"isDoorLeReSts_3",2,12,10},
				{"isDoorRiReSts_3",2,31,29},
				{"isDoorDrvrSts_4",2,15,13},
				{"isDoorPassSts_4",2,20,18},
				{"isDoorOpenwarnOn1_1",2,23,21},
				{"isTrSts_4",2,79,77},
				{"isCinhDrvrSwt_1",1,1,0},
				{"isSuspPosnVertRi1SuspPosnVertRiChks_2",8,60,-1},
				{"isSuspPosnVertRi1SuspPosnVertRiFrnt_2",15,26,-1},
				{"isPawlDrvrSwt_1",1,28,27},
				{"isCinhDrvrSts_1",1,3,2},
				{"isOpenDrvrReSwt_1",1,9,8},
				{"isCinhDrvrReSwt_1",1,5,4},
				{"isCinhDrvrReSts_1",1,7,6},
				{"isPawlDrvrReSwt_1",1,17,16},
				{"isSuspPosnVertRi1SuspPosnVertRiRe_2",15,43,-1},
				{"isSuspPosnVertRi1SuspPosnVertRiReQf_2",2,66,-1},
				{"isSuspPosnVertRi1SuspPosnVertRiFrntQf_2",2,68,-1}
			},
			{
				{"igSuspPosnVertRi1_2","ZcudZCUDCANFD4SignalIPdu09",64}
			}
		},
		{
			"ZCUD_CANFD4","ZcudZCUDCANFD4VFCVectorFr","Out",0x541,8,1000,1,0,0,63,1,
			{
				{"isVFCVectorZCUDMVFCid32_8",1,34,-1},
				{"isVFCVectorZCUDMVFCid19_8",1,21,-1},
				{"isVFCVectorZCUDMVFCid43_8",1,45,-1},
				{"isVFCVectorZCUDMVFCid22_8",1,24,-1},
				{"isVFCVectorZCUDMVFCid60_8",1,62,-1},
				{"isVFCVectorZCUDMVFCid1_8",1,3,-1},
				{"isVFCVectorZCUDMVFCid37_8",1,39,-1},
				{"isVFCVectorZCUDMVFCid8_8",1,10,-1},
				{"isVFCVectorZCUDMVFCid10_8",1,12,-1},
				{"isVFCVectorZCUDMVFCid56_8",1,58,-1},
				{"isVFCVectorZCUDMVFCid51_8",1,53,-1},
				{"isVFCVectorZCUDMVFCid33_8",1,35,-1},
				{"isVFCVectorZCUDMVFCid2_8",1,4,-1},
				{"isVFCVectorZCUDMVFCid36_8",1,38,-1},
				{"isVFCVectorZCUDMVFCid3_8",1,5,-1},
				{"isVFCVectorZCUDMVFCid57_8",1,59,-1},
				{"isVFCVectorZCUDMVFCid27_8",1,29,-1},
				{"isVFCVectorZCUDMVFCid45_8",1,47,-1},
				{"isVFCVectorZCUDMVFCid44_8",1,46,-1},
				{"isVFCVectorZCUDMVFCid29_8",1,31,-1},
				{"isVFCVectorZCUDMVFCid39_8",1,41,-1},
				{"isVFCVectorZCUDMVFCid42_8",1,44,-1},
				{"isVFCVectorZCUDMVFCid46_8",1,48,-1},
				{"isVFCVectorZCUDMVFCid48_8",1,50,-1},
				{"isVFCVectorZCUDMVFCid9_8",1,11,-1},
				{"isVFCVectorZCUDMVFCid24_8",1,26,-1},
				{"isVFCVectorZCUDMVFCid35_8",1,37,-1},
				{"isVFCVectorZCUDMBlockID_8",2,1,-1},
				{"isVFCVectorZCUDMVFCid47_8",1,49,-1},
				{"isVFCVectorZCUDMVFCid17_8",1,19,-1},
				{"isVFCVectorZCUDMVFCid49_8",1,51,-1},
				{"isVFCVectorZCUDMVFCid0_8",1,2,-1},
				{"isVFCVectorZCUDMVFCid28_8",1,30,-1},
				{"isVFCVectorZCUDMVFCid16_8",1,18,-1},
				{"isVFCVectorZCUDMVFCid4_8",1,6,-1},
				{"isVFCVectorZCUDMVFCid20_8",1,22,-1},
				{"isVFCVectorZCUDMVFCid18_8",1,20,-1},
				{"isVFCVectorZCUDMVFCid14_8",1,16,-1},
				{"isVFCVectorZCUDMVFCid58_8",1,60,-1},
				{"isVFCVectorZCUDMVFCid50_8",1,52,-1},
				{"isVFCVectorZCUDMVFCid26_8",1,28,-1},
				{"isVFCVectorZCUDMVFCid59_8",1,61,-1},
				{"isVFCVectorZCUDMVFCid25_8",1,27,-1},
				{"isVFCVectorZCUDMVFCid11_8",1,13,-1},
				{"isVFCVectorZCUDMVFCid12_8",1,14,-1},
				{"isVFCVectorZCUDMVFCid55_8",1,57,-1},
				{"isVFCVectorZCUDMVFCid34_8",1,36,-1},
				{"isVFCVectorZCUDMVFCid31_8",1,33,-1},
				{"isVFCVectorZCUDMVFCid52_8",1,54,-1},
				{"isVFCVectorZCUDMVFCid38_8",1,40,-1},
				{"isVFCVectorZCUDMVFCid21_8",1,23,-1},
				{"isVFCVectorZCUDMVFCid40_8",1,42,-1},
				{"isVFCVectorZCUDMVFCid7_8",1,9,-1},
				{"isVFCVectorZCUDMVFCid15_8",1,17,-1},
				{"isVFCVectorZCUDMVFCid13_8",1,15,-1},
				{"isVFCVectorZCUDMVFCid61_8",1,63,-1},
				{"isVFCVectorZCUDMVFCid30_8",1,32,-1},
				{"isVFCVectorZCUDMVFCid5_8",1,7,-1},
				{"isVFCVectorZCUDMVFCid54_8",1,56,-1},
				{"isVFCVectorZCUDMVFCid23_8",1,25,-1},
				{"isVFCVectorZCUDMVFCid53_8",1,55,-1},
				{"isVFCVectorZCUDMVFCid41_8",1,43,-1},
				{"isVFCVectorZCUDMVFCid6_8",1,8,-1}
			},
			{
				{"igVFCVectorZCUDM_8","ZcudZCUDCANFD4VFCVectorSignalIPdu",-1}
			}
		},
		{
			"ZCUD_CANFD4","ZcudZCUDCANFD4Fr07","Out",0x50,64,10,1,0,0,30,5,
			{
				{"isVehModMngtGlbSafe1CarModSts1_9",3,39,-1},
				{"isDoorPassReObstPos2ObjectPosY_1",8,135,-1},
				{"isDoorPassPosnToObst2AngleDeg11_1",8,95,-1},
				{"isVehModMngtGlbSafe1PwrLvlElecSubtyp_9",4,31,-1},
				{"isDoorPassReObstPos2Chks_1",8,119,-1},
				{"isVehModMngtGlbSafe1EgyLvlElecMai_9",4,11,-1},
				{"isDoorPassReObstPos2ObjectPosX_1",8,127,-1},
				{"isDoorPassPosnToObst2Chks_1",8,103,-1},
				{"isDoorPassObstPos2ObjectPosZ_1",8,79,-1},
				{"isVehModMngtGlbSafe1Cntr_9",4,15,-1},
				{"isVehModMngtGlbSafe1FltEgyCnsWdSts_9",1,33,-1},
				{"isDoorPassRePosnToObst2Cntr_1",4,175,-1},
				{"isDoorPassReObstPos2Cntr_1",4,151,-1},
				{"isDoorPassObstPos2ObjectPosX_1",8,63,-1},
				{"isDoorPassObstPos2ObjectPosY_1",8,71,-1},
				{"isDoorPassReObstPos2ObjectPosZ_1",8,143,-1},
				{"isVehModMngtGlbSafe1PwrLvlElecMai_9",4,19,-1},
				{"isDoorDrvrLatPosn_1",2,47,45},
				{"isVehModMngtGlbSafe1Chks_9",8,7,-1},
				{"isDoorPassObstPos2Cntr_1",4,87,-1},
				{"isVehModMngtGlbSafe1EgyLvlElecSubtyp_9",4,23,-1},
				{"isDoorPassRePosnToObst2AngleDeg11_1",8,159,-1},
				{"isVehModMngtGlbSafe1CarModSubtypWdCarModSubtyp_9",3,36,-1},
				{"isVehModMngtGlbSafe1UsgModSts_9",4,27,-1},
				{"isDoorPassObstPos2Chks_1",8,55,-1},
				{"isDoorPassPosnToObst2Cntr_1",4,111,-1},
				{"isDoorDrvrReLatPosn_1",2,44,42},
				{"isDoorPassRePosnToObst2Chks_1",8,167,-1},
				{"isDoorPassRePosn2_1",7,183,176},
				{"isDoorPassReAntiPnch2_1",1,41,40}
			},
			{
				{"igDoorPassRePosnToObst2_1","ZcudZCUDCANFD4SignalIPdu07",171},
				{"igVehModMngtGlbSafe1_9","ZcudZCUDCANFD4SignalIPdu07",32},
				{"igDoorPassObstPos2_1","ZcudZCUDCANFD4SignalIPdu07",83},
				{"igDoorPassPosnToObst2_1","ZcudZCUDCANFD4SignalIPdu07",107},
				{"igDoorPassReObstPos2_1","ZcudZCUDCANFD4SignalIPdu07",147}
			}
		},
		{"ZCUD_CANFD4","ZcudToDpodZcudCanFD4DiagReqFrame","Out",0x749,64,0,1,4,0},
		{"ZCUD_CANFD4","ZcudZCUDCANFD4Fr08","Out",0x1da,64,0,1,1,0},
		{"ZCUD_CANFD4","ZcudZCUDCANFD4NmFr01","Out",0x501,8,0,1,3,0},
		{
			"ZCUD_CANFD4","ZcudZCUDCANFD4Fr02","Out",0x1c0,64,50,1,0,0,16,2,
			{
				{"isAutoManStsDoorLeRe_1",1,5,4},
				{"isAutoManStsDoorDrvr_1",1,7,6},
				{"isRadioFrqAM_2",11,21,26},
				{"isDoorLeRePercSetFromHmi_1",7,87,80},
				{"isDoorOpenwarnLeIndcn_2",2,13,11},
				{"isRoadInclnRoadIncln_3",16,39,-1},
				{"isDoorDrvrPercSetFromHmi_1",7,79,72},
				{"isRollAgGlbVal_3",16,52,-1},
				{"isRollAgGlbQf_3",2,68,-1},
				{"isDoorDrvrPosnProgmReq_1",1,1,0},
				{"isDoorRiRePercSetFromHmi_1",7,95,88},
				{"isDoorLeRePosnProgmReq_1",1,15,14},
				{"isDoorOpenwarnRiIndcn_2",2,10,8},
				{"isRoadInclnQly_3",2,55,-1},
				{"isAutoManStsDoorRiRe_1",1,3,2},
				{"isDoorRiRePosnProgmReq_1",1,23,22}
			},
			{
				{"igRollAgGlb_3","ZcudZCUDCANFD4SignalIPdu02",66},
				{"igRoadIncln_3","ZcudZCUDCANFD4SignalIPdu02",53}
			}
		},
		{"ZCUD_CANFD4","LpodToZcudZcudCanFD4DiagReqFrame","In",0x64a,64,0,1,4,0},
		{"ZCUD_CANFD4","RDRMZCUDCANFD4VFCVectorFr","In",0x545,8,0,1,0,0},
		{"ZCUD_CANFD4","RdrmToZcudZcudCanFD4DiagReqFrame","In",0x64b,64,0,1,4,0},
		{"ZCUD_CANFD4","LpodZCUDCANFD4Fr03","In",0x1d5,64,0,1,0,0},
		{"ZCUD_CANFD4","DdrmToZcudZcudCanFD4DiagReqFrame","In",0x648,64,0,1,4,0},
		{"ZCUD_CANFD4","RdrmZCUDCANFD4Fr01","In",0x70,64,0,1,0,0},
		{"ZCUD_CANFD4","LpodZCUDCANFD4Fr01","In",0x155,64,0,1,0,0},
		{"ZCUD_CANFD4","DpodZCUDCANFD4Fr03","In",0x1d0,64,0,1,0,0},
		{"ZCUD_CANFD4","DdrmZCUDCANFD4Fr01","In",0x60,64,0,1,0,0},
		{"ZCUD_CANFD4","DpodToZcudZcudCanFD4DiagReqFrame","In",0x649,64,0,1,4,0},
		{"ZCUD_CANFD4","DPODZCUDCANFD4VFCVectorFr","In",0x543,8,0,1,0,0},
		{"ZCUD_CANFD4","DDRMZCUDCANFD4NmFr01","In",0x502,8,0,1,3,0},
		{"ZCUD_CANFD4","DDRMZCUDCANFD4VFCVectorFr","In",0x542,8,0,1,0,0},
		{"ZCUD_CANFD4","LPODZCUDCANFD4VFCVectorFr","In",0x544,8,0,1,0,0},
		{"ZCUD_CANFD4","DpodZCUDCANFD4Fr01","In",0x150,64,0,1,0,0},
		{"ZCU_CANFD2","ZcudRmlToDhuZCUCANFD2DiagResFr","Out",0x610,64,0,1,4,0},
		{"ZCU_CANFD2","ZcudRmrToDhuZCUCANFD2DiagResFr","Out",0x611,64,0,1,4,0},
		{"ZCU_CANFD2","ZCUDZCUCANFD2PduR1000Fr34","Out",0x4bf,64,0,1,1,0},
		{
			"ZCU_CANFD2","ZCUDZCUCANFD2Fr23","Out",0x2e3,64,100,1,0,0,159,14,
			{
				{"isFrntCurtOpenPosnCmd_1",5,511,506},
				{"isWiprMotFrntLvrCmdNotSafeLvrInSnglStrokePos",1,388,-1},
				{"isSBWFltStsH1FltStsR1_1",1,349,-1},
				{"isWinFltStsAtDrvrThermProtn1",1,55,-1},
				{"isWinFltStsAtDrvrReUnexpActn",1,77,-1},
				{"isLockgFbAcoustReq",3,399,396},
				{"isActvnOfBrkLi",1,273,272},
				{"isMirrAdjVceAtDrvrCmd",3,395,392},
				{"isWinFltStsAtDrvrReFrmlessOpenAndNoInit",1,61,-1},
				{"isTcsTNowCtrlReq_1",8,223,472},
				{"isPawlDrvrSwt_0",1,455,454},
				{"isWinAntiPinchStsAtDrvr",1,459,458},
				{"isThirdRowRiReadLiReq_1",8,239,486},
				{"isWinFltStsAtDrvrReThermProtn1",1,79,-1},
				{"isWiprMotFrntLvrCmdNotSafeLvrInLoSpdPosn",1,389,-1},
				{"isWinFltStsAtDrvrMotBlkd",1,34,-1},
				{"isSolarSnsrRiValue_2",8,207,440},
				{"isSBWFltStsR1FltStsH1_1",1,359,-1},
				{"isWinFltStsAtDrvrOpenCircOnOper",1,45,-1},
				{"isEgyCnsAllwdForClima",7,151,144},
				{"isWinFltStsAtDrvrReReserved4",1,65,-1},
				{"isMirrTintgCmd",7,175,168},
				{"isWiprMotFrntLvrCmdNotSafeLvrInHiSpdPosn",1,391,-1},
				{"isSBWFltStsH1FltStsH1_1",1,351,-1},
				{"isWiprMotFrntLvrCmdNotSafeLvrInIntlPosn",1,390,-1},
				{"isMirrCmdAtPassMirrDwnCmd",2,164,-1},
				{"isWinFltStsAtDrvrReReserved2",1,67,-1},
				{"isRFKApproachReqAndKeyIdKeyId1",4,183,-1},
				{"isRowSecRiSeatRotPosPerc_1",8,191,304},
				{"isSBWFltStsR1FltStsR1_1",1,357,-1},
				{"isMirrAtDrvrForVce",3,403,400},
				{"isWinIninStsAtDrvrReLP",1,383,-1},
				{"isWinIninStsAtDrvrReRP",1,380,-1},
				{"isPawlDrvrReSwt_0",1,442,441},
				{"isWinFltStsAtDrvrReserved4",1,41,-1},
				{"isSeatMassgFctRowThrdRiOnOff_1",1,290,-1},
				{"isWinFltStsAtDrvrReWinNoInit",1,76,-1},
				{"isWinIninLrnStsAtDrvrRe",1,469,468},
				{"isSeatMassgFctRowThrdLeMassgInten_1",2,284,-1},
				{"isWinFltStsAtDrvrMotOpenCirc",1,33,-1},
				{"isWinFltStsAtDrvrReReserved5",1,64,-1},
				{"isDoorPassOpenReqOutdSwt1",2,503,501},
				{"isSeatHeatgAvlStsRowThrdRi_1",3,423,420},
				{"isSunRoofTiltSts",1,449,448},
				{"isTCSnsrTSts_1",8,215,473},
				{"isIndcrPatCmd1WdTiOff_0",16,7,-1},
				{"isWinFltStsAtDrvrReMotOpenCirc",1,57,-1},
				{"isWinMvngStsAtDrvrRe",1,465,464},
				{"isMirrAtDrvrInMovmt",1,329,328},
				{"isLockgFbAudioWarn",1,321,320},
				{"isSeatHSWTRawThrdLe_1",11,127,132},
				{"isWinAntiPinchStsAtDrvrRe",1,457,456},
				{"isWiprFrntLvrStsFrntWiprLvrQf_1",2,90,-1},
				{"isSBWFltStsH1FltStsR2_1",1,348,-1},
				{"isWinTemProtnStsAtDrvrRe",2,439,437},
				{"isWshrHeatgSts",1,475,474},
				{"isRFKApproachReqAndKeyIdRFKApproachReq",4,179,-1},
				{"isClimaPwrAllwd",11,103,108},
				{"isWinFltStsAtDrvrReReserved3",1,66,-1},
				{"isWinLossIninReasAtDrvr",5,319,314},
				{"isMirrBtnPsdAtDrvr",1,337,336},
				{"isSBWFltStsR2FltStsH2_1",1,366,-1},
				{"isWinDrvUAtDrvrRe",8,255,484},
				{"isWinFltStsAtDrvrUnexpActn",1,53,-1},
				{"isSunCurtPosnCmd_1",5,303,298},
				{"isSBWFltStsR1FltStsR2_1",1,356,-1},
				{"isSeatHeatgLvlStsRowThrdLe_1",2,354,352},
				{"isWinFltStsAtDrvrWinNoInit",1,52,-1},
				{"isSeatHeatgAvlStsRowThrdLe_1",3,411,408},
				{"isWinTemProtnStsAtDrvr",2,427,425},
				{"isWiprFrntLvrStsFrntWiprLvrCmd1_1",3,95,-1},
				{"isSeatVentnLvlStsRowThrdRi_1",2,386,384},
				{"isWinFltStsAtDrvrReserved2",1,43,-1},
				{"isWinIninStsAtDrvrReReserved",1,382,-1},
				{"isWinFltStsAtDrvrReMotBlkd",1,58,-1},
				{"isWiprReInPosnForSrv",1,477,476},
				{"isHoodLatchPosn_0",2,276,274},
				{"isWinFltStsAtDrvrReCurrSampChipFailr",1,63,-1},
				{"isWinFltStsAtDrvrReHiP",1,60,-1},
				{"isOpenDrvrSwt_0",1,444,443},
				{"isSBWFltStsR2FltStsR1_1",1,365,-1},
				{"isSolarSnsrLeValue_2",8,199,424},
				{"isWinMvngStsAtDrvr",1,467,466},
				{"isSeatHeatgAvlStsRowSecRi2_1",3,415,412},
				{"isWinFltStsAtDrvrReThermProtn2",1,78,-1},
				{"isChrgLidManvgDCorAcDcReq2",8,495,480},
				{"isMirrCmdAtPassMirrPosAdjCmd",3,167,-1},
				{"isWinLossIninReasAtDrvrRe",5,327,322},
				{"isSeatVentnLvlStsRowThrdLe_1",2,378,376},
				{"isWinIninStsAtDrvrLP",1,375,-1},
				{"isSeatMassgFctRowThrdLeOnOff_1",1,282,-1},
				{"isWiprFrntLvrStsFrntWiprLvrCrc_1",8,87,-1},
				{"isWinFltStsAtDrvrReReserved1",1,68,-1},
				{"isIndirectLifeDetnAndCareLvl2Warn",1,313,312},
				{"isReSunCurtMvngSts",1,453,452},
				{"isHWLTrigSrc",8,159,305},
				{"isWinIninStsAtDrvrReRF",1,381,-1},
				{"isWinIninLrnStsAtDrvr",1,471,470},
				{"isDoorLeReOpenReqOutdSwt1",2,483,481},
				{"isTCSUsgModReq",1,461,460},
				{"isHeiLimModIncn_0",2,279,277},
				{"isSeatMassgFctRowThrdRiMassgProg_1",3,295,-1},
				{"isSeatMassgFctRowThrdRiMassgInten_1",2,292,-1},
				{"isWinFltStsAtDrvrReserved5",1,40,-1},
				{"isGlvBoxRelsReq",1,497,496},
				{"isSeatVentnAvlStsRowThrdRi_1",3,431,428},
				{"isMobDevChrgngLidOpnReq",1,505,504},
				{"isSBWFltStsH1FltStsH2_1",1,350,-1},
				{"isThirdRowLeReadLiReq_1",8,231,487},
				{"isWiprInPosnForSrv",1,479,478},
				{"isWinFltStsAtDrvrReDrvrChipFailr",1,62,-1},
				{"isOpenDrvrReSwt_0",1,433,432},
				{"isSBWFltStsR2FltStsR2_1",1,364,-1},
				{"isWinIninStsAtDrvrRF",1,373,-1},
				{"isSBWFltStsR1FltStsH2_1",1,358,-1},
				{"isWinOperCntAtDrvr",7,263,256},
				{"isWinFltStsAtDrvrMotOverCurr",1,32,-1},
				{"isSeatVentnAvlStsRowThrdLe_1",3,419,416},
				{"isMirrAdjVceAtPassCmd",3,407,404},
				{"isDoorDrvrRelsReq",2,74,72},
				{"isWinFltStsAtDrvrReserved3",1,42,-1},
				{"isSeatHeatgLvlStsRowSecRi2_1",2,346,344},
				{"isSeatMassgFctRowThrdLeMassgProg_1",3,287,-1},
				{"isWiprReLvrSts",2,436,434},
				{"isSeatHSWTRawThrdRi_1",11,131,136},
				{"isSunRoofPosnCmd_1",5,311,306},
				{"isWinFltStsAtDrvrLoP",1,35,-1},
				{"isWinIninStsAtDrvrRP",1,372,-1},
				{"isSBWFltStsR2FltStsH1_1",1,367,-1},
				{"isWinFltStsAtDrvrNVMWrFailr",1,46,-1},
				{"isWinFltStsAtDrvrReserved1",1,44,-1},
				{"isWiprSysFailrDetdSafe",2,447,445},
				{"isSwtLiHzrdWarn_0",1,463,462},
				{"isWinFltStsAtDrvrReOpenCircOnOper",1,69,-1},
				{"isRmnLockgPrsnlReq",1,451,450},
				{"isWinDrvUAtDrvr",8,247,485},
				{"isWinFltStsAtDrvrHiP",1,36,-1},
				{"isSeatHSWTRawSecRi2_1",11,107,112},
				{"isWinFltStsAtDrvrReMotOverCurr",1,56,-1},
				{"isWinFltStsAtDrvrThermProtn2",1,54,-1},
				{"isWinIninStsAtDrvrReserved",1,374,-1},
				{"isWinFltStsAtDrvrReNVMWrFailr",1,70,-1},
				{"isChassisObstclCrsModIncn_0",2,50,48},
				{"isDoorRiReOpenReqOutdSwt1",2,500,498},
				{"isSeatOccptAtRowThrdMid_1",2,370,368},
				{"isWinFltStsAtDrvrReMotShoCirc",1,71,-1},
				{"isWinFltStsAtDrvrReLoP",1,59,-1},
				{"isIndcrPatCmd1WdTiOn_0",16,23,-1},
				{"isWinOperStsAtDrvr",5,335,330},
				{"isWiprFrntLvrStsFrntWiprLvrCntr_1",2,92,-1},
				{"isWinOperCntAtDrvrRe",7,271,264},
				{"isSeatHeatgLvlStsRowThrdRi_1",2,362,360},
				{"isWinFltStsAtDrvrDrvrChipFailr",1,38,-1},
				{"isWinOperStsAtDrvrRe",5,343,338},
				{"isIceBreakDoorLeReActv",1,297,296},
				{"isWinFltStsAtDrvrCurrSampChipFailr",1,39,-1},
				{"isMirrCmdAtPassMirrFoldCmd",2,162,-1},
				{"isWinFltStsAtDrvrFrmlessOpenAndNoInit",1,37,-1},
				{"isWinFltStsAtDrvrMotShoCirc",1,47,-1}
			},
			{
				{"igSBWFltStsR1_1","ZCUDZCUCANFD2SignalIPdu23",355},
				{"igIndcrPat_0","ZCUDZCUCANFD2SignalIPdu23",280},
				{"igWinFltStsAtDrvr","ZCUDZCUCANFD2SignalIPdu23",51},
				{"igSeatMassgFctRowThrdLe_1","ZCUDZCUCANFD2SignalIPdu23",281},
				{"igWiprFrntLvrSts_1","ZCUDZCUCANFD2SignalIPdu23",88},
				{"igSBWFltStsH1_1","ZCUDZCUCANFD2SignalIPdu23",347},
				{"igSeatMassgFctRowThrdRi_1","ZCUDZCUCANFD2SignalIPdu23",289},
				{"igWinFltStsAtDrvrRe","ZCUDZCUCANFD2SignalIPdu23",75},
				{"igWinIninStsAtDrvr","ZCUDZCUCANFD2SignalIPdu23",371},
				{"igMirrCmdAtPass","ZCUDZCUCANFD2SignalIPdu23",160},
				{"igWiprMotFrntLvrCmdNotSafe","ZCUDZCUCANFD2SignalIPdu23",387},
				{"igRFKApproachReqAndKeyId","ZCUDZCUCANFD2SignalIPdu23",288},
				{"igWinIninStsAtDrvrRe","ZCUDZCUCANFD2SignalIPdu23",379},
				{"igSBWFltStsR2_1","ZCUDZCUCANFD2SignalIPdu23",363}
			}
		},
		{
			"ZCU_CANFD2","ZCUDZCUCANFD2Fr17","Out",0x1e5,64,50,1,0,0,157,23,
			{
				{"isReadLiErrStsReadLiStsSecondRowLe_1",1,165,-1},
				{"isElecStepFltActrFlt4_1",1,156,-1},
				{"isSeatMassgBackBlstrFailrDrvr_1",1,193,192},
				{"isTCSDoorSts2_1",1,339,338},
				{"isSunCurtMvngSts2_1",1,329,328},
				{"isPtnDimRoofFailrStsIntHighVolt_1",1,102,-1},
				{"isRearSteerMotInfoGroupMotSpdQf_1",2,438,-1},
				{"isRelHumSnsrRelHum_1",8,111,24},
				{"isReadLiIntensityValZone6_1",5,30,-1},
				{"isSeatMassgCushBlstrFailrRowSecLe_1",1,309,308},
				{"isDimRoofFailrStsOutOverCircuit_1",1,90,-1},
				{"isElecStepFltActrFlt3_1",1,157,-1},
				{"isMobDevCtrlPwrPassDoorKeyId4",6,383,-1},
				{"isReadLiStsFirstRowLe_1",1,175,-1},
				{"isSeatMassgBackBlstrFailrRowSecLe_1",1,201,200},
				{"isSeatMidLumPosPercSecLe_1",7,471,464},
				{"isActnOfLedRePosnLamp",1,345,344},
				{"isSunRoofAndCurtFailr2EcuFailrGen_1",1,116,-1},
				{"isIntrLiCmdGroupIntrLiActvn_1",1,295,-1},
				{"isStreamingMirrImg_1",4,263,259},
				{"isBtnStsOHCLiBtnReadingRi_1",1,220,-1},
				{"isReadLiErrStsReadLiStsFirstRowLe_1",1,167,-1},
				{"isSeatMassgFctCptFailrRowThrdRi_1",1,317,316},
				{"isSunRoofAndCurtFailr2Resvd_1",1,112,-1},
				{"isSunCurtPosnSts2_1",5,191,186},
				{"isSunRoofAndCurtFailr2PanMotNotAvl_1",1,113,-1},
				{"isAmbIllmnFwdStsChks_1",8,54,-1},
				{"isMobDevCtrlPwrRiReDoorKeyId4",6,389,-1},
				{"isWiprInWipgArFromWMM_1",1,351,350},
				{"isOHCSecRowBtnErrStsLiBtnReadingLe_1",1,234,-1},
				{"isPtnDimRoofFailrStsResvd_1",1,97,-1},
				{"isBtnStsOHCRLiBtnReadingRi_1",1,217,-1},
				{"isDimRoofFailrStsOutOpenCircuit_1",1,91,-1},
				{"isMobDevCtrlPwrPassDoorTrReq",3,377,-1},
				{"isTCScoolgGrdReq2_1",4,279,275},
				{"isOHCThirdRowBtnErrStsLiBtnReadingLe_1",1,242,-1},
				{"isTCSTNowSts2_1",8,151,349},
				{"isDimRoofFailrStsResvd_1",1,89,-1},
				{"isRainSnsrErrCalErr_1",1,247,-1},
				{"isSunRoofAndCurtFailr2CurtMotNotAvl_1",1,117,-1},
				{"isElecStepFltTmrFlt_1",1,154,-1},
				{"isSeatMassgEcuIntFailrRowThrdLe_1",1,307,306},
				{"isSeatDownLumPosPercDrvr_1",7,447,440},
				{"isSecRowRiSeatHeatgBtn2_1",1,323,322},
				{"isReadLiIntensityValZone5_1",5,19,-1},
				{"isStreamingMirrPosn_1",4,271,267},
				{"isBtnStsOHCIntrLiSwtAllOnSts_1",1,223,-1},
				{"isActvnOfReLogoLamp1",1,357,356},
				{"isBtnStsOHCLiBtnReadingLe_1",1,221,-1},
				{"isPtnDimRoofFailrStsECUFailrGen_1",1,103,-1},
				{"isFloatDrivingModStsSts_1",3,499,-1},
				{"isRearSteerMotInfoGroupChks_1",8,418,-1},
				{"isSeatMassgCushBlstrFailrDrvr_1",1,311,310},
				{"isPtnDimRoofFailrStsOutOpenCircuit_1",1,99,-1},
				{"isWiprInPrkgPosnLoFromWMM_1",1,337,336},
				{"isReadLiStsSecondRowLe_1",1,173,-1},
				{"isTCSTmrOverSts2_1",5,215,210},
				{"isActnOfLedReFogLamp",1,347,346},
				{"isSunRoofAndCurtFailr2PanMotFailr_1",1,115,-1},
				{"isReadLiIntensityValZone1_1",5,7,-1},
				{"isBtnStsOHCIntrLiSwtAutOnSts_1",1,222,-1},
				{"isSeatMidLumPosPercDrvr_1",7,463,456},
				{"isOHCFrBtnErrStsLiBtnReadingLe_1",1,237,-1},
				{"isWinSwtReqCntr_1",4,79,-1},
				{"isElecChromFailr_1",1,177,176},
				{"isSunRoofAndCurtFailr2CurtMotHallFailr_1",1,118,-1},
				{"isSecRowRiSeatHeatgBtnStkErr2_1",1,321,320},
				{"isAmbIllmnFwdStsAmblillmn2_1",8,46,-1},
				{"isRearSteerMotInfoGroupMotSpd_1",14,395,-1},
				{"isTCSnsrTSts2_1",8,127,160},
				{"isWinSwtReqChks_1",8,71,-1},
				{"isFloatDrivingModStsCntr_1",4,503,-1},
				{"isWinSwtReqReLe_1",3,85,-1},
				{"isOHCSecRowBtnErrStsLiBtnReadingRi_1",1,233,-1},
				{"isTCSTmrStrtSts2_1",2,274,272},
				{"isElecChromRoofFb_1",4,231,227},
				{"isOHCFrBtnErrStsIntrLiSwtAutOnSts_1",1,238,-1},
				{"isTCSRadrTSts2_1",8,143,280},
				{"isRearSteerMotInfoGroupCntr_1",4,426,-1},
				{"isMobDevCtrlPwrDrvrDoorTrReq",3,365,-1},
				{"isSecRowRiSeatVentnBtnStkErr2_1",1,333,332},
				{"isDimRoofFailrStsLoadErr_1",1,92,-1},
				{"isReadLiErrStsReadLiStsSecondRowRi_1",1,164,-1},
				{"isWinSwtReqFrntLe_1",3,75,-1},
				{"isBtnStsOHTRLiBtnReadingLe_1",1,226,-1},
				{"isSeatMassgCmftHwFailrDrvr_1",1,209,208},
				{"isBtnStsOHCRLiBtnReadingLe_1",1,218,-1},
				{"isSunRoofAndCurtFailr2CurtMotFailr_1",1,119,-1},
				{"isIntrLiCmdGroupIntrLiRoofDmdOff_1",1,293,-1},
				{"isRainSnsrErrRainDetnErr_1",1,245,-1},
				{"isReadLiStsThirdRowLe_1",1,171,-1},
				{"isElecStepFltActrFlt1_1",1,159,-1},
				{"isSeatMassgEcuIntFailrRowThrdRi_1",1,305,304},
				{"isRearSteerMotInfoGroupMotTq_1",11,413,-1},
				{"isSeatMassgFltStsForEcuDrvr_1",1,315,314},
				{"isSunRoofMvngSts2_1",1,343,342},
				{"isTcsConTCtrlSts_1",2,250,248},
				{"isReadLiStsFirstRowRi_1",1,174,-1},
				{"isAmbIllmnFwdStsAmblillmn1_1",9,39,-1},
				{"isMobDevCtrlPwrLeReDoorKeyId4",6,361,-1},
				{"isOHCFrBtnErrStsLiBtnReadingRi_1",1,236,-1},
				{"isElecStepFltActrFlt5_1",1,155,-1},
				{"isRainSnsrErrCalErrActv_1",1,246,-1},
				{"isRearSteerMotInfoGroupMotTqQf_1",2,436,-1},
				{"isFloatDrivingModStsChks_1",8,495,-1},
				{"isReadLiErrStsReadLiStsFirstRowRi_1",1,166,-1},
				{"isPtnDimRoofFailrStsIntLowVolt_1",1,101,-1},
				{"isTCSFltSts2_1",4,287,283},
				{"isReadLiIntensityValZone2_1",5,2,-1},
				{"isSunRoofAndCurtFailr2PanMotHallFailr_1",1,114,-1},
				{"isReadLiErrStsReadLiStsThirdRowLe_1",1,163,-1},
				{"isPtnDimRoofFailrStsLoadErr_1",1,100,-1},
				{"isBtnStsOHTRLiBtnReadingRi_1",1,225,-1},
				{"isReadLiIntensityValZone4_1",5,8,-1},
				{"isDrvrElecRunngBdSts_1",1,57,56},
				{"isSeatMassgPnmFailrRowSecLe_1",1,325,324},
				{"isSeatMassgCmftHwFailrRowSecLe_1",1,282,281},
				{"isSeatUpLumPosPercDrvr_1",7,479,472},
				{"isSeatMassgFctCptFailrRowThrdLe_1",1,319,318},
				{"isSeatDownLumPosPercSecLe_1",7,455,448},
				{"isReadLiIntensityValZone3_1",5,13,-1},
				{"isDimRoofFailrStsIntLowVolt_1",1,93,-1},
				{"isActnOfLedRvsgLamp",1,359,358},
				{"isMobDevCtrlPwrRiReDoorTrReq",3,399,-1},
				{"isSunRoofImpctDetnStsSRM2_1",3,299,296},
				{"isSunCurtImpctDetnStsSRM2_1",3,303,300},
				{"isTcsOvrheatdProtnSts_1",2,266,264},
				{"isWinSwtReqFrntRi_1",3,72,-1},
				{"isPassElecRunngBdSts_1",1,185,184},
				{"isDimRoofFailrStsIntHighVolt_1",1,94,-1},
				{"isMobDevCtrlPwrLeReDoorTrReq",3,371,-1},
				{"isRainSnsrErrRainDetnErrActv_1",1,244,-1},
				{"isSunCurtMoveDir2_1",5,183,178},
				{"isMobDevCtrlPwrDrvrDoorKeyId4",6,355,-1},
				{"isIntrLiCmdGroupIntrLiRoofDim_1",1,294,-1},
				{"isStreamingMirrBri_1",4,255,251},
				{"isSunRoofMoveDir2_1",5,199,194},
				{"isTCSCmprStrtFlt2_1",1,341,340},
				{"isDimRoofFailrStsECUFailrGen_1",1,95,-1},
				{"isSunRoofPosnSts2_1",5,207,202},
				{"isOHCFrBtnErrStsIntrLiSwtAllOnSts_1",1,239,-1},
				{"isTCSRadrTreq2_1",8,135,168},
				{"isPtnDimRoofFailrStsOutOverCircuit_1",1,98,-1},
				{"isTCSModSwtSts2_1",2,258,256},
				{"isAmbIllmnFwdStsCntr_1",4,62,-1},
				{"isReadLiStsThirdRowRi_1",1,170,-1},
				{"isIntrlMirrDispSysSts_1",3,291,288},
				{"isStreamingMirrEnable_1",1,331,330},
				{"isSecRowRiSeatVentnBtn2_1",1,335,334},
				{"isSeatUpLumPosPercSecLe_1",7,487,480},
				{"isWinSwtReqReRi_1",3,82,-1},
				{"isSeatMassgFltStsForEcuRowSecLe_1",1,313,312},
				{"isReadLiErrStsReadLiStsThirdRowRi_1",1,162,-1},
				{"isReadLiStsSecondRowRi_1",1,172,-1},
				{"isElecStepFltActrFlt2_1",1,158,-1},
				{"isSeatMassgPnmFailrDrvr_1",1,327,326},
				{"isOHCThirdRowBtnErrStsLiBtnReadingRi_1",1,241,-1}
			},
			{
				{"igReadLiErrSts_1","ZCUDZCUCANFD2SignalIPdu17",161},
				{"igAmbIllmnFwdSts_1","ZCUDZCUCANFD2SignalIPdu17",58},
				{"igReadLiSts_1","ZCUDZCUCANFD2SignalIPdu17",169},
				{"igMobDevCtrlPwrLeReDoor","ZCUDZCUCANFD2SignalIPdu17",368},
				{"igOHCThirdRowBtnErrSts_1","ZCUDZCUCANFD2SignalIPdu17",240},
				{"igMobDevCtrlPwrRiReDoor","ZCUDZCUCANFD2SignalIPdu17",396},
				{"igWinSwtReq_1","ZCUDZCUCANFD2SignalIPdu17",348},
				{"igDimRoofFailrSts_1","ZCUDZCUCANFD2SignalIPdu17",88},
				{"igReadLiIntensityVal_1","ZCUDZCUCANFD2SignalIPdu17",25},
				{"igMobDevCtrlPwrPassDoor","ZCUDZCUCANFD2SignalIPdu17",390},
				{"igFloatDrivingModSts_1","ZCUDZCUCANFD2SignalIPdu17",496},
				{"igBtnStsOHC_1","ZCUDZCUCANFD2SignalIPdu17",219},
				{"igRearSteerMotInfoGroup_1","ZCUDZCUCANFD2SignalIPdu17",434},
				{"igOHCFrBtnErrSts_1","ZCUDZCUCANFD2SignalIPdu17",235},
				{"igIntrLiCmdGroup_1","ZCUDZCUCANFD2SignalIPdu17",292},
				{"igSunRoofAndCurtFailr2_1","ZCUDZCUCANFD2SignalIPdu17",152},
				{"igRainSnsrErr_1","ZCUDZCUCANFD2SignalIPdu17",243},
				{"igMobDevCtrlPwrDrvrDoor","ZCUDZCUCANFD2SignalIPdu17",362},
				{"igOHCSecRowBtnErrSts_1","ZCUDZCUCANFD2SignalIPdu17",232},
				{"igBtnStsOHCR_1","ZCUDZCUCANFD2SignalIPdu17",216},
				{"igElecStepFlt_1","ZCUDZCUCANFD2SignalIPdu17",153},
				{"igPtnDimRoofFailrSts_1","ZCUDZCUCANFD2SignalIPdu17",96},
				{"igBtnStsOHTR_1","ZCUDZCUCANFD2SignalIPdu17",224}
			}
		},
		{
			"ZCU_CANFD2","ZCUDZCUCANFD2Fr56","Out",0x4c6,64,1000,1,0,0,78,10,
			{
				{"isTrsmGearNotAvlSts2_1",12,295,299},
				{"isBattCycDchaCntrDurgConvceRaw_1",14,175,177},
				{"isTrsmCluT2Val_1",9,339,-1},
				{"isSteerExtFctStsCntr_1",4,421,-1},
				{"isSteerExtFctStsExtFctLowerLimActive_1",1,416,-1},
				{"isSteerLockChkSteerLockDataChk3_1",8,383,-1},
				{"isTrsmEngmtLimd3TrsmEngmtLimd_1",1,323,-1},
				{"isAsyDataWithCmpSafeALat1Qf_2",2,118,-1},
				{"isActnOfLedFrntCrossLamp_0",1,17,16},
				{"isTrsmGearActrScanForRefActv_1",1,311,310},
				{"isTrsmGbxActrOff_1",1,307,306},
				{"isTrsmCluT2Qf_1",2,346,-1},
				{"isBattCircOpenU_1",5,143,138},
				{"isTrsmNRecOutpDir_1",1,273,-1},
				{"isActnOfLedFrntCrossLampDyn_0",1,31,30},
				{"isBattCpEstimdAtTNomRaw_1",7,151,144},
				{"isTrsmNRecInpDir2_1",1,274,-1},
				{"isSteerLockStsBolt_1",2,439,-1},
				{"isTrsmNRecChks_1",8,261,-1},
				{"isAsyDataWithCmpSafeGrdtOfALgt_2",14,80,-1},
				{"isBattTLiCellBattTCell2_1",9,490,-1},
				{"isSteerLockStsSafety_1",2,435,-1},
				{"isAsyDataWithCmpSafeChks_2",8,98,-1},
				{"isSteerExtFctStsLatAgReqNotInRange_1",1,428,-1},
				{"isSteerExtFctStsLatCtrlReqNotInRange_1",1,427,-1},
				{"isSteerExtFctStsExtSafeLimActive_1",1,429,-1},
				{"isSteerExtFctStsDrvrSteerOvrd_1",1,417,-1},
				{"isTrsmErrIndcnReq2_1",1,305,304},
				{"isTrsmEngmtLimd3TrsmEngmtLimdCntr_1",4,327,-1},
				{"isSteerExtFctStsChks_1",8,413,-1},
				{"isBattChrgnBalDurgDrvgRaw_1",16,127,33},
				{"isSRSResdSig1ToZCUDMSafetyCntr_1",4,487,-1},
				{"isTrsmCluT1Val_1",9,335,-1},
				{"isBattCycDchaCntrDurgDrvgRaw_1",14,191,193},
				{"isAsyDataWithCmpSafeCntr_2",4,106,-1},
				{"isActnOfFrntFogLampDrv",1,23,22},
				{"isTrsmNRecInp1_1",14,223,-1},
				{"isBattCycDchaCntrDurgQuiscPhaRaw_1",14,207,209},
				{"isAsyDataWithCmpSafeYawRateQf_2",2,114,-1},
				{"isSteerLockChkSteerLockDataChk6_1",8,407,-1},
				{"isActnOfReSideMkrLampPass",1,41,40},
				{"isTrsmNRecOutpQf_1",2,277,-1},
				{"isTrsmNRecOutp_1",14,243,-1},
				{"isTrsmNRecInpDir1_1",1,275,-1},
				{"isSRSResdSig1ToZCUDMSafetyChks_1",8,479,-1},
				{"isActnOfFrntSideMkrLampPass",1,21,20},
				{"isSteerLockChkSteerLockDataChk2_1",8,375,-1},
				{"isTrsmNRecInpQf1_1",2,265,-1},
				{"isSafetyCrashFb_1",2,425,321},
				{"isActvnOfShowModLi_0",1,55,54},
				{"isSteerLockChkSteerLockDataChk1_1",8,367,-1},
				{"isAsyDataWithCmpSafeALgt1Qf_2",2,116,-1},
				{"isTrsmModNotAvlSts2_1",8,287,32},
				{"isSteerLockChkSteerLockDataChk4_1",8,391,-1},
				{"isSteerLockChkSteerLockDataChk0_1",8,359,-1},
				{"isSteerExtFctStsExtFctRateLimActive_1",1,431,-1},
				{"isTrsmNRecInp2_1",14,225,-1},
				{"isSteerExtFctStsExtFctUpperLimActive_1",1,430,-1},
				{"isBattTLiCellBattTCell1_1",9,483,-1},
				{"isTrsmCluT1Qf_1",2,342,-1},
				{"isAsyDataWithCmpSafeALatWithCmp_2",15,79,-1},
				{"isTrsmNRecInpQf2_1",2,279,-1},
				{"isAsyDataWithCmpSafeYawRateWithCmp_2",16,63,-1},
				{"isTrsmGearActrScanForRefReq_1",1,309,308},
				{"isSteerLockStsFault_1",2,437,-1},
				{"isActnOfLedRiLogoLampDyn_0",1,45,44},
				{"isTrsmHardRotReq1_1",1,137,136},
				{"isSteerLockStsUnit_1",2,433,-1},
				{"isTrsmEngmtLimd3TrsmEngmtLimdChks_1",8,319,-1},
				{"isBattCycChrgCntrRaw_1",14,159,161},
				{"isSteerLockChkSteerLockDataChk5_1",8,399,-1},
				{"isSteerLockChkSts_1",1,415,-1},
				{"isTrsmHardRotReq2_1",1,49,48},
				{"isTrsmGearActrTLvl_1",2,298,296},
				{"isActnOfReFogLampPass",1,43,42},
				{"isSRSResdSig1ToZCUDMSafetyUInt32_1",32,447,-1},
				{"isTrsmNRecCntr_1",4,269,-1},
				{"isBattTLiCellBattTCell3_1",9,497,-1}
			},
			{
				{"igSteerLockChk_1","ZCUDZCUCANFD2SignalIPdu56",414},
				{"igSRSResdSig1ToZCUDMSafety_1","ZCUDZCUCANFD2SignalIPdu56",320},
				{"igAsyDataWithCmpSafe_2","ZCUDZCUCANFD2SignalIPdu56",112},
				{"igSteerLockSts_1","ZCUDZCUCANFD2SignalIPdu56",160},
				{"igSteerExtFctSts_1","ZCUDZCUCANFD2SignalIPdu56",426},
				{"igTrsmCluT2_1","ZCUDZCUCANFD2SignalIPdu56",344},
				{"igTrsmNRec_1","ZCUDZCUCANFD2SignalIPdu56",272},
				{"igTrsmEngmtLimd3_1","ZCUDZCUCANFD2SignalIPdu56",322},
				{"igBattTLiCell_1","ZCUDZCUCANFD2SignalIPdu56",504},
				{"igTrsmCluT1_1","ZCUDZCUCANFD2SignalIPdu56",340}
			}
		},
		{"ZCU_CANFD2","ZCUDZCUCANFD2PduR1000Fr04","Out",0x39f,64,0,1,1,0},
		{"ZCU_CANFD2","ZcudRdrmToDhuZCUCANFD2DiagResFr","Out",0x64b,64,0,1,4,0},
		{"ZCU_CANFD2","ZCUDZCUCANFD2PduR500Fr01","Out",0x36e,64,0,1,1,0},
		{"ZCU_CANFD2","ZcudTrmToDhuZCUCANFD2DiagResFr","Out",0x617,64,0,1,4,0},
		{"ZCU_CANFD2","ZcudHrmToDhuZCUCANFD2DiagResFr","Out",0x630,64,0,1,4,0},
		{"ZCU_CANFD2","ZcudRwamToDhuZCUCANFD2DiagResFr","Out",0x643,64,0,1,4,0},
		{
			"ZCU_CANFD2","ZCUDZCUCANFD2Fr39","Out",0x361,64,250,1,0,0,91,6,
			{
				{"isEngForbidRespFromVMM",1,282,281},
				{"isCfgPrmForLeReKickSnsrMPBytePosn7_1",8,383,-1},
				{"isSeatHeatgAvlStsDrvrRowSec",3,59,56},
				{"isSunRoofAndCurtFailrPanMotHallFailr",1,186,-1},
				{"isCfgPrmForLeReKickSnsrMPBytePosn6_1",8,375,-1},
				{"isClimRlyCmd",1,257,256},
				{"isDoorDrvrReRealLockSts_0",2,391,389},
				{"isDrvrSecRowSeatVentnActlPwrCns",8,159,305},
				{"isKickSnsrLeReEnaReq_1",2,388,386},
				{"isDoorMaxOpnSetStsRiRe",7,135,128},
				{"isSecRowLeVentnLvl_1",2,279,277},
				{"isCfgPrmForLeReKickSnsrMPBytePosn3_1",8,351,-1},
				{"isVMMToHmiSetSetting7",3,21,-1},
				{"isCfgPrmForLeReKickSnsrMPBytePosn5_1",8,367,-1},
				{"isCfgPrmForLeReKickSnsrMPBytePosn4_1",8,359,-1},
				{"isSunRoofAndCurtFailrCurtMotFailr",1,191,-1},
				{"isVMMtoHMIFBSwitch8",1,192,-1},
				{"isSeatVentAvlStsDrvrRowSec",3,91,88},
				{"isDrvrSecRowSeatHeatgActlPwrCns",8,151,306},
				{"isPwrAvlDelta",16,71,318},
				{"isAntithftActvnNotif",1,233,232},
				{"isVMMToHmiSetSetting4",3,14,-1},
				{"isDoorOpenerDrvrReqChks_0",8,31,-1},
				{"isDrveSecRowSeatHeatgDesPwrCns",8,143,307},
				{"isVMMtoHMIFBSwitch5",1,195,-1},
				{"isVMMtoHMIFBSwitch7",1,193,-1},
				{"isDoorDrvrReLatPawlSt_0",2,239,237},
				{"isHoodOpenerReqDoorOpenerReq_0",2,62,-1},
				{"isVMMtoHMIFBSwitch2",1,198,-1},
				{"isSteerWhlHeatgAvlSts",3,231,228},
				{"isHoodOpenerReqTrigSrc_0",3,49,-1},
				{"isVMMtoHMIFBSwitch1",1,199,-1},
				{"isKeyReadStsToVoiceCtrl",2,255,253},
				{"isKeyIntrVldDetd",1,291,290},
				{"isLeSolarData_2",8,175,319},
				{"isRlyCmdCmft",1,303,302},
				{"isSeatHSWTRawDrvrSec",11,87,92},
				{"isVMMToHmiSetSetting6",3,8,-1},
				{"isActvnOfRainAutLi",2,247,245},
				{"isVMMToHmiSetSetting8",3,18,-1},
				{"isSolarSnsrVluQf_1",1,301,300},
				{"isPwrOutSetFBMsg",2,263,261},
				{"isDrvrSecRowSeatVentnDesPwrCns",8,167,304},
				{"isHoodOpenerReqChks_0",8,45,-1},
				{"isDoorDrvrRealLockSts_0",2,295,293},
				{"isDCLevelMotAgLeReq_1",8,111,309},
				{"isVMMtoHMIFBSwitch4",1,196,-1},
				{"isKnkSnsrEnaReq_1",2,252,250},
				{"isWinFailrStsAtReLe_1",1,311,310},
				{"isActvnOfLedFrntAutDrvgLi_0",2,202,200},
				{"isSunRoofAndCurtFailrEcuFailrGen",1,188,-1},
				{"isVMMtoHMIFBSwitch3",1,197,-1},
				{"isAutoManStsDoorDrvr_0",1,241,240},
				{"isWinFailrStsAtDrvr_1",1,297,296},
				{"isDoorOpenerDrvrReqCntr_0",4,39,-1},
				{"isChrgStrtEngRes",4,207,203},
				{"isLiBattInPWLockTC",1,289,288},
				{"isSunRoofAndCurtFailrResvd",1,184,-1},
				{"isVMMToHmiSetSetting3",3,1,-1},
				{"isCfgPrmForLeReKickSnsrMPBytePosn1_1",8,335,-1},
				{"isTrOpenerByFootOperCmd_1",1,299,298},
				{"isDoorOpenerDrvrReqDoorOpenerReq_0",2,32,-1},
				{"isDCLevelMotAgRiReq_1",8,119,308},
				{"isSwtStrt3",2,276,274},
				{"isSecRowLeHeatgLvl_1",2,268,266},
				{"isDoorDrvrPosnProgmReq_0",1,273,272},
				{"isVMMtoHMIMsg",4,223,219},
				{"isSeatHeatgLvlStsDrvrRowSec",2,260,258},
				{"isSwtStrt4",2,287,285},
				{"isCloseDoorWhenLockSetSts",1,265,264},
				{"isVMMtoHMIFBSwitch6",1,194,-1},
				{"isCarLoctrActvnSts",2,210,208},
				{"isHoodRelsReq",2,244,242},
				{"isDoorDrvrLatPawlSt_0",2,218,216},
				{"isCfgPrmForLeReKickSnsrMPBytePosn2_1",8,343,-1},
				{"isHoodOpenerReqCntr_0",4,53,-1},
				{"isSunRoofAndCurtFailrCurtMotNotAvl",1,189,-1},
				{"isSunRoofAndCurtFailrPanMotNotAvl",1,185,-1},
				{"isSunRoofAndCurtFailrCurtMotHallFailr",1,190,-1},
				{"isSeatVentnLvlStsDrvrRowSec",2,271,269},
				{"isSecLeVentnHeatgWarn",2,399,397},
				{"isSunRoofAndCurtFailrPanMotFailr",1,187,-1},
				{"isVMMToHmiSetSetting5",3,11,-1},
				{"isVMMToHmiSetSetting1",3,7,-1},
				{"isCfgPrmForLeReKickSnsrBlkIDBytePons0_1",8,327,-1},
				{"isDoorOpenerDrvrReqTrigSrc_0",3,35,-1},
				{"isVMMToHmiSetSetting2",3,4,-1},
				{"isFuLeakDetdActv_1",2,236,234},
				{"isDChrgStrtEngRes",4,215,211},
				{"isDoorMaxOpnSetStsLeRe",7,127,120},
				{"isRiSolarData_2",8,183,317}
			},
			{
				{"igCfgPrmForLeReKickSnsr_1","ZCUDZCUCANFD2SignalIPdu39",249},
				{"igVMMtoHMIFB","ZCUDZCUCANFD2SignalIPdu39",315},
				{"igSunRoofAndCurtFailr","ZCUDZCUCANFD2SignalIPdu39",316},
				{"igVMMToHmiSet","ZCUDZCUCANFD2SignalIPdu39",314},
				{"igHoodOpenerReq_0","ZCUDZCUCANFD2SignalIPdu39",60},
				{"igDoorOpenerDrvrReq_0","ZCUDZCUCANFD2SignalIPdu39",46}
			}
		},
		{"ZCU_CANFD2","ZCUDZCUCANFD2PduR500Fr27","Out",0x3c5,64,0,1,1,0},
		{"ZCU_CANFD2","ZcudWprrToDhuZCUCANFD2DiagResFr","Out",0x637,64,0,1,4,0},
		{
			"ZCU_CANFD2","ZCUDZCUCANFD2Fr22","Out",0x1c6,64,70,1,0,0,120,19,
			{
				{"isThrdRowRiCushFldMotSts",4,423,419},
				{"isThrdRowRiInclMotSts",4,431,427},
				{"isSecRowRiSideSldPosSeatPosQf",2,379,-1},
				{"isDrvrSeatFrntHeiMotSts",4,403,352},
				{"isSecRowLeArmRstMotSts",4,7,3},
				{"isSecRowRiLegExtMotSts",4,255,251},
				{"isSecRowRiLegExtPosSeatPosQf",2,309,-1},
				{"isSecRowRiEasyInOutForThrdSwt2",2,114,112},
				{"isSecRowRiZeroGrvyMotSts",4,343,339},
				{"isSecRowRiInclMotSts",4,239,235},
				{"isSecRowLeInclMotSts",4,39,35},
				{"isSecRowRiLegExtSwt",2,130,128},
				{"isSecRowLeSideSldMotSts",4,111,107},
				{"isSecLeDiagcStopReq_0",1,10,9},
				{"isThrdRowLeFldRsdTrnkSwt",2,234,232},
				{"isThrdRowRiCushFldLckMotSts",2,266,264},
				{"isThrdRowRiInclSwt",2,306,304},
				{"isDrvrSeatHeiMotSts",4,495,417},
				{"isSecRowRiZeroGrvyPosSeatPosQf",2,405,-1},
				{"isSecRowLeZeroGrvySwt",2,74,72},
				{"isSecRowLeLegRotSwt",2,50,48},
				{"isSecRowLeRotLckMotSts",2,58,56},
				{"isSecRowLeSldMotSts",4,119,115},
				{"isSecRowRiDiveMotSts",4,143,139},
				{"isSecRowRiZeroGrvyPosSeatPosPerc",10,399,-1},
				{"isThrdRowRiLegRotSwt",2,322,320},
				{"isSecRowRiLegExtPosSeatPosPerc",10,303,-1},
				{"isThrdRowLeSldMotSts",4,415,360},
				{"isDrvrSeatIntgrSwtStsIntgrSwtSelnSts",2,507,-1},
				{"isSecRowLeArmRstPosQf1",2,98,-1},
				{"isThrdRowRiFldRsdSwt",2,274,272},
				{"isSecRowRiLegRotMotSts",4,263,259},
				{"isDrvrSeatIntgrSwtStsIntgrSwtVertSts",2,505,-1},
				{"isSecRowRiFldRsdSwt",2,122,120},
				{"isThrdRowLeLegRotSwt",2,250,248},
				{"isSecRowRiLegRotPosSeatPosQf",2,325,-1},
				{"isSecRowRiDivePosSeatPosPerc_0",10,287,-1},
				{"isSecRowRiDivePosSeatPosQf_0",2,293,-1},
				{"isSecRowRiSideSldPosSeatPosPerc",10,377,-1},
				{"isSecRowLeLegRotMotSts",4,55,51},
				{"isSecRowRiZeroGrvySwt",2,178,176},
				{"isDrvrSeatIntgrSwtStsIntgrSwtRotSts",2,509,-1},
				{"isSecRowRiRotPosAirTFbFromClima",8,375,-1},
				{"isDrvrSeatCushExtPosPercSeatPosPerc",10,471,-1},
				{"isThrdRowLeInclSwt",2,242,240},
				{"isDrvrSeatSldMotSts",4,503,474},
				{"isSecRowLeSideSldPosSeatPosQf",2,197,-1},
				{"isSecRowLeLegExtMotSts",4,47,43},
				{"isExtrLiStsOfAssistantLi",2,442,440},
				{"isSecRowRiDiveMotSts2",4,151,147},
				{"isSecRowLeRotSwtRot180",1,244,-1},
				{"isDrvrSeatIntgrSwtStsIntgrSwtHozlSts",2,511,-1},
				{"isThrdRowLeCushFldMotSts",4,351,347},
				{"isSecRowRiMassSwt",1,362,361},
				{"isSecRowRiArmRstPosAngleDeg180",8,210,-1},
				{"isSecRowLeEasyInOutForThrdSwt",2,18,16},
				{"isSecRowRiArmRstMotSts",4,135,131},
				{"isSecRowLeLegExtPosSeatPosQf",2,93,-1},
				{"isSecRowLeDivePosSeatPosQf_0",2,77,-1},
				{"isSecRowLeRotPosQf1",2,183,-1},
				{"isSecRowRiRotLckMotSts",2,162,160},
				{"isThrdRowRiSldMotSts",4,455,451},
				{"isDrvrSeatInclMotSts",4,491,416},
				{"isReFogActvdbyRain",1,499,498},
				{"isThrdRowRiSldSwt",2,330,328},
				{"isLoBeamNotOpenAlert",1,497,496},
				{"isSecRowLeHeiMotSts",4,31,27},
				{"isDrvrSeatCushExtMotSts",4,411,418},
				{"isSecRowLeZeroGrvyMotSts",4,127,123},
				{"isUnlckgInhbStsLvlElecMai",4,487,-1},
				{"isSecRowLeLegRotPosSeatPosQf",2,165,-1},
				{"isSecRowLeSideSldPosSeatPosPerc",10,191,-1},
				{"isSecRowLeLegExtPosSeatPosPerc",10,87,-1},
				{"isFbOfPrkgLiShow",2,450,448},
				{"isSecRowRiSideSldMotSts",4,279,275},
				{"isSecRowRiArmRstSwt",1,354,353},
				{"isThrdRowLeInclMotSts",4,359,355},
				{"isSecRowRiHeiMotSts",4,231,227},
				{"isSecRowLeLegExtSwt",2,42,40},
				{"isSecRowLeRotSwtRot90",1,245,-1},
				{"isSecRowLeArmRstPosAngleDeg180",8,90,-1},
				{"isDrvrSeatCushExtPosPercSeatPosQf",2,477,-1},
				{"isSecRowLeEasyInOutForThrdSwt2",2,26,24},
				{"isThrdRowLeSldSwt",2,258,256},
				{"isSecRowLeFldRsdSwt",2,34,32},
				{"isSecRowRiRotSwtRot90",1,437,-1},
				{"isSecRowRiRotSwtRot180",1,436,-1},
				{"isSecRowLeRotSwtRot45",1,246,-1},
				{"isSecRowLeRotPosAirTFbFromClima",8,175,-1},
				{"isSecRowRiArmRstPosQf1",2,218,-1},
				{"isSecRowLeZeroGrvyPosSeatPosQf",2,213,-1},
				{"isSecRowLeRotMotSts",4,63,59},
				{"isSecRowRiLegRotSwt",2,138,136},
				{"isDrvrSeatPosCalResp",3,426,472},
				{"isSecRowRiRotSwtRot0",1,439,-1},
				{"isSecRowLeArmRstSwt",1,338,337},
				{"isSecRowRiRotSwtRot45",1,438,-1},
				{"isSecRowRiRotPosQf1",2,383,-1},
				{"isSecRowLeRotSwtRot0",1,247,-1},
				{"isThrdRowLeCushFldLckMotSts",2,194,192},
				{"isDrvrSeatSwtCushExtSts",2,434,432},
				{"isSecRowRiEasyInOutForThrdSwt",2,106,104},
				{"isThrdRowRiFldRsdTrnkSwt",2,290,288},
				{"isSecSeatRiPosCalResp",3,459,456},
				{"isSecRowRiSldMotSts",4,335,331},
				{"isSecRiDiagcStopReq_0",1,146,145},
				{"isAuxHiBeamLiSts",2,2,0},
				{"isSecRowLeMassSwt",1,346,345},
				{"isSecRowRiLegRotPosSeatPosPerc",10,319,-1},
				{"isThrdRowRiLegRotMotSts",4,447,443},
				{"isThrdRowLeLegRotMotSts",4,367,363},
				{"isSecRowLeLegRotPosSeatPosPerc",10,159,-1},
				{"isThrdRowLeFldRsdSwt",2,226,224},
				{"isSecRowLeDivePosSeatPosPerc_0",10,71,-1},
				{"isSecRowLeDiveMotSts2",4,23,19},
				{"isSecRowLeZeroGrvyPosSeatPosPerc",10,207,-1},
				{"isUnlckgInhbStsLvlElecSubtyp",4,483,-1},
				{"isSecRowLeDiveMotSts",4,15,11},
				{"isSecRowRiRotMotSts",4,271,267},
				{"isSecSeatLePosCalResp",3,463,460}
			},
			{
				{"igSecRowLeRotSwt","ZCUDZCUCANFD2SignalIPdu22",243},
				{"igSecRowRiLegExtPos","ZCUDZCUCANFD2SignalIPdu22",307},
				{"igSecRowLeArmRstPos","ZCUDZCUCANFD2SignalIPdu22",96},
				{"igSecRowRiSideSldPos","ZCUDZCUCANFD2SignalIPdu22",8},
				{"igSecRowRiDivePos_0","ZCUDZCUCANFD2SignalIPdu22",291},
				{"igSecRowLeRotPos","ZCUDZCUCANFD2SignalIPdu22",179},
				{"igSecRowRiLegRotPos","ZCUDZCUCANFD2SignalIPdu22",323},
				{"igUnlckgInhbSts","ZCUDZCUCANFD2SignalIPdu22",336},
				{"igSecRowRiRotSwt","ZCUDZCUCANFD2SignalIPdu22",435},
				{"igSecRowLeLegRotPos","ZCUDZCUCANFD2SignalIPdu22",163},
				{"igSecRowRiZeroGrvyPos","ZCUDZCUCANFD2SignalIPdu22",344},
				{"igSecRowRiRotPos","ZCUDZCUCANFD2SignalIPdu22",144},
				{"igSecRowLeZeroGrvyPos","ZCUDZCUCANFD2SignalIPdu22",211},
				{"igDrvrSeatCushExtPosPerc","ZCUDZCUCANFD2SignalIPdu22",475},
				{"igSecRowRiArmRstPos","ZCUDZCUCANFD2SignalIPdu22",216},
				{"igSecRowLeDivePos_0","ZCUDZCUCANFD2SignalIPdu22",75},
				{"igDrvrSeatIntgrSwtSts","ZCUDZCUCANFD2SignalIPdu22",473},
				{"igSecRowLeSideSldPos","ZCUDZCUCANFD2SignalIPdu22",195},
				{"igSecRowLeLegExtPos","ZCUDZCUCANFD2SignalIPdu22",91}
			}
		},
		{
			"ZCU_CANFD2","ZCUDZCUCANFD2Fr43","Out",0x365,64,250,1,0,0,81,4,
			{
				{"isFrntIntHCMChEnaRi11_1",1,391,390},
				{"isFrntIntHCMLiLe25LED3_1",6,11,-1},
				{"isFrntIntHCMLiRi25LED6_1",6,89,-1},
				{"isFrntIntHCMChIntenLe12_1",7,255,248},
				{"isFrntIntHCMLiRi25LED10_1",6,113,-1},
				{"isFrntIntHCMChIntenLe9_1",7,231,224},
				{"isFrntIntHCMChEnaRi2_1",1,361,360},
				{"isHSD2OutRiPWM_1",8,455,401},
				{"isFrntIntHCMChEnaRi3_1",1,375,374},
				{"isFrntIntHCMChEnaLe7_1",1,357,356},
				{"isFrntIntHCMChEnaLe10_1",1,367,366},
				{"isFrntIntHCMLiLe25LED10_1",6,49,-1},
				{"isFrntIntHCMChEnaRi5_1",1,371,370},
				{"isHSD1OutRiPWM_1",8,439,120},
				{"isFrntIntHCMChIntenLe1_1",7,167,160},
				{"isFrntIntHCMChIntenLe10_1",7,239,232},
				{"isFrntIntHCMChEnaRi6_1",1,369,368},
				{"isHCMCommReq_1",3,387,384},
				{"isFrntIntHCMLiLe25LED6_1",6,25,-1},
				{"isFrntIntHCMChIntenRi2_1",7,271,264},
				{"isFrntIntHCMLiRi25LED4_1",6,85,-1},
				{"isFrntIntHCMLiRi25LED9_1",6,119,-1},
				{"isFrntIntHCMLiLe25LED8_1",6,45,-1},
				{"isFrntIntHCMLiRi25LED5_1",6,95,-1},
				{"isFrntIntHCMChEnaLe1ActnOfLedLoBeam_1",1,139,-1},
				{"isFrntIntHCMChEnaRi1ActnOfLedLoBeamCntr_1",4,159,-1},
				{"isFrntIntHCMLiRi25LED7_1",6,99,-1},
				{"isFrntIntHCMChIntenLe5_1",7,199,192},
				{"isFrntIntHCMLiLe25LED9_1",6,55,-1},
				{"isFrntIntHCMChIntenRi1_1",7,263,256},
				{"isFrntIntHCMChIntenLe4_1",7,191,184},
				{"isSwivelMotAgRiReq_1",12,467,418},
				{"isFrntIntHCMLiRi25LED2_1",6,65,-1},
				{"isSwivelMotAgLeReq_1",12,463,400},
				{"isFrntIntHCMChIntenRi11_1",7,343,336},
				{"isFrntIntHCMChIntenLe11_1",7,247,240},
				{"isFrntIntHCMChIntenRi10_1",7,335,328},
				{"isFrntIntHCMChEnaLe4_1",1,137,136},
				{"isFrntIntHCMChEnaLe1ActnOfLedLoBeamCntr_1",4,143,-1},
				{"isFrntIntHCMChEnaLe2_1",1,58,57},
				{"isStepLevelMotAgLeReq_1",12,399,403},
				{"isFrntIntHCMChIntenRi7_1",7,311,304},
				{"isFrntIntHCMChEnaLe11_1",1,365,364},
				{"isFrntIntHCMChIntenRi9_1",7,327,320},
				{"isFrntIntHCMChIntenLe3_1",7,183,176},
				{"isFrntIntHCMChIntenLe6_1",7,207,200},
				{"isFrntIntHCMChIntenRi5_1",7,295,288},
				{"isFrntIntHCMChIntenLe8_1",7,223,216},
				{"isFrntIntHCMChEnaLe6_1",1,359,358},
				{"isFrntIntHCMChEnaRi12_1",1,389,388},
				{"isFrntIntHCMChIntenLe2_1",7,175,168},
				{"isFrntIntHCMLiLe25LED4_1",6,21,-1},
				{"isFrntIntHCMLiRi25LED3_1",6,75,-1},
				{"isFrntIntHCMChIntenRi4_1",7,287,280},
				{"isFrntIntHCMChEnaRi9_1",1,379,378},
				{"isFrntIntHCMChEnaLe12_1",1,363,362},
				{"isFrntIntHCMChEnaRi1ActnOfLedLoBeam_1",1,155,-1},
				{"isFrntIntHCMChEnaRi10_1",1,377,376},
				{"isFrntIntHCMLiLe25LED2_1",6,1,-1},
				{"isFrntIntHCMChEnaRi4_1",1,373,372},
				{"isFrntIntHCMLiLe25LED5_1",6,31,-1},
				{"isFrntIntHCMLiLe25LED1_1",6,7,-1},
				{"isFrntIntHCMLiLe25LED7_1",6,35,-1},
				{"isFrntIntHCMChEnaRi1ActnOfLedLoBeamChks_1",8,151,-1},
				{"isFrntIntHCMChIntenRi3_1",7,279,272},
				{"isFrntIntHCMChEnaRi7_1",1,383,382},
				{"isHSD2OutLePWM_1",8,447,402},
				{"isFrntIntHCMLiRi25LED8_1",6,109,-1},
				{"isFrntIntHCMChEnaLe1ActnOfLedLoBeamChks_1",8,135,-1},
				{"isFrntIntHCMChEnaLe8_1",1,355,354},
				{"isHSD1OutLePWM_1",8,431,56},
				{"isFrntIntHCMChIntenLe7_1",7,215,208},
				{"isFrntIntHCMChEnaLe3_1",1,122,121},
				{"isFrntIntHCMChIntenRi8_1",7,319,312},
				{"isFrntIntHCMChEnaLe9_1",1,353,352},
				{"isFrntIntHCMChEnaLe5_1",1,153,152},
				{"isFrntIntHCMChEnaRi8_1",1,381,380},
				{"isFrntIntHCMLiRi25LED1_1",6,71,-1},
				{"isStepLevelMotAgRiReq_1",12,415,419},
				{"isFrntIntHCMChIntenRi6_1",7,303,296},
				{"isFrntIntHCMChIntenRi12_1",7,351,344}
			},
			{
				{"igFrntIntHCMLiLe25_1","ZCUDZCUCANFD2SignalIPdu43",59},
				{"igFrntIntHCMChEnaRi1_1","ZCUDZCUCANFD2SignalIPdu43",154},
				{"igFrntIntHCMChEnaLe1_1","ZCUDZCUCANFD2SignalIPdu43",138},
				{"igFrntIntHCMLiRi25_1","ZCUDZCUCANFD2SignalIPdu43",123}
			}
		},
		{
			"ZCU_CANFD2","ZCUDZCUCANFD2Fr51","Out",0x4c1,64,1000,1,0,0,56,9,
			{
				{"isEngActvnMod1WdReq_1",2,303,301},
				{"isCEMdevelpsignalgroupVMM1Functiondevpsignalgroup2",8,375,-1},
				{"isBMXSDrvTq2VDMTqVDMQf",2,195,-1},
				{"isGVMCPrpsnTqDistReqChks_0",8,144,-1},
				{"isCEMdevelpsignalgroupVMM1Functiondevpsignalgroup5",8,399,-1},
				{"isGVMCSuspStfnCtrlReqGVMCSuspStfnReq",2,207,-1},
				{"isDampgRealFrntLe",16,223,208},
				{"isGVMCSteerWhlAgReqReChks_1",8,112,-1},
				{"isCEMdevelpsignalgroupVMM2Functiondevpsignalgroup7",8,479,-1},
				{"isPtActvnReq1WdPtActvnReq_1",2,311,309},
				{"isTVCWrcActvFlgForFrntAxle_1",1,339,338},
				{"isCEMdevelpsignalgroupVMM2Functiondevpsignalgroup3",8,447,-1},
				{"isBMXSDrvTq2VDMCntr",4,199,-1},
				{"isGVMCPrpsnTqDistReqCntr_0",4,152,-1},
				{"isCEMdevelpsignalgroupVMM1Functiondevpsignalgroup1",8,367,-1},
				{"isGVMCSuspStfnCtrlReqGVMCSuspStfnCtrlMod",1,215,-1},
				{"isGVMCSteerWhlAgReqReCntr_1",4,120,-1},
				{"isCEMdevelpsignalgroupVMM1Functiondevpsignalgroup4",8,391,-1},
				{"isTCSCooltFlowReq_1",7,351,344},
				{"isCEMdevelpsignalgroupVMM1Functiondevpsignalgroup6",8,407,-1},
				{"isGVMCSuspDampgCtrlReqGVMCSuspDampgCtrlMod_0",2,71,-1},
				{"isDampgRealFrntRi",16,239,318},
				{"isDrvrIntrLockSngSwt",1,289,288},
				{"isDampgRealReRi",16,271,322},
				{"isCEMdevelpsignalgroupVMM1Functiondevpsignalgroup3",8,383,-1},
				{"isBMXSDrvTq2VDMTqVDM",16,175,-1},
				{"isGVMCPrpsnTqDistbnReqAtAxleReCntr_1",4,101,-1},
				{"isCEMdevelpsignalgroupVMM2Functiondevpsignalgroup6",8,471,-1},
				{"isBMXSDrvTq2VDMTqVDMCtrlMode",1,193,-1},
				{"isFricEstimnFromVehDynFricEstimnFromVehDyn_1",8,335,-1},
				{"isFricEstimnFromVehDynQly_1",3,343,-1},
				{"isCEMdevelpsignalgroupVMM2Functiondevpsignalgroup1",8,431,-1},
				{"isGVMCSteerWhlAgReqReAgReqRe_1",15,111,-1},
				{"isBattCpRel",8,287,128},
				{"isDampgRealReLe",16,255,323},
				{"isGVMCSteerWhlAgReqReCtrlModRe_1",3,132,-1},
				{"isGVMCSuspDampgCtrlReqGVMCDampgCtrlReqFL_0",16,7,-1},
				{"isShortDropWinDrvrDoor2",2,308,306},
				{"isCEMdevelpsignalgroupVMM2Functiondevpsignalgroup4",8,455,-1},
				{"isMobDeBtnPanicAlarmSts",2,300,298},
				{"isCEMdevelpsignalgroupVMM2Functiondevpsignalgroup8",8,487,-1},
				{"isCEMdevelpsignalgroupVMM1Functiondevpsignalgroup7",8,415,-1},
				{"isGVMCPrpsnTqDistbnReqAtAxleReDistReq_1",18,79,-1},
				{"isGVMCSuspDampgCtrlReqGVMCDampgCtrlReqFR_0",16,23,-1},
				{"isCEMdevelpsignalgroupVMM2Functiondevpsignalgroup5",8,463,-1},
				{"isTrCrashUnlckCmd_0",1,297,296},
				{"isGVMCSuspDampgCtrlReqGVMCSuspDampgModReq_0",2,69,-1},
				{"isGVMCPrpsnTqDistbnReqAtAxleReChks_1",8,93,-1},
				{"isGVMCPrpsnTqDistbnReqAtAxleReCtrlMod_1",1,97,-1},
				{"isGVMCPrpsnTqDistReqCtrlMod_0",1,164,-1},
				{"isCEMdevelpsignalgroupVMM2Functiondevpsignalgroup2",8,439,-1},
				{"isCEMdevelpsignalgroupVMM1Functiondevpsignalgroup8",8,423,-1},
				{"isGVMCPrpsnTqDistReqDistReq_0",15,143,-1},
				{"isGVMCSuspDampgCtrlReqGVMCDampgCtrlReqRR_0",16,55,-1},
				{"isBMXSDrvTq2VDMChks",8,191,-1},
				{"isGVMCSuspDampgCtrlReqGVMCDampgCtrlReqRL_0",16,39,-1}
			},
			{
				{"igCEMdevelpsignalgroupVMM2","ZCUDZCUCANFD2SignalIPdu51",509},
				{"igGVMCPrpsnTqDistReq_0","ZCUDZCUCANFD2SignalIPdu51",163},
				{"igBMXSDrvTq2VDM","ZCUDZCUCANFD2SignalIPdu51",192},
				{"igGVMCSuspStfnCtrlReq","ZCUDZCUCANFD2SignalIPdu51",214},
				{"igGVMCSuspDampgCtrlReq_0","ZCUDZCUCANFD2SignalIPdu51",67},
				{"igGVMCPrpsnTqDistbnReqAtAxleRe_1","ZCUDZCUCANFD2SignalIPdu51",96},
				{"igFricEstimnFromVehDyn_1","ZCUDZCUCANFD2SignalIPdu51",340},
				{"igCEMdevelpsignalgroupVMM1","ZCUDZCUCANFD2SignalIPdu51",320},
				{"igGVMCSteerWhlAgReqRe_1","ZCUDZCUCANFD2SignalIPdu51",129}
			}
		},
		{
			"ZCU_CANFD2","ZCUDZCUCANFD2Fr21","Out",0x2e2,64,100,1,0,0,104,6,
			{
				{"isSunRoofElecChromCmdGroupTF2_1",1,451,-1},
				{"isEasyInOutPassReq",2,212,210},
				{"isSteerWhlHeatgDesPwr",8,431,454},
				{"isDoorpocketLiSts",1,233,232},
				{"isRelHumSnsrQf_1",1,351,350},
				{"isActvnOfDoorSwtIllmn_0",1,3,2},
				{"isActvnOfTrCmptmtLi",8,119,130},
				{"isTcsModSwtReq_1",2,482,480},
				{"isDefrstStsWinDefrstFrnt",3,248,-1},
				{"isSecRowLeReadLiReq_1",8,383,328},
				{"isSecRowRiReadLiReq_1",8,391,345},
				{"isSecRowSeatHeatgDesPwrCnsLe",8,407,441},
				{"isActvnOfDrvSideStepIllmn",8,23,126},
				{"isRainSnsrSnvtyForUsrSnvty0_1",4,309,-1},
				{"isDefrstStsMirrDefrst",3,251,-1},
				{"isSeatHSWTRawSecLe",11,359,364},
				{"isTCSRadrTreq_1",8,495,505},
				{"isActvnOfSillPlateIllmn",8,95,133},
				{"isCarLoctrHornLiSetActv",2,147,145},
				{"isSunRoofElecChromCmdGroupTF5_1",1,448,-1},
				{"isCarLoctrAcoustReq",8,167,168},
				{"isExtrADMLiSts",2,231,229},
				{"isSunRoofElecChromCmdGroupTF6_1",1,463,-1},
				{"isReWashFldSts",1,349,348},
				{"isSunRoofElecChromCmdGroupTF7_1",1,462,-1},
				{"isHornOperStsFb",5,295,290},
				{"isActvnOfRoofSwtIllmn_1",1,1,0},
				{"isSunRoofElecChromCmd_1",4,471,467},
				{"isRainSnsrSnvtyForUsrSnvty5_1",4,321,-1},
				{"isHornInhbCtrlFbLvlElecMai",4,207,-1},
				{"isActvnOfRePasDoorIllmn",8,79,135},
				{"isVehNotParkInfoWarn",2,343,341},
				{"isIntrLiRoofAUTOIndication_1",1,300,299},
				{"isActvnOfWshrRe",1,170,169},
				{"isExtrLiLogicSwt_1",2,228,226},
				{"isClsdDueToRainSetgFb",2,175,173},
				{"isSunRoofElecChromCmdGroupTF4_1",1,449,-1},
				{"isTcsTmrOverReq_1",5,511,506},
				{"isTCSRadrTSts_1",8,503,504},
				{"isDrvrSeatHSWTRaw",11,247,252},
				{"isFrLeReadLiReq_1",8,191,217},
				{"isFrntWashFldSts",1,209,208},
				{"isDoorDrvrOpenReqInsdSwt1",2,268,266},
				{"isSunRoofElecChromCmdGroupTF3_1",1,450,-1},
				{"isMirrAdjVceStsAtDrvr",1,311,310},
				{"isDoorSldngLeReOpenEnaSts_1",1,257,256},
				{"isDoorSldngRiReOpenEnaSts_1",1,265,264},
				{"isSecRowSeatVentnActlPwrCnsLe",8,415,440},
				{"isRainSnsrSnvtyForUsrSnvty3_1",4,313,-1},
				{"isExtrMirrTiltSetgFbMirrPass",1,235,-1},
				{"isExtrMirrFoldSetgFbMirrPass",1,238,-1},
				{"isElecStepPass_1",2,220,218},
				{"isTcsDoorEleBailReq_1",2,487,485},
				{"isTCSCmprStrtFlt",1,484,483},
				{"isPanicAlrmAcoustReq",8,287,296},
				{"isShortDropWinDrvrReDoor2Int",2,444,442},
				{"isActvnOfStrtIllmn",8,103,132},
				{"isActvnOfWiprRe",1,129,128},
				{"isRainSnsrSnvtyForUsrSnvty4_1",4,325,-1},
				{"isHornSwitchSts",1,289,288},
				{"isActvnOfFootwellLamp",8,31,125},
				{"isFrRiReadLiReq_1",8,199,216},
				{"isEasyInOutDrvrReq",2,215,213},
				{"isShortDropWinDrvrDoor2Int",2,447,445},
				{"isExtrMirrTiltSetgFbMirrDrvr",1,236,-1},
				{"isSunRoofElecChromCmdGroupTF8_1",1,461,-1},
				{"isActvOfHorn",1,183,182},
				{"isIndicatorIntensityLvl_1",8,279,224},
				{"isSteerWhlHSWTRaw_1",11,363,368},
				{"isActvnOfDrvSideDoorIllmn",8,15,127},
				{"isSecRowSeatHeatgActlPwrCnsLe",8,399,344},
				{"isActvnOfPasSideStepIllmn",8,55,122},
				{"isCmptmtFrntWindT",11,143,148},
				{"isMirrFoldType",2,303,301},
				{"isRainSnsrStsToHMI",1,337,336},
				{"isHornInhbCtrlFbLvlElecSubtyp",4,203,-1},
				{"isSunRoofElecChromCmdGroupTF10_1",1,459,-1},
				{"isActvnOfRePasSideStepIllmn",8,87,134},
				{"isRainSnsrSnvtyForUsrSnvty6_1",4,333,-1},
				{"isSplrTyp_1",3,7,4},
				{"isSunRoofElecChromCmdGroupTF1_1",1,452,-1},
				{"isActvnOfReDrvDoorIllmn",8,63,121},
				{"isTCSDcdcactvdReq_1",2,474,472},
				{"isActvnOfSwtIllmnSply_1",8,111,131},
				{"isExtrMirrFoldSetgFbMirrDrvr",1,239,-1},
				{"isSunroofGlassAutAdjmtHmiFb",1,457,456},
				{"isRainSnsrSnvtyForUsrSnvty1_1",4,305,-1},
				{"isCameraHeatingSts",1,181,180},
				{"isSunRoofDimEna_1",2,466,464},
				{"isSteerWhlHeatgPwrAct",8,439,453},
				{"isTCScoolgGrdReq_1",4,479,475},
				{"isActvnOfWshrFrntNotSafe",1,172,171},
				{"isDefrstStsWinDefrstRe",3,261,-1},
				{"isActvnOfReDrvSideStepIllmn",8,71,120},
				{"isCarLoctrAcoustSts",1,179,178},
				{"isSecRowSeatVentnDesPwrCnsLe",8,423,455},
				{"isActvnOfPasSideDoorIllmn",8,47,123},
				{"isActvnOfHzrd",8,39,124},
				{"isDoorDrvrOpenLowReqOutdSwt1",2,271,269},
				{"isSunRoofElecChromCmdGroupTF9_1",1,460,-1},
				{"isReWshrAvlSts",1,347,346},
				{"isRainSnsrSnvtyForUsrSnvty2_1",4,317,-1},
				{"isAlrmAcoustReq01",8,159,144},
				{"isElecStepDrvr_1",2,223,221}
			},
			{
				{"igExtrMirrFoldSetgFb","ZCUDZCUCANFD2SignalIPdu21",237},
				{"igSunRoofElecChromCmdGroup_1","ZCUDZCUCANFD2SignalIPdu21",458},
				{"igHornInhbCtrlFb","ZCUDZCUCANFD2SignalIPdu21",225},
				{"igDefrstSts","ZCUDZCUCANFD2SignalIPdu21",258},
				{"igRainSnsrSnvtyForUsrSnvty_1","ZCUDZCUCANFD2SignalIPdu21",329},
				{"igExtrMirrTiltSetgFb","ZCUDZCUCANFD2SignalIPdu21",234}
			}
		},
		{
			"ZCU_CANFD2","ZCUDZCUCANFD2Fr54","Out",0x4c4,64,1000,1,0,0,223,8,
			{
				{"isKeyReadStsToVMMNFCKey10",2,179,-1},
				{"isBLEKeyReadStsToKeyRmnWrnKey39",2,73,-1},
				{"isBLEKeyReadStsToVMMKey0",2,87,-1},
				{"isBLEKeyReadStsToVMMKey34",2,147,-1},
				{"isNFCKeyReadStsToKeyRmnWrnKey29",2,301,-1},
				{"isNFCKeyReadStsToKeyRmnWrnKey0",2,247,-1},
				{"isKeyReadStsToVMMNFCKey16",2,199,-1},
				{"isMobDevKeyDiReqKey1",1,326,-1},
				{"isBLEKeyReadStsToVMMKey5",2,93,-1},
				{"isBLEKeyReadStsToKeyRmnWrnKey32",2,71,-1},
				{"isBLEKeyReadStsToVMMKey19",2,113,-1},
				{"isKeyReadStsToVMMNFCKey36",2,239,-1},
				{"isNFCKeyReadStsToKeyRmnWrnKey14",2,267,-1},
				{"isBLEKeyReadStsToVMMKey16",2,119,-1},
				{"isBLEKeyReadStsToKeyRmnWrnKey15",2,25,-1},
				{"isKeyReadStsToVMMNFCKey17",2,197,-1},
				{"isMobDevKeyDiReqKey13",1,330,-1},
				{"isNFCKeyReadStsToKeyRmnWrnKey3",2,241,-1},
				{"isMobDevKeyDiReqKey32",1,359,-1},
				{"isKeyReadStsToVMMNFCKey0",2,167,-1},
				{"isZCUDMResdSig1ToSRSSafetyCntr_0",4,511,-1},
				{"isMobDevKeyDiReqKey38",1,353,-1},
				{"isBLEKeyReadStsToKeyRmnWrnKey12",2,31,-1},
				{"isIntrMirrCmdIntrMirrInhbDim_1",1,361,-1},
				{"isNFCKeyReadStsToKeyRmnWrnKey11",2,257,-1},
				{"isBLEKeyReadStsToVMMKey2",2,83,-1},
				{"isBLEKeyReadStsToKeyRmnWrnKey21",2,45,-1},
				{"isBLEKeyReadStsToVMMKey24",2,135,-1},
				{"isMobDevKeyDiReqKey6",1,321,-1},
				{"isBLEKeyReadStsToKeyRmnWrnKey33",2,69,-1},
				{"isBLEKeyReadStsToKeyRmnWrnKey18",2,35,-1},
				{"isNFCKeyReadStsToKeyRmnWrnKey16",2,279,-1},
				{"isMobDevKeyDiReqKey25",1,350,-1},
				{"isNFCKeyReadStsToKeyRmnWrnKey12",2,271,-1},
				{"isKeyReadStsToVMMNFCKey26",2,211,-1},
				{"isKeyReadStsToVMMNFCKey34",2,227,-1},
				{"isBLEKeyReadStsToVMMKey17",2,117,-1},
				{"isNFCKeyReadStsToKeyRmnWrnKey33",2,309,-1},
				{"isBLEKeyReadStsToVMMKey39",2,153,-1},
				{"isKeyReadStsToVMMNFCKey9",2,181,-1},
				{"isKeyReadStsToVMMNFCKey5",2,173,-1},
				{"isBLEKeyReadStsToKeyRmnWrnKey25",2,53,-1},
				{"isNFCKeyReadStsToKeyRmnWrnKey9",2,261,-1},
				{"isNFCKeyReadStsToKeyRmnWrnKey23",2,281,-1},
				{"isKeyReadStsToVMMNFCKey1",2,165,-1},
				{"isBLEKeyReadStsToKeyRmnWrnKey31",2,57,-1},
				{"isBLEKeyReadStsToKeyRmnWrnKey38",2,75,-1},
				{"isActnOfDynEDIForChrgn",1,431,430},
				{"isMobDevKeyDiReqKey2",1,325,-1},
				{"isMobDevKeyDiReqKey11",1,332,-1},
				{"isBLEKeyReadStsToVMMKey30",2,139,-1},
				{"isBLEKeyReadStsToVMMKey25",2,133,-1},
				{"isBLEKeyReadStsToKeyRmnWrnKey35",2,65,-1},
				{"isBLEKeyReadStsToKeyRmnWrnKey5",2,13,-1},
				{"isMobDevKeyDiReqKey29",1,346,-1},
				{"isBLEKeyReadStsToKeyRmnWrnKey22",2,43,-1},
				{"isEngRunngReqByVehModMgrChassie_1",1,399,-1},
				{"isIntrMirrCmdIntrMirrEna_1",1,362,-1},
				{"isBLEKeyReadStsToVMMKey13",2,109,-1},
				{"isBLEKeyReadStsToKeyRmnWrnKey1",2,5,-1},
				{"isBLEKeyReadStsToKeyRmnWrnKey0",2,7,-1},
				{"isMobDevKeyDiReqKey3",1,324,-1},
				{"isBLEKeyReadStsToKeyRmnWrnKey17",2,37,-1},
				{"isBLEKeyReadStsToVMMKey6",2,91,-1},
				{"isNFCKeyReadStsToKeyRmnWrnKey6",2,251,-1},
				{"isMobDevKeyDiReqKey27",1,348,-1},
				{"isNFCKeyReadStsToKeyRmnWrnKey21",2,285,-1},
				{"isMobDevKeyDiReqKey0",1,327,-1},
				{"isBLEKeyReadStsToVMMKey9",2,101,-1},
				{"isMobDevKeyDiReqKey28",1,347,-1},
				{"isBLEKeyReadStsToKeyRmnWrnKey30",2,59,-1},
				{"isBLEKeyReadStsToKeyRmnWrnKey29",2,61,-1},
				{"isBLEKeyReadStsToVMMKey31",2,137,-1},
				{"isNFCKeyReadStsToKeyRmnWrnKey2",2,243,-1},
				{"isEngRunngReqByVehModMgrTrailerPrsnt_1",1,396,-1},
				{"isBLEKeyReadStsToKeyRmnWrnKey27",2,49,-1},
				{"isDlyClsReq",1,455,454},
				{"isMobDevKeyDiReqKey33",1,358,-1},
				{"isMobDevKeyDiReqKey24",1,351,-1},
				{"isBLEKeyReadStsToKeyRmnWrnKey11",2,17,-1},
				{"isMobDevKeyDiReqKey4",1,323,-1},
				{"isBLEKeyReadStsToVMMKey21",2,125,-1},
				{"isBLEKeyReadStsToVMMKey4",2,95,-1},
				{"isBLEKeyReadStsToKeyRmnWrnKey7",2,9,-1},
				{"isBLEKeyReadStsToVMMKey37",2,157,-1},
				{"isMobDevKeyDiReqKey18",1,341,-1},
				{"isIntrMirrCmdIntrMirrDimSnvty_1",2,367,-1},
				{"isKeyReadStsToVMMNFCKey29",2,221,-1},
				{"isKeyReadStsToVMMNFCKey25",2,213,-1},
				{"isKeyReadStsToVMMNFCKey8",2,183,-1},
				{"isBLEKeyReadStsToKeyRmnWrnKey10",2,19,-1},
				{"isMobDevVldUserStsToVMM",1,449,448},
				{"isBLEKeyReadStsToKeyRmnWrnKey24",2,55,-1},
				{"isBLEKeyReadStsToKeyRmnWrnKey2",2,3,-1},
				{"isBLEKeyReadStsToVMMKey8",2,103,-1},
				{"isMobDevKeyDiReqKey15",1,328,-1},
				{"isKeyReadStsToVMMNFCKey15",2,185,-1},
				{"isMobDevKeyDiReqKey14",1,329,-1},
				{"isShortDropWinDrvrSts",2,420,418},
				{"isKeyReadStsToVMMNFCKey2",2,163,-1},
				{"isZCUDMResdSig1ToSRSSafetyUInt32_0",32,471,-1},
				{"isBLEKeyReadStsToVMMKey12",2,111,-1},
				{"isBLEKeyReadStsToKeyRmnWrnKey4",2,15,-1},
				{"isNFCKeyReadStsToKeyRmnWrnKey5",2,253,-1},
				{"isBLEKeyReadStsToKeyRmnWrnKey13",2,29,-1},
				{"isEngRunngReqByVehModMgrClimate_1",1,398,-1},
				{"isKeyReadStsToVMMNFCKey33",2,229,-1},
				{"isMobDevKeyDiReqKey8",1,335,-1},
				{"isNFCKeyReadStsToKeyRmnWrnKey15",2,265,-1},
				{"isKeyReadStsToVMMNFCKey37",2,237,-1},
				{"isNFCKeyReadStsToKeyRmnWrnKey28",2,303,-1},
				{"isBLEKeyReadStsToVMMKey38",2,155,-1},
				{"isMobDevKeyDiReqKey36",1,355,-1},
				{"isBLEKeyReadStsToKeyRmnWrnKey34",2,67,-1},
				{"isBLEKeyReadStsToVMMKey23",2,121,-1},
				{"isBLEKeyReadStsToVMMKey20",2,127,-1},
				{"isMobDevKeyDiReqKey39",1,352,-1},
				{"isBLEKeyReadStsToKeyRmnWrnKey23",2,41,-1},
				{"isBLEKeyReadStsToVMMKey33",2,149,-1},
				{"isBLEKeyReadStsToKeyRmnWrnKey36",2,79,-1},
				{"isIntrMirrCmdDrvrSide_1",1,365,-1},
				{"isKeyReadStsToVMMNFCKey30",2,219,-1},
				{"isBLEKeyReadStsToVMMKey15",2,105,-1},
				{"isActvnOfEIDForVSTD",2,386,384},
				{"isNFCKeyReadStsToKeyRmnWrnKey36",2,319,-1},
				{"isBLEKeyReadStsToKeyRmnWrnKey16",2,39,-1},
				{"isKeyReadStsToVMMNFCKey7",2,169,-1},
				{"isKeyReadStsToVMMNFCKey28",2,223,-1},
				{"isKeyReadStsToVMMNFCKey13",2,189,-1},
				{"isMobDevKeyDiReqKey30",1,345,-1},
				{"isKeyReadStsToVMMNFCKey18",2,195,-1},
				{"isBLEKeyReadStsToVMMKey27",2,129,-1},
				{"isIntrMirrCmdIntrMirrWindHeatrCmpMag_1",1,360,-1},
				{"isIntrMirrCmdIntrMirrAsyFanCmpMag_1",1,364,-1},
				{"isNFCKeyReadStsToKeyRmnWrnKey30",2,299,-1},
				{"isMobDevKeyDiReqKey5",1,322,-1},
				{"isNFCKeyReadStsToKeyRmnWrnKey4",2,255,-1},
				{"isMobDevKeyDiReqKey35",1,356,-1},
				{"isShortDropWinReLeSts",2,506,504},
				{"isZCUDMResdSig1ToSRSSafetyChks_0",8,503,-1},
				{"isBLEKeyReadStsToKeyRmnWrnKey28",2,63,-1},
				{"isMobDevKeyDiReqKey20",1,339,-1},
				{"isKeyReadStsToVMMNFCKey22",2,203,-1},
				{"isMobDevKeyDiReqKey17",1,342,-1},
				{"isNFCKeyReadStsToKeyRmnWrnKey26",2,291,-1},
				{"isMobDevKeyDiReqKey31",1,344,-1},
				{"isBLEKeyReadStsToVMMKey26",2,131,-1},
				{"isMobDevKeyDiReqKey37",1,354,-1},
				{"isKeyReadStsToVMMNFCKey31",2,217,-1},
				{"isMobDevWinOpnClsReq",2,423,421},
				{"isBLEKeyReadStsToVMMKey18",2,115,-1},
				{"isNFCKeyReadStsToKeyRmnWrnKey32",2,311,-1},
				{"isNFCKeyReadStsToKeyRmnWrnKey8",2,263,-1},
				{"isKeyReadStsToVMMNFCKey3",2,161,-1},
				{"isEngRunngReqByVehModMgrElectricalSystem_1",1,397,-1},
				{"isNFCKeyReadStsToKeyRmnWrnKey25",2,293,-1},
				{"isIntrMirrCmdIntrMirrDiagcRst_1",1,363,-1},
				{"isNFCKeyReadStsToKeyRmnWrnKey17",2,277,-1},
				{"isMobDevKeyDiReqKey21",1,338,-1},
				{"isKeyReadStsToVMMNFCKey24",2,215,-1},
				{"isBLEKeyReadStsToVMMKey28",2,143,-1},
				{"isMobDevKeyDiReqKey9",1,334,-1},
				{"isBLEKeyReadStsToVMMKey10",2,99,-1},
				{"isNFCKeyReadStsToKeyRmnWrnKey7",2,249,-1},
				{"isNFCKeyReadStsToKeyRmnWrnKey35",2,305,-1},
				{"isNFCKeyReadStsToKeyRmnWrnKey38",2,315,-1},
				{"isNFCKeyReadStsToKeyRmnWrnKey27",2,289,-1},
				{"isBLEKeyReadStsToKeyRmnWrnKey37",2,77,-1},
				{"isMobDevKeyDiReqKey7",1,320,-1},
				{"isMobDevKeyDiReqKey10",1,333,-1},
				{"isKeyReadStsToVMMNFCKey4",2,175,-1},
				{"isMobDevKeyDiReqKey34",1,357,-1},
				{"isNFCKeyReadStsToKeyRmnWrnKey1",2,245,-1},
				{"isNFCKeyReadStsToKeyRmnWrnKey34",2,307,-1},
				{"isNFCKeyReadStsToKeyRmnWrnKey37",2,317,-1},
				{"isKeyReadStsToVMMNFCKey38",2,235,-1},
				{"isMobDeBtnCarLctrSts",1,453,452},
				{"isNFCKeyReadStsToKeyRmnWrnKey13",2,269,-1},
				{"isNFCKeyReadStsToKeyRmnWrnKey31",2,297,-1},
				{"isMobDevKeyDiReqKey19",1,340,-1},
				{"isKeyReadStsToVMMNFCKey6",2,171,-1},
				{"isMobDevKeyDiReqKey12",1,331,-1},
				{"isBLEKeyReadStsToKeyRmnWrnKey6",2,11,-1},
				{"isBLEKeyReadStsToVMMKey3",2,81,-1},
				{"isKeyReadStsToVMMNFCKey32",2,231,-1},
				{"isKeyReadStsToVMMNFCKey27",2,209,-1},
				{"isBLEKeyReadStsToVMMKey11",2,97,-1},
				{"isKeyReadStsToVMMNFCKey20",2,207,-1},
				{"isBLEKeyReadStsToKeyRmnWrnKey19",2,33,-1},
				{"isNFCKeyReadStsToKeyRmnWrnKey39",2,313,-1},
				{"isMobDevKeyDiReqKey22",1,337,-1},
				{"isBLEKeyReadStsToVMMKey32",2,151,-1},
				{"isKeyReadStsToVMMNFCKey39",2,233,-1},
				{"isBLEKeyReadStsToVMMKey29",2,141,-1},
				{"isBLEKeyReadStsToKeyRmnWrnKey26",2,51,-1},
				{"isBLEKeyReadStsToVMMKey7",2,89,-1},
				{"isBLEKeyReadStsToVMMKey35",2,145,-1},
				{"isMobDevKeyDiReqKey26",1,349,-1},
				{"isBLEKeyReadStsToKeyRmnWrnKey3",2,1,-1},
				{"isKeyReadStsToVMMNFCKey35",2,225,-1},
				{"isNFCKeyReadStsToKeyRmnWrnKey22",2,283,-1},
				{"isNFCKeyReadStsToKeyRmnWrnKey24",2,295,-1},
				{"isBLEKeyReadStsToVMMKey14",2,107,-1},
				{"isNFCKeyReadStsToKeyRmnWrnKey18",2,275,-1},
				{"isBLEKeyReadStsToKeyRmnWrnKey14",2,27,-1},
				{"isBLEKeyReadStsToKeyRmnWrnKey20",2,47,-1},
				{"isNFCKeyReadStsToKeyRmnWrnKey19",2,273,-1},
				{"isNFCKeyReadStsToKeyRmnWrnKey20",2,287,-1},
				{"isBLEKeyReadStsToKeyRmnWrnKey9",2,21,-1},
				{"isBLEKeyReadStsToVMMKey1",2,85,-1},
				{"isKeyReadStsToVMMNFCKey12",2,191,-1},
				{"isBLEKeyReadStsToKeyRmnWrnKey8",2,23,-1},
				{"isNFCKeyReadStsToKeyRmnWrnKey10",2,259,-1},
				{"isKeyReadStsToVMMNFCKey21",2,205,-1},
				{"isBLEKeyReadStsToVMMKey22",2,123,-1},
				{"isBLEKeyReadStsToVMMKey36",2,159,-1},
				{"isMobDevKeyDiReqKey16",1,343,-1},
				{"isWinHwSwtDrvrReDoor",3,415,412},
				{"isKeyReadStsToVMMNFCKey19",2,193,-1},
				{"isKeyReadStsToVMMNFCKey11",2,177,-1},
				{"isKeyReadStsToVMMNFCKey23",2,201,-1},
				{"isKeyReadStsToVMMNFCKey14",2,187,-1},
				{"isMobDevKeyDiReqKey23",1,336,-1}
			},
			{
				{"igNFCKeyReadStsToKeyRmnWrn","ZCUDZCUCANFD2SignalIPdu54",459},
				{"igBLEKeyReadStsToKeyRmnWrn","ZCUDZCUCANFD2SignalIPdu54",408},
				{"igZCUDMResdSig1ToSRSSafety_0","ZCUDZCUCANFD2SignalIPdu54",507},
				{"igKeyReadStsToVMMNFC","ZCUDZCUCANFD2SignalIPdu54",461},
				{"igMobDevKeyDiReq","ZCUDZCUCANFD2SignalIPdu54",460},
				{"igIntrMirrCmd_1","ZCUDZCUCANFD2SignalIPdu54",462},
				{"igBLEKeyReadStsToVMM","ZCUDZCUCANFD2SignalIPdu54",463},
				{"igEngRunngReqByVehModMgr_1","ZCUDZCUCANFD2SignalIPdu54",395}
			}
		},
		{
			"ZCU_CANFD2","ZCUDZCUCANFD2Fr48","Out",0x390,64,350,1,0,0,38,6,
			{
				{"isPassAirbLampReqCntr_2",4,127,-1},
				{"isSldngdoorLeReAntiPnchFaultFltMovngEvnt_1",1,111,-1},
				{"isPVMCVehCtrlSts5BrkTqDeltaActrSts_1",3,47,-1},
				{"isSldngDoorRiRePos_1",7,87,80},
				{"isSldngdoorRiReAntiPnchFaultPinchEvnt_1",1,105,-1},
				{"isSldngdoorLeReAntiPnchFaultPinchEvnt_1",1,110,-1},
				{"isPVMCVehCtrlSts5PrpsnTqTotActrSts_1",3,51,-1},
				{"isPVMCVehCtrlSts6SuspStfnReRiActrSts_1",3,38,-1},
				{"isPVMCVehCtrlSts6SuspStfnFrntLeActrSts_1",3,31,-1},
				{"isConvPwrRelsForbRelsMtnFrbn",1,90,-1},
				{"isRainSnsrActvnErrToHmi",1,103,102},
				{"isPassAirbLampReqChks_2",8,119,-1},
				{"isPVMCVehCtrlSts5SuspDmpgFrntLeActrSts_1",3,61,-1},
				{"isPVMCVehCtrlSts5SuspDmpgReRiActrSts_1",3,68,-1},
				{"isRlyPwrDistbnCmd1WdIgnRlyCmd_2",1,101,100},
				{"isPVMCVehCtrlSts6Chks_1",8,7,-1},
				{"isPVMCVehCtrlSts6SuspStfnReLeActrSts_1",3,25,-1},
				{"isConvPwrRelsForbRelsFrbn1",1,91,-1},
				{"isSldngDoorLeRePos_1",7,79,72},
				{"isPVMCVehCtrlSts6SuspHeiFrntRiActrSts_1",3,8,-1},
				{"isPVMCVehCtrlSts6SuspStfnFrntRiActrSts_1",3,28,-1},
				{"isPVMCVehCtrlSts6SuspHeiReLeActrSts_1",3,21,-1},
				{"isPVMCVehCtrlSts5PrpsnTqDistbnFrntReActrSts_1",3,44,-1},
				{"isPassAirbLampReqPassAirbLampEnaReq_2",2,121,-1},
				{"isPVMCVehCtrlSts5PrpsnTqDistbnReAxleActrSts_1",3,41,-1},
				{"isPVMCVehCtrlSts5PrpsnTqLimnActrSts_1",3,54,-1},
				{"isPassAirbLampReqChgOfPassAirbSts_2",1,135,-1},
				{"isEWDCActFlg",1,34,33},
				{"isPVMCVehCtrlSts6SuspHeiReRiActrSts_1",3,18,-1},
				{"isPVMCVehCtrlSts6SuspHeiFrntLeActrSts_1",3,11,-1},
				{"isSldngdoorRiReAntiPnchFaultFltMovngEvnt_1",1,106,-1},
				{"isPVMCVehCtrlSts5SuspDmpgReLeActrSts_1",3,71,-1},
				{"isPassAirbLampReqPassAirbLampDiReq_2",2,123,-1},
				{"isSteerLockMgrWarnIndcn",3,95,92},
				{"isPVMCVehCtrlSts6Cntr_1",4,15,-1},
				{"isRlyPwrDistbnCmd1WdIgnRlyExtCmd_0",1,99,98},
				{"isPVMCVehCtrlSts5SuspDmpgFrntRiActrSts_1",3,58,-1},
				{"isPVMCVehCtrlSts5SplrReActvActrSts_1",3,48,-1}
			},
			{
				{"igPassAirbLampReq_2","ZCUDZCUCANFD2SignalIPdu48",134},
				{"igSldngdoorLeReAntiPnchFault_1","ZCUDZCUCANFD2SignalIPdu48",109},
				{"igSldngdoorRiReAntiPnchFault_1","ZCUDZCUCANFD2SignalIPdu48",104},
				{"igPVMCVehCtrlSts6_1","ZCUDZCUCANFD2SignalIPdu48",35},
				{"igPVMCVehCtrlSts5_1","ZCUDZCUCANFD2SignalIPdu48",65},
				{"igConvPwrRelsForb","ZCUDZCUCANFD2SignalIPdu48",89}
			}
		},
		{
			"ZCU_CANFD2","ZCUDZCUCANFD2Fr16","Out",0x1c5,64,50,1,0,0,109,20,
			{
				{"isRowSecLeLegRstLenPosPercSeatPosPerc_1",10,231,-1},
				{"isRowSecLeInclPosAngle_1",8,383,136},
				{"isRowSecRiLegRstHeiPosPercSeatPosQf_1",2,269,-1},
				{"isSBWErrReqH1Cntr_1",4,175,-1},
				{"isHwRowRearRiMultiVertSwt_1",2,218,216},
				{"isFrntWshrSwt_1",1,492,491},
				{"isActvReSplrIntFltActrFlt2_1",1,478,-1},
				{"isDoorOpenerRiReReqTrigSrc_0",3,129,-1},
				{"isDoorOpenerPassReqChks",8,111,-1},
				{"isHoodOpenerPosn_1",7,375,368},
				{"isHwSwtRowSecLeEasyInOutForThrd_1",2,298,296},
				{"isHwRowThrdLeFldRsdSwtSts_1",2,234,232},
				{"isDoorOpenerRiReReqChks_0",8,125,-1},
				{"isDoorOpenerRiReReqDoorOpenerReq_0",2,142,-1},
				{"isAFSSetSrvSts",1,463,462},
				{"isRowSecRiSldPosPercSeatPosQf_1",2,317,-1},
				{"isRowSecLeLegRstHeiPosPercSeatPosQf_1",2,221,-1},
				{"isSteerActReGroupChks_1",8,44,-1},
				{"isHwSeatRowSecRiInclHallEna_1",1,444,443},
				{"isDoorOpenerLeReReqCntr_0",4,90,-1},
				{"isRestrntSysMsgReq_1",2,447,445},
				{"isSBWErrReqH1SteerErrReq_1",3,171,-1},
				{"isSBWErrReqH1Chks_1",8,167,-1},
				{"isAltI_1",9,330,337},
				{"isAccrpedlStsCntr_1",4,207,-1},
				{"isDoorOpenerLeReReqChks_0",8,82,-1},
				{"isActvReSplrIntFltActrFlt4_1",1,476,-1},
				{"isHwSwtRowSecRiEasyInOutForThrd_1",2,402,400},
				{"isManSyncnIndcnReqR1_2",2,431,429},
				{"isWPRRPhoneForgottenRmn_1",1,449,448},
				{"isManSyncnIndcnReqR2_1",2,428,426},
				{"isSBWErrReqR2Chks_1",8,183,-1},
				{"isAltIAvl_1",9,351,358},
				{"isRestrntSysLampReq_1",2,436,434},
				{"isSteerActReGroupAgMaxAvlFromSteerActrRe_1",15,8,-1},
				{"isPtVehSpdMaxReq_1",8,79,-1},
				{"isActvReSplrIntFltActrFlt1_1",1,479,-1},
				{"isLimSts_1",2,418,416},
				{"isWPRLSts_1",4,415,411},
				{"isSeatRowThrdLeMassgRunng_1",1,455,454},
				{"isSoundSwt_1",1,480,488},
				{"isDoorOpenerLeReReqDoorOpenerReq_0",2,99,-1},
				{"isSteerActReGroupAgAct_1",15,7,-1},
				{"isDoorOpenerRiReReqCntr_0",4,133,-1},
				{"isHwSwtRowSecRiEasyInOutForThrd2_1",2,410,408},
				{"isSBWErrReqR2SteerErrReq_1",3,187,-1},
				{"isCmptmtCoolgSts_2",4,407,403},
				{"isHwRowThrdRiFldRsdTrnkSwtSts_1",2,282,280},
				{"isAjarChrgLidFrntSwitch",2,511,509},
				{"isFloatDrvingActvCntr_1",4,159,-1},
				{"isRowSecRiSideSldPosPercSeatPosQf_1",2,301,-1},
				{"isTrOpenPosn_1",7,399,392},
				{"isActvReSplrIntFltActrFlt5_1",1,475,-1},
				{"isCalStsToDHU_1",2,495,493},
				{"isFloatDrvingActvStatus_1",3,155,-1},
				{"isActvReSplrIntFltActrFlt3_1",1,477,-1},
				{"isSteerActReGroupAgActQf_1",2,61,-1},
				{"isSunRoofTiltSts2_1",1,490,489},
				{"isDBLSetSrvSts",1,457,456},
				{"isActvReSplrUFltHiVoltDetdFlt_1",1,483,-1},
				{"isRowSecRiLegRstLenPosPercSeatPosQf_1",2,285,-1},
				{"isRowSecRiZeroGrvyPosPercSeatPosPerc_1",10,327,-1},
				{"isRowSecRiSldPosPercSeatPosPerc_1",10,311,-1},
				{"isSteerActReGroupAgGrdtMaxAvlFromSteerActrRe_1",13,25,-1},
				{"isHwRowRearRiMassSwt_1",1,425,424},
				{"isPtVehSpdMaxChks_1",8,71,-1},
				{"isFloatDrvingActvChks_1",8,151,-1},
				{"isWPRRSts_1",4,423,419},
				{"isActvReSplrUFltLoVoltDetdFlt_1",1,482,-1},
				{"isActvReSplrHallSnsrFltHallBFlt_1",1,486,-1},
				{"isSteerActReGroupSteerActrReSts_1",3,48,-1},
				{"isRowSecRiLegRstHeiPosPercSeatPosPerc_1",10,263,-1},
				{"isAccrpedlStsFltSts_1",1,203,-1},
				{"isActvReSplrHallSnsrFltHallAFlt_1",1,487,-1},
				{"isHwRowThrdRiFldRsdSwtSts_1",2,266,264},
				{"isHwRowRearRiMultiHozlSwt_1",2,139,137},
				{"isDenoOfDiagcRateGen_1",1,201,200},
				{"isChdPrtnRightSwReq_1",1,459,458},
				{"isDoorOpenerPassReqDoorOpenerReq",2,112,-1},
				{"isSeatRowThrdRiMassgRunng_1",1,453,452},
				{"isPedProtnMsgReqForFlt_1",2,439,437},
				{"isRowSecLeLegRstLenPosPercSeatPosQf_1",2,237,-1},
				{"isRowSecLeSldPosPercSeatPosQf_1",2,253,-1},
				{"isSBWErrReqR2Cntr_1",4,191,-1},
				{"isChdPrtnLeftSwReq_1",1,461,460},
				{"isDoorOpenerPassReqTrigSrc",3,115,-1},
				{"isRowSecLeSeatRotPosPerc_1",8,471,440},
				{"isHwSwtRowSecLeEasyInOutForThrd2_1",2,314,312},
				{"isHwRowThrdLeFldRsdTrnkSwtSts_1",2,250,248},
				{"isRowSecRiLegRstLenPosPercSeatPosPerc_1",10,279,-1},
				{"isKnkSnsrFltSts_1",8,503,472},
				{"isAccrpedlStsChks_1",8,199,-1},
				{"isRowSecLeSldPosPercSeatPosPerc_1",10,247,-1},
				{"isDoorOpenerLeReReqTrigSrc_0",3,102,-1},
				{"isErsStrtApplSts",2,58,56},
				{"isHwRowRearRiMassSwtStck_1",1,433,432},
				{"isRowSecLeLegRstHeiPosPercSeatPosPerc_1",10,215,-1},
				{"isActvReSplrHallSnsrFltHallOutpFlt_1",1,485,-1},
				{"isPedProtnMsgReqForImpct_1",1,442,441},
				{"isChrgnOrDisChrgnStsFb_1",5,357,352},
				{"isDoorOpenerPassReqCntr",4,119,-1},
				{"isActvReSplrIntFltTmrFlt_1",1,474,-1},
				{"isRowSecRiZeroGrvyPosPercSeatPosQf_1",2,333,-1},
				{"isWPRLPhoneForgottenRmn_1",1,451,450},
				{"isEngPAmbAir_1",8,367,96},
				{"isSteerActReGroupCntr_1",4,52,-1},
				{"isRowSecRiInclPosAngle_1",8,391,336},
				{"isRowSecRiSideSldPosPercSeatPosPerc_1",10,295,-1},
				{"isPtVehSpdMaxCntr_1",4,87,-1}
			},
			{
				{"igRowSecLeSldPosPerc_1","ZCUDZCUCANFD2SignalIPdu16",251},
				{"igActvReSplrUFlt_1","ZCUDZCUCANFD2SignalIPdu16",481},
				{"igRowSecRiZeroGrvyPosPerc_1","ZCUDZCUCANFD2SignalIPdu16",331},
				{"igSBWErrReqH1_1","ZCUDZCUCANFD2SignalIPdu16",168},
				{"igFloatDrvingActv_1","ZCUDZCUCANFD2SignalIPdu16",152},
				{"igActvReSplrIntFlt_1","ZCUDZCUCANFD2SignalIPdu16",473},
				{"igDoorOpenerRiReReq_0","ZCUDZCUCANFD2SignalIPdu16",140},
				{"igRowSecRiSideSldPosPerc_1","ZCUDZCUCANFD2SignalIPdu16",299},
				{"igActvReSplrHallSnsrFlt_1","ZCUDZCUCANFD2SignalIPdu16",484},
				{"igRowSecRiLegRstLenPosPerc_1","ZCUDZCUCANFD2SignalIPdu16",283},
				{"igSBWErrReqR2_1","ZCUDZCUCANFD2SignalIPdu16",184},
				{"igDoorOpenerLeReReq_0","ZCUDZCUCANFD2SignalIPdu16",97},
				{"igRowSecLeLegRstHeiPosPerc_1","ZCUDZCUCANFD2SignalIPdu16",219},
				{"igRowSecRiLegRstHeiPosPerc_1","ZCUDZCUCANFD2SignalIPdu16",267},
				{"igAccrpedlSts_1","ZCUDZCUCANFD2SignalIPdu16",202},
				{"igDoorOpenerPassReq","ZCUDZCUCANFD2SignalIPdu16",126},
				{"igRowSecRiSldPosPerc_1","ZCUDZCUCANFD2SignalIPdu16",315},
				{"igSteerActReGroup_1","ZCUDZCUCANFD2SignalIPdu16",59},
				{"igPtVehSpdMax_1","ZCUDZCUCANFD2SignalIPdu16",83},
				{"igRowSecLeLegRstLenPosPerc_1","ZCUDZCUCANFD2SignalIPdu16",235}
			}
		},
		{
			"ZCU_CANFD2","ZCUDZCUCANFD2Fr24","Out",0x2e4,64,100,1,0,0,56,7,
			{
				{"isBodyDataTraceZCUDM4Functiondevpsignalgroup2",8,207,-1},
				{"isBodyDataTraceZCUDM5Functiondevpsignalgroup3",8,279,-1},
				{"isBodyDataTraceZCUDM5Functiondevpsignalgroup7",8,311,-1},
				{"isBodyDataTraceZCUDM4Functiondevpsignalgroup7",8,247,-1},
				{"isBodyDataTraceZCUDM2Functiondevpsignalgroup2",8,79,-1},
				{"isBodyDataTraceZCUDM3Functiondevpsignalgroup5",8,167,-1},
				{"isBodyDataTraceZCUDM1Functiondevpsignalgroup8",8,63,-1},
				{"isBodyDataTraceZCUDM6Functiondevpsignalgroup6",8,367,-1},
				{"isBodyDataTraceZCUDM6Functiondevpsignalgroup1",8,327,-1},
				{"isBodyDataTraceZCUDM1Functiondevpsignalgroup3",8,23,-1},
				{"isBodyDataTraceZCUDM6Functiondevpsignalgroup3",8,343,-1},
				{"isBodyDataTraceZCUDM4Functiondevpsignalgroup3",8,215,-1},
				{"isBodyDataTraceZCUDM2Functiondevpsignalgroup8",8,127,-1},
				{"isBodyDataTraceZCUDM5Functiondevpsignalgroup2",8,271,-1},
				{"isBodyDataTraceZCUDM7Functiondevpsignalgroup2",8,399,-1},
				{"isBodyDataTraceZCUDM3Functiondevpsignalgroup3",8,151,-1},
				{"isBodyDataTraceZCUDM3Functiondevpsignalgroup6",8,175,-1},
				{"isBodyDataTraceZCUDM4Functiondevpsignalgroup4",8,223,-1},
				{"isBodyDataTraceZCUDM2Functiondevpsignalgroup1",8,71,-1},
				{"isBodyDataTraceZCUDM2Functiondevpsignalgroup5",8,103,-1},
				{"isBodyDataTraceZCUDM2Functiondevpsignalgroup6",8,111,-1},
				{"isBodyDataTraceZCUDM7Functiondevpsignalgroup1",8,391,-1},
				{"isBodyDataTraceZCUDM3Functiondevpsignalgroup1",8,135,-1},
				{"isBodyDataTraceZCUDM7Functiondevpsignalgroup7",8,439,-1},
				{"isBodyDataTraceZCUDM1Functiondevpsignalgroup4",8,31,-1},
				{"isBodyDataTraceZCUDM7Functiondevpsignalgroup3",8,407,-1},
				{"isBodyDataTraceZCUDM3Functiondevpsignalgroup4",8,159,-1},
				{"isBodyDataTraceZCUDM1Functiondevpsignalgroup6",8,47,-1},
				{"isBodyDataTraceZCUDM2Functiondevpsignalgroup3",8,87,-1},
				{"isBodyDataTraceZCUDM3Functiondevpsignalgroup2",8,143,-1},
				{"isBodyDataTraceZCUDM2Functiondevpsignalgroup4",8,95,-1},
				{"isBodyDataTraceZCUDM5Functiondevpsignalgroup1",8,263,-1},
				{"isBodyDataTraceZCUDM4Functiondevpsignalgroup5",8,231,-1},
				{"isBodyDataTraceZCUDM4Functiondevpsignalgroup6",8,239,-1},
				{"isBodyDataTraceZCUDM1Functiondevpsignalgroup7",8,55,-1},
				{"isBodyDataTraceZCUDM6Functiondevpsignalgroup4",8,351,-1},
				{"isBodyDataTraceZCUDM3Functiondevpsignalgroup8",8,191,-1},
				{"isBodyDataTraceZCUDM5Functiondevpsignalgroup8",8,319,-1},
				{"isBodyDataTraceZCUDM5Functiondevpsignalgroup4",8,287,-1},
				{"isBodyDataTraceZCUDM7Functiondevpsignalgroup6",8,431,-1},
				{"isBodyDataTraceZCUDM4Functiondevpsignalgroup8",8,255,-1},
				{"isBodyDataTraceZCUDM1Functiondevpsignalgroup1",8,7,-1},
				{"isBodyDataTraceZCUDM5Functiondevpsignalgroup5",8,295,-1},
				{"isBodyDataTraceZCUDM3Functiondevpsignalgroup7",8,183,-1},
				{"isBodyDataTraceZCUDM7Functiondevpsignalgroup4",8,415,-1},
				{"isBodyDataTraceZCUDM7Functiondevpsignalgroup5",8,423,-1},
				{"isBodyDataTraceZCUDM6Functiondevpsignalgroup8",8,383,-1},
				{"isBodyDataTraceZCUDM6Functiondevpsignalgroup2",8,335,-1},
				{"isBodyDataTraceZCUDM7Functiondevpsignalgroup8",8,447,-1},
				{"isBodyDataTraceZCUDM1Functiondevpsignalgroup5",8,39,-1},
				{"isBodyDataTraceZCUDM5Functiondevpsignalgroup6",8,303,-1},
				{"isBodyDataTraceZCUDM1Functiondevpsignalgroup2",8,15,-1},
				{"isBodyDataTraceZCUDM6Functiondevpsignalgroup7",8,375,-1},
				{"isBodyDataTraceZCUDM6Functiondevpsignalgroup5",8,359,-1},
				{"isBodyDataTraceZCUDM2Functiondevpsignalgroup7",8,119,-1},
				{"isBodyDataTraceZCUDM4Functiondevpsignalgroup1",8,199,-1}
			},
			{
				{"igBodyDataTraceZCUDM1","ZCUDZCUCANFD2SignalIPdu24",455},
				{"igBodyDataTraceZCUDM7","ZCUDZCUCANFD2SignalIPdu24",449},
				{"igBodyDataTraceZCUDM6","ZCUDZCUCANFD2SignalIPdu24",450},
				{"igBodyDataTraceZCUDM3","ZCUDZCUCANFD2SignalIPdu24",453},
				{"igBodyDataTraceZCUDM4","ZCUDZCUCANFD2SignalIPdu24",452},
				{"igBodyDataTraceZCUDM2","ZCUDZCUCANFD2SignalIPdu24",454},
				{"igBodyDataTraceZCUDM5","ZCUDZCUCANFD2SignalIPdu24",451}
			}
		},
		{"ZCU_CANFD2","ZcudHcmlToDhuZCUCANFD2DiagResFr","Out",0x6b3,64,0,1,4,0},
		{
			"ZCU_CANFD2","ZCUDZCUCANFD2Fr15","Out",0x180,64,40,1,0,0,70,7,
			{
				{"isPubCANRWASysR1Group1Cntr_1",4,242,-1},
				{"isFrntSunCurtFailrSRM2CurtMotHallFailr_1",1,38,-1},
				{"isEPBLockChk2Data5_1",8,327,-1},
				{"isPubCANRWA1Group1ActRackPosn_1",15,133,-1},
				{"isPubCANRWA1Group1PwrCpFac_1",7,213,-1},
				{"isPubCANRWASysR1Group1SteerErr_1",3,260,-1},
				{"isReSunCurtFailrSRM2CurtMotFailr_1",1,47,-1},
				{"isReSunCurtMvngSts2_1",1,49,48},
				{"isFrntSunCurtFailrSRM2EcuFailrGen_1",1,35,-1},
				{"isPubCANRWA1Group1ActRackPosnVel_1",14,167,-1},
				{"isEPBLockChk2Data4_1",8,319,-1},
				{"isHoodObstclDetn_1",1,225,224},
				{"isEPBLockChk2Data2_1",8,303,-1},
				{"isFrntSunCurtFailrSRM2CurtMotNotAvl_1",1,36,-1},
				{"isPubCANRWA1Group1RackMtrTrq_1",18,103,-1},
				{"isPubCANRWA1Group1Cntr_1",4,218,-1},
				{"isReSunCurtMoveDir2_1",5,71,66},
				{"isPubCANRWASysR1Group1FltDateStoreFlag_1",1,267,-1},
				{"isReSunCurtFailrSRM2CurtMotHallNotAvl_1",1,45,-1},
				{"isSecRiVentnHeatgWarnSMX_1",2,340,338},
				{"isPubCANRWASysR1Group1Chks_1",8,239,-1},
				{"isReSunCurtPosnSts2_1",5,79,74},
				{"isSuspStfnVlvCtrlStsFbFL_1",2,31,-1},
				{"isSteerStsToParkAssi_1",3,279,276},
				{"isPubCANRWA1Group1RackFEstimd_1",16,117,-1},
				{"isBattLoStsFild",1,65,64},
				{"isReSunCurtFailrSRM2EcuFailrGen_1",1,43,-1},
				{"isPubCANRWA1Group1TarRackPosnAtADAS_1",15,150,-1},
				{"isEPBLockChk2Data6_1",8,335,-1},
				{"isPubCANRWASysR1Group1MaiSts_1",3,263,-1},
				{"isSteerColRatGroupH1SteerRatVal_1",16,7,-1},
				{"isSuspStfnVlvCtrlStsFbRL_1",2,27,-1},
				{"isRlyPwrDistbnCmd1WdPreBattSaveCmd_1",1,57,56},
				{"isPubCANRWASysR1Group1FltSts_1",3,250,-1},
				{"isPubCANRWA1Group1ActRackPosnQf_1",2,230,-1},
				{"isReSunCurtFailrSRM2Resvd_1",1,42,-1},
				{"isFrntSunCurtFailrSRM2CurtMotFailr_1",1,39,-1},
				{"isFrntSunCurtMoveDir2_1",5,55,50},
				{"isEPBLockChk2Data0_1",8,287,-1},
				{"isSteerColRatGroupH1RatMod_1",4,23,-1},
				{"isFrntSunCurtPosnSts2_1",5,63,58},
				{"isEPBLockSts2_1",2,275,273},
				{"isReSunCurtImpctDetnSts2_1",3,91,88},
				{"isPubCANRWASysR1Group1FctModCfmd_1",5,247,-1},
				{"isPubCANRWASysR1Group1SbWSysStR1_1",4,254,-1},
				{"isWiprReInWipgAr",1,337,336},
				{"isHomeSafeSetSts",1,73,72},
				{"isPubCANRWA1Group1MaxRackPosnLe_1",14,169,-1},
				{"isPubCANRWA1Group1Chks_1",8,205,-1},
				{"isReSunCurtFailrSRM2CurtMotNotAvl_1",1,44,-1},
				{"isEPBLockChk2Data3_1",8,311,-1},
				{"isSuspStfnVlvCtrlStsFbFR_1",2,29,-1},
				{"isPubCANRWASysR1Group1FiveMinRuleSts_1",1,268,-1},
				{"isReSunCurtFailrSRM2CurtMotHallFailr_1",1,46,-1},
				{"isPubCANRWA1Group1AgCtrlPath_1",4,222,-1},
				{"isHoodAntiPnch_1",1,82,81},
				{"isSecLeVentnHeatgWarnSMX_1",2,343,341},
				{"isFrntSunCurtFailrSRM2Resvd_1",1,34,-1},
				{"isSuspStfnVlvCtrlStsFbRR_1",2,25,-1},
				{"isPubCANRWA1Group1MaxRackPosnRi_1",14,187,-1},
				{"isEPBLockChk2Chk_1",1,272,-1},
				{"isEPBLockChk2Data1_1",8,295,-1},
				{"isPubCANRWASysR1Group1TankTurnState_1",3,257,-1},
				{"isFrSunCurtImpctDetSts2_1",3,95,92},
				{"isPubCANRWA1Group1RackMtrTrqVld_1",1,227,-1},
				{"isPubCANRWASysR1Group1HealthSts_1",2,270,-1},
				{"isTrOpenerSts_1",4,87,83},
				{"isFrntSunCurtFailrSRM2CurtMotHallNotAvl_1",1,37,-1},
				{"isPubCANRWA1Group1RackFEstimdVld_1",1,228,-1},
				{"isFrntSunCurtMvngSts2_1",1,18,17}
			},
			{
				{"igPubCANRWA1Group1_1","ZCUDZCUCANFD2SignalIPdu15",226},
				{"igReSunCurtFailrSRM2_1","ZCUDZCUCANFD2SignalIPdu15",41},
				{"igSuspStfnVlvCtrlStsFb_1","ZCUDZCUCANFD2SignalIPdu15",16},
				{"igEPBLockChk2_1","ZCUDZCUCANFD2SignalIPdu15",80},
				{"igPubCANRWASysR1Group1_1","ZCUDZCUCANFD2SignalIPdu15",266},
				{"igSteerColRatGroupH1_1","ZCUDZCUCANFD2SignalIPdu15",19},
				{"igFrntSunCurtFailrSRM2_1","ZCUDZCUCANFD2SignalIPdu15",33}
			}
		},
		{"ZCU_CANFD2","ZCUDZCUCANFD2PduR1000Fr22","Out",0x4ba,64,0,1,1,0},
		{"ZCU_CANFD2","ZcudImsToDhuZCUCANFD2DiagResFr","Out",0x652,64,0,1,4,0},
		{"ZCU_CANFD2","ZCUDZCUCANFD2PduR1000Fr03","Out",0x3cf,64,0,1,1,0},
		{
			"ZCU_CANFD2","ZCUDZCUCANFD2Fr71","Out",0x3b5,64,450,1,0,0,48,6,
			{
				{"isBMS2FltStsADataDData4_1",8,223,-1},
				{"isBMS2FltStsADataCData6_1",8,175,-1},
				{"isBMS2FltStsADataEData7_1",8,311,-1},
				{"isBMS2FltStsADataEData6_1",8,303,-1},
				{"isBMS2FltStsADataAData7_1",8,55,-1},
				{"isBMS2FltStsADataDData7_1",8,247,-1},
				{"isBMS2FltStsADataBData1_1",8,71,-1},
				{"isBMS2FltStsADataCData7_1",8,183,-1},
				{"isBMS2FltStsADataFData2_1",8,335,-1},
				{"isBMS2FltStsADataDData1_1",8,199,-1},
				{"isBMS2FltStsADataBData5_1",8,103,-1},
				{"isBMS2FltStsADataEData3_1",8,279,-1},
				{"isBMS2FltStsADataAData4_1",8,31,-1},
				{"isBMS2FltStsADataFData3_1",8,343,-1},
				{"isBMS2FltStsADataFData1_1",8,327,-1},
				{"isBMS2FltStsADataBCnt_1",7,127,-1},
				{"isBMS2FltStsADataCCnt_1",7,191,-1},
				{"isBMS2FltStsADataCData2_1",8,143,-1},
				{"isBMS2FltStsADataBData3_1",8,87,-1},
				{"isBMS2FltStsADataFData6_1",8,367,-1},
				{"isBMS2FltStsADataCData5_1",8,167,-1},
				{"isBMS2FltStsADataBData6_1",8,111,-1},
				{"isBMS2FltStsADataFData5_1",8,359,-1},
				{"isBMS2FltStsADataEData4_1",8,287,-1},
				{"isBMS2FltStsADataDData5_1",8,231,-1},
				{"isBMS2FltStsADataDData3_1",8,215,-1},
				{"isBMS2FltStsADataDData2_1",8,207,-1},
				{"isBMS2FltStsADataAData3_1",8,23,-1},
				{"isBMS2FltStsADataFCnt_1",7,383,-1},
				{"isBMS2FltStsADataDCnt_1",7,255,-1},
				{"isBMS2FltStsADataCData3_1",8,151,-1},
				{"isBMS2FltStsADataACnt_1",7,63,-1},
				{"isBMS2FltStsADataECnt_1",7,319,-1},
				{"isBMS2FltStsADataCData1_1",8,135,-1},
				{"isBMS2FltStsADataEData1_1",8,263,-1},
				{"isBMS2FltStsADataAData1_1",8,7,-1},
				{"isBMS2FltStsADataAData5_1",8,39,-1},
				{"isBMS2FltStsADataEData2_1",8,271,-1},
				{"isBMS2FltStsADataFData7_1",8,375,-1},
				{"isBMS2FltStsADataBData2_1",8,79,-1},
				{"isBMS2FltStsADataBData7_1",8,119,-1},
				{"isBMS2FltStsADataAData6_1",8,47,-1},
				{"isBMS2FltStsADataFData4_1",8,351,-1},
				{"isBMS2FltStsADataAData2_1",8,15,-1},
				{"isBMS2FltStsADataCData4_1",8,159,-1},
				{"isBMS2FltStsADataBData4_1",8,95,-1},
				{"isBMS2FltStsADataEData5_1",8,295,-1},
				{"isBMS2FltStsADataDData6_1",8,239,-1}
			},
			{
				{"igBMS2FltStsADataC_1","ZCUDZCUCANFD2SignalIPdu71",184},
				{"igBMS2FltStsADataB_1","ZCUDZCUCANFD2SignalIPdu71",120},
				{"igBMS2FltStsADataA_1","ZCUDZCUCANFD2SignalIPdu71",56},
				{"igBMS2FltStsADataD_1","ZCUDZCUCANFD2SignalIPdu71",248},
				{"igBMS2FltStsADataF_1","ZCUDZCUCANFD2SignalIPdu71",376},
				{"igBMS2FltStsADataE_1","ZCUDZCUCANFD2SignalIPdu71",312}
			}
		},
		{
			"ZCU_CANFD2","ZCUDZCUCANFD2Fr03","Out",0x4b5,64,1000,1,0,0,504,8,
			{
				{"isVFCVectorCRPMVFCid35_1",1,418,-1},
				{"isVFCVectorSUMVFCid47_1",1,246,-1},
				{"isVFCVectorSUMVFCid4_1",1,193,-1},
				{"isVFCVectorCRPMVFCid19_1",1,402,-1},
				{"isVFCVectorWPRLVFCid53_1",1,304,-1},
				{"isVFCVectorWPRLVFCid37_1",1,288,-1},
				{"isVFCVectorWPCVFCid5_1",1,448,-1},
				{"isVFCVectorRBCMVFCid43_1",1,106,-1},
				{"isVFCVectorWPCVFCid58_1",1,507,-1},
				{"isVFCVectorCRPMVFCid48_1",1,437,-1},
				{"isVFCVectorHWAMVFCid12_1",1,9,-1},
				{"isVFCVectorSASVFCid11_1",1,138,-1},
				{"isVFCVectorWPRRVFCid10_1",1,331,-1},
				{"isVFCVectorSUMVFCid34_1",1,227,-1},
				{"isVFCVectorRBCMVFCid33_1",1,100,-1},
				{"isVFCVectorHWAMVFCid37_1",1,32,-1},
				{"isVFCVectorCRPMVFCid40_1",1,429,-1},
				{"isVFCVectorSUMVFCid39_1",1,238,-1},
				{"isVFCVectorWPRLVFCid4_1",1,257,-1},
				{"isVFCVectorWPRRVFCid42_1",1,363,-1},
				{"isVFCVectorWPRLVFCid31_1",1,294,-1},
				{"isVFCVectorSASVFCid22_1",1,159,-1},
				{"isVFCVectorWPRRVFCid18_1",1,339,-1},
				{"isVFCVectorSASVFCid0_1",1,133,-1},
				{"isVFCVectorWPCVFCid30_1",1,487,-1},
				{"isVFCVectorWPRLVFCid12_1",1,265,-1},
				{"isVFCVectorWPRRVFCid43_1",1,362,-1},
				{"isVFCVectorRBCMVFCid27_1",1,90,-1},
				{"isVFCVectorSASVFCid5_1",1,128,-1},
				{"isVFCVectorCRPMVFCid51_1",1,434,-1},
				{"isVFCVectorWPRRVFCid48_1",1,373,-1},
				{"isVFCVectorSUMVFCid49_1",1,244,-1},
				{"isVFCVectorRBCMVFCid35_1",1,98,-1},
				{"isVFCVectorSUMVFCid10_1",1,203,-1},
				{"isVFCVectorWPRRVFCid24_1",1,349,-1},
				{"isVFCVectorSASVFCid37_1",1,160,-1},
				{"isVFCVectorWPCVFCid18_1",1,467,-1},
				{"isVFCVectorHWAMVFCid45_1",1,40,-1},
				{"isVFCVectorWPRRVFCid21_1",1,336,-1},
				{"isVFCVectorSASVFCid34_1",1,163,-1},
				{"isVFCVectorWPCVFCid28_1",1,473,-1},
				{"isVFCVectorWPRRVFCid13_1",1,328,-1},
				{"isVFCVectorWPRLVFCid40_1",1,301,-1},
				{"isVFCVectorWPRRVFCid6_1",1,335,-1},
				{"isVFCVectorWPRLVFCid3_1",1,258,-1},
				{"isVFCVectorSASVFCid52_1",1,177,-1},
				{"isVFCVectorSUMVFCid25_1",1,220,-1},
				{"isVFCVectorWPRRVFCid3_1",1,322,-1},
				{"isVFCVectorWPRLBlockID_1",2,263,-1},
				{"isVFCVectorSASVFCid46_1",1,183,-1},
				{"isVFCVectorCRPMVFCid28_1",1,409,-1},
				{"isVFCVectorRBCMVFCid29_1",1,88,-1},
				{"isVFCVectorWPRLVFCid15_1",1,278,-1},
				{"isVFCVectorWPRRVFCid28_1",1,345,-1},
				{"isVFCVectorHWAMVFCid55_1",1,62,-1},
				{"isVFCVectorCRPMVFCid57_1",1,444,-1},
				{"isVFCVectorCRPMVFCid34_1",1,419,-1},
				{"isVFCVectorHWAMVFCid49_1",1,52,-1},
				{"isVFCVectorHWAMVFCid52_1",1,49,-1},
				{"isVFCVectorSUMVFCid44_1",1,233,-1},
				{"isVFCVectorWPRLVFCid50_1",1,307,-1},
				{"isVFCVectorWPCVFCid48_1",1,501,-1},
				{"isVFCVectorWPRLVFCid25_1",1,284,-1},
				{"isVFCVectorSASVFCid33_1",1,164,-1},
				{"isVFCVectorWPRLVFCid29_1",1,280,-1},
				{"isVFCVectorWPRRVFCid55_1",1,382,-1},
				{"isVFCVectorRBCMVFCid6_1",1,79,-1},
				{"isVFCVectorWPRRVFCid50_1",1,371,-1},
				{"isVFCVectorWPRLVFCid43_1",1,298,-1},
				{"isVFCVectorWPRRVFCid16_1",1,341,-1},
				{"isVFCVectorWPCVFCid14_1",1,471,-1},
				{"isVFCVectorWPCVFCid61_1",1,504,-1},
				{"isVFCVectorCRPMVFCid59_1",1,442,-1},
				{"isVFCVectorHWAMVFCid15_1",1,22,-1},
				{"isVFCVectorSASVFCid15_1",1,150,-1},
				{"isVFCVectorSASVFCid32_1",1,165,-1},
				{"isVFCVectorWPCVFCid39_1",1,494,-1},
				{"isVFCVectorSASVFCid26_1",1,155,-1},
				{"isVFCVectorSUMVFCid9_1",1,204,-1},
				{"isVFCVectorRBCMVFCid58_1",1,123,-1},
				{"isVFCVectorWPRLVFCid9_1",1,268,-1},
				{"isVFCVectorSASVFCid18_1",1,147,-1},
				{"isVFCVectorRBCMVFCid4_1",1,65,-1},
				{"isVFCVectorCRPMVFCid39_1",1,430,-1},
				{"isVFCVectorSASVFCid10_1",1,139,-1},
				{"isVFCVectorHWAMVFCid41_1",1,44,-1},
				{"isVFCVectorHWAMVFCid10_1",1,11,-1},
				{"isVFCVectorSASVFCid3_1",1,130,-1},
				{"isVFCVectorSUMVFCid42_1",1,235,-1},
				{"isVFCVectorCRPMVFCid11_1",1,394,-1},
				{"isVFCVectorWPCVFCid53_1",1,496,-1},
				{"isVFCVectorWPRLVFCid58_1",1,315,-1},
				{"isVFCVectorRBCMVFCid52_1",1,113,-1},
				{"isVFCVectorWPCVFCid2_1",1,451,-1},
				{"isVFCVectorWPCVFCid43_1",1,490,-1},
				{"isVFCVectorSASVFCid40_1",1,173,-1},
				{"isVFCVectorWPRLVFCid33_1",1,292,-1},
				{"isVFCVectorSASVFCid6_1",1,143,-1},
				{"isVFCVectorCRPMVFCid15_1",1,406,-1},
				{"isVFCVectorRBCMVFCid7_1",1,78,-1},
				{"isVFCVectorWPRRVFCid59_1",1,378,-1},
				{"isVFCVectorWPCVFCid45_1",1,488,-1},
				{"isVFCVectorSUMVFCid40_1",1,237,-1},
				{"isVFCVectorSASVFCid20_1",1,145,-1},
				{"isVFCVectorSASVFCid42_1",1,171,-1},
				{"isVFCVectorSUMVFCid27_1",1,218,-1},
				{"isVFCVectorRBCMVFCid31_1",1,102,-1},
				{"isVFCVectorHWAMVFCid35_1",1,34,-1},
				{"isVFCVectorCRPMVFCid9_1",1,396,-1},
				{"isVFCVectorCRPMVFCid43_1",1,426,-1},
				{"isVFCVectorWPRLVFCid41_1",1,300,-1},
				{"isVFCVectorCRPMVFCid26_1",1,411,-1},
				{"isVFCVectorWPCVFCid32_1",1,485,-1},
				{"isVFCVectorSUMVFCid59_1",1,250,-1},
				{"isVFCVectorRBCMVFCid45_1",1,104,-1},
				{"isVFCVectorWPCVFCid25_1",1,476,-1},
				{"isVFCVectorHWAMVFCid47_1",1,54,-1},
				{"isVFCVectorCRPMVFCid25_1",1,412,-1},
				{"isVFCVectorWPRLVFCid59_1",1,314,-1},
				{"isVFCVectorWPRLVFCid46_1",1,311,-1},
				{"isVFCVectorCRPMVFCid7_1",1,398,-1},
				{"isVFCVectorSUMVFCid58_1",1,251,-1},
				{"isVFCVectorCRPMVFCid36_1",1,417,-1},
				{"isVFCVectorSUMVFCid5_1",1,192,-1},
				{"isVFCVectorRBCMVFCid8_1",1,77,-1},
				{"isVFCVectorWPRLVFCid17_1",1,276,-1},
				{"isVFCVectorHWAMVFCid9_1",1,12,-1},
				{"isVFCVectorSASVFCid50_1",1,179,-1},
				{"isVFCVectorRBCMVFCid38_1",1,111,-1},
				{"isVFCVectorHWAMVFCid33_1",1,36,-1},
				{"isVFCVectorWPRRVFCid12_1",1,329,-1},
				{"isVFCVectorWPRRVFCid14_1",1,343,-1},
				{"isVFCVectorHWAMVFCid58_1",1,59,-1},
				{"isVFCVectorRBCMVFCid15_1",1,86,-1},
				{"isVFCVectorRBCMVFCid16_1",1,85,-1},
				{"isVFCVectorWPRLVFCid57_1",1,316,-1},
				{"isVFCVectorRBCMVFCid18_1",1,83,-1},
				{"isVFCVectorHWAMVFCid16_1",1,21,-1},
				{"isVFCVectorWPRRVFCid46_1",1,375,-1},
				{"isVFCVectorSASVFCid38_1",1,175,-1},
				{"isVFCVectorHWAMVFCid26_1",1,27,-1},
				{"isVFCVectorHWAMVFCid5_1",1,0,-1},
				{"isVFCVectorWPRLVFCid48_1",1,309,-1},
				{"isVFCVectorSUMVFCid11_1",1,202,-1},
				{"isVFCVectorWPRRVFCid41_1",1,364,-1},
				{"isVFCVectorRBCMVFCid19_1",1,82,-1},
				{"isVFCVectorSUMVFCid30_1",1,231,-1},
				{"isVFCVectorRBCMVFCid11_1",1,74,-1},
				{"isVFCVectorSUMVFCid60_1",1,249,-1},
				{"isVFCVectorSASVFCid54_1",1,191,-1},
				{"isVFCVectorWPRRVFCid29_1",1,344,-1},
				{"isVFCVectorWPRRVFCid0_1",1,325,-1},
				{"isVFCVectorSASBlockID_1",2,135,-1},
				{"isVFCVectorWPRRVFCid35_1",1,354,-1},
				{"isVFCVectorCRPMVFCid20_1",1,401,-1},
				{"isVFCVectorSASVFCid60_1",1,185,-1},
				{"isVFCVectorWPCVFCid35_1",1,482,-1},
				{"isVFCVectorSASVFCid25_1",1,156,-1},
				{"isVFCVectorHWAMVFCid14_1",1,23,-1},
				{"isVFCVectorSASVFCid14_1",1,151,-1},
				{"isVFCVectorWPCVFCid0_1",1,453,-1},
				{"isVFCVectorRBCMVFCid10_1",1,75,-1},
				{"isVFCVectorHWAMVFCid31_1",1,38,-1},
				{"isVFCVectorCRPMVFCid41_1",1,428,-1},
				{"isVFCVectorSASVFCid24_1",1,157,-1},
				{"isVFCVectorSUMVFCid36_1",1,225,-1},
				{"isVFCVectorSASVFCid35_1",1,162,-1},
				{"isVFCVectorSUMVFCid24_1",1,221,-1},
				{"isVFCVectorWPRRVFCid45_1",1,360,-1},
				{"isVFCVectorSASVFCid55_1",1,190,-1},
				{"isVFCVectorSUMVFCid0_1",1,197,-1},
				{"isVFCVectorSUMVFCid6_1",1,207,-1},
				{"isVFCVectorWPRLVFCid27_1",1,282,-1},
				{"isVFCVectorWPRLVFCid6_1",1,271,-1},
				{"isVFCVectorWPRLVFCid24_1",1,285,-1},
				{"isVFCVectorWPCVFCid24_1",1,477,-1},
				{"isVFCVectorCRPMVFCid6_1",1,399,-1},
				{"isVFCVectorWPRRVFCid19_1",1,338,-1},
				{"isVFCVectorCRPMVFCid10_1",1,395,-1},
				{"isVFCVectorSUMVFCid37_1",1,224,-1},
				{"isVFCVectorCRPMVFCid45_1",1,424,-1},
				{"isVFCVectorWPRLVFCid18_1",1,275,-1},
				{"isVFCVectorWPRLVFCid49_1",1,308,-1},
				{"isVFCVectorHWAMVFCid19_1",1,18,-1},
				{"isVFCVectorWPCVFCid3_1",1,450,-1},
				{"isVFCVectorWPCVFCid11_1",1,458,-1},
				{"isVFCVectorWPCVFCid31_1",1,486,-1},
				{"isVFCVectorWPRLVFCid39_1",1,302,-1},
				{"isVFCVectorCRPMBlockID_1",2,391,-1},
				{"isVFCVectorWPRLVFCid26_1",1,283,-1},
				{"isVFCVectorWPRRVFCid53_1",1,368,-1},
				{"isVFCVectorSASVFCid17_1",1,148,-1},
				{"isVFCVectorWPRLVFCid61_1",1,312,-1},
				{"isVFCVectorHWAMBlockID_1",2,7,-1},
				{"isVFCVectorWPRRBlockID_1",2,327,-1},
				{"isVFCVectorWPRLVFCid36_1",1,289,-1},
				{"isVFCVectorCRPMVFCid46_1",1,439,-1},
				{"isVFCVectorWPRRVFCid49_1",1,372,-1},
				{"isVFCVectorSUMVFCid61_1",1,248,-1},
				{"isVFCVectorWPCVFCid9_1",1,460,-1},
				{"isVFCVectorWPRRVFCid25_1",1,348,-1},
				{"isVFCVectorWPRRVFCid7_1",1,334,-1},
				{"isVFCVectorRBCMVFCid13_1",1,72,-1},
				{"isVFCVectorWPRLVFCid35_1",1,290,-1},
				{"isVFCVectorSUMVFCid31_1",1,230,-1},
				{"isVFCVectorSASVFCid31_1",1,166,-1},
				{"isVFCVectorWPRRVFCid32_1",1,357,-1},
				{"isVFCVectorRBCMVFCid21_1",1,80,-1},
				{"isVFCVectorHWAMVFCid11_1",1,10,-1},
				{"isVFCVectorHWAMVFCid3_1",1,2,-1},
				{"isVFCVectorRBCMVFCid47_1",1,118,-1},
				{"isVFCVectorHWAMVFCid7_1",1,14,-1},
				{"isVFCVectorHWAMVFCid56_1",1,61,-1},
				{"isVFCVectorSASVFCid4_1",1,129,-1},
				{"isVFCVectorWPRRVFCid15_1",1,342,-1},
				{"isVFCVectorHWAMVFCid17_1",1,20,-1},
				{"isVFCVectorRBCMVFCid44_1",1,105,-1},
				{"isVFCVectorRBCMVFCid57_1",1,124,-1},
				{"isVFCVectorSUMVFCid43_1",1,234,-1},
				{"isVFCVectorSUMVFCid28_1",1,217,-1},
				{"isVFCVectorCRPMVFCid53_1",1,432,-1},
				{"isVFCVectorWPCVFCid36_1",1,481,-1},
				{"isVFCVectorWPRLVFCid8_1",1,269,-1},
				{"isVFCVectorSASVFCid61_1",1,184,-1},
				{"isVFCVectorWPCVFCid6_1",1,463,-1},
				{"isVFCVectorHWAMVFCid4_1",1,1,-1},
				{"isVFCVectorSUMVFCid14_1",1,215,-1},
				{"isVFCVectorWPRRVFCid60_1",1,377,-1},
				{"isVFCVectorSUMVFCid51_1",1,242,-1},
				{"isVFCVectorCRPMVFCid30_1",1,423,-1},
				{"isVFCVectorWPRLVFCid22_1",1,287,-1},
				{"isVFCVectorWPRLVFCid11_1",1,266,-1},
				{"isVFCVectorRBCMVFCid25_1",1,92,-1},
				{"isVFCVectorCRPMVFCid12_1",1,393,-1},
				{"isVFCVectorRBCMVFCid37_1",1,96,-1},
				{"isVFCVectorHWAMVFCid57_1",1,60,-1},
				{"isVFCVectorWPRLVFCid54_1",1,319,-1},
				{"isVFCVectorWPCVFCid23_1",1,478,-1},
				{"isVFCVectorWPCVFCid27_1",1,474,-1},
				{"isVFCVectorRBCMVFCid28_1",1,89,-1},
				{"isVFCVectorSASVFCid53_1",1,176,-1},
				{"isVFCVectorHWAMVFCid23_1",1,30,-1},
				{"isVFCVectorWPRLVFCid21_1",1,272,-1},
				{"isVFCVectorWPCVFCid19_1",1,466,-1},
				{"isVFCVectorWPRRVFCid8_1",1,333,-1},
				{"isVFCVectorWPCBlockID_1",2,455,-1},
				{"isVFCVectorHWAMVFCid44_1",1,41,-1},
				{"isVFCVectorWPRRVFCid17_1",1,340,-1},
				{"isVFCVectorWPCVFCid47_1",1,502,-1},
				{"isVFCVectorWPRLVFCid55_1",1,318,-1},
				{"isVFCVectorSASVFCid39_1",1,174,-1},
				{"isVFCVectorCRPMVFCid13_1",1,392,-1},
				{"isVFCVectorRBCMVFCid56_1",1,125,-1},
				{"isVFCVectorRBCMVFCid1_1",1,68,-1},
				{"isVFCVectorSUMVFCid13_1",1,200,-1},
				{"isVFCVectorWPCVFCid38_1",1,495,-1},
				{"isVFCVectorWPRLVFCid1_1",1,260,-1},
				{"isVFCVectorSUMVFCid55_1",1,254,-1},
				{"isVFCVectorWPRRVFCid44_1",1,361,-1},
				{"isVFCVectorCRPMVFCid50_1",1,435,-1},
				{"isVFCVectorSASVFCid59_1",1,186,-1},
				{"isVFCVectorWPRRVFCid22_1",1,351,-1},
				{"isVFCVectorWPRLVFCid13_1",1,264,-1},
				{"isVFCVectorWPCVFCid22_1",1,479,-1},
				{"isVFCVectorWPCVFCid26_1",1,475,-1},
				{"isVFCVectorSUMVFCid54_1",1,255,-1},
				{"isVFCVectorWPRRVFCid39_1",1,366,-1},
				{"isVFCVectorSASVFCid41_1",1,172,-1},
				{"isVFCVectorRBCMVFCid42_1",1,107,-1},
				{"isVFCVectorCRPMVFCid37_1",1,416,-1},
				{"isVFCVectorSASVFCid30_1",1,167,-1},
				{"isVFCVectorWPCVFCid37_1",1,480,-1},
				{"isVFCVectorSUMVFCid56_1",1,253,-1},
				{"isVFCVectorCRPMVFCid58_1",1,443,-1},
				{"isVFCVectorWPRLVFCid60_1",1,313,-1},
				{"isVFCVectorWPRLVFCid2_1",1,259,-1},
				{"isVFCVectorSASVFCid7_1",1,142,-1},
				{"isVFCVectorWPRLVFCid30_1",1,295,-1},
				{"isVFCVectorHWAMVFCid22_1",1,31,-1},
				{"isVFCVectorHWAMVFCid27_1",1,26,-1},
				{"isVFCVectorHWAMVFCid46_1",1,55,-1},
				{"isVFCVectorSASVFCid57_1",1,188,-1},
				{"isVFCVectorWPRRVFCid54_1",1,383,-1},
				{"isVFCVectorHWAMVFCid48_1",1,53,-1},
				{"isVFCVectorWPCVFCid52_1",1,497,-1},
				{"isVFCVectorWPRRVFCid26_1",1,347,-1},
				{"isVFCVectorHWAMVFCid6_1",1,15,-1},
				{"isVFCVectorSUMVFCid16_1",1,213,-1},
				{"isVFCVectorRBCMVFCid49_1",1,116,-1},
				{"isVFCVectorWPRRVFCid56_1",1,381,-1},
				{"isVFCVectorWPRLVFCid51_1",1,306,-1},
				{"isVFCVectorWPCVFCid57_1",1,508,-1},
				{"isVFCVectorCRPMVFCid14_1",1,407,-1},
				{"isVFCVectorRBCMVFCid39_1",1,110,-1},
				{"isVFCVectorRBCMVFCid54_1",1,127,-1},
				{"isVFCVectorCRPMVFCid33_1",1,420,-1},
				{"isVFCVectorSUMVFCid29_1",1,216,-1},
				{"isVFCVectorWPRLVFCid38_1",1,303,-1},
				{"isVFCVectorWPRRVFCid37_1",1,352,-1},
				{"isVFCVectorCRPMVFCid17_1",1,404,-1},
				{"isVFCVectorWPCVFCid51_1",1,498,-1},
				{"isVFCVectorSUMVFCid2_1",1,195,-1},
				{"isVFCVectorSASVFCid58_1",1,187,-1},
				{"isVFCVectorWPRLVFCid19_1",1,274,-1},
				{"isVFCVectorSASVFCid19_1",1,146,-1},
				{"isVFCVectorCRPMVFCid60_1",1,441,-1},
				{"isVFCVectorCRPMVFCid61_1",1,440,-1},
				{"isVFCVectorSASVFCid8_1",1,141,-1},
				{"isVFCVectorSASVFCid23_1",1,158,-1},
				{"isVFCVectorWPCVFCid1_1",1,452,-1},
				{"isVFCVectorWPCVFCid40_1",1,493,-1},
				{"isVFCVectorWPCVFCid15_1",1,470,-1},
				{"isVFCVectorCRPMVFCid18_1",1,403,-1},
				{"isVFCVectorWPRLVFCid34_1",1,291,-1},
				{"isVFCVectorSUMVFCid22_1",1,223,-1},
				{"isVFCVectorCRPMVFCid1_1",1,388,-1},
				{"isVFCVectorSASVFCid44_1",1,169,-1},
				{"isVFCVectorSUMVFCid38_1",1,239,-1},
				{"isVFCVectorWPRLVFCid56_1",1,317,-1},
				{"isVFCVectorHWAMVFCid0_1",1,5,-1},
				{"isVFCVectorSUMVFCid50_1",1,243,-1},
				{"isVFCVectorHWAMVFCid28_1",1,25,-1},
				{"isVFCVectorSUMVFCid17_1",1,212,-1},
				{"isVFCVectorHWAMVFCid53_1",1,48,-1},
				{"isVFCVectorHWAMVFCid1_1",1,4,-1},
				{"isVFCVectorRBCMBlockID_1",2,71,-1},
				{"isVFCVectorWPCVFCid13_1",1,456,-1},
				{"isVFCVectorRBCMVFCid5_1",1,64,-1},
				{"isVFCVectorRBCMVFCid2_1",1,67,-1},
				{"isVFCVectorHWAMVFCid13_1",1,8,-1},
				{"isVFCVectorCRPMVFCid49_1",1,436,-1},
				{"isVFCVectorHWAMVFCid20_1",1,17,-1},
				{"isVFCVectorWPCVFCid33_1",1,484,-1},
				{"isVFCVectorWPRRVFCid11_1",1,330,-1},
				{"isVFCVectorRBCMVFCid32_1",1,101,-1},
				{"isVFCVectorCRPMVFCid0_1",1,389,-1},
				{"isVFCVectorRBCMVFCid50_1",1,115,-1},
				{"isVFCVectorWPCVFCid17_1",1,468,-1},
				{"isVFCVectorRBCMVFCid24_1",1,93,-1},
				{"isVFCVectorHWAMVFCid34_1",1,35,-1},
				{"isVFCVectorWPCVFCid20_1",1,465,-1},
				{"isVFCVectorWPRLVFCid45_1",1,296,-1},
				{"isVFCVectorRBCMVFCid48_1",1,117,-1},
				{"isVFCVectorWPRLVFCid7_1",1,270,-1},
				{"isVFCVectorSUMVFCid1_1",1,196,-1},
				{"isVFCVectorWPRRVFCid33_1",1,356,-1},
				{"isVFCVectorSUMVFCid35_1",1,226,-1},
				{"isVFCVectorCRPMVFCid2_1",1,387,-1},
				{"isVFCVectorRBCMVFCid22_1",1,95,-1},
				{"isVFCVectorSUMVFCid46_1",1,247,-1},
				{"isVFCVectorWPCVFCid12_1",1,457,-1},
				{"isVFCVectorWPRRVFCid9_1",1,332,-1},
				{"isVFCVectorWPRRVFCid5_1",1,320,-1},
				{"isVFCVectorCRPMVFCid22_1",1,415,-1},
				{"isVFCVectorWPRRVFCid61_1",1,376,-1},
				{"isVFCVectorWPCVFCid41_1",1,492,-1},
				{"isVFCVectorSASVFCid1_1",1,132,-1},
				{"isVFCVectorWPRRVFCid57_1",1,380,-1},
				{"isVFCVectorSUMVFCid3_1",1,194,-1},
				{"isVFCVectorHWAMVFCid43_1",1,42,-1},
				{"isVFCVectorHWAMVFCid36_1",1,33,-1},
				{"isVFCVectorCRPMVFCid5_1",1,384,-1},
				{"isVFCVectorCRPMVFCid3_1",1,386,-1},
				{"isVFCVectorWPRRVFCid38_1",1,367,-1},
				{"isVFCVectorHWAMVFCid25_1",1,28,-1},
				{"isVFCVectorHWAMVFCid40_1",1,45,-1},
				{"isVFCVectorHWAMVFCid61_1",1,56,-1},
				{"isVFCVectorHWAMVFCid50_1",1,51,-1},
				{"isVFCVectorSUMVFCid53_1",1,240,-1},
				{"isVFCVectorHWAMVFCid32_1",1,37,-1},
				{"isVFCVectorRBCMVFCid3_1",1,66,-1},
				{"isVFCVectorSUMVFCid8_1",1,205,-1},
				{"isVFCVectorSUMVFCid26_1",1,219,-1},
				{"isVFCVectorSUMVFCid18_1",1,211,-1},
				{"isVFCVectorHWAMVFCid24_1",1,29,-1},
				{"isVFCVectorRBCMVFCid30_1",1,103,-1},
				{"isVFCVectorWPRRVFCid20_1",1,337,-1},
				{"isVFCVectorWPCVFCid34_1",1,483,-1},
				{"isVFCVectorWPCVFCid56_1",1,509,-1},
				{"isVFCVectorSASVFCid49_1",1,180,-1},
				{"isVFCVectorCRPMVFCid52_1",1,433,-1},
				{"isVFCVectorWPCVFCid49_1",1,500,-1},
				{"isVFCVectorSASVFCid2_1",1,131,-1},
				{"isVFCVectorWPCVFCid44_1",1,489,-1},
				{"isVFCVectorRBCMVFCid60_1",1,121,-1},
				{"isVFCVectorCRPMVFCid44_1",1,425,-1},
				{"isVFCVectorSASVFCid27_1",1,154,-1},
				{"isVFCVectorSASVFCid12_1",1,137,-1},
				{"isVFCVectorHWAMVFCid8_1",1,13,-1},
				{"isVFCVectorRBCMVFCid12_1",1,73,-1},
				{"isVFCVectorRBCMVFCid61_1",1,120,-1},
				{"isVFCVectorWPCVFCid16_1",1,469,-1},
				{"isVFCVectorHWAMVFCid54_1",1,63,-1},
				{"isVFCVectorWPCVFCid7_1",1,462,-1},
				{"isVFCVectorCRPMVFCid56_1",1,445,-1},
				{"isVFCVectorCRPMVFCid31_1",1,422,-1},
				{"isVFCVectorSUMVFCid48_1",1,245,-1},
				{"isVFCVectorSUMVFCid23_1",1,222,-1},
				{"isVFCVectorSUMVFCid19_1",1,210,-1},
				{"isVFCVectorWPCVFCid54_1",1,511,-1},
				{"isVFCVectorHWAMVFCid2_1",1,3,-1},
				{"isVFCVectorSASVFCid29_1",1,152,-1},
				{"isVFCVectorSASVFCid9_1",1,140,-1},
				{"isVFCVectorSASVFCid16_1",1,149,-1},
				{"isVFCVectorSUMVFCid52_1",1,241,-1},
				{"isVFCVectorWPRRVFCid27_1",1,346,-1},
				{"isVFCVectorCRPMVFCid4_1",1,385,-1},
				{"isVFCVectorCRPMVFCid16_1",1,405,-1},
				{"isVFCVectorRBCMVFCid40_1",1,109,-1},
				{"isVFCVectorRBCMVFCid59_1",1,122,-1},
				{"isVFCVectorWPRRVFCid23_1",1,350,-1},
				{"isVFCVectorWPRRVFCid30_1",1,359,-1},
				{"isVFCVectorWPRLVFCid32_1",1,293,-1},
				{"isVFCVectorWPCVFCid50_1",1,499,-1},
				{"isVFCVectorWPCVFCid4_1",1,449,-1},
				{"isVFCVectorWPCVFCid10_1",1,459,-1},
				{"isVFCVectorSASVFCid47_1",1,182,-1},
				{"isVFCVectorWPRLVFCid5_1",1,256,-1},
				{"isVFCVectorSUMVFCid12_1",1,201,-1},
				{"isVFCVectorRBCMVFCid14_1",1,87,-1},
				{"isVFCVectorWPCVFCid46_1",1,503,-1},
				{"isVFCVectorHWAMVFCid42_1",1,43,-1},
				{"isVFCVectorHWAMVFCid18_1",1,19,-1},
				{"isVFCVectorRBCMVFCid23_1",1,94,-1},
				{"isVFCVectorWPRLVFCid14_1",1,279,-1},
				{"isVFCVectorWPRRVFCid40_1",1,365,-1},
				{"isVFCVectorRBCMVFCid53_1",1,112,-1},
				{"isVFCVectorRBCMVFCid0_1",1,69,-1},
				{"isVFCVectorSASVFCid21_1",1,144,-1},
				{"isVFCVectorHWAMVFCid39_1",1,46,-1},
				{"isVFCVectorSUMVFCid32_1",1,229,-1},
				{"isVFCVectorWPRRVFCid4_1",1,321,-1},
				{"isVFCVectorWPRLVFCid47_1",1,310,-1},
				{"isVFCVectorWPRRVFCid31_1",1,358,-1},
				{"isVFCVectorWPRLVFCid16_1",1,277,-1},
				{"isVFCVectorSASVFCid43_1",1,170,-1},
				{"isVFCVectorSASVFCid56_1",1,189,-1},
				{"isVFCVectorSUMVFCid57_1",1,252,-1},
				{"isVFCVectorCRPMVFCid47_1",1,438,-1},
				{"isVFCVectorSUMVFCid20_1",1,209,-1},
				{"isVFCVectorCRPMVFCid23_1",1,414,-1},
				{"isVFCVectorWPCVFCid21_1",1,464,-1},
				{"isVFCVectorCRPMVFCid55_1",1,446,-1},
				{"isVFCVectorCRPMVFCid38_1",1,431,-1},
				{"isVFCVectorSASVFCid28_1",1,153,-1},
				{"isVFCVectorHWAMVFCid60_1",1,57,-1},
				{"isVFCVectorSUMVFCid45_1",1,232,-1},
				{"isVFCVectorSASVFCid51_1",1,178,-1},
				{"isVFCVectorSUMVFCid7_1",1,206,-1},
				{"isVFCVectorWPRLVFCid23_1",1,286,-1},
				{"isVFCVectorWPRLVFCid28_1",1,281,-1},
				{"isVFCVectorWPRRVFCid36_1",1,353,-1},
				{"isVFCVectorSUMBlockID_1",2,199,-1},
				{"isVFCVectorCRPMVFCid29_1",1,408,-1},
				{"isVFCVectorWPRRVFCid58_1",1,379,-1},
				{"isVFCVectorWPRRVFCid51_1",1,370,-1},
				{"isVFCVectorRBCMVFCid9_1",1,76,-1},
				{"isVFCVectorWPRRVFCid47_1",1,374,-1},
				{"isVFCVectorHWAMVFCid59_1",1,58,-1},
				{"isVFCVectorWPRLVFCid52_1",1,305,-1},
				{"isVFCVectorRBCMVFCid55_1",1,126,-1},
				{"isVFCVectorWPRLVFCid44_1",1,297,-1},
				{"isVFCVectorSUMVFCid33_1",1,228,-1},
				{"isVFCVectorWPCVFCid8_1",1,461,-1},
				{"isVFCVectorRBCMVFCid17_1",1,84,-1},
				{"isVFCVectorHWAMVFCid38_1",1,47,-1},
				{"isVFCVectorCRPMVFCid27_1",1,410,-1},
				{"isVFCVectorWPCVFCid29_1",1,472,-1},
				{"isVFCVectorWPCVFCid42_1",1,491,-1},
				{"isVFCVectorRBCMVFCid51_1",1,114,-1},
				{"isVFCVectorRBCMVFCid41_1",1,108,-1},
				{"isVFCVectorSASVFCid45_1",1,168,-1},
				{"isVFCVectorRBCMVFCid46_1",1,119,-1},
				{"isVFCVectorHWAMVFCid21_1",1,16,-1},
				{"isVFCVectorSASVFCid48_1",1,181,-1},
				{"isVFCVectorWPRLVFCid0_1",1,261,-1},
				{"isVFCVectorHWAMVFCid51_1",1,50,-1},
				{"isVFCVectorWPRLVFCid20_1",1,273,-1},
				{"isVFCVectorRBCMVFCid36_1",1,97,-1},
				{"isVFCVectorHWAMVFCid29_1",1,24,-1},
				{"isVFCVectorWPRLVFCid10_1",1,267,-1},
				{"isVFCVectorHWAMVFCid30_1",1,39,-1},
				{"isVFCVectorSUMVFCid21_1",1,208,-1},
				{"isVFCVectorWPRLVFCid42_1",1,299,-1},
				{"isVFCVectorWPCVFCid60_1",1,505,-1},
				{"isVFCVectorSASVFCid36_1",1,161,-1},
				{"isVFCVectorCRPMVFCid8_1",1,397,-1},
				{"isVFCVectorWPCVFCid55_1",1,510,-1},
				{"isVFCVectorWPRRVFCid2_1",1,323,-1},
				{"isVFCVectorSASVFCid13_1",1,136,-1},
				{"isVFCVectorCRPMVFCid42_1",1,427,-1},
				{"isVFCVectorWPCVFCid59_1",1,506,-1},
				{"isVFCVectorCRPMVFCid54_1",1,447,-1},
				{"isVFCVectorCRPMVFCid32_1",1,421,-1},
				{"isVFCVectorCRPMVFCid21_1",1,400,-1},
				{"isVFCVectorWPRRVFCid34_1",1,355,-1},
				{"isVFCVectorRBCMVFCid26_1",1,91,-1},
				{"isVFCVectorRBCMVFCid34_1",1,99,-1},
				{"isVFCVectorCRPMVFCid24_1",1,413,-1},
				{"isVFCVectorRBCMVFCid20_1",1,81,-1},
				{"isVFCVectorSUMVFCid15_1",1,214,-1},
				{"isVFCVectorWPRRVFCid52_1",1,369,-1},
				{"isVFCVectorSUMVFCid41_1",1,236,-1},
				{"isVFCVectorWPRRVFCid1_1",1,324,-1}
			},
			{
				{"igVFCVectorSUM_1","ZCUDZCUCANFD2SignalIPdu03",-1},
				{"igVFCVectorRBCM_1","ZCUDZCUCANFD2SignalIPdu03",-1},
				{"igVFCVectorWPRL_1","ZCUDZCUCANFD2SignalIPdu03",-1},
				{"igVFCVectorWPC_1","ZCUDZCUCANFD2SignalIPdu03",-1},
				{"igVFCVectorSAS_1","ZCUDZCUCANFD2SignalIPdu03",-1},
				{"igVFCVectorCRPM_1","ZCUDZCUCANFD2SignalIPdu03",-1},
				{"igVFCVectorWPRR_1","ZCUDZCUCANFD2SignalIPdu03",-1},
				{"igVFCVectorHWAM_1","ZCUDZCUCANFD2SignalIPdu03",-1}
			}
		},
		{"ZCU_CANFD2","ZCUDZCUCANFD2PduR500Fr09","Out",0x35a,64,0,1,1,0},
		{"ZCU_CANFD2","ZcudSrsToDhuZCUCANFD2DiagResFr","Out",0x639,64,0,1,4,0},
		{
			"ZCU_CANFD2","ZCUDZCUCANFD2Fr40","Out",0x362,64,250,1,0,0,80,8,
			{
				{"isFrntIntHCMLiLe2LED5_1",6,95,-1},
				{"isFrntIntHCMLiLe4LED10_1",6,241,-1},
				{"isFrntIntHCMLiLe7LED6_1",6,409,-1},
				{"isFrntIntHCMLiLe8LED9_1",6,503,-1},
				{"isFrntIntHCMLiLe7LED2_1",6,385,-1},
				{"isFrntIntHCMLiLe1LED6_1",6,25,-1},
				{"isFrntIntHCMLiLe4LED9_1",6,247,-1},
				{"isFrntIntHCMLiLe4LED3_1",6,203,-1},
				{"isFrntIntHCMLiLe8LED2_1",6,449,-1},
				{"isFrntIntHCMLiLe4LED8_1",6,237,-1},
				{"isFrntIntHCMLiLe1LED5_1",6,31,-1},
				{"isFrntIntHCMLiLe4LED5_1",6,223,-1},
				{"isFrntIntHCMLiLe8LED3_1",6,459,-1},
				{"isFrntIntHCMLiLe6LED7_1",6,355,-1},
				{"isFrntIntHCMLiLe3LED8_1",6,173,-1},
				{"isFrntIntHCMLiLe5LED8_1",6,301,-1},
				{"isFrntIntHCMLiLe5LED5_1",6,287,-1},
				{"isFrntIntHCMLiLe3LED7_1",6,163,-1},
				{"isFrntIntHCMLiLe5LED6_1",6,281,-1},
				{"isFrntIntHCMLiLe1LED9_1",6,55,-1},
				{"isFrntIntHCMLiLe1LED8_1",6,45,-1},
				{"isFrntIntHCMLiLe6LED9_1",6,375,-1},
				{"isFrntIntHCMLiLe6LED2_1",6,321,-1},
				{"isFrntIntHCMLiLe2LED7_1",6,99,-1},
				{"isFrntIntHCMLiLe6LED1_1",6,327,-1},
				{"isFrntIntHCMLiLe5LED9_1",6,311,-1},
				{"isFrntIntHCMLiLe1LED10_1",6,49,-1},
				{"isFrntIntHCMLiLe5LED3_1",6,267,-1},
				{"isFrntIntHCMLiLe4LED4_1",6,213,-1},
				{"isFrntIntHCMLiLe1LED7_1",6,35,-1},
				{"isFrntIntHCMLiLe6LED5_1",6,351,-1},
				{"isFrntIntHCMLiLe7LED8_1",6,429,-1},
				{"isFrntIntHCMLiLe3LED6_1",6,153,-1},
				{"isFrntIntHCMLiLe8LED1_1",6,455,-1},
				{"isFrntIntHCMLiLe1LED2_1",6,1,-1},
				{"isFrntIntHCMLiLe1LED1_1",6,7,-1},
				{"isFrntIntHCMLiLe3LED1_1",6,135,-1},
				{"isFrntIntHCMLiLe2LED3_1",6,75,-1},
				{"isFrntIntHCMLiLe8LED5_1",6,479,-1},
				{"isFrntIntHCMLiLe2LED2_1",6,65,-1},
				{"isFrntIntHCMLiLe6LED10_1",6,369,-1},
				{"isFrntIntHCMLiLe6LED8_1",6,365,-1},
				{"isFrntIntHCMLiLe8LED8_1",6,493,-1},
				{"isFrntIntHCMLiLe5LED7_1",6,291,-1},
				{"isFrntIntHCMLiLe4LED7_1",6,227,-1},
				{"isFrntIntHCMLiLe2LED1_1",6,71,-1},
				{"isFrntIntHCMLiLe3LED5_1",6,159,-1},
				{"isFrntIntHCMLiLe7LED10_1",6,433,-1},
				{"isFrntIntHCMLiLe3LED10_1",6,177,-1},
				{"isFrntIntHCMLiLe2LED4_1",6,85,-1},
				{"isFrntIntHCMLiLe6LED4_1",6,341,-1},
				{"isFrntIntHCMLiLe8LED4_1",6,469,-1},
				{"isFrntIntHCMLiLe1LED3_1",6,11,-1},
				{"isFrntIntHCMLiLe3LED2_1",6,129,-1},
				{"isFrntIntHCMLiLe7LED1_1",6,391,-1},
				{"isFrntIntHCMLiLe2LED6_1",6,89,-1},
				{"isFrntIntHCMLiLe2LED9_1",6,119,-1},
				{"isFrntIntHCMLiLe7LED9_1",6,439,-1},
				{"isFrntIntHCMLiLe2LED8_1",6,109,-1},
				{"isFrntIntHCMLiLe3LED3_1",6,139,-1},
				{"isFrntIntHCMLiLe4LED6_1",6,217,-1},
				{"isFrntIntHCMLiLe5LED4_1",6,277,-1},
				{"isFrntIntHCMLiLe2LED10_1",6,113,-1},
				{"isFrntIntHCMLiLe4LED2_1",6,193,-1},
				{"isFrntIntHCMLiLe7LED4_1",6,405,-1},
				{"isFrntIntHCMLiLe7LED5_1",6,415,-1},
				{"isFrntIntHCMLiLe6LED6_1",6,345,-1},
				{"isFrntIntHCMLiLe3LED9_1",6,183,-1},
				{"isFrntIntHCMLiLe5LED1_1",6,263,-1},
				{"isFrntIntHCMLiLe4LED1_1",6,199,-1},
				{"isFrntIntHCMLiLe7LED3_1",6,395,-1},
				{"isFrntIntHCMLiLe7LED7_1",6,419,-1},
				{"isFrntIntHCMLiLe8LED6_1",6,473,-1},
				{"isFrntIntHCMLiLe5LED2_1",6,257,-1},
				{"isFrntIntHCMLiLe8LED7_1",6,483,-1},
				{"isFrntIntHCMLiLe1LED4_1",6,21,-1},
				{"isFrntIntHCMLiLe3LED4_1",6,149,-1},
				{"isFrntIntHCMLiLe8LED10_1",6,497,-1},
				{"isFrntIntHCMLiLe6LED3_1",6,331,-1},
				{"isFrntIntHCMLiLe5LED10_1",6,305,-1}
			},
			{
				{"igFrntIntHCMLiLe6_1","ZCUDZCUCANFD2SignalIPdu40",379},
				{"igFrntIntHCMLiLe1_1","ZCUDZCUCANFD2SignalIPdu40",59},
				{"igFrntIntHCMLiLe4_1","ZCUDZCUCANFD2SignalIPdu40",251},
				{"igFrntIntHCMLiLe3_1","ZCUDZCUCANFD2SignalIPdu40",187},
				{"igFrntIntHCMLiLe8_1","ZCUDZCUCANFD2SignalIPdu40",507},
				{"igFrntIntHCMLiLe5_1","ZCUDZCUCANFD2SignalIPdu40",315},
				{"igFrntIntHCMLiLe7_1","ZCUDZCUCANFD2SignalIPdu40",443},
				{"igFrntIntHCMLiLe2_1","ZCUDZCUCANFD2SignalIPdu40",123}
			}
		},
		{"ZCU_CANFD2","ZCUDZCUCANFD2PduR500Fr16","Out",0x2c1,64,0,1,1,0},
		{"ZCU_CANFD2","ZCUDZCUCANFD2PduR120Fr06","Out",0x28e,64,0,1,1,0},
		{"ZCU_CANFD2","ZcudSdrToDhuZCUCANFD2DiagResFr","Out",0x624,64,0,1,4,0},
		{
			"ZCU_CANFD2","ZCUDZCUCANFD2Fr44","Out",0x366,64,250,1,0,0,80,8,
			{
				{"isFrntIntHCMLiRi7LED5_1",6,415,-1},
				{"isFrntIntHCMLiRi1LED3_1",6,11,-1},
				{"isFrntIntHCMLiRi5LED4_1",6,277,-1},
				{"isFrntIntHCMLiRi1LED5_1",6,31,-1},
				{"isFrntIntHCMLiRi8LED5_1",6,479,-1},
				{"isFrntIntHCMLiRi1LED7_1",6,35,-1},
				{"isFrntIntHCMLiRi4LED2_1",6,193,-1},
				{"isFrntIntHCMLiRi2LED2_1",6,65,-1},
				{"isFrntIntHCMLiRi5LED6_1",6,281,-1},
				{"isFrntIntHCMLiRi2LED3_1",6,75,-1},
				{"isFrntIntHCMLiRi6LED3_1",6,331,-1},
				{"isFrntIntHCMLiRi2LED5_1",6,95,-1},
				{"isFrntIntHCMLiRi5LED8_1",6,301,-1},
				{"isFrntIntHCMLiRi8LED7_1",6,483,-1},
				{"isFrntIntHCMLiRi6LED2_1",6,321,-1},
				{"isFrntIntHCMLiRi3LED10_1",6,177,-1},
				{"isFrntIntHCMLiRi7LED1_1",6,391,-1},
				{"isFrntIntHCMLiRi7LED6_1",6,409,-1},
				{"isFrntIntHCMLiRi6LED5_1",6,351,-1},
				{"isFrntIntHCMLiRi7LED4_1",6,405,-1},
				{"isFrntIntHCMLiRi5LED10_1",6,305,-1},
				{"isFrntIntHCMLiRi4LED3_1",6,203,-1},
				{"isFrntIntHCMLiRi6LED9_1",6,375,-1},
				{"isFrntIntHCMLiRi2LED1_1",6,71,-1},
				{"isFrntIntHCMLiRi1LED8_1",6,45,-1},
				{"isFrntIntHCMLiRi1LED2_1",6,1,-1},
				{"isFrntIntHCMLiRi5LED2_1",6,257,-1},
				{"isFrntIntHCMLiRi4LED9_1",6,247,-1},
				{"isFrntIntHCMLiRi2LED8_1",6,109,-1},
				{"isFrntIntHCMLiRi2LED7_1",6,99,-1},
				{"isFrntIntHCMLiRi7LED3_1",6,395,-1},
				{"isFrntIntHCMLiRi3LED6_1",6,153,-1},
				{"isFrntIntHCMLiRi1LED4_1",6,21,-1},
				{"isFrntIntHCMLiRi3LED4_1",6,149,-1},
				{"isFrntIntHCMLiRi3LED8_1",6,173,-1},
				{"isFrntIntHCMLiRi6LED4_1",6,341,-1},
				{"isFrntIntHCMLiRi5LED9_1",6,311,-1},
				{"isFrntIntHCMLiRi3LED7_1",6,163,-1},
				{"isFrntIntHCMLiRi2LED10_1",6,113,-1},
				{"isFrntIntHCMLiRi1LED10_1",6,49,-1},
				{"isFrntIntHCMLiRi8LED6_1",6,473,-1},
				{"isFrntIntHCMLiRi1LED9_1",6,55,-1},
				{"isFrntIntHCMLiRi6LED7_1",6,355,-1},
				{"isFrntIntHCMLiRi4LED1_1",6,199,-1},
				{"isFrntIntHCMLiRi8LED9_1",6,503,-1},
				{"isFrntIntHCMLiRi8LED1_1",6,455,-1},
				{"isFrntIntHCMLiRi2LED6_1",6,89,-1},
				{"isFrntIntHCMLiRi3LED1_1",6,135,-1},
				{"isFrntIntHCMLiRi8LED8_1",6,493,-1},
				{"isFrntIntHCMLiRi2LED9_1",6,119,-1},
				{"isFrntIntHCMLiRi7LED9_1",6,439,-1},
				{"isFrntIntHCMLiRi5LED3_1",6,267,-1},
				{"isFrntIntHCMLiRi4LED5_1",6,223,-1},
				{"isFrntIntHCMLiRi4LED4_1",6,213,-1},
				{"isFrntIntHCMLiRi6LED8_1",6,365,-1},
				{"isFrntIntHCMLiRi4LED10_1",6,241,-1},
				{"isFrntIntHCMLiRi7LED2_1",6,385,-1},
				{"isFrntIntHCMLiRi8LED4_1",6,469,-1},
				{"isFrntIntHCMLiRi6LED6_1",6,345,-1},
				{"isFrntIntHCMLiRi1LED1_1",6,7,-1},
				{"isFrntIntHCMLiRi6LED10_1",6,369,-1},
				{"isFrntIntHCMLiRi2LED4_1",6,85,-1},
				{"isFrntIntHCMLiRi3LED2_1",6,129,-1},
				{"isFrntIntHCMLiRi7LED8_1",6,429,-1},
				{"isFrntIntHCMLiRi4LED7_1",6,227,-1},
				{"isFrntIntHCMLiRi7LED10_1",6,433,-1},
				{"isFrntIntHCMLiRi3LED9_1",6,183,-1},
				{"isFrntIntHCMLiRi6LED1_1",6,327,-1},
				{"isFrntIntHCMLiRi7LED7_1",6,419,-1},
				{"isFrntIntHCMLiRi5LED5_1",6,287,-1},
				{"isFrntIntHCMLiRi5LED1_1",6,263,-1},
				{"isFrntIntHCMLiRi8LED3_1",6,459,-1},
				{"isFrntIntHCMLiRi8LED2_1",6,449,-1},
				{"isFrntIntHCMLiRi3LED5_1",6,159,-1},
				{"isFrntIntHCMLiRi4LED6_1",6,217,-1},
				{"isFrntIntHCMLiRi4LED8_1",6,237,-1},
				{"isFrntIntHCMLiRi5LED7_1",6,291,-1},
				{"isFrntIntHCMLiRi3LED3_1",6,139,-1},
				{"isFrntIntHCMLiRi1LED6_1",6,25,-1},
				{"isFrntIntHCMLiRi8LED10_1",6,497,-1}
			},
			{
				{"igFrntIntHCMLiRi2_1","ZCUDZCUCANFD2SignalIPdu44",123},
				{"igFrntIntHCMLiRi3_1","ZCUDZCUCANFD2SignalIPdu44",187},
				{"igFrntIntHCMLiRi7_1","ZCUDZCUCANFD2SignalIPdu44",443},
				{"igFrntIntHCMLiRi5_1","ZCUDZCUCANFD2SignalIPdu44",315},
				{"igFrntIntHCMLiRi1_1","ZCUDZCUCANFD2SignalIPdu44",59},
				{"igFrntIntHCMLiRi4_1","ZCUDZCUCANFD2SignalIPdu44",251},
				{"igFrntIntHCMLiRi6_1","ZCUDZCUCANFD2SignalIPdu44",379},
				{"igFrntIntHCMLiRi8_1","ZCUDZCUCANFD2SignalIPdu44",507}
			}
		},
		{
			"ZCU_CANFD2","ZCUDZCUCANFD2Fr02","Out",0x4b1,64,1000,1,0,0,441,7,
			{
				{"isVFCVectorSMBLVFCid19_1",1,274,-1},
				{"isVFCVectorSMBLVFCid6_1",1,271,-1},
				{"isVFCVectorSDLVFCid9_1",1,76,-1},
				{"isVFCVectorSMBVFCid9_1",1,204,-1},
				{"isVFCVectorSMBLVFCid47_1",1,310,-1},
				{"isVFCVectorSMBRVFCid18_1",1,339,-1},
				{"isVFCVectorSRSVFCid17_1",1,468,-1},
				{"isVFCVectorSMBVFCid47_1",1,246,-1},
				{"isVFCVectorSDLVFCid49_1",1,116,-1},
				{"isVFCVectorSDLVFCid59_1",1,122,-1},
				{"isVFCVectorSRSVFCid27_1",1,474,-1},
				{"isVFCVectorSMBVFCid38_1",1,239,-1},
				{"isVFCVectorHRMVFCid57_1",1,60,-1},
				{"isVFCVectorSMBLVFCid52_1",1,305,-1},
				{"isVFCVectorSMBLVFCid61_1",1,312,-1},
				{"isVFCVectorSMBVFCid60_1",1,249,-1},
				{"isVFCVectorHRMVFCid60_1",1,57,-1},
				{"isVFCVectorSDLVFCid13_1",1,72,-1},
				{"isVFCVectorSDRVFCid13_1",1,136,-1},
				{"isVFCVectorSMBLVFCid38_1",1,303,-1},
				{"isVFCVectorSMBLVFCid48_1",1,309,-1},
				{"isVFCVectorSRSVFCid2_1",1,451,-1},
				{"isVFCVectorSRSVFCid18_1",1,467,-1},
				{"isVFCVectorSRSVFCid60_1",1,505,-1},
				{"isVFCVectorHRMVFCid17_1",1,20,-1},
				{"isVFCVectorSMBRVFCid46_1",1,375,-1},
				{"isVFCVectorSDRVFCid57_1",1,188,-1},
				{"isVFCVectorSMBRVFCid21_1",1,336,-1},
				{"isVFCVectorSDLVFCid4_1",1,65,-1},
				{"isVFCVectorSMBVFCid52_1",1,241,-1},
				{"isVFCVectorSMBVFCid48_1",1,245,-1},
				{"isVFCVectorSRSVFCid57_1",1,508,-1},
				{"isVFCVectorHRMVFCid7_1",1,14,-1},
				{"isVFCVectorSDLVFCid25_1",1,92,-1},
				{"isVFCVectorSMBRVFCid29_1",1,344,-1},
				{"isVFCVectorSMBLVFCid59_1",1,314,-1},
				{"isVFCVectorSMBRVFCid38_1",1,367,-1},
				{"isVFCVectorSDRVFCid37_1",1,160,-1},
				{"isVFCVectorSDRVFCid53_1",1,176,-1},
				{"isVFCVectorSDLVFCid32_1",1,101,-1},
				{"isVFCVectorSDLVFCid31_1",1,102,-1},
				{"isVFCVectorSDRVFCid36_1",1,161,-1},
				{"isVFCVectorSMBVFCid13_1",1,200,-1},
				{"isVFCVectorSMBLVFCid22_1",1,287,-1},
				{"isVFCVectorSDRVFCid44_1",1,169,-1},
				{"isVFCVectorSMBRVFCid50_1",1,371,-1},
				{"isVFCVectorSMBVFCid32_1",1,229,-1},
				{"isVFCVectorSMBVFCid2_1",1,195,-1},
				{"isVFCVectorSDLVFCid15_1",1,86,-1},
				{"isVFCVectorHRMVFCid61_1",1,56,-1},
				{"isVFCVectorSMBLVFCid54_1",1,319,-1},
				{"isVFCVectorSRSVFCid44_1",1,489,-1},
				{"isVFCVectorSDRVFCid47_1",1,182,-1},
				{"isVFCVectorSDRVFCid39_1",1,174,-1},
				{"isVFCVectorSMBLBlockID_1",2,263,-1},
				{"isVFCVectorHRMVFCid3_1",1,2,-1},
				{"isVFCVectorSRSVFCid46_1",1,503,-1},
				{"isVFCVectorSMBLVFCid4_1",1,257,-1},
				{"isVFCVectorSRSVFCid30_1",1,487,-1},
				{"isVFCVectorSMBRVFCid3_1",1,322,-1},
				{"isVFCVectorSMBLVFCid3_1",1,258,-1},
				{"isVFCVectorSMBVFCid57_1",1,252,-1},
				{"isVFCVectorSMBLVFCid35_1",1,290,-1},
				{"isVFCVectorSMBRVFCid19_1",1,338,-1},
				{"isVFCVectorSMBLVFCid30_1",1,295,-1},
				{"isVFCVectorSRSVFCid1_1",1,452,-1},
				{"isVFCVectorSMBRVFCid39_1",1,366,-1},
				{"isVFCVectorSMBRVFCid17_1",1,340,-1},
				{"isVFCVectorSDLVFCid10_1",1,75,-1},
				{"isVFCVectorHRMVFCid49_1",1,52,-1},
				{"isVFCVectorSRSVFCid24_1",1,477,-1},
				{"isVFCVectorSDLVFCid50_1",1,115,-1},
				{"isVFCVectorSRSVFCid59_1",1,506,-1},
				{"isVFCVectorSMBLVFCid39_1",1,302,-1},
				{"isVFCVectorSDRVFCid1_1",1,132,-1},
				{"isVFCVectorSMBLVFCid58_1",1,315,-1},
				{"isVFCVectorSMBLVFCid31_1",1,294,-1},
				{"isVFCVectorSRSVFCid54_1",1,511,-1},
				{"isVFCVectorSMBLVFCid29_1",1,280,-1},
				{"isVFCVectorHRMVFCid22_1",1,31,-1},
				{"isVFCVectorSMBVFCid28_1",1,217,-1},
				{"isVFCVectorSDLVFCid26_1",1,91,-1},
				{"isVFCVectorSMBLVFCid40_1",1,301,-1},
				{"isVFCVectorSMBLVFCid44_1",1,297,-1},
				{"isVFCVectorSMBRVFCid24_1",1,349,-1},
				{"isVFCVectorSDLVFCid19_1",1,82,-1},
				{"isVFCVectorSMBLVFCid34_1",1,291,-1},
				{"isVFCVectorSDLVFCid37_1",1,96,-1},
				{"isVFCVectorSDLVFCid57_1",1,124,-1},
				{"isVFCVectorSMBLVFCid37_1",1,288,-1},
				{"isVFCVectorSMBRVFCid11_1",1,330,-1},
				{"isVFCVectorSMBLVFCid15_1",1,278,-1},
				{"isVFCVectorSMBLVFCid18_1",1,275,-1},
				{"isVFCVectorSRSVFCid23_1",1,478,-1},
				{"isVFCVectorSRSVFCid43_1",1,490,-1},
				{"isVFCVectorSDLVFCid56_1",1,125,-1},
				{"isVFCVectorSDLVFCid12_1",1,73,-1},
				{"isVFCVectorSDRVFCid46_1",1,183,-1},
				{"isVFCVectorSMBVFCid40_1",1,237,-1},
				{"isVFCVectorHRMVFCid24_1",1,29,-1},
				{"isVFCVectorSDLVFCid51_1",1,114,-1},
				{"isVFCVectorSDRVFCid51_1",1,178,-1},
				{"isVFCVectorSDRVFCid10_1",1,139,-1},
				{"isVFCVectorSDRVFCid52_1",1,177,-1},
				{"isVFCVectorSMBLVFCid26_1",1,283,-1},
				{"isVFCVectorSDLVFCid42_1",1,107,-1},
				{"isVFCVectorHRMVFCid43_1",1,42,-1},
				{"isVFCVectorSMBVFCid54_1",1,255,-1},
				{"isVFCVectorSMBLVFCid11_1",1,266,-1},
				{"isVFCVectorSMBRVFCid36_1",1,353,-1},
				{"isVFCVectorHRMVFCid37_1",1,32,-1},
				{"isVFCVectorSMBVFCid45_1",1,232,-1},
				{"isVFCVectorSMBVFCid0_1",1,197,-1},
				{"isVFCVectorSMBVFCid51_1",1,242,-1},
				{"isVFCVectorSDLVFCid41_1",1,108,-1},
				{"isVFCVectorSDRVFCid5_1",1,128,-1},
				{"isVFCVectorSDLVFCid2_1",1,67,-1},
				{"isVFCVectorSMBRVFCid33_1",1,356,-1},
				{"isVFCVectorSDLVFCid16_1",1,85,-1},
				{"isVFCVectorSMBLVFCid20_1",1,273,-1},
				{"isVFCVectorSMBRVFCid52_1",1,369,-1},
				{"isVFCVectorSDRVFCid40_1",1,173,-1},
				{"isVFCVectorSRSVFCid12_1",1,457,-1},
				{"isVFCVectorSMBVFCid27_1",1,218,-1},
				{"isVFCVectorSDLVFCid3_1",1,66,-1},
				{"isVFCVectorSMBLVFCid42_1",1,299,-1},
				{"isVFCVectorSDLVFCid48_1",1,117,-1},
				{"isVFCVectorSMBRVFCid40_1",1,365,-1},
				{"isVFCVectorSMBLVFCid49_1",1,308,-1},
				{"isVFCVectorSDRVFCid60_1",1,185,-1},
				{"isVFCVectorSMBRVFCid58_1",1,379,-1},
				{"isVFCVectorSMBVFCid61_1",1,248,-1},
				{"isVFCVectorSMBVFCid23_1",1,222,-1},
				{"isVFCVectorHRMVFCid46_1",1,55,-1},
				{"isVFCVectorSRSVFCid56_1",1,509,-1},
				{"isVFCVectorHRMVFCid56_1",1,61,-1},
				{"isVFCVectorSDRVFCid30_1",1,167,-1},
				{"isVFCVectorSMBVFCid39_1",1,238,-1},
				{"isVFCVectorSMBRVFCid0_1",1,325,-1},
				{"isVFCVectorSRSVFCid41_1",1,492,-1},
				{"isVFCVectorSMBLVFCid46_1",1,311,-1},
				{"isVFCVectorSDLVFCid14_1",1,87,-1},
				{"isVFCVectorSMBRVFCid1_1",1,324,-1},
				{"isVFCVectorHRMVFCid1_1",1,4,-1},
				{"isVFCVectorSRSVFCid50_1",1,499,-1},
				{"isVFCVectorHRMVFCid32_1",1,37,-1},
				{"isVFCVectorSDRVFCid59_1",1,186,-1},
				{"isVFCVectorSRSVFCid34_1",1,483,-1},
				{"isVFCVectorSDLVFCid45_1",1,104,-1},
				{"isVFCVectorSMBLVFCid23_1",1,286,-1},
				{"isVFCVectorSMBRVFCid53_1",1,368,-1},
				{"isVFCVectorHRMVFCid21_1",1,16,-1},
				{"isVFCVectorSMBVFCid55_1",1,254,-1},
				{"isVFCVectorSMBVFCid37_1",1,224,-1},
				{"isVFCVectorHRMVFCid51_1",1,50,-1},
				{"isVFCVectorSDLVFCid30_1",1,103,-1},
				{"isVFCVectorHRMVFCid5_1",1,0,-1},
				{"isVFCVectorSMBVFCid42_1",1,235,-1},
				{"isVFCVectorSMBLVFCid27_1",1,282,-1},
				{"isVFCVectorSDLVFCid7_1",1,78,-1},
				{"isVFCVectorSMBRVFCid55_1",1,382,-1},
				{"isVFCVectorSMBLVFCid32_1",1,293,-1},
				{"isVFCVectorSDLVFCid61_1",1,120,-1},
				{"isVFCVectorSDRVFCid25_1",1,156,-1},
				{"isVFCVectorSMBRVFCid27_1",1,346,-1},
				{"isVFCVectorSMBVFCid34_1",1,227,-1},
				{"isVFCVectorSDRVFCid11_1",1,138,-1},
				{"isVFCVectorSMBLVFCid5_1",1,256,-1},
				{"isVFCVectorSDRVFCid24_1",1,157,-1},
				{"isVFCVectorSRSVFCid49_1",1,500,-1},
				{"isVFCVectorSDLVFCid58_1",1,123,-1},
				{"isVFCVectorSMBRVFCid22_1",1,351,-1},
				{"isVFCVectorSRSVFCid51_1",1,498,-1},
				{"isVFCVectorSDRVFCid41_1",1,172,-1},
				{"isVFCVectorSDRVFCid33_1",1,164,-1},
				{"isVFCVectorSDLVFCid36_1",1,97,-1},
				{"isVFCVectorSMBLVFCid17_1",1,276,-1},
				{"isVFCVectorSRSVFCid37_1",1,480,-1},
				{"isVFCVectorHRMVFCid2_1",1,3,-1},
				{"isVFCVectorSDLVFCid40_1",1,109,-1},
				{"isVFCVectorSMBLVFCid51_1",1,306,-1},
				{"isVFCVectorHRMVFCid29_1",1,24,-1},
				{"isVFCVectorSMBRVFCid57_1",1,380,-1},
				{"isVFCVectorSMBVFCid3_1",1,194,-1},
				{"isVFCVectorSMBRVFCid10_1",1,331,-1},
				{"isVFCVectorSDLVFCid46_1",1,119,-1},
				{"isVFCVectorSMBVFCid17_1",1,212,-1},
				{"isVFCVectorSDLVFCid34_1",1,99,-1},
				{"isVFCVectorSDRVFCid16_1",1,149,-1},
				{"isVFCVectorSMBRVFCid59_1",1,378,-1},
				{"isVFCVectorSDLVFCid17_1",1,84,-1},
				{"isVFCVectorSDLVFCid47_1",1,118,-1},
				{"isVFCVectorSRSVFCid7_1",1,462,-1},
				{"isVFCVectorSMBVFCid16_1",1,213,-1},
				{"isVFCVectorSRSVFCid58_1",1,507,-1},
				{"isVFCVectorSDRVFCid49_1",1,180,-1},
				{"isVFCVectorSMBVFCid26_1",1,219,-1},
				{"isVFCVectorSRSVFCid52_1",1,497,-1},
				{"isVFCVectorHRMVFCid15_1",1,22,-1},
				{"isVFCVectorSDRVFCid18_1",1,147,-1},
				{"isVFCVectorSDLVFCid52_1",1,113,-1},
				{"isVFCVectorHRMVFCid28_1",1,25,-1},
				{"isVFCVectorSDRBlockID_1",2,135,-1},
				{"isVFCVectorHRMVFCid52_1",1,49,-1},
				{"isVFCVectorSMBVFCid50_1",1,243,-1},
				{"isVFCVectorHRMVFCid44_1",1,41,-1},
				{"isVFCVectorSRSVFCid48_1",1,501,-1},
				{"isVFCVectorSDRVFCid23_1",1,158,-1},
				{"isVFCVectorSDLVFCid24_1",1,93,-1},
				{"isVFCVectorSDRVFCid9_1",1,140,-1},
				{"isVFCVectorSDRVFCid45_1",1,168,-1},
				{"isVFCVectorSMBVFCid21_1",1,208,-1},
				{"isVFCVectorSMBRVFCid56_1",1,381,-1},
				{"isVFCVectorSDLVFCid27_1",1,90,-1},
				{"isVFCVectorSDLVFCid53_1",1,112,-1},
				{"isVFCVectorHRMVFCid34_1",1,35,-1},
				{"isVFCVectorHRMVFCid50_1",1,51,-1},
				{"isVFCVectorSMBVFCid44_1",1,233,-1},
				{"isVFCVectorSRSVFCid26_1",1,475,-1},
				{"isVFCVectorSMBVFCid5_1",1,192,-1},
				{"isVFCVectorSMBLVFCid45_1",1,296,-1},
				{"isVFCVectorSDRVFCid2_1",1,131,-1},
				{"isVFCVectorSMBLVFCid16_1",1,277,-1},
				{"isVFCVectorSRSVFCid28_1",1,473,-1},
				{"isVFCVectorSDLVFCid29_1",1,88,-1},
				{"isVFCVectorSDLVFCid28_1",1,89,-1},
				{"isVFCVectorSMBRVFCid31_1",1,358,-1},
				{"isVFCVectorSMBVFCid25_1",1,220,-1},
				{"isVFCVectorSMBRVFCid25_1",1,348,-1},
				{"isVFCVectorSDLVFCid43_1",1,106,-1},
				{"isVFCVectorSDLVFCid39_1",1,110,-1},
				{"isVFCVectorSMBLVFCid57_1",1,316,-1},
				{"isVFCVectorSDRVFCid27_1",1,154,-1},
				{"isVFCVectorSMBRVFCid51_1",1,370,-1},
				{"isVFCVectorSMBRVFCid28_1",1,345,-1},
				{"isVFCVectorSRSVFCid38_1",1,495,-1},
				{"isVFCVectorSRSVFCid55_1",1,510,-1},
				{"isVFCVectorHRMVFCid14_1",1,23,-1},
				{"isVFCVectorSMBRVFCid44_1",1,361,-1},
				{"isVFCVectorSMBRVFCid26_1",1,347,-1},
				{"isVFCVectorHRMVFCid54_1",1,63,-1},
				{"isVFCVectorSRSVFCid0_1",1,453,-1},
				{"isVFCVectorSRSVFCid61_1",1,504,-1},
				{"isVFCVectorSMBRVFCid20_1",1,337,-1},
				{"isVFCVectorSMBLVFCid9_1",1,268,-1},
				{"isVFCVectorHRMVFCid41_1",1,44,-1},
				{"isVFCVectorSDRVFCid32_1",1,165,-1},
				{"isVFCVectorSMBLVFCid55_1",1,318,-1},
				{"isVFCVectorHRMVFCid16_1",1,21,-1},
				{"isVFCVectorSRSVFCid35_1",1,482,-1},
				{"isVFCVectorSDRVFCid54_1",1,191,-1},
				{"isVFCVectorSRSVFCid6_1",1,463,-1},
				{"isVFCVectorSMBLVFCid8_1",1,269,-1},
				{"isVFCVectorSMBRVFCid14_1",1,343,-1},
				{"isVFCVectorSMBLVFCid25_1",1,284,-1},
				{"isVFCVectorSMBRVFCid54_1",1,383,-1},
				{"isVFCVectorSRSVFCid22_1",1,479,-1},
				{"isVFCVectorSDLVFCid11_1",1,74,-1},
				{"isVFCVectorSMBLVFCid1_1",1,260,-1},
				{"isVFCVectorSRSVFCid11_1",1,458,-1},
				{"isVFCVectorSMBRVFCid4_1",1,321,-1},
				{"isVFCVectorSMBLVFCid21_1",1,272,-1},
				{"isVFCVectorHRMVFCid48_1",1,53,-1},
				{"isVFCVectorHRMVFCid20_1",1,17,-1},
				{"isVFCVectorSRSVFCid10_1",1,459,-1},
				{"isVFCVectorSMBRVFCid48_1",1,373,-1},
				{"isVFCVectorSMBVFCid35_1",1,226,-1},
				{"isVFCVectorSDLVFCid20_1",1,81,-1},
				{"isVFCVectorSDRVFCid56_1",1,189,-1},
				{"isVFCVectorHRMVFCid4_1",1,1,-1},
				{"isVFCVectorSMBLVFCid50_1",1,307,-1},
				{"isVFCVectorSDRVFCid12_1",1,137,-1},
				{"isVFCVectorSMBRVFCid47_1",1,374,-1},
				{"isVFCVectorSMBVFCid11_1",1,202,-1},
				{"isVFCVectorSMBLVFCid60_1",1,313,-1},
				{"isVFCVectorSMBRVFCid13_1",1,328,-1},
				{"isVFCVectorSRSBlockID_1",2,455,-1},
				{"isVFCVectorSDRVFCid6_1",1,143,-1},
				{"isVFCVectorHRMVFCid55_1",1,62,-1},
				{"isVFCVectorSRSVFCid20_1",1,465,-1},
				{"isVFCVectorHRMVFCid45_1",1,40,-1},
				{"isVFCVectorSMBRVFCid2_1",1,323,-1},
				{"isVFCVectorHRMVFCid6_1",1,15,-1},
				{"isVFCVectorSDLVFCid8_1",1,77,-1},
				{"isVFCVectorHRMVFCid31_1",1,38,-1},
				{"isVFCVectorSDRVFCid43_1",1,170,-1},
				{"isVFCVectorSMBVFCid30_1",1,231,-1},
				{"isVFCVectorSDRVFCid34_1",1,163,-1},
				{"isVFCVectorSRSVFCid45_1",1,488,-1},
				{"isVFCVectorSDLVFCid18_1",1,83,-1},
				{"isVFCVectorSMBLVFCid41_1",1,300,-1},
				{"isVFCVectorHRMVFCid47_1",1,54,-1},
				{"isVFCVectorSMBLVFCid7_1",1,270,-1},
				{"isVFCVectorSMBVFCid46_1",1,247,-1},
				{"isVFCVectorSRSVFCid40_1",1,493,-1},
				{"isVFCVectorSDRVFCid3_1",1,130,-1},
				{"isVFCVectorHRMVFCid42_1",1,43,-1},
				{"isVFCVectorSDRVFCid4_1",1,129,-1},
				{"isVFCVectorSMBLVFCid56_1",1,317,-1},
				{"isVFCVectorSMBRVFCid23_1",1,350,-1},
				{"isVFCVectorHRMVFCid8_1",1,13,-1},
				{"isVFCVectorHRMVFCid35_1",1,34,-1},
				{"isVFCVectorSDRVFCid21_1",1,144,-1},
				{"isVFCVectorSMBBlockID_1",2,199,-1},
				{"isVFCVectorSRSVFCid13_1",1,456,-1},
				{"isVFCVectorSMBVFCid7_1",1,206,-1},
				{"isVFCVectorSRSVFCid4_1",1,449,-1},
				{"isVFCVectorSMBVFCid31_1",1,230,-1},
				{"isVFCVectorSMBRVFCid45_1",1,360,-1},
				{"isVFCVectorSDLVFCid38_1",1,111,-1},
				{"isVFCVectorSDRVFCid7_1",1,142,-1},
				{"isVFCVectorSDLVFCid0_1",1,69,-1},
				{"isVFCVectorSDLVFCid35_1",1,98,-1},
				{"isVFCVectorSRSVFCid8_1",1,461,-1},
				{"isVFCVectorSMBLVFCid14_1",1,279,-1},
				{"isVFCVectorSDRVFCid50_1",1,179,-1},
				{"isVFCVectorSMBVFCid6_1",1,207,-1},
				{"isVFCVectorSMBVFCid1_1",1,196,-1},
				{"isVFCVectorHRMVFCid38_1",1,47,-1},
				{"isVFCVectorHRMVFCid59_1",1,58,-1},
				{"isVFCVectorSDRVFCid61_1",1,184,-1},
				{"isVFCVectorSDRVFCid58_1",1,187,-1},
				{"isVFCVectorSRSVFCid15_1",1,470,-1},
				{"isVFCVectorSDLVFCid21_1",1,80,-1},
				{"isVFCVectorHRMVFCid40_1",1,45,-1},
				{"isVFCVectorSMBLVFCid0_1",1,261,-1},
				{"isVFCVectorHRMVFCid33_1",1,36,-1},
				{"isVFCVectorSMBRVFCid35_1",1,354,-1},
				{"isVFCVectorSDLVFCid44_1",1,105,-1},
				{"isVFCVectorSRSVFCid29_1",1,472,-1},
				{"isVFCVectorSMBRVFCid9_1",1,332,-1},
				{"isVFCVectorSRSVFCid42_1",1,491,-1},
				{"isVFCVectorSRSVFCid3_1",1,450,-1},
				{"isVFCVectorSDRVFCid15_1",1,150,-1},
				{"isVFCVectorHRMVFCid27_1",1,26,-1},
				{"isVFCVectorSMBVFCid29_1",1,216,-1},
				{"isVFCVectorSMBVFCid49_1",1,244,-1},
				{"isVFCVectorSMBLVFCid28_1",1,281,-1},
				{"isVFCVectorSMBRVFCid16_1",1,341,-1},
				{"isVFCVectorSMBRVFCid30_1",1,359,-1},
				{"isVFCVectorHRMVFCid58_1",1,59,-1},
				{"isVFCVectorSDRVFCid48_1",1,181,-1},
				{"isVFCVectorSMBVFCid36_1",1,225,-1},
				{"isVFCVectorSMBVFCid33_1",1,228,-1},
				{"isVFCVectorHRMVFCid53_1",1,48,-1},
				{"isVFCVectorSDRVFCid28_1",1,153,-1},
				{"isVFCVectorSDRVFCid55_1",1,190,-1},
				{"isVFCVectorSDRVFCid29_1",1,152,-1},
				{"isVFCVectorSRSVFCid19_1",1,466,-1},
				{"isVFCVectorSMBLVFCid12_1",1,265,-1},
				{"isVFCVectorSRSVFCid21_1",1,464,-1},
				{"isVFCVectorSMBRVFCid32_1",1,357,-1},
				{"isVFCVectorSRSVFCid31_1",1,486,-1},
				{"isVFCVectorSMBVFCid53_1",1,240,-1},
				{"isVFCVectorSDLVFCid33_1",1,100,-1},
				{"isVFCVectorSMBRVFCid7_1",1,334,-1},
				{"isVFCVectorSMBRBlockID_1",2,327,-1},
				{"isVFCVectorSDLVFCid60_1",1,121,-1},
				{"isVFCVectorHRMVFCid23_1",1,30,-1},
				{"isVFCVectorSMBRVFCid5_1",1,320,-1},
				{"isVFCVectorSMBRVFCid43_1",1,362,-1},
				{"isVFCVectorHRMVFCid12_1",1,9,-1},
				{"isVFCVectorSRSVFCid53_1",1,496,-1},
				{"isVFCVectorSMBRVFCid6_1",1,335,-1},
				{"isVFCVectorSMBVFCid41_1",1,236,-1},
				{"isVFCVectorSMBRVFCid12_1",1,329,-1},
				{"isVFCVectorSMBVFCid4_1",1,193,-1},
				{"isVFCVectorHRMVFCid10_1",1,11,-1},
				{"isVFCVectorSRSVFCid39_1",1,494,-1},
				{"isVFCVectorSMBRVFCid42_1",1,363,-1},
				{"isVFCVectorSMBVFCid58_1",1,251,-1},
				{"isVFCVectorSMBVFCid43_1",1,234,-1},
				{"isVFCVectorSMBVFCid19_1",1,210,-1},
				{"isVFCVectorSMBVFCid20_1",1,209,-1},
				{"isVFCVectorSDRVFCid17_1",1,148,-1},
				{"isVFCVectorSDRVFCid8_1",1,141,-1},
				{"isVFCVectorSMBRVFCid61_1",1,376,-1},
				{"isVFCVectorSRSVFCid14_1",1,471,-1},
				{"isVFCVectorSMBLVFCid36_1",1,289,-1},
				{"isVFCVectorSRSVFCid47_1",1,502,-1},
				{"isVFCVectorSDLVFCid22_1",1,95,-1},
				{"isVFCVectorHRMBlockID_1",2,7,-1},
				{"isVFCVectorSDRVFCid42_1",1,171,-1},
				{"isVFCVectorSDRVFCid0_1",1,133,-1},
				{"isVFCVectorSDRVFCid19_1",1,146,-1},
				{"isVFCVectorSMBLVFCid24_1",1,285,-1},
				{"isVFCVectorSMBLVFCid43_1",1,298,-1},
				{"isVFCVectorSRSVFCid25_1",1,476,-1},
				{"isVFCVectorSMBVFCid12_1",1,201,-1},
				{"isVFCVectorSMBVFCid14_1",1,215,-1},
				{"isVFCVectorHRMVFCid9_1",1,12,-1},
				{"isVFCVectorSMBVFCid24_1",1,221,-1},
				{"isVFCVectorSMBLVFCid10_1",1,267,-1},
				{"isVFCVectorSMBLVFCid13_1",1,264,-1},
				{"isVFCVectorHRMVFCid11_1",1,10,-1},
				{"isVFCVectorHRMVFCid19_1",1,18,-1},
				{"isVFCVectorSRSVFCid33_1",1,484,-1},
				{"isVFCVectorHRMVFCid30_1",1,39,-1},
				{"isVFCVectorSMBRVFCid49_1",1,372,-1},
				{"isVFCVectorHRMVFCid13_1",1,8,-1},
				{"isVFCVectorSDRVFCid20_1",1,145,-1},
				{"isVFCVectorSMBRVFCid15_1",1,342,-1},
				{"isVFCVectorSMBVFCid15_1",1,214,-1},
				{"isVFCVectorSDLVFCid1_1",1,68,-1},
				{"isVFCVectorHRMVFCid0_1",1,5,-1},
				{"isVFCVectorSMBVFCid59_1",1,250,-1},
				{"isVFCVectorSMBLVFCid33_1",1,292,-1},
				{"isVFCVectorHRMVFCid25_1",1,28,-1},
				{"isVFCVectorSMBVFCid18_1",1,211,-1},
				{"isVFCVectorSDRVFCid14_1",1,151,-1},
				{"isVFCVectorSMBRVFCid60_1",1,377,-1},
				{"isVFCVectorSDRVFCid26_1",1,155,-1},
				{"isVFCVectorSRSVFCid16_1",1,469,-1},
				{"isVFCVectorSRSVFCid36_1",1,481,-1},
				{"isVFCVectorSMBRVFCid37_1",1,352,-1},
				{"isVFCVectorSRSVFCid32_1",1,485,-1},
				{"isVFCVectorSDLVFCid55_1",1,126,-1},
				{"isVFCVectorHRMVFCid18_1",1,19,-1},
				{"isVFCVectorSMBRVFCid34_1",1,355,-1},
				{"isVFCVectorSDLVFCid6_1",1,79,-1},
				{"isVFCVectorSMBVFCid22_1",1,223,-1},
				{"isVFCVectorSRSVFCid5_1",1,448,-1},
				{"isVFCVectorSDLVFCid23_1",1,94,-1},
				{"isVFCVectorSMBVFCid56_1",1,253,-1},
				{"isVFCVectorSMBVFCid8_1",1,205,-1},
				{"isVFCVectorSRSVFCid9_1",1,460,-1},
				{"isVFCVectorSMBLVFCid2_1",1,259,-1},
				{"isVFCVectorSMBLVFCid53_1",1,304,-1},
				{"isVFCVectorSDRVFCid38_1",1,175,-1},
				{"isVFCVectorSDRVFCid35_1",1,162,-1},
				{"isVFCVectorSDLVFCid54_1",1,127,-1},
				{"isVFCVectorSMBRVFCid41_1",1,364,-1},
				{"isVFCVectorSDLBlockID_1",2,71,-1},
				{"isVFCVectorSMBVFCid10_1",1,203,-1},
				{"isVFCVectorSDRVFCid22_1",1,159,-1},
				{"isVFCVectorHRMVFCid26_1",1,27,-1},
				{"isVFCVectorSDLVFCid5_1",1,64,-1},
				{"isVFCVectorSDRVFCid31_1",1,166,-1},
				{"isVFCVectorHRMVFCid39_1",1,46,-1},
				{"isVFCVectorSMBRVFCid8_1",1,333,-1},
				{"isVFCVectorHRMVFCid36_1",1,33,-1}
			},
			{
				{"igVFCVectorSDR_1","ZCUDZCUCANFD2SignalIPdu02",-1},
				{"igVFCVectorSRS_1","ZCUDZCUCANFD2SignalIPdu02",-1},
				{"igVFCVectorHRM_1","ZCUDZCUCANFD2SignalIPdu02",-1},
				{"igVFCVectorSDL_1","ZCUDZCUCANFD2SignalIPdu02",-1},
				{"igVFCVectorSMBL_1","ZCUDZCUCANFD2SignalIPdu02",-1},
				{"igVFCVectorSMB_1","ZCUDZCUCANFD2SignalIPdu02",-1},
				{"igVFCVectorSMBR_1","ZCUDZCUCANFD2SignalIPdu02",-1}
			}
		},
		{"ZCU_CANFD2","ZCUDZCUCANFD2PduR400Fr32","Out",0x3b1,64,0,1,1,0},
		{
			"ZCU_CANFD2","ZCUDZCUCANFD2Fr50","Out",0x3d0,64,450,1,0,0,51,5,
			{
				{"isPtRotReqAckd2_1",1,143,142},
				{"isSnsrInclnStsAlrmSts_1",1,171,-1},
				{"isEngPwrNormDes_1",11,75,80},
				{"isSteerAstLvl_1",3,287,284},
				{"isLowrTailgOpenerSwt_1",1,121,120},
				{"isAltitudeInfrom_1",15,7,8},
				{"isSnsrIntrScanStsArmSts_1",1,154,-1},
				{"isBattHwFltStsPrimRMFlt_1",1,249,-1},
				{"isDtEngdStDtEngdFrnt_1",1,103,-1},
				{"isDrvrPrpsnTqReq_1",16,23,141},
				{"isSnsrSoundrBattBackedStsArmSts_1",1,163,-1},
				{"isBattHwFltStsPrimReserved9_1",1,251,-1},
				{"isEgyMeas_1",13,55,58},
				{"isSldgActiveInteWarn",3,127,124},
				{"isDtEngdStDtEngdRe_1",1,102,-1},
				{"isBattHwFltStsPrimReserved8_1",1,252,-1},
				{"isActvnOfWshrFrntSafe",2,98,96},
				{"isSnsrIntrScanStsSnsrInclnExist_1",1,153,-1},
				{"isMirrDirReq_1",3,119,116},
				{"isSnsrInclnStsSnsrInclnErrSts_1",2,173,-1},
				{"isEngCrashFb_1",2,138,136},
				{"isStrtMsgToModMngt_1",3,151,148},
				{"isSnsrInclnStsArmSts_1",1,170,-1},
				{"isBattHwFltStsPrimBuckFlt_1",1,241,-1},
				{"isSnsrIntrScanStsAlrmReq_1",1,155,-1},
				{"isDtEngdStDtNotEngdRe_1",1,100,-1},
				{"isPtRotReqAckd1_1",1,129,128},
				{"isDtEngdStDtNotEngdFrnt_1",1,101,-1},
				{"isSnsrSoundrBattBackedStsSoundrBattBackedErrSts_1",2,165,-1},
				{"isBattHwFltStsPrimReserved10_1",1,250,-1},
				{"isBattHwFltStsPrimReserved0_1",1,255,-1},
				{"isEgyLvlChk",1,57,56},
				{"isBattHwFltStsPrimReserved6_1",1,254,-1},
				{"isSnsrSoundrBattBackedStsSoundSts_1",1,161,-1},
				{"isEngPwrCns_1",11,71,76},
				{"isMirrActvBtn_1",1,135,134},
				{"isBattHwFltStsPrimACFlt_1",1,243,-1},
				{"isSnsrIntrScanStsSnsrIntrScanErrSts_1",2,157,-1},
				{"isFloatDrvingModStsForAutoMod_1",3,111,108},
				{"isSnsrSoundrBattBackedStsSnsrInclnExist_1",1,162,-1},
				{"isLiBattInPWLock_0",1,123,122},
				{"isEgyMeasSec_1",8,95,140},
				{"isPtGearActrAdpnCmd_1",1,131,130},
				{"isEngLoadReqElec_1",16,39,139},
				{"isSnsrInclnStsCfgSts_1",2,175,-1},
				{"isBattHwFltStsPrimReserved7_1",1,253,-1},
				{"isBattHwFltStsPrimBCFlt_1",1,242,-1},
				{"isSnsrIntrScanStsCfgSts_1",2,159,-1},
				{"isBattHwFltStsPrimMosFlt_1",1,240,-1},
				{"isSnsrSoundrBattBackedStsCfgSts_1",2,167,-1},
				{"isMirrDefrstAtPassCmd",1,133,132}
			},
			{
				{"igSnsrSoundrBattBackedSts_1","ZCUDZCUCANFD2SignalIPdu50",160},
				{"igBattHwFltStsPrim_1","ZCUDZCUCANFD2SignalIPdu50",248},
				{"igSnsrInclnSts_1","ZCUDZCUCANFD2SignalIPdu50",169},
				{"igDtEngdSt_1","ZCUDZCUCANFD2SignalIPdu50",99},
				{"igSnsrIntrScanSts_1","ZCUDZCUCANFD2SignalIPdu50",152}
			}
		},
		{
			"ZCU_CANFD2","ZCUDZCUCANFD2Fr09","Out",0x130,64,20,1,0,0,44,5,
			{
				{"isActvnOfIndcrIndcrOut_0",2,11,-1},
				{"isDoorPassRelsReq",2,49,94},
				{"isDoorLeReRelsReq",2,53,91},
				{"isActvnOfIndcrIndcrOutChks_0",8,7,-1},
				{"isActnOfRoofCampingLi",1,24,72},
				{"isDoorPassRelsReqOutdSnsr",2,63,95},
				{"isPVMCSuspHeiCtrlReqGVMCSuspPosnCtrlMod_0",2,178,-1},
				{"isPVMCSuspHeiCtrlReqGVMCSuspPosnModReq_0",3,181,-1},
				{"isPVMCSuspHeiCtrlReqGVMCSuspPosnRLReq_0",15,147,-1},
				{"isDoorDrvrReLatPosn_0",2,47,84},
				{"isDoorDrvrReRelsFailMechRels",1,25,-1},
				{"isActnOfLedStopLampCntr",4,119,-1},
				{"isDoorDrvrReOpenLowReqOutdSwt1",2,43,86},
				{"isDoorRiReRelsReqOutdSnsr",2,59,98},
				{"isDoorDrvrReCinhIntFailInfCinchFlt1",1,33,-1},
				{"isPVMCSuspHeiCtrlReqGVMCSuspPosnFRReq_0",15,130,-1},
				{"isShortDropWinLeReDoor2",2,57,100},
				{"isDoorDrvrReRelsFailCinchOverTimed",1,27,-1},
				{"isActnOfRoofWarnLiLe",1,66,74},
				{"isDoorDrvrReCinhIntFailInfCinchRestFlt",1,32,-1},
				{"isChdLockLeftCmd",2,37,81},
				{"isDoorLeReRelsReqOutdSnsr",2,51,92},
				{"isActvnOfSideAutDrvgLi",2,39,80},
				{"isShortDropWinRiReDoor2",2,69,102},
				{"isDoorLeReLatPosn",2,55,89},
				{"isChdLockRightCmd",2,35,82},
				{"isDoorLeReLockCmd",4,23,90},
				{"isActnOfRoofWarnLiFrnt",1,67,73},
				{"isIceBreakDoorDrvrReActv",1,79,99},
				{"isPVMCSuspHeiCtrlReqGVMCSuspPosnRRReq_0",15,164,-1},
				{"isDoorDrvrReOpenReqInsdSwt1",2,41,87},
				{"isActvnOfAutDrvgLi",2,9,77},
				{"isDoorDrvrReLockSts",2,45,85},
				{"isActnOfLedStopLampActnOfLedStopLamp",1,115,-1},
				{"isDoorRiReLockCmd",4,31,96},
				{"isActnOfRoofWarnLiRi",1,64,76},
				{"isActnOfRoofWarnLiRe",1,65,75},
				{"isShortDropWinPassDoor2",2,71,101},
				{"isDoorRiReRelsReq",2,61,97},
				{"isActnOfLedStopLampChks",8,111,-1},
				{"isPVMCSuspHeiCtrlReqGVMCSuspPosnFLReq_0",15,113,-1},
				{"isActvnOfIndcrIndcrOutCntr_0",4,15,-1},
				{"isDoorDrvrReRelsFailFailure1",1,26,-1},
				{"isDoorPassLockCmd",4,19,93}
			},
			{
				{"igDoorDrvrReCinhIntFailInf","ZCUDZCUCANFD2SignalIPdu09",83},
				{"igActvnOfIndcr_0","ZCUDZCUCANFD2SignalIPdu09",78},
				{"igActnOfLedStopLamp","ZCUDZCUCANFD2SignalIPdu09",114},
				{"igPVMCSuspHeiCtrlReq_0","ZCUDZCUCANFD2SignalIPdu09",176},
				{"igDoorDrvrReRelsFail","ZCUDZCUCANFD2SignalIPdu09",88}
			}
		},
		{
			"ZCU_CANFD2","ZCUDZCUCANFD2Fr53","Out",0x4c3,64,1000,1,0,0,50,6,
			{
				{"isLiOprnMod_1",2,314,312},
				{"isWiprMotDiagcWiprMotLoVoltDetd_1",2,437,-1},
				{"isStrtReqOfLgtCtrlForPrpsn_1",1,485,484},
				{"isEgyMeasIntlIntl1_1",8,167,-1},
				{"isStopReqOfLgtCtrlForPrpsn_1",1,487,486},
				{"isBattIMidAvb_2",16,199,264},
				{"isDrvrSteerActvCntr_1",4,303,-1},
				{"isDrvrSteerActvDrvrSteerActv_1",1,299,-1},
				{"isEgyMeasIntlIntl4_1",8,191,-1},
				{"isDrvrSteerWhlHldGroupDrvrSteerWhlHldQly_1",4,431,-1},
				{"isBltCrashNotifPass_1",2,453,-1},
				{"isEgyMeasIntlIntl2_1",8,175,-1},
				{"isTrsmSelfLrngMod_1",8,407,499},
				{"isFrntSteerFEstimd1_1",16,231,464},
				{"isWiprMotDiagcWiprMotOvldDetd_1",2,435,-1},
				{"isBattTiInSrvRaw_1",12,311,315},
				{"isBattUMinAvgDurgCrkRaw_1",6,423,417},
				{"isDrvrSteerWhlHldGroupDrvrSteerWhlHld_1",2,427,-1},
				{"isTrCrashUnlckSts_1",1,495,494},
				{"isWiprMotDiagcWiprMotHiVoltDetd_1",2,439,-1},
				{"isBattRRaw_1",8,399,424},
				{"isWiprMotErrSafe_1",2,479,477},
				{"isBattSnsrCalcnNotVldRaw_1",1,297,296},
				{"isWiprMotCrkAg_1",8,415,498},
				{"isCmptFrntWindDewT_1",11,327,332},
				{"isPassAirbLampStsRecPassAirbLampStsCntr_1",4,271,-1},
				{"isSwtTrClsSts_1",1,483,482},
				{"isWshngCycActvFromWMM_1",1,503,502},
				{"isSteerWhlTqAddl_2",14,279,281},
				{"isBattIQuiscFildLongRaw_1",9,357,364},
				{"isTrLatPosn_1",2,458,456},
				{"isTrCinhSwt_1",1,481,480},
				{"isBattRAtTNomRaw_1",8,391,416},
				{"isWipgAutFrntMod_1",2,467,465},
				{"isBattCpEstimdRaw_1",7,383,376},
				{"isTCSCooltTReq_1",8,247,255},
				{"isCmptFrntWindT_1",11,331,336},
				{"isBattIShrtAvb_2",16,215,280},
				{"isPassAirbLampStsRecPassAirbLampSts_1",2,267,-1},
				{"isBattSnsrHwFltRaw_1",1,369,368},
				{"isEgyMeasIntlIntl3_1",8,183,-1},
				{"isPassAirbLampStsRecPassAirbLampStsChks_1",8,263,-1},
				{"isTrsmReqForPfmncRedn3_1",1,491,490},
				{"isBltCrashNotifDrvr_1",2,455,-1},
				{"isWiprActvFromWMM_1",1,489,488},
				{"isDrvrSteerActvChks_1",8,295,-1},
				{"isBattIQuiscFildShoRaw_1",9,363,370},
				{"isBotmSnsrStsFromFootOper_1",1,441,440},
				{"isEngSt1WdSts1_1",4,463,459},
				{"isBattIQuiscAvgRaw_1",9,351,358}
			},
			{
				{"igPassAirbLampStsRec_1","ZCUDZCUCANFD2SignalIPdu53",265},
				{"igDrvrSteerActv_1","ZCUDZCUCANFD2SignalIPdu53",298},
				{"igDrvrSteerWhlHldGroup_1","ZCUDZCUCANFD2SignalIPdu53",425},
				{"igEgyMeasIntl_1","ZCUDZCUCANFD2SignalIPdu53",432},
				{"igWiprMotDiagc_1","ZCUDZCUCANFD2SignalIPdu53",433},
				{"igBltCrashNotif_1","ZCUDZCUCANFD2SignalIPdu53",451}
			}
		},
		{
			"ZCU_CANFD2","ZCUDZCUCANFD2Fr42","Out",0x364,64,250,1,0,0,80,8,
			{
				{"isFrntIntHCMLiLe24LED5_1",6,479,-1},
				{"isFrntIntHCMLiLe23LED3_1",6,395,-1},
				{"isFrntIntHCMLiLe19LED2_1",6,129,-1},
				{"isFrntIntHCMLiLe17LED6_1",6,25,-1},
				{"isFrntIntHCMLiLe22LED8_1",6,365,-1},
				{"isFrntIntHCMLiLe18LED8_1",6,109,-1},
				{"isFrntIntHCMLiLe17LED3_1",6,11,-1},
				{"isFrntIntHCMLiLe22LED6_1",6,345,-1},
				{"isFrntIntHCMLiLe18LED5_1",6,95,-1},
				{"isFrntIntHCMLiLe21LED8_1",6,301,-1},
				{"isFrntIntHCMLiLe20LED9_1",6,247,-1},
				{"isFrntIntHCMLiLe21LED9_1",6,311,-1},
				{"isFrntIntHCMLiLe20LED5_1",6,223,-1},
				{"isFrntIntHCMLiLe24LED9_1",6,503,-1},
				{"isFrntIntHCMLiLe19LED8_1",6,173,-1},
				{"isFrntIntHCMLiLe17LED1_1",6,7,-1},
				{"isFrntIntHCMLiLe21LED5_1",6,287,-1},
				{"isFrntIntHCMLiLe17LED8_1",6,45,-1},
				{"isFrntIntHCMLiLe17LED9_1",6,55,-1},
				{"isFrntIntHCMLiLe23LED5_1",6,415,-1},
				{"isFrntIntHCMLiLe19LED3_1",6,139,-1},
				{"isFrntIntHCMLiLe24LED1_1",6,455,-1},
				{"isFrntIntHCMLiLe19LED10_1",6,177,-1},
				{"isFrntIntHCMLiLe18LED6_1",6,89,-1},
				{"isFrntIntHCMLiLe24LED6_1",6,473,-1},
				{"isFrntIntHCMLiLe21LED3_1",6,267,-1},
				{"isFrntIntHCMLiLe19LED6_1",6,153,-1},
				{"isFrntIntHCMLiLe19LED9_1",6,183,-1},
				{"isFrntIntHCMLiLe23LED1_1",6,391,-1},
				{"isFrntIntHCMLiLe19LED5_1",6,159,-1},
				{"isFrntIntHCMLiLe18LED3_1",6,75,-1},
				{"isFrntIntHCMLiLe18LED10_1",6,113,-1},
				{"isFrntIntHCMLiLe17LED2_1",6,1,-1},
				{"isFrntIntHCMLiLe21LED7_1",6,291,-1},
				{"isFrntIntHCMLiLe22LED2_1",6,321,-1},
				{"isFrntIntHCMLiLe17LED10_1",6,49,-1},
				{"isFrntIntHCMLiLe17LED7_1",6,35,-1},
				{"isFrntIntHCMLiLe24LED8_1",6,493,-1},
				{"isFrntIntHCMLiLe22LED3_1",6,331,-1},
				{"isFrntIntHCMLiLe19LED7_1",6,163,-1},
				{"isFrntIntHCMLiLe20LED8_1",6,237,-1},
				{"isFrntIntHCMLiLe23LED4_1",6,405,-1},
				{"isFrntIntHCMLiLe18LED4_1",6,85,-1},
				{"isFrntIntHCMLiLe24LED7_1",6,483,-1},
				{"isFrntIntHCMLiLe24LED2_1",6,449,-1},
				{"isFrntIntHCMLiLe24LED4_1",6,469,-1},
				{"isFrntIntHCMLiLe20LED2_1",6,193,-1},
				{"isFrntIntHCMLiLe20LED3_1",6,203,-1},
				{"isFrntIntHCMLiLe24LED10_1",6,497,-1},
				{"isFrntIntHCMLiLe18LED2_1",6,65,-1},
				{"isFrntIntHCMLiLe20LED6_1",6,217,-1},
				{"isFrntIntHCMLiLe20LED1_1",6,199,-1},
				{"isFrntIntHCMLiLe22LED10_1",6,369,-1},
				{"isFrntIntHCMLiLe23LED7_1",6,419,-1},
				{"isFrntIntHCMLiLe21LED4_1",6,277,-1},
				{"isFrntIntHCMLiLe20LED7_1",6,227,-1},
				{"isFrntIntHCMLiLe20LED10_1",6,241,-1},
				{"isFrntIntHCMLiLe21LED1_1",6,263,-1},
				{"isFrntIntHCMLiLe23LED8_1",6,429,-1},
				{"isFrntIntHCMLiLe22LED5_1",6,351,-1},
				{"isFrntIntHCMLiLe22LED1_1",6,327,-1},
				{"isFrntIntHCMLiLe23LED10_1",6,433,-1},
				{"isFrntIntHCMLiLe17LED5_1",6,31,-1},
				{"isFrntIntHCMLiLe22LED7_1",6,355,-1},
				{"isFrntIntHCMLiLe21LED10_1",6,305,-1},
				{"isFrntIntHCMLiLe19LED4_1",6,149,-1},
				{"isFrntIntHCMLiLe20LED4_1",6,213,-1},
				{"isFrntIntHCMLiLe21LED6_1",6,281,-1},
				{"isFrntIntHCMLiLe17LED4_1",6,21,-1},
				{"isFrntIntHCMLiLe19LED1_1",6,135,-1},
				{"isFrntIntHCMLiLe22LED4_1",6,341,-1},
				{"isFrntIntHCMLiLe18LED7_1",6,99,-1},
				{"isFrntIntHCMLiLe18LED9_1",6,119,-1},
				{"isFrntIntHCMLiLe23LED6_1",6,409,-1},
				{"isFrntIntHCMLiLe23LED9_1",6,439,-1},
				{"isFrntIntHCMLiLe21LED2_1",6,257,-1},
				{"isFrntIntHCMLiLe22LED9_1",6,375,-1},
				{"isFrntIntHCMLiLe23LED2_1",6,385,-1},
				{"isFrntIntHCMLiLe24LED3_1",6,459,-1},
				{"isFrntIntHCMLiLe18LED1_1",6,71,-1}
			},
			{
				{"igFrntIntHCMLiLe17_1","ZCUDZCUCANFD2SignalIPdu42",59},
				{"igFrntIntHCMLiLe19_1","ZCUDZCUCANFD2SignalIPdu42",187},
				{"igFrntIntHCMLiLe20_1","ZCUDZCUCANFD2SignalIPdu42",251},
				{"igFrntIntHCMLiLe22_1","ZCUDZCUCANFD2SignalIPdu42",379},
				{"igFrntIntHCMLiLe21_1","ZCUDZCUCANFD2SignalIPdu42",315},
				{"igFrntIntHCMLiLe18_1","ZCUDZCUCANFD2SignalIPdu42",123},
				{"igFrntIntHCMLiLe23_1","ZCUDZCUCANFD2SignalIPdu42",443},
				{"igFrntIntHCMLiLe24_1","ZCUDZCUCANFD2SignalIPdu42",507}
			}
		},
		{"ZCU_CANFD2","ZcudSmbrToDhuZCUCANFD2DiagResFr","Out",0x632,64,0,1,4,0},
		{"ZCU_CANFD2","ZcudHvfmToDhuZCUCANFD2DiagResFr","Out",0x644,64,0,1,4,0},
		{"ZCU_CANFD2","ZcudFtksToDhuZCUCANFD2DiagResFr","Out",0x671,64,0,1,4,0},
		{
			"ZCU_CANFD2","ZCUDZCUCANFD2Fr70","Out",0x2d8,64,120,1,0,0,79,7,
			{
				{"isPetModWinDiStsAtDrvr",1,228,227},
				{"isReSunCurtOperReq",5,279,274},
				{"isSeatMassgHeiSetDrvr_0",7,431,424},
				{"isFrSunCurtOperReq",5,95,90},
				{"isRWASteerLockReqSteerLockDataReq1_0",8,303,-1},
				{"isSldngDoorClsLeReRmn",1,237,236},
				{"isSeatUpLumPosCtrlDrvr_0",7,463,456},
				{"isEPBLockMgrReq2Data0_1",8,12,-1},
				{"isImobEngMgrReq1ImobEngDataMgrReq6_1",8,155,-1},
				{"isEPBLockMgrReq2Data1_1",8,20,-1},
				{"isSeatMidLumPosCtrlDrvr_0",7,447,440},
				{"isEPBLockMgrReq2Data4_1",8,44,-1},
				{"isFrSunCurtIninLrnSts",1,89,88},
				{"isFrSunCurtIceBreakSts",1,87,86},
				{"isActvnOfFrontTrunkLi",8,7,15},
				{"isPetModWinDiStsAtDrvrRe",1,226,225},
				{"isRWASteerLockReq2SteerLockDataReq5_1",8,388,-1},
				{"isRWASteerLockReqCommand_0",2,351,-1},
				{"isEPBLockMgrReq2Data3_1",8,36,-1},
				{"isImobEngMgrReq1ImobEngDataMgrReq3_1",8,131,-1},
				{"isFrSunCurtTemProtnSts",2,98,96},
				{"isImobEngMgrReq3ImobEngDataMgrReq6_1",8,223,-1},
				{"isImobEngMgrReq3ImobEngDataMgrReq5_1",8,215,-1},
				{"isImobEngMgrReq3ImobEngDataMgrReq2_1",8,191,-1},
				{"isEPBLockMgrReq2Data5_1",8,52,-1},
				{"isRWASteerLockReqSteerLockDataReq6_0",8,343,-1},
				{"isFrSunCurtDrvU",8,79,65},
				{"isFrSunCurtLossIninReas",5,85,80},
				{"isRainClsdForVoice",1,247,246},
				{"isReSunCurtLossIninReas",5,271,266},
				{"isReSunCurtOperSts",3,287,284},
				{"isReSunCurtIninLrnSts",1,263,262},
				{"isRWASteerLockReq2SteerLockDataReq0_1",8,348,-1},
				{"isFrSunCurtIninStsRF",1,101,-1},
				{"isFrSunCurtOperSts",3,111,108},
				{"isRWASteerLockReqSteerLockDataReq2_0",8,311,-1},
				{"isImobEngMgrReq1ImobEngDataMgrReq5_1",8,147,-1},
				{"isImobEngMgrReq3ImobEngDataMgrReq0_1",8,175,-1},
				{"isFrSunCurtIninStsReserved",1,102,-1},
				{"isRWASteerLockReq2Command_1",2,404,-1},
				{"isRWASteerLockReq2SteerLockDataReq4_1",8,380,-1},
				{"isReSunCurtIninStsReserved",1,260,-1},
				{"isRWASteerLockReq2SteerLockDataReq2_1",8,364,-1},
				{"isRWASteerLockReq2SteerLockDataReq6_1",8,396,-1},
				{"isImobEngMgrReq1ImobEngDataMgrReq0_1",8,107,-1},
				{"isImobEngMgrReq1ImobEngDataMgrReq2_1",8,123,-1},
				{"isSeatUpLumPosCtrlSecLe_0",7,471,464},
				{"isRainClsdWinFb",2,245,243},
				{"isReSunCurtIceBreakSts",1,242,241},
				{"isEPBLockMgrReq2Cmd_1",2,68,-1},
				{"isSeatDownLumPosCtrlSecLe_0",7,423,416},
				{"isRWASteerLockReq2SteerLockDataReq1_1",8,356,-1},
				{"isRWASteerLockReqSteerLockDataReq0_0",8,295,-1},
				{"isImobEngMgrReq1ImobEngMgrCmdTar1_1",2,163,-1},
				{"isSeatMassgHeiSetSecLe_0",7,439,432},
				{"isImobEngMgrReq3ImobEngDataMgrReq3_1",8,199,-1},
				{"isEPBLockMgrReq2Data2_1",8,28,-1},
				{"isImobEngMgrReq3ImobEngMgrCmdTar1_1",2,231,-1},
				{"isSldngDoorClsRiReRmn",1,235,234},
				{"isRWASteerLockReqSteerLockDataReq3_0",8,319,-1},
				{"isImobEngMgrReq1ImobEngDataMgrReq4_1",8,139,-1},
				{"isReSunCurtTemProtnSts",2,283,281},
				{"isRWASteerLockReqSteerLockDataReq4_0",8,327,-1},
				{"isRWASteerLockReqSteerLockDataReq5_0",8,335,-1},
				{"isImobEngMgrReq1ImobEngDataMgrReq1_1",8,115,-1},
				{"isRWASteerLockReq2SteerLockDataReq3_1",8,372,-1},
				{"isImobEngMgrReq3ImobEngDataMgrReq4_1",8,207,-1},
				{"isReSunCurtDrvU",8,255,160},
				{"isImobEngMgrReq3ImobEngDataMgrReq1_1",8,183,-1},
				{"isReSunCurtIninStsRP",1,258,-1},
				{"isFrSunCurtIninStsLP",1,103,-1},
				{"isSecRowLeReadLiSwt",1,239,238},
				{"isSeatMidLumPosCtrlSecLe_0",7,455,448},
				{"isReSunCurtIninStsRF",1,259,-1},
				{"isEntertainmentModStsFb",1,14,13},
				{"isFrSunCurtIninStsRP",1,100,-1},
				{"isEPBLockMgrReq2Data6_1",8,60,-1},
				{"isReSunCurtIninStsLP",1,261,-1},
				{"isSeatDownLumPosCtrlDrvr_0",7,415,408}
			},
			{
				{"igRWASteerLockReq_0","ZCUDZCUCANFD2SignalIPdu70",349},
				{"igRWASteerLockReq2_1","ZCUDZCUCANFD2SignalIPdu70",402},
				{"igReSunCurtIninSts","ZCUDZCUCANFD2SignalIPdu70",257},
				{"igFrSunCurtIninSts","ZCUDZCUCANFD2SignalIPdu70",99},
				{"igEPBLockMgrReq2_1","ZCUDZCUCANFD2SignalIPdu70",66},
				{"igImobEngMgrReq1_1","ZCUDZCUCANFD2SignalIPdu70",161},
				{"igImobEngMgrReq3_1","ZCUDZCUCANFD2SignalIPdu70",229}
			}
		},
		{"ZCU_CANFD2","ZcudCmdToDhuZCUCANFD2DiagResFr","Out",0x61c,64,0,1,4,0},
		{
			"ZCU_CANFD2","ZCUDZCUCANFD2Fr01","Out",0x489,64,1000,1,0,0,504,8,
			{
				{"isVFCVectorPOTVFCid45_1",1,360,-1},
				{"isVFCVectorOGMVFCid56_1",1,317,-1},
				{"isVFCVectorRDRMVFCid53_1",1,240,-1},
				{"isVFCVectorRDRMVFCid3_1",1,194,-1},
				{"isVFCVectorDPODVFCid35_1",1,98,-1},
				{"isVFCVectorDDRMVFCid10_1",1,11,-1},
				{"isVFCVectorRDRMVFCid16_1",1,213,-1},
				{"isVFCVectorDPODVFCid13_1",1,72,-1},
				{"isVFCVectorOGMVFCid50_1",1,307,-1},
				{"isVFCVectorDDRMVFCid58_1",1,59,-1},
				{"isVFCVectorCMDVFCid38_1",1,495,-1},
				{"isVFCVectorPOTVFCid30_1",1,359,-1},
				{"isVFCVectorTRMVFCid17_1",1,404,-1},
				{"isVFCVectorTRMVFCid32_1",1,421,-1},
				{"isVFCVectorOGMVFCid48_1",1,309,-1},
				{"isVFCVectorDDRMVFCid28_1",1,25,-1},
				{"isVFCVectorCMDVFCid35_1",1,482,-1},
				{"isVFCVectorTRMVFCid0_1",1,389,-1},
				{"isVFCVectorCMDVFCid8_1",1,461,-1},
				{"isVFCVectorPOTVFCid29_1",1,344,-1},
				{"isVFCVectorLPODVFCid45_1",1,168,-1},
				{"isVFCVectorDDRMVFCid12_1",1,9,-1},
				{"isVFCVectorLPODVFCid2_1",1,131,-1},
				{"isVFCVectorLPODVFCid26_1",1,155,-1},
				{"isVFCVectorLPODVFCid27_1",1,154,-1},
				{"isVFCVectorPOTVFCid0_1",1,325,-1},
				{"isVFCVectorTRMVFCid57_1",1,444,-1},
				{"isVFCVectorPOTVFCid39_1",1,366,-1},
				{"isVFCVectorDPODVFCid30_1",1,103,-1},
				{"isVFCVectorDPODVFCid34_1",1,99,-1},
				{"isVFCVectorDPODVFCid7_1",1,78,-1},
				{"isVFCVectorTRMVFCid4_1",1,385,-1},
				{"isVFCVectorOGMVFCid53_1",1,304,-1},
				{"isVFCVectorDPODBlockID_1",2,71,-1},
				{"isVFCVectorDPODVFCid11_1",1,74,-1},
				{"isVFCVectorPOTVFCid52_1",1,369,-1},
				{"isVFCVectorTRMVFCid2_1",1,387,-1},
				{"isVFCVectorTRMVFCid45_1",1,424,-1},
				{"isVFCVectorOGMVFCid45_1",1,296,-1},
				{"isVFCVectorTRMVFCid22_1",1,415,-1},
				{"isVFCVectorDDRMVFCid8_1",1,13,-1},
				{"isVFCVectorRDRMVFCid46_1",1,247,-1},
				{"isVFCVectorDPODVFCid17_1",1,84,-1},
				{"isVFCVectorLPODVFCid47_1",1,182,-1},
				{"isVFCVectorLPODVFCid3_1",1,130,-1},
				{"isVFCVectorRDRMVFCid47_1",1,246,-1},
				{"isVFCVectorTRMVFCid54_1",1,447,-1},
				{"isVFCVectorPOTVFCid16_1",1,341,-1},
				{"isVFCVectorLPODVFCid21_1",1,144,-1},
				{"isVFCVectorDPODVFCid36_1",1,97,-1},
				{"isVFCVectorLPODVFCid32_1",1,165,-1},
				{"isVFCVectorTRMVFCid35_1",1,418,-1},
				{"isVFCVectorLPODVFCid42_1",1,171,-1},
				{"isVFCVectorCMDVFCid23_1",1,478,-1},
				{"isVFCVectorOGMVFCid6_1",1,271,-1},
				{"isVFCVectorTRMVFCid39_1",1,430,-1},
				{"isVFCVectorTRMVFCid37_1",1,416,-1},
				{"isVFCVectorDPODVFCid27_1",1,90,-1},
				{"isVFCVectorRDRMVFCid24_1",1,221,-1},
				{"isVFCVectorDPODVFCid42_1",1,107,-1},
				{"isVFCVectorPOTVFCid11_1",1,330,-1},
				{"isVFCVectorRDRMVFCid51_1",1,242,-1},
				{"isVFCVectorRDRMVFCid54_1",1,255,-1},
				{"isVFCVectorTRMVFCid23_1",1,414,-1},
				{"isVFCVectorTRMVFCid33_1",1,420,-1},
				{"isVFCVectorLPODVFCid55_1",1,190,-1},
				{"isVFCVectorDPODVFCid9_1",1,76,-1},
				{"isVFCVectorPOTVFCid48_1",1,373,-1},
				{"isVFCVectorRDRMVFCid40_1",1,237,-1},
				{"isVFCVectorLPODVFCid5_1",1,128,-1},
				{"isVFCVectorRDRMVFCid18_1",1,211,-1},
				{"isVFCVectorDPODVFCid0_1",1,69,-1},
				{"isVFCVectorRDRMVFCid7_1",1,206,-1},
				{"isVFCVectorCMDVFCid56_1",1,509,-1},
				{"isVFCVectorTRMVFCid25_1",1,412,-1},
				{"isVFCVectorDPODVFCid23_1",1,94,-1},
				{"isVFCVectorPOTVFCid8_1",1,333,-1},
				{"isVFCVectorDPODVFCid18_1",1,83,-1},
				{"isVFCVectorOGMVFCid34_1",1,291,-1},
				{"isVFCVectorPOTVFCid36_1",1,353,-1},
				{"isVFCVectorDDRMVFCid2_1",1,3,-1},
				{"isVFCVectorPOTVFCid22_1",1,351,-1},
				{"isVFCVectorDPODVFCid19_1",1,82,-1},
				{"isVFCVectorLPODVFCid58_1",1,187,-1},
				{"isVFCVectorLPODVFCid57_1",1,188,-1},
				{"isVFCVectorRDRMVFCid59_1",1,250,-1},
				{"isVFCVectorLPODVFCid10_1",1,139,-1},
				{"isVFCVectorOGMVFCid30_1",1,295,-1},
				{"isVFCVectorOGMVFCid11_1",1,266,-1},
				{"isVFCVectorLPODVFCid14_1",1,151,-1},
				{"isVFCVectorOGMVFCid26_1",1,283,-1},
				{"isVFCVectorRDRMVFCid39_1",1,238,-1},
				{"isVFCVectorPOTVFCid51_1",1,370,-1},
				{"isVFCVectorDPODVFCid32_1",1,101,-1},
				{"isVFCVectorRDRMVFCid5_1",1,192,-1},
				{"isVFCVectorRDRMVFCid13_1",1,200,-1},
				{"isVFCVectorDDRMVFCid16_1",1,21,-1},
				{"isVFCVectorLPODVFCid28_1",1,153,-1},
				{"isVFCVectorOGMVFCid35_1",1,290,-1},
				{"isVFCVectorTRMVFCid11_1",1,394,-1},
				{"isVFCVectorDPODVFCid49_1",1,116,-1},
				{"isVFCVectorOGMVFCid29_1",1,280,-1},
				{"isVFCVectorTRMVFCid14_1",1,407,-1},
				{"isVFCVectorRDRMVFCid57_1",1,252,-1},
				{"isVFCVectorDDRMVFCid50_1",1,51,-1},
				{"isVFCVectorDPODVFCid39_1",1,110,-1},
				{"isVFCVectorCMDVFCid58_1",1,507,-1},
				{"isVFCVectorDPODVFCid51_1",1,114,-1},
				{"isVFCVectorPOTVFCid32_1",1,357,-1},
				{"isVFCVectorCMDVFCid32_1",1,485,-1},
				{"isVFCVectorPOTVFCid55_1",1,382,-1},
				{"isVFCVectorOGMVFCid14_1",1,279,-1},
				{"isVFCVectorCMDBlockID_1",2,455,-1},
				{"isVFCVectorOGMVFCid16_1",1,277,-1},
				{"isVFCVectorOGMVFCid3_1",1,258,-1},
				{"isVFCVectorDPODVFCid55_1",1,126,-1},
				{"isVFCVectorLPODVFCid25_1",1,156,-1},
				{"isVFCVectorDDRMVFCid39_1",1,46,-1},
				{"isVFCVectorCMDVFCid54_1",1,511,-1},
				{"isVFCVectorCMDVFCid42_1",1,491,-1},
				{"isVFCVectorDPODVFCid20_1",1,81,-1},
				{"isVFCVectorCMDVFCid21_1",1,464,-1},
				{"isVFCVectorLPODVFCid7_1",1,142,-1},
				{"isVFCVectorPOTVFCid35_1",1,354,-1},
				{"isVFCVectorDDRMVFCid40_1",1,45,-1},
				{"isVFCVectorTRMVFCid52_1",1,433,-1},
				{"isVFCVectorRDRMVFCid34_1",1,227,-1},
				{"isVFCVectorDDRMVFCid55_1",1,62,-1},
				{"isVFCVectorRDRMVFCid12_1",1,201,-1},
				{"isVFCVectorDDRMVFCid44_1",1,41,-1},
				{"isVFCVectorRDRMVFCid4_1",1,193,-1},
				{"isVFCVectorCMDVFCid4_1",1,449,-1},
				{"isVFCVectorTRMVFCid48_1",1,437,-1},
				{"isVFCVectorTRMVFCid13_1",1,392,-1},
				{"isVFCVectorCMDVFCid1_1",1,452,-1},
				{"isVFCVectorTRMVFCid46_1",1,439,-1},
				{"isVFCVectorCMDVFCid39_1",1,494,-1},
				{"isVFCVectorLPODVFCid19_1",1,146,-1},
				{"isVFCVectorRDRMVFCid55_1",1,254,-1},
				{"isVFCVectorDDRMVFCid9_1",1,12,-1},
				{"isVFCVectorDDRMVFCid5_1",1,0,-1},
				{"isVFCVectorCMDVFCid40_1",1,493,-1},
				{"isVFCVectorTRMVFCid31_1",1,422,-1},
				{"isVFCVectorDPODVFCid26_1",1,91,-1},
				{"isVFCVectorOGMVFCid2_1",1,259,-1},
				{"isVFCVectorCMDVFCid34_1",1,483,-1},
				{"isVFCVectorRDRMVFCid0_1",1,197,-1},
				{"isVFCVectorLPODVFCid61_1",1,184,-1},
				{"isVFCVectorRDRMVFCid8_1",1,205,-1},
				{"isVFCVectorLPODVFCid43_1",1,170,-1},
				{"isVFCVectorCMDVFCid57_1",1,508,-1},
				{"isVFCVectorOGMVFCid20_1",1,273,-1},
				{"isVFCVectorDDRMVFCid42_1",1,43,-1},
				{"isVFCVectorOGMVFCid13_1",1,264,-1},
				{"isVFCVectorLPODVFCid15_1",1,150,-1},
				{"isVFCVectorCMDVFCid12_1",1,457,-1},
				{"isVFCVectorDDRMVFCid29_1",1,24,-1},
				{"isVFCVectorTRMVFCid58_1",1,443,-1},
				{"isVFCVectorPOTVFCid38_1",1,367,-1},
				{"isVFCVectorTRMVFCid20_1",1,401,-1},
				{"isVFCVectorDDRMVFCid43_1",1,42,-1},
				{"isVFCVectorRDRMVFCid36_1",1,225,-1},
				{"isVFCVectorCMDVFCid46_1",1,503,-1},
				{"isVFCVectorOGMVFCid4_1",1,257,-1},
				{"isVFCVectorDDRMVFCid6_1",1,15,-1},
				{"isVFCVectorDDRMVFCid21_1",1,16,-1},
				{"isVFCVectorOGMVFCid8_1",1,269,-1},
				{"isVFCVectorCMDVFCid37_1",1,480,-1},
				{"isVFCVectorTRMVFCid27_1",1,410,-1},
				{"isVFCVectorTRMVFCid55_1",1,446,-1},
				{"isVFCVectorOGMVFCid32_1",1,293,-1},
				{"isVFCVectorDPODVFCid41_1",1,108,-1},
				{"isVFCVectorDDRMVFCid27_1",1,26,-1},
				{"isVFCVectorLPODVFCid24_1",1,157,-1},
				{"isVFCVectorLPODVFCid46_1",1,183,-1},
				{"isVFCVectorLPODVFCid60_1",1,185,-1},
				{"isVFCVectorRDRMVFCid23_1",1,222,-1},
				{"isVFCVectorPOTVFCid46_1",1,375,-1},
				{"isVFCVectorOGMVFCid22_1",1,287,-1},
				{"isVFCVectorOGMVFCid39_1",1,302,-1},
				{"isVFCVectorLPODVFCid4_1",1,129,-1},
				{"isVFCVectorCMDVFCid36_1",1,481,-1},
				{"isVFCVectorOGMVFCid0_1",1,261,-1},
				{"isVFCVectorDPODVFCid60_1",1,121,-1},
				{"isVFCVectorPOTVFCid40_1",1,365,-1},
				{"isVFCVectorDDRMVFCid48_1",1,53,-1},
				{"isVFCVectorOGMVFCid55_1",1,318,-1},
				{"isVFCVectorDDRMVFCid18_1",1,19,-1},
				{"isVFCVectorRDRMVFCid19_1",1,210,-1},
				{"isVFCVectorLPODVFCid50_1",1,179,-1},
				{"isVFCVectorOGMVFCid12_1",1,265,-1},
				{"isVFCVectorRDRMVFCid28_1",1,217,-1},
				{"isVFCVectorDDRMVFCid34_1",1,35,-1},
				{"isVFCVectorDDRMVFCid22_1",1,31,-1},
				{"isVFCVectorPOTVFCid2_1",1,323,-1},
				{"isVFCVectorDDRMVFCid33_1",1,36,-1},
				{"isVFCVectorDPODVFCid1_1",1,68,-1},
				{"isVFCVectorLPODVFCid16_1",1,149,-1},
				{"isVFCVectorLPODVFCid8_1",1,141,-1},
				{"isVFCVectorCMDVFCid43_1",1,490,-1},
				{"isVFCVectorDDRMVFCid60_1",1,57,-1},
				{"isVFCVectorRDRMVFCid10_1",1,203,-1},
				{"isVFCVectorOGMVFCid5_1",1,256,-1},
				{"isVFCVectorOGMVFCid38_1",1,303,-1},
				{"isVFCVectorDPODVFCid16_1",1,85,-1},
				{"isVFCVectorTRMVFCid44_1",1,425,-1},
				{"isVFCVectorLPODVFCid35_1",1,162,-1},
				{"isVFCVectorLPODVFCid31_1",1,166,-1},
				{"isVFCVectorDPODVFCid29_1",1,88,-1},
				{"isVFCVectorDDRMVFCid51_1",1,50,-1},
				{"isVFCVectorDPODVFCid50_1",1,115,-1},
				{"isVFCVectorDDRMVFCid38_1",1,47,-1},
				{"isVFCVectorTRMVFCid6_1",1,399,-1},
				{"isVFCVectorLPODVFCid59_1",1,186,-1},
				{"isVFCVectorLPODVFCid12_1",1,137,-1},
				{"isVFCVectorOGMVFCid24_1",1,285,-1},
				{"isVFCVectorCMDVFCid14_1",1,471,-1},
				{"isVFCVectorLPODVFCid23_1",1,158,-1},
				{"isVFCVectorOGMVFCid40_1",1,301,-1},
				{"isVFCVectorCMDVFCid11_1",1,458,-1},
				{"isVFCVectorOGMVFCid15_1",1,278,-1},
				{"isVFCVectorCMDVFCid52_1",1,497,-1},
				{"isVFCVectorLPODVFCid44_1",1,169,-1},
				{"isVFCVectorRDRMVFCid9_1",1,204,-1},
				{"isVFCVectorRDRMVFCid6_1",1,207,-1},
				{"isVFCVectorRDRMVFCid43_1",1,234,-1},
				{"isVFCVectorPOTVFCid26_1",1,347,-1},
				{"isVFCVectorPOTVFCid7_1",1,334,-1},
				{"isVFCVectorDDRMBlockID_1",2,7,-1},
				{"isVFCVectorRDRMVFCid27_1",1,218,-1},
				{"isVFCVectorDPODVFCid28_1",1,89,-1},
				{"isVFCVectorDDRMVFCid26_1",1,27,-1},
				{"isVFCVectorDPODVFCid48_1",1,117,-1},
				{"isVFCVectorPOTVFCid49_1",1,372,-1},
				{"isVFCVectorTRMVFCid53_1",1,432,-1},
				{"isVFCVectorTRMVFCid15_1",1,406,-1},
				{"isVFCVectorRDRMVFCid35_1",1,226,-1},
				{"isVFCVectorCMDVFCid0_1",1,453,-1},
				{"isVFCVectorTRMVFCid34_1",1,419,-1},
				{"isVFCVectorCMDVFCid59_1",1,506,-1},
				{"isVFCVectorOGMVFCid51_1",1,306,-1},
				{"isVFCVectorPOTVFCid57_1",1,380,-1},
				{"isVFCVectorOGMVFCid21_1",1,272,-1},
				{"isVFCVectorPOTVFCid53_1",1,368,-1},
				{"isVFCVectorDDRMVFCid19_1",1,18,-1},
				{"isVFCVectorCMDVFCid47_1",1,502,-1},
				{"isVFCVectorOGMVFCid9_1",1,268,-1},
				{"isVFCVectorRDRMVFCid11_1",1,202,-1},
				{"isVFCVectorDPODVFCid22_1",1,95,-1},
				{"isVFCVectorOGMVFCid61_1",1,312,-1},
				{"isVFCVectorCMDVFCid27_1",1,474,-1},
				{"isVFCVectorDDRMVFCid45_1",1,40,-1},
				{"isVFCVectorDDRMVFCid7_1",1,14,-1},
				{"isVFCVectorRDRMVFCid22_1",1,223,-1},
				{"isVFCVectorPOTVFCid27_1",1,346,-1},
				{"isVFCVectorLPODVFCid36_1",1,161,-1},
				{"isVFCVectorDPODVFCid3_1",1,66,-1},
				{"isVFCVectorRDRMVFCid31_1",1,230,-1},
				{"isVFCVectorDDRMVFCid59_1",1,58,-1},
				{"isVFCVectorTRMVFCid38_1",1,431,-1},
				{"isVFCVectorOGMVFCid27_1",1,282,-1},
				{"isVFCVectorLPODVFCid6_1",1,143,-1},
				{"isVFCVectorLPODVFCid34_1",1,163,-1},
				{"isVFCVectorDDRMVFCid37_1",1,32,-1},
				{"isVFCVectorTRMVFCid59_1",1,442,-1},
				{"isVFCVectorRDRMVFCid42_1",1,235,-1},
				{"isVFCVectorLPODVFCid37_1",1,160,-1},
				{"isVFCVectorRDRMVFCid25_1",1,220,-1},
				{"isVFCVectorRDRMVFCid15_1",1,214,-1},
				{"isVFCVectorDPODVFCid12_1",1,73,-1},
				{"isVFCVectorPOTVFCid9_1",1,332,-1},
				{"isVFCVectorPOTVFCid60_1",1,377,-1},
				{"isVFCVectorLPODVFCid53_1",1,176,-1},
				{"isVFCVectorTRMVFCid30_1",1,423,-1},
				{"isVFCVectorRDRMVFCid26_1",1,219,-1},
				{"isVFCVectorOGMVFCid19_1",1,274,-1},
				{"isVFCVectorDDRMVFCid54_1",1,63,-1},
				{"isVFCVectorTRMVFCid42_1",1,427,-1},
				{"isVFCVectorPOTVFCid14_1",1,343,-1},
				{"isVFCVectorDDRMVFCid52_1",1,49,-1},
				{"isVFCVectorCMDVFCid49_1",1,500,-1},
				{"isVFCVectorCMDVFCid50_1",1,499,-1},
				{"isVFCVectorPOTVFCid31_1",1,358,-1},
				{"isVFCVectorCMDVFCid10_1",1,459,-1},
				{"isVFCVectorDPODVFCid6_1",1,79,-1},
				{"isVFCVectorDDRMVFCid57_1",1,60,-1},
				{"isVFCVectorPOTVFCid42_1",1,363,-1},
				{"isVFCVectorLPODVFCid22_1",1,159,-1},
				{"isVFCVectorCMDVFCid20_1",1,465,-1},
				{"isVFCVectorDDRMVFCid53_1",1,48,-1},
				{"isVFCVectorDPODVFCid38_1",1,111,-1},
				{"isVFCVectorDDRMVFCid49_1",1,52,-1},
				{"isVFCVectorCMDVFCid33_1",1,484,-1},
				{"isVFCVectorPOTVFCid34_1",1,355,-1},
				{"isVFCVectorOGMVFCid46_1",1,311,-1},
				{"isVFCVectorDPODVFCid54_1",1,127,-1},
				{"isVFCVectorDPODVFCid44_1",1,105,-1},
				{"isVFCVectorOGMVFCid17_1",1,276,-1},
				{"isVFCVectorDDRMVFCid24_1",1,29,-1},
				{"isVFCVectorOGMVFCid36_1",1,289,-1},
				{"isVFCVectorDDRMVFCid30_1",1,39,-1},
				{"isVFCVectorRDRMVFCid30_1",1,231,-1},
				{"isVFCVectorLPODVFCid54_1",1,191,-1},
				{"isVFCVectorLPODVFCid17_1",1,148,-1},
				{"isVFCVectorTRMBlockID_1",2,391,-1},
				{"isVFCVectorDPODVFCid47_1",1,118,-1},
				{"isVFCVectorPOTVFCid6_1",1,335,-1},
				{"isVFCVectorTRMVFCid49_1",1,436,-1},
				{"isVFCVectorDPODVFCid10_1",1,75,-1},
				{"isVFCVectorPOTVFCid1_1",1,324,-1},
				{"isVFCVectorLPODVFCid51_1",1,178,-1},
				{"isVFCVectorDPODVFCid46_1",1,119,-1},
				{"isVFCVectorDPODVFCid43_1",1,106,-1},
				{"isVFCVectorDDRMVFCid14_1",1,23,-1},
				{"isVFCVectorPOTVFCid50_1",1,371,-1},
				{"isVFCVectorDDRMVFCid36_1",1,33,-1},
				{"isVFCVectorOGMVFCid58_1",1,315,-1},
				{"isVFCVectorOGMVFCid25_1",1,284,-1},
				{"isVFCVectorCMDVFCid25_1",1,476,-1},
				{"isVFCVectorDPODVFCid53_1",1,112,-1},
				{"isVFCVectorDDRMVFCid17_1",1,20,-1},
				{"isVFCVectorPOTVFCid43_1",1,362,-1},
				{"isVFCVectorDDRMVFCid61_1",1,56,-1},
				{"isVFCVectorLPODVFCid9_1",1,140,-1},
				{"isVFCVectorDPODVFCid59_1",1,122,-1},
				{"isVFCVectorTRMVFCid5_1",1,384,-1},
				{"isVFCVectorDPODVFCid25_1",1,92,-1},
				{"isVFCVectorLPODVFCid18_1",1,147,-1},
				{"isVFCVectorLPODVFCid39_1",1,174,-1},
				{"isVFCVectorTRMVFCid28_1",1,409,-1},
				{"isVFCVectorTRMVFCid12_1",1,393,-1},
				{"isVFCVectorOGMVFCid42_1",1,299,-1},
				{"isVFCVectorOGMVFCid7_1",1,270,-1},
				{"isVFCVectorRDRMVFCid49_1",1,244,-1},
				{"isVFCVectorRDRMVFCid14_1",1,215,-1},
				{"isVFCVectorRDRMVFCid41_1",1,236,-1},
				{"isVFCVectorPOTVFCid41_1",1,364,-1},
				{"isVFCVectorDDRMVFCid13_1",1,8,-1},
				{"isVFCVectorDPODVFCid2_1",1,67,-1},
				{"isVFCVectorLPODVFCid13_1",1,136,-1},
				{"isVFCVectorDPODVFCid31_1",1,102,-1},
				{"isVFCVectorOGMVFCid52_1",1,305,-1},
				{"isVFCVectorDPODVFCid45_1",1,104,-1},
				{"isVFCVectorPOTVFCid28_1",1,345,-1},
				{"isVFCVectorOGMVFCid37_1",1,288,-1},
				{"isVFCVectorDPODVFCid37_1",1,96,-1},
				{"isVFCVectorDDRMVFCid1_1",1,4,-1},
				{"isVFCVectorPOTVFCid61_1",1,376,-1},
				{"isVFCVectorCMDVFCid24_1",1,477,-1},
				{"isVFCVectorRDRMVFCid48_1",1,245,-1},
				{"isVFCVectorTRMVFCid1_1",1,388,-1},
				{"isVFCVectorOGMBlockID_1",2,263,-1},
				{"isVFCVectorOGMVFCid23_1",1,286,-1},
				{"isVFCVectorRDRMVFCid60_1",1,249,-1},
				{"isVFCVectorRDRMVFCid20_1",1,209,-1},
				{"isVFCVectorTRMVFCid21_1",1,400,-1},
				{"isVFCVectorDDRMVFCid3_1",1,2,-1},
				{"isVFCVectorCMDVFCid17_1",1,468,-1},
				{"isVFCVectorCMDVFCid19_1",1,466,-1},
				{"isVFCVectorDDRMVFCid46_1",1,55,-1},
				{"isVFCVectorDPODVFCid57_1",1,124,-1},
				{"isVFCVectorRDRMVFCid29_1",1,216,-1},
				{"isVFCVectorPOTVFCid23_1",1,350,-1},
				{"isVFCVectorOGMVFCid60_1",1,313,-1},
				{"isVFCVectorPOTVFCid33_1",1,356,-1},
				{"isVFCVectorPOTVFCid10_1",1,331,-1},
				{"isVFCVectorDDRMVFCid25_1",1,28,-1},
				{"isVFCVectorTRMVFCid10_1",1,395,-1},
				{"isVFCVectorTRMVFCid43_1",1,426,-1},
				{"isVFCVectorLPODVFCid33_1",1,164,-1},
				{"isVFCVectorCMDVFCid13_1",1,456,-1},
				{"isVFCVectorCMDVFCid9_1",1,460,-1},
				{"isVFCVectorTRMVFCid8_1",1,397,-1},
				{"isVFCVectorTRMVFCid50_1",1,435,-1},
				{"isVFCVectorCMDVFCid7_1",1,462,-1},
				{"isVFCVectorLPODVFCid1_1",1,132,-1},
				{"isVFCVectorCMDVFCid53_1",1,496,-1},
				{"isVFCVectorDPODVFCid5_1",1,64,-1},
				{"isVFCVectorCMDVFCid16_1",1,469,-1},
				{"isVFCVectorRDRMVFCid50_1",1,243,-1},
				{"isVFCVectorPOTVFCid56_1",1,381,-1},
				{"isVFCVectorCMDVFCid22_1",1,479,-1},
				{"isVFCVectorTRMVFCid40_1",1,429,-1},
				{"isVFCVectorPOTVFCid44_1",1,361,-1},
				{"isVFCVectorPOTVFCid18_1",1,339,-1},
				{"isVFCVectorRDRMVFCid52_1",1,241,-1},
				{"isVFCVectorDPODVFCid14_1",1,87,-1},
				{"isVFCVectorOGMVFCid57_1",1,316,-1},
				{"isVFCVectorPOTVFCid21_1",1,336,-1},
				{"isVFCVectorLPODVFCid38_1",1,175,-1},
				{"isVFCVectorTRMVFCid3_1",1,386,-1},
				{"isVFCVectorRDRMVFCid56_1",1,253,-1},
				{"isVFCVectorDDRMVFCid15_1",1,22,-1},
				{"isVFCVectorOGMVFCid1_1",1,260,-1},
				{"isVFCVectorTRMVFCid29_1",1,408,-1},
				{"isVFCVectorOGMVFCid44_1",1,297,-1},
				{"isVFCVectorCMDVFCid48_1",1,501,-1},
				{"isVFCVectorCMDVFCid29_1",1,472,-1},
				{"isVFCVectorDPODVFCid4_1",1,65,-1},
				{"isVFCVectorPOTVFCid37_1",1,352,-1},
				{"isVFCVectorTRMVFCid26_1",1,411,-1},
				{"isVFCVectorCMDVFCid28_1",1,473,-1},
				{"isVFCVectorCMDVFCid55_1",1,510,-1},
				{"isVFCVectorCMDVFCid18_1",1,467,-1},
				{"isVFCVectorCMDVFCid45_1",1,488,-1},
				{"isVFCVectorCMDVFCid15_1",1,470,-1},
				{"isVFCVectorLPODVFCid11_1",1,138,-1},
				{"isVFCVectorPOTVFCid12_1",1,329,-1},
				{"isVFCVectorCMDVFCid51_1",1,498,-1},
				{"isVFCVectorOGMVFCid41_1",1,300,-1},
				{"isVFCVectorLPODVFCid40_1",1,173,-1},
				{"isVFCVectorLPODVFCid49_1",1,180,-1},
				{"isVFCVectorDDRMVFCid31_1",1,38,-1},
				{"isVFCVectorPOTVFCid13_1",1,328,-1},
				{"isVFCVectorTRMVFCid9_1",1,396,-1},
				{"isVFCVectorDDRMVFCid23_1",1,30,-1},
				{"isVFCVectorCMDVFCid2_1",1,451,-1},
				{"isVFCVectorRDRMVFCid38_1",1,239,-1},
				{"isVFCVectorLPODVFCid29_1",1,152,-1},
				{"isVFCVectorLPODVFCid30_1",1,167,-1},
				{"isVFCVectorTRMVFCid16_1",1,405,-1},
				{"isVFCVectorPOTVFCid59_1",1,378,-1},
				{"isVFCVectorPOTVFCid47_1",1,374,-1},
				{"isVFCVectorOGMVFCid54_1",1,319,-1},
				{"isVFCVectorCMDVFCid61_1",1,504,-1},
				{"isVFCVectorCMDVFCid3_1",1,450,-1},
				{"isVFCVectorOGMVFCid28_1",1,281,-1},
				{"isVFCVectorRDRMVFCid1_1",1,196,-1},
				{"isVFCVectorPOTVFCid15_1",1,342,-1},
				{"isVFCVectorRDRMVFCid44_1",1,233,-1},
				{"isVFCVectorPOTVFCid5_1",1,320,-1},
				{"isVFCVectorPOTVFCid24_1",1,349,-1},
				{"isVFCVectorPOTVFCid4_1",1,321,-1},
				{"isVFCVectorRDRMVFCid32_1",1,229,-1},
				{"isVFCVectorTRMVFCid24_1",1,413,-1},
				{"isVFCVectorDDRMVFCid0_1",1,5,-1},
				{"isVFCVectorOGMVFCid31_1",1,294,-1},
				{"isVFCVectorPOTVFCid54_1",1,383,-1},
				{"isVFCVectorTRMVFCid56_1",1,445,-1},
				{"isVFCVectorLPODVFCid56_1",1,189,-1},
				{"isVFCVectorTRMVFCid41_1",1,428,-1},
				{"isVFCVectorOGMVFCid47_1",1,310,-1},
				{"isVFCVectorPOTVFCid58_1",1,379,-1},
				{"isVFCVectorRDRMVFCid45_1",1,232,-1},
				{"isVFCVectorDDRMVFCid32_1",1,37,-1},
				{"isVFCVectorDPODVFCid56_1",1,125,-1},
				{"isVFCVectorDPODVFCid40_1",1,109,-1},
				{"isVFCVectorRDRMVFCid21_1",1,208,-1},
				{"isVFCVectorLPODVFCid0_1",1,133,-1},
				{"isVFCVectorCMDVFCid30_1",1,487,-1},
				{"isVFCVectorDDRMVFCid35_1",1,34,-1},
				{"isVFCVectorDPODVFCid61_1",1,120,-1},
				{"isVFCVectorDDRMVFCid47_1",1,54,-1},
				{"isVFCVectorTRMVFCid7_1",1,398,-1},
				{"isVFCVectorOGMVFCid43_1",1,298,-1},
				{"isVFCVectorTRMVFCid61_1",1,440,-1},
				{"isVFCVectorCMDVFCid5_1",1,448,-1},
				{"isVFCVectorDDRMVFCid4_1",1,1,-1},
				{"isVFCVectorPOTVFCid17_1",1,340,-1},
				{"isVFCVectorRDRMVFCid37_1",1,224,-1},
				{"isVFCVectorTRMVFCid19_1",1,402,-1},
				{"isVFCVectorCMDVFCid6_1",1,463,-1},
				{"isVFCVectorCMDVFCid41_1",1,492,-1},
				{"isVFCVectorLPODVFCid41_1",1,172,-1},
				{"isVFCVectorPOTVFCid3_1",1,322,-1},
				{"isVFCVectorDDRMVFCid20_1",1,17,-1},
				{"isVFCVectorTRMVFCid36_1",1,417,-1},
				{"isVFCVectorRDRMVFCid2_1",1,195,-1},
				{"isVFCVectorOGMVFCid49_1",1,308,-1},
				{"isVFCVectorPOTVFCid19_1",1,338,-1},
				{"isVFCVectorRDRMBlockID_1",2,199,-1},
				{"isVFCVectorRDRMVFCid61_1",1,248,-1},
				{"isVFCVectorDPODVFCid21_1",1,80,-1},
				{"isVFCVectorRDRMVFCid33_1",1,228,-1},
				{"isVFCVectorDDRMVFCid11_1",1,10,-1},
				{"isVFCVectorDPODVFCid15_1",1,86,-1},
				{"isVFCVectorTRMVFCid60_1",1,441,-1},
				{"isVFCVectorLPODVFCid48_1",1,181,-1},
				{"isVFCVectorLPODVFCid20_1",1,145,-1},
				{"isVFCVectorTRMVFCid18_1",1,403,-1},
				{"isVFCVectorPOTVFCid25_1",1,348,-1},
				{"isVFCVectorOGMVFCid10_1",1,267,-1},
				{"isVFCVectorPOTBlockID_1",2,327,-1},
				{"isVFCVectorDPODVFCid58_1",1,123,-1},
				{"isVFCVectorPOTVFCid20_1",1,337,-1},
				{"isVFCVectorRDRMVFCid17_1",1,212,-1},
				{"isVFCVectorDPODVFCid8_1",1,77,-1},
				{"isVFCVectorLPODVFCid52_1",1,177,-1},
				{"isVFCVectorDDRMVFCid41_1",1,44,-1},
				{"isVFCVectorDPODVFCid52_1",1,113,-1},
				{"isVFCVectorCMDVFCid26_1",1,475,-1},
				{"isVFCVectorDDRMVFCid56_1",1,61,-1},
				{"isVFCVectorOGMVFCid18_1",1,275,-1},
				{"isVFCVectorCMDVFCid60_1",1,505,-1},
				{"isVFCVectorDPODVFCid24_1",1,93,-1},
				{"isVFCVectorOGMVFCid59_1",1,314,-1},
				{"isVFCVectorOGMVFCid33_1",1,292,-1},
				{"isVFCVectorRDRMVFCid58_1",1,251,-1},
				{"isVFCVectorTRMVFCid47_1",1,438,-1},
				{"isVFCVectorCMDVFCid31_1",1,486,-1},
				{"isVFCVectorLPODBlockID_1",2,135,-1},
				{"isVFCVectorDPODVFCid33_1",1,100,-1},
				{"isVFCVectorTRMVFCid51_1",1,434,-1},
				{"isVFCVectorCMDVFCid44_1",1,489,-1}
			},
			{
				{"igVFCVectorLPOD_1","ZCUDZCUCANFD2SignalIPdu01",-1},
				{"igVFCVectorDPOD_1","ZCUDZCUCANFD2SignalIPdu01",-1},
				{"igVFCVectorTRM_1","ZCUDZCUCANFD2SignalIPdu01",-1},
				{"igVFCVectorRDRM_1","ZCUDZCUCANFD2SignalIPdu01",-1},
				{"igVFCVectorOGM_1","ZCUDZCUCANFD2SignalIPdu01",-1},
				{"igVFCVectorCMD_1","ZCUDZCUCANFD2SignalIPdu01",-1},
				{"igVFCVectorPOT_1","ZCUDZCUCANFD2SignalIPdu01",-1},
				{"igVFCVectorDDRM_1","ZCUDZCUCANFD2SignalIPdu01",-1}
			}
		},
		{"ZCU_CANFD2","ZcudLpodToDhuZCUCANFD2DiagResFr","Out",0x64a,64,0,1,4,0},
		{
			"ZCU_CANFD2","ZCUDZCUCANFD2Fr46","Out",0x368,64,250,1,0,0,80,8,
			{
				{"isFrntIntHCMLiRi24LED2_1",6,449,-1},
				{"isFrntIntHCMLiRi24LED7_1",6,483,-1},
				{"isFrntIntHCMLiRi18LED3_1",6,75,-1},
				{"isFrntIntHCMLiRi24LED6_1",6,473,-1},
				{"isFrntIntHCMLiRi18LED1_1",6,71,-1},
				{"isFrntIntHCMLiRi21LED2_1",6,257,-1},
				{"isFrntIntHCMLiRi23LED2_1",6,385,-1},
				{"isFrntIntHCMLiRi23LED6_1",6,409,-1},
				{"isFrntIntHCMLiRi22LED1_1",6,327,-1},
				{"isFrntIntHCMLiRi18LED7_1",6,99,-1},
				{"isFrntIntHCMLiRi22LED7_1",6,355,-1},
				{"isFrntIntHCMLiRi24LED8_1",6,493,-1},
				{"isFrntIntHCMLiRi22LED2_1",6,321,-1},
				{"isFrntIntHCMLiRi17LED10_1",6,49,-1},
				{"isFrntIntHCMLiRi17LED3_1",6,11,-1},
				{"isFrntIntHCMLiRi22LED6_1",6,345,-1},
				{"isFrntIntHCMLiRi17LED9_1",6,55,-1},
				{"isFrntIntHCMLiRi18LED9_1",6,119,-1},
				{"isFrntIntHCMLiRi21LED9_1",6,311,-1},
				{"isFrntIntHCMLiRi20LED9_1",6,247,-1},
				{"isFrntIntHCMLiRi17LED6_1",6,25,-1},
				{"isFrntIntHCMLiRi20LED4_1",6,213,-1},
				{"isFrntIntHCMLiRi19LED5_1",6,159,-1},
				{"isFrntIntHCMLiRi23LED9_1",6,439,-1},
				{"isFrntIntHCMLiRi17LED7_1",6,35,-1},
				{"isFrntIntHCMLiRi24LED1_1",6,455,-1},
				{"isFrntIntHCMLiRi20LED3_1",6,203,-1},
				{"isFrntIntHCMLiRi21LED10_1",6,305,-1},
				{"isFrntIntHCMLiRi20LED8_1",6,237,-1},
				{"isFrntIntHCMLiRi20LED6_1",6,217,-1},
				{"isFrntIntHCMLiRi19LED8_1",6,173,-1},
				{"isFrntIntHCMLiRi19LED2_1",6,129,-1},
				{"isFrntIntHCMLiRi23LED4_1",6,405,-1},
				{"isFrntIntHCMLiRi20LED5_1",6,223,-1},
				{"isFrntIntHCMLiRi24LED5_1",6,479,-1},
				{"isFrntIntHCMLiRi21LED1_1",6,263,-1},
				{"isFrntIntHCMLiRi19LED10_1",6,177,-1},
				{"isFrntIntHCMLiRi22LED3_1",6,331,-1},
				{"isFrntIntHCMLiRi20LED1_1",6,199,-1},
				{"isFrntIntHCMLiRi20LED10_1",6,241,-1},
				{"isFrntIntHCMLiRi18LED2_1",6,65,-1},
				{"isFrntIntHCMLiRi18LED5_1",6,95,-1},
				{"isFrntIntHCMLiRi17LED4_1",6,21,-1},
				{"isFrntIntHCMLiRi24LED3_1",6,459,-1},
				{"isFrntIntHCMLiRi21LED6_1",6,281,-1},
				{"isFrntIntHCMLiRi22LED5_1",6,351,-1},
				{"isFrntIntHCMLiRi23LED5_1",6,415,-1},
				{"isFrntIntHCMLiRi18LED6_1",6,89,-1},
				{"isFrntIntHCMLiRi20LED7_1",6,227,-1},
				{"isFrntIntHCMLiRi23LED8_1",6,429,-1},
				{"isFrntIntHCMLiRi17LED1_1",6,7,-1},
				{"isFrntIntHCMLiRi18LED10_1",6,113,-1},
				{"isFrntIntHCMLiRi18LED8_1",6,109,-1},
				{"isFrntIntHCMLiRi22LED10_1",6,369,-1},
				{"isFrntIntHCMLiRi23LED3_1",6,395,-1},
				{"isFrntIntHCMLiRi19LED4_1",6,149,-1},
				{"isFrntIntHCMLiRi17LED8_1",6,45,-1},
				{"isFrntIntHCMLiRi20LED2_1",6,193,-1},
				{"isFrntIntHCMLiRi21LED3_1",6,267,-1},
				{"isFrntIntHCMLiRi19LED9_1",6,183,-1},
				{"isFrntIntHCMLiRi23LED7_1",6,419,-1},
				{"isFrntIntHCMLiRi21LED5_1",6,287,-1},
				{"isFrntIntHCMLiRi24LED9_1",6,503,-1},
				{"isFrntIntHCMLiRi17LED5_1",6,31,-1},
				{"isFrntIntHCMLiRi23LED1_1",6,391,-1},
				{"isFrntIntHCMLiRi21LED4_1",6,277,-1},
				{"isFrntIntHCMLiRi19LED7_1",6,163,-1},
				{"isFrntIntHCMLiRi18LED4_1",6,85,-1},
				{"isFrntIntHCMLiRi24LED10_1",6,497,-1},
				{"isFrntIntHCMLiRi17LED2_1",6,1,-1},
				{"isFrntIntHCMLiRi19LED6_1",6,153,-1},
				{"isFrntIntHCMLiRi19LED1_1",6,135,-1},
				{"isFrntIntHCMLiRi21LED7_1",6,291,-1},
				{"isFrntIntHCMLiRi22LED9_1",6,375,-1},
				{"isFrntIntHCMLiRi24LED4_1",6,469,-1},
				{"isFrntIntHCMLiRi22LED4_1",6,341,-1},
				{"isFrntIntHCMLiRi19LED3_1",6,139,-1},
				{"isFrntIntHCMLiRi23LED10_1",6,433,-1},
				{"isFrntIntHCMLiRi22LED8_1",6,365,-1},
				{"isFrntIntHCMLiRi21LED8_1",6,301,-1}
			},
			{
				{"igFrntIntHCMLiRi17_1","ZCUDZCUCANFD2SignalIPdu46",59},
				{"igFrntIntHCMLiRi20_1","ZCUDZCUCANFD2SignalIPdu46",251},
				{"igFrntIntHCMLiRi24_1","ZCUDZCUCANFD2SignalIPdu46",507},
				{"igFrntIntHCMLiRi18_1","ZCUDZCUCANFD2SignalIPdu46",123},
				{"igFrntIntHCMLiRi21_1","ZCUDZCUCANFD2SignalIPdu46",315},
				{"igFrntIntHCMLiRi22_1","ZCUDZCUCANFD2SignalIPdu46",379},
				{"igFrntIntHCMLiRi23_1","ZCUDZCUCANFD2SignalIPdu46",443},
				{"igFrntIntHCMLiRi19_1","ZCUDZCUCANFD2SignalIPdu46",187}
			}
		},
		{
			"ZCU_CANFD2","ZCUDZCUCANFD2Fr28","Out",0x323,64,150,1,0,0,106,0,
			{
				{"isInternalErrDTCLeSts_1",8,71,137},
				{"isADC1DTCLeSts_1",3,327,324},
				{"isStsOfLedDaytiRunngLampWithLINLe_1",2,218,216},
				{"isCANCommErrDTCRiSts_1",1,122,121},
				{"isADC4DTCRiSts_1",3,347,344},
				{"isStsOfLedFrntFogLampWithLINLe_1",2,250,248},
				{"isHCMR2DTCGroup3_1",8,55,128},
				{"isSupply5VErrDTCLeSts_1",2,475,473},
				{"isStsOfLedCornrgLampwithLINRi_1",2,210,208},
				{"isDCMotrCtrlDTCLeSts_1",2,98,96},
				{"isSWVLMotrDTCRiSts_1",3,503,500},
				{"isHSD2DTCLeSts_1",3,383,380},
				{"isADC6DTCRiSts_1",3,363,360},
				{"isADC5DTCLeSts_1",3,359,356},
				{"isADC1DTCRiSts_1",3,323,320},
				{"isCH10DTCLeSts_1",4,103,99},
				{"isSwivelMotRiIninSts_1",1,481,480},
				{"isLevelMotLeIninSts_1",1,146,145},
				{"isStsOfLedFrntFogLampWithLINRi_1",2,258,256},
				{"isStsOfLedLoBeamWithLINLe_1",2,314,312},
				{"isDCMotrCtrlDTCRiSts_1",2,106,104},
				{"isCH7DTCRiSts_1",4,255,251},
				{"isSupplyInptDTCRiSts_1",2,495,493},
				{"isCH7DTCLeSts_1",4,247,243},
				{"isCVCH2DTCLeSts_1",4,311,307},
				{"isStsOfLedFrntTurnIndcrWithLINLe_1",2,282,280},
				{"isStsOfLedFrntAutoDrvMkrLampWithLINRi_1",2,242,240},
				{"isCVCH2DTCRiSts_1",4,319,315},
				{"isSeatHeatgLvlStsRowSecLe",2,511,488},
				{"isEpbRelsEnaSec_1",1,456,160},
				{"isADC3DTCLeSts_1",3,343,340},
				{"isStsOfLedHiBeamWithLINLe_1",2,298,296},
				{"isHSD2DTCRiSts_1",3,379,376},
				{"isMatrixADCErrDTCLeSts_1",4,455,451},
				{"isLobmE2EDTCRiSts_1",2,178,176},
				{"isADC5DTCRiSts_1",3,355,352},
				{"isCH10DTCRiSts_1",4,111,107},
				{"isCH12DTCRiSts_1",4,143,139},
				{"isCH3DTCRiSts_1",4,191,187},
				{"isSwivelMotLeIninSts_1",1,465,464},
				{"isADC2DTCRiSts_1",3,331,328},
				{"isStsOfLedFrntPosnLampWithLINRi_1",2,274,272},
				{"isSupply5VErrDTCRiSts_1",2,487,485},
				{"isCH11DTCRiSts_1",4,127,123},
				{"isHCMR2DTCGroup4_1",8,63,138},
				{"isHCML2DTCGroup3_1",8,23,112},
				{"isADC2DTCLeSts_1",3,335,332},
				{"isStsOfLedCornrgLampwithLINLe_1",2,202,200},
				{"isLMMCommDTCLeSts_1",16,391,144},
				{"isHCML2DTCGroup1_1",8,7,80},
				{"isCH6DTCRiSts_1",4,239,235},
				{"isHCML2DTCGroup2_1",8,15,88},
				{"isHCML2DTCGroup4_1",8,31,120},
				{"isCH3DTCLeSts_1",4,183,179},
				{"isBoostBuckErrDTCRiSts_1",6,95,89},
				{"isEpbApplyEnaSec_1",1,509,472},
				{"isCVCH1DTCRiSts_1",4,303,299},
				{"isHSD1DTCLeSts_1",3,375,372},
				{"isStsOfLedHiBeamWithLINRi_1",2,306,304},
				{"isInternalErrDTCRiSts_1",8,79,136},
				{"isStsOfLedLoBeamWithLINRi_1",2,450,448},
				{"isADC4DTCLeSts_1",3,351,348},
				{"isHCMR2DTCGroup2_1",8,47,129},
				{"isCH12DTCLeSts_1",4,135,131},
				{"isBrkSysWarnIndcnReqSec_1",1,506,505},
				{"isMatrixADCErrDTCRiSts_1",4,463,459},
				{"isStsOfWelGbyFrntWithLINLe_1",1,458,457},
				{"isCH5DTCLeSts_1",4,215,211},
				{"isStsOfLedFrntTurnIndcrWithLINRi_1",2,290,288},
				{"isStsOfLedDaytiRunngLampWithLINRi_1",2,226,224},
				{"isHSD1DTCRiSts_1",3,371,368},
				{"isADC3DTCRiSts_1",3,339,336},
				{"isCH6DTCLeSts_1",4,231,227},
				{"isSWVLMotrDTCLeSts_1",3,492,489},
				{"isCH1DTCLeSts_1",4,151,147},
				{"isBoostBuckErrDTCLeSts_1",6,87,81},
				{"isCH4DTCLeSts_1",4,199,195},
				{"isCH4DTCRiSts_1",4,207,203},
				{"isSupplyInptDTCLeSts_1",2,484,482},
				{"isCH2DTCRiSts_1",4,175,171},
				{"isCANCommErrDTCLeSts_1",1,114,113},
				{"isHCMR2DTCGroup1_1",8,39,130},
				{"isStsOfLedFrntAutoDrvMkrLampWithLINLe_1",2,234,232},
				{"isADC6DTCLeSts_1",3,367,364},
				{"isLobmE2EDTCLeSts_1",2,170,168},
				{"isCVCH1DTCLeSts_1",4,295,291},
				{"isStsOfWelGbyFrntWithLINRi_1",1,471,470},
				{"isCH5DTCRiSts_1",4,223,219},
				{"isLRDetctDTCRiSts_1",2,194,192},
				{"isLMMLedDTCRiSts_1",16,439,161},
				{"isCH1DTCRiSts_1",4,159,155},
				{"isCH8DTCRiSts_1",4,271,267},
				{"isCH11DTCLeSts_1",4,119,115},
				{"isCH9DTCRiSts_1",4,287,283},
				{"isCH2DTCLeSts_1",4,167,163},
				{"isSeatHeatgAvlStsRowSecLe",3,499,496},
				{"isCH9DTCLeSts_1",4,279,275},
				{"isLRDetctDTCLeSts_1",2,186,184},
				{"isLMMLedDTCLeSts_1",16,423,162},
				{"isStepLVLMotrDTCRiSts_1",3,479,476},
				{"isLMMCommDTCRiSts_1",16,407,152},
				{"isStsOfLedFrntPosnLampWithLINLe_1",2,266,264},
				{"isCH8DTCLeSts_1",4,263,259},
				{"isStepLVLMotrDTCLeSts_1",3,469,466},
				{"isBrkBoostErrIndcnReq_1",1,508,507},
				{"isLevelMotRiIninSts_1",1,154,153}
			},
			{
				{"","",-1}
			}
		},
		{
			"ZCU_CANFD2","ZCUDZCUCANFD2Fr14","Out",0x170,64,30,1,0,0,93,19,
			{
				{"isPassFrntHeiMotMoveReq",2,427,449},
				{"isADataRawSafeALat1Qf_3",2,62,-1},
				{"isPassFrntHeiMotPosReqTargPosReq",10,140,-1},
				{"isSecRowRiInclMotMoveReq_0",2,443,457},
				{"isTwbrWarnStsYesNo_1",2,387,-1},
				{"isDrvrSeatPosPercSeatPosSldPerc_0",10,83,-1},
				{"isAdjSpdLimnMsg_1",2,511,480},
				{"isActvnOfTechLiInfoDisp",2,423,421},
				{"isWinGlbCmd",3,415,412},
				{"isSecRowLeInclMotPosReqSpeed_0",8,293,-1},
				{"isADataRawSafeChks_3",8,42,-1},
				{"isSecRowLeSldMotPosReqSpeed_0",8,306,-1},
				{"isDrvrSeatPosPercSeatPosHeiPerc_0",10,77,-1},
				{"isTrRelsFailtoHMI_1",1,401,400},
				{"isAutoShowModPrpsnEna_1",1,506,505},
				{"isAdjSpdLimnStbOk_1",1,497,496},
				{"isLowrTailgAntiPnch_1",1,470,469},
				{"isPVMCVehCtrlSts3EarlyWarnAndDynCtrlFctSts_2",3,260,-1},
				{"isTwbrWarnStsCntr_1",4,391,-1},
				{"isPassInclMotPosReqSpeed",8,186,-1},
				{"isTiDrvgCycOff_2",16,367,384},
				{"isPassFrntHeiMotPosReqSpeed",8,146,-1},
				{"isSecRowLeInclMotMoveReq_0",2,447,459},
				{"isThrdRowLeVentnAutoSts_1",2,455,471},
				{"isPassInclMotPosReqTargPosReq",10,180,-1},
				{"isPassCushExtMotPosReqTargPosReq",10,98,-1},
				{"isCatchActvnSts_1",1,482,481},
				{"isAdjSpdLimnActvnOk_1",1,489,488},
				{"isPassHeiMotMoveReq",2,425,448},
				{"isPVMCVehCtrlSts3VehRollStabyFctSts_2",3,277,-1},
				{"isADataRawSafeAVertQf_3",2,58,-1},
				{"isPassLegRotMotPosReqTargPosReq",10,220,-1},
				{"isDoorSldngLeReStsFrstTmLveAbnd_1",1,491,-1},
				{"isPassLegRotMotPosReqSpeed",8,226,-1},
				{"isSeatMassgFctRowSecLeMassgProg_0",3,399,-1},
				{"isADataRawSafeALat_3",15,7,-1},
				{"isExtrLiRlySafe",1,273,272},
				{"isPassDiveMotPosReqTargPosReq",10,127,-1},
				{"isPassLegExtMotPosReqSpeed",8,213,-1},
				{"isFltEgyRstECUReq",1,313,312},
				{"isFltEgyRstRecReq",1,353,352},
				{"isDrvrSeatPosPercSeatPosSldQF_0",2,101,-1},
				{"isTwbrWarnStsChks_1",8,383,-1},
				{"isPVMCVehCtrlSts3RoadTypAndFricDetnFctSts_2",3,267,-1},
				{"isSecRowRiSldMotPosReqTargPosReq_0",10,340,-1},
				{"isPVMCVehCtrlSts3OffRoadCrsCtrlFctSts_2",3,270,-1},
				{"isFbOfMusicShow",2,420,418},
				{"isDrvrSeatPosPercSeatPosFrntHeiPerc_0",10,71,-1},
				{"isPassCushExtMotMoveReq",2,431,408},
				{"isSecRowRiSldMotPosReqSpeed_0",8,346,-1},
				{"isSecRowRiSldMotMoveReq_0",2,441,456},
				{"isDoorSldngLeReStsDoorOpenSts_1",4,495,-1},
				{"isThrdRowRiVentnAutoSts_1",2,453,417},
				{"isActnOfStopLampPass",1,233,232},
				{"isPassDiveMotMoveReq",2,429,392},
				{"isPassHeiMotPosReqTargPosReq",10,167,-1},
				{"isDrvrSeatPosPercSeatPosHeiQF_0",2,103,-1},
				{"isPVMCVehCtrlSts3TVCPrpsnDistbnFrntReFctSts_2",3,264,-1},
				{"isPVMCVehCtrlSts3GetOutOfStuckFctSts_2",3,257,-1},
				{"isUpprLowrTailgCtrlInhbFb_1",2,451,416},
				{"isSecRowLeSldMotMoveReq_0",2,445,458},
				{"isPassHeiMotPosReqSpeed",8,173,-1},
				{"isDoorSldngRiReStsDoorOpenSts_1",4,503,-1},
				{"isADataRawSafeALgt_3",15,8,-1},
				{"isActnOfAuxHiBeam",1,153,152},
				{"isSecRowRiInclMotPosReqSpeed_0",8,333,-1},
				{"isPassCushExtMotPosReqSpeed",8,104,-1},
				{"isSeatMassgFctRowSecLeMassgInten_0",2,396,-1},
				{"isActnOfLedLeLogoLampDyn_0",1,193,192},
				{"isPassSldMotPosReqTargPosReq",10,247,-1},
				{"isADataRawSafeCntr_3",4,50,-1},
				{"isPassInclMotMoveReq",2,439,463},
				{"isPassSldMotMoveReq",2,433,460},
				{"isPassLegExtMotMoveReq",2,437,462},
				{"isSecRowRiInclMotPosReqTargPosReq_0",10,327,-1},
				{"isSecRowLeInclMotPosReqTargPosReq_0",10,287,-1},
				{"isSecRowLeSldMotPosReqTargPosReq_0",10,300,-1},
				{"isDrvrSeatPosPercSeatPosFrntHeiQF_0",2,89,-1},
				{"isDoorSldngRiReStsFrstTmLveAbnd_1",1,499,-1},
				{"isLowrTailgObstclDetn_1",1,468,479},
				{"isLowrTailgOpenPosn_1",7,478,486},
				{"isPassSldMotPosReqSpeed",8,253,-1},
				{"isADataRawSafeALgt1Qf_3",2,60,-1},
				{"isPassLegExtMotPosReqTargPosReq",10,207,-1},
				{"isADataRawSafeAVert_3",15,25,-1},
				{"isSeatMassgFctRowSecLeOnOff_0",1,394,-1},
				{"isLowrTailgOpenerSts_1",4,467,487},
				{"isLowrTailgSts_1",2,485,483},
				{"isPassLegRotMotMoveReq",2,435,461},
				{"isActvnOfLedReAutDrvgLi",2,411,409},
				{"isSunCurtPosnSts_0",5,407,402},
				{"isAdjSpdLimnWarn_1",2,509,507},
				{"isPassDiveMotPosReqSpeed",8,133,-1}
			},
			{
				{"igPassInclMotPosReq","ZCUDZCUCANFD2SignalIPdu14",194},
				{"igPassFrntHeiMotPosReq","ZCUDZCUCANFD2SignalIPdu14",154},
				{"igPassSldMotPosReq","ZCUDZCUCANFD2SignalIPdu14",261},
				{"igPVMCVehCtrlSts3_2","ZCUDZCUCANFD2SignalIPdu14",274},
				{"igDoorSldngLeReSts_1","ZCUDZCUCANFD2SignalIPdu14",490},
				{"igPassDiveMotPosReq","ZCUDZCUCANFD2SignalIPdu14",141},
				{"igSecRowLeInclMotPosReq_0","ZCUDZCUCANFD2SignalIPdu14",301},
				{"igTwbrWarnSts_1","ZCUDZCUCANFD2SignalIPdu14",385},
				{"igSecRowRiInclMotPosReq_0","ZCUDZCUCANFD2SignalIPdu14",341},
				{"igPassLegRotMotPosReq","ZCUDZCUCANFD2SignalIPdu14",234},
				{"igDrvrSeatPosPerc_0","ZCUDZCUCANFD2SignalIPdu14",99},
				{"igPassLegExtMotPosReq","ZCUDZCUCANFD2SignalIPdu14",221},
				{"igSeatMassgFctRowSecLe_0","ZCUDZCUCANFD2SignalIPdu14",393},
				{"igDoorSldngRiReSts_1","ZCUDZCUCANFD2SignalIPdu14",498},
				{"igSecRowRiSldMotPosReq_0","ZCUDZCUCANFD2SignalIPdu14",354},
				{"igPassHeiMotPosReq","ZCUDZCUCANFD2SignalIPdu14",181},
				{"igADataRawSafe_3","ZCUDZCUCANFD2SignalIPdu14",56},
				{"igPassCushExtMotPosReq","ZCUDZCUCANFD2SignalIPdu14",112},
				{"igSecRowLeSldMotPosReq_0","ZCUDZCUCANFD2SignalIPdu14",314}
			}
		},
		{
			"ZCU_CANFD2","ZCUDZCUCANFD2Fr45","Out",0x367,64,250,1,0,0,80,8,
			{
				{"isFrntIntHCMLiRi12LED6_1",6,217,-1},
				{"isFrntIntHCMLiRi9LED3_1",6,11,-1},
				{"isFrntIntHCMLiRi14LED8_1",6,365,-1},
				{"isFrntIntHCMLiRi15LED8_1",6,429,-1},
				{"isFrntIntHCMLiRi10LED10_1",6,113,-1},
				{"isFrntIntHCMLiRi14LED5_1",6,351,-1},
				{"isFrntIntHCMLiRi11LED4_1",6,149,-1},
				{"isFrntIntHCMLiRi10LED2_1",6,65,-1},
				{"isFrntIntHCMLiRi15LED4_1",6,405,-1},
				{"isFrntIntHCMLiRi12LED9_1",6,247,-1},
				{"isFrntIntHCMLiRi10LED7_1",6,99,-1},
				{"isFrntIntHCMLiRi13LED7_1",6,291,-1},
				{"isFrntIntHCMLiRi16LED1_1",6,455,-1},
				{"isFrntIntHCMLiRi13LED6_1",6,281,-1},
				{"isFrntIntHCMLiRi11LED2_1",6,129,-1},
				{"isFrntIntHCMLiRi13LED8_1",6,301,-1},
				{"isFrntIntHCMLiRi16LED10_1",6,497,-1},
				{"isFrntIntHCMLiRi10LED6_1",6,89,-1},
				{"isFrntIntHCMLiRi14LED10_1",6,369,-1},
				{"isFrntIntHCMLiRi15LED10_1",6,433,-1},
				{"isFrntIntHCMLiRi16LED7_1",6,483,-1},
				{"isFrntIntHCMLiRi12LED10_1",6,241,-1},
				{"isFrntIntHCMLiRi14LED4_1",6,341,-1},
				{"isFrntIntHCMLiRi12LED7_1",6,227,-1},
				{"isFrntIntHCMLiRi9LED10_1",6,49,-1},
				{"isFrntIntHCMLiRi13LED5_1",6,287,-1},
				{"isFrntIntHCMLiRi16LED5_1",6,479,-1},
				{"isFrntIntHCMLiRi10LED5_1",6,95,-1},
				{"isFrntIntHCMLiRi13LED4_1",6,277,-1},
				{"isFrntIntHCMLiRi16LED2_1",6,449,-1},
				{"isFrntIntHCMLiRi12LED5_1",6,223,-1},
				{"isFrntIntHCMLiRi16LED8_1",6,493,-1},
				{"isFrntIntHCMLiRi10LED9_1",6,119,-1},
				{"isFrntIntHCMLiRi9LED6_1",6,25,-1},
				{"isFrntIntHCMLiRi11LED5_1",6,159,-1},
				{"isFrntIntHCMLiRi12LED3_1",6,203,-1},
				{"isFrntIntHCMLiRi14LED1_1",6,327,-1},
				{"isFrntIntHCMLiRi15LED1_1",6,391,-1},
				{"isFrntIntHCMLiRi15LED6_1",6,409,-1},
				{"isFrntIntHCMLiRi11LED7_1",6,163,-1},
				{"isFrntIntHCMLiRi12LED1_1",6,199,-1},
				{"isFrntIntHCMLiRi11LED3_1",6,139,-1},
				{"isFrntIntHCMLiRi10LED8_1",6,109,-1},
				{"isFrntIntHCMLiRi16LED3_1",6,459,-1},
				{"isFrntIntHCMLiRi13LED3_1",6,267,-1},
				{"isFrntIntHCMLiRi14LED6_1",6,345,-1},
				{"isFrntIntHCMLiRi15LED2_1",6,385,-1},
				{"isFrntIntHCMLiRi9LED9_1",6,55,-1},
				{"isFrntIntHCMLiRi11LED1_1",6,135,-1},
				{"isFrntIntHCMLiRi9LED4_1",6,21,-1},
				{"isFrntIntHCMLiRi9LED8_1",6,45,-1},
				{"isFrntIntHCMLiRi13LED10_1",6,305,-1},
				{"isFrntIntHCMLiRi11LED8_1",6,173,-1},
				{"isFrntIntHCMLiRi15LED9_1",6,439,-1},
				{"isFrntIntHCMLiRi11LED10_1",6,177,-1},
				{"isFrntIntHCMLiRi14LED3_1",6,331,-1},
				{"isFrntIntHCMLiRi9LED2_1",6,1,-1},
				{"isFrntIntHCMLiRi12LED4_1",6,213,-1},
				{"isFrntIntHCMLiRi13LED9_1",6,311,-1},
				{"isFrntIntHCMLiRi10LED4_1",6,85,-1},
				{"isFrntIntHCMLiRi15LED7_1",6,419,-1},
				{"isFrntIntHCMLiRi14LED2_1",6,321,-1},
				{"isFrntIntHCMLiRi9LED1_1",6,7,-1},
				{"isFrntIntHCMLiRi14LED7_1",6,355,-1},
				{"isFrntIntHCMLiRi11LED9_1",6,183,-1},
				{"isFrntIntHCMLiRi15LED3_1",6,395,-1},
				{"isFrntIntHCMLiRi13LED2_1",6,257,-1},
				{"isFrntIntHCMLiRi12LED2_1",6,193,-1},
				{"isFrntIntHCMLiRi10LED1_1",6,71,-1},
				{"isFrntIntHCMLiRi14LED9_1",6,375,-1},
				{"isFrntIntHCMLiRi16LED9_1",6,503,-1},
				{"isFrntIntHCMLiRi15LED5_1",6,415,-1},
				{"isFrntIntHCMLiRi11LED6_1",6,153,-1},
				{"isFrntIntHCMLiRi12LED8_1",6,237,-1},
				{"isFrntIntHCMLiRi13LED1_1",6,263,-1},
				{"isFrntIntHCMLiRi10LED3_1",6,75,-1},
				{"isFrntIntHCMLiRi9LED7_1",6,35,-1},
				{"isFrntIntHCMLiRi16LED6_1",6,473,-1},
				{"isFrntIntHCMLiRi9LED5_1",6,31,-1},
				{"isFrntIntHCMLiRi16LED4_1",6,469,-1}
			},
			{
				{"igFrntIntHCMLiRi12_1","ZCUDZCUCANFD2SignalIPdu45",251},
				{"igFrntIntHCMLiRi15_1","ZCUDZCUCANFD2SignalIPdu45",443},
				{"igFrntIntHCMLiRi16_1","ZCUDZCUCANFD2SignalIPdu45",507},
				{"igFrntIntHCMLiRi13_1","ZCUDZCUCANFD2SignalIPdu45",315},
				{"igFrntIntHCMLiRi9_1","ZCUDZCUCANFD2SignalIPdu45",59},
				{"igFrntIntHCMLiRi10_1","ZCUDZCUCANFD2SignalIPdu45",123},
				{"igFrntIntHCMLiRi11_1","ZCUDZCUCANFD2SignalIPdu45",187},
				{"igFrntIntHCMLiRi14_1","ZCUDZCUCANFD2SignalIPdu45",379}
			}
		},
		{"ZCU_CANFD2","ZCUDZCUCANFD2Fr18","Out",0x43,64,0,1,1,0},
		{"ZCU_CANFD2","ZcudWpcToDhuZCUCANFD2DiagResFr","Out",0x62b,64,0,1,4,0},
		{"ZCU_CANFD2","ZcudHcmrToDhuZCUCANFD2DiagResFr","Out",0x6b4,64,0,1,4,0},
		{
			"ZCU_CANFD2","ZCUDZCUCANFD2Fr19","Out",0x2e5,64,100,1,0,0,121,12,
			{
				{"isRowSecRiSeatInAutMovmt",1,409,408},
				{"isAutoManStsDoorLeRe_0",1,305,304},
				{"isTrsmNOutp_1",15,56,-1},
				{"isHiBeamSwt_1",1,474,473},
				{"isDoorDrvrRelsFailCinchOverTimed",1,439,-1},
				{"isDoorDrvrReSecOpnSts_1",1,379,378},
				{"isFrntWiprLvrCmd2FrntWiprLvrCntr_1",2,172,-1},
				{"isIDcDcAvlMaxLoSide_1",12,183,187},
				{"isGVMCSteerCtrlModCfmdChks_1",8,487,-1},
				{"isAgDataRawSafeRollRateQf_3",2,43,-1},
				{"isAutoManStsDoorRiRe_0",1,372,371},
				{"isTCSTNowSts_1",8,279,430},
				{"isRowThrdRiSeatAutMovmtStsPosCtrlSts",3,231,-1},
				{"isIDcDcActLoSideChks_2",8,147,-1},
				{"isErsStrtRes",5,287,282},
				{"isTCSDoorNoClsSts",1,419,418},
				{"isRowThrdLeSeatAutMovmtStsFunctionID",8,203,-1},
				{"isDoorDrvrAcsKeylsSts",1,355,354},
				{"isDoorRiRePosnProgmReq_0",1,387,386},
				{"isRowThrdLeSeatAutMovmtStsPosCtrlSts",3,211,-1},
				{"isSeatOccptAtRowThrdRi2_1",2,346,344},
				{"isReSunCurtPosnSts",5,303,298},
				{"isIntFailrOfLeReKickSnsr_1",1,503,502},
				{"isDrvrSeatInAutMovmt",1,385,384},
				{"isTCSModSwtSts_1",2,364,362},
				{"isDoorDrvrSecOpnSts_1",1,377,376},
				{"isDoorLeReAcsKeylsReq",2,455,453},
				{"isDoorDrvrRePercPosn2_1",7,511,504},
				{"isIDcDcActLoSideIDcDcActLoSide_2",12,143,-1},
				{"isDoorLeReCinhIntFailInfCinchFlt1_1",1,452,-1},
				{"isTcsClsdSrcSts",4,351,347},
				{"isDoorDrvrRelsFailMechRels",1,437,-1},
				{"isSeatOccptAtRowThrdLe2_1",2,330,328},
				{"isDoorRiReAcsKeylsReq",2,471,469},
				{"isHvBattSocEngStart_1",11,199,204},
				{"isChdLockRightPopUpReq",1,225,224},
				{"isIDcDcActLoSideCntr_2",4,155,-1},
				{"isDoorLeReOpenLowReqOutdSwt1",2,463,461},
				{"isDoorMaxOpnSetStsDrvrRe_1",7,263,256},
				{"isTrsmNOutpOk_1",1,92,-1},
				{"isImobRemMgrChkImobDataRemMgrChk4",8,122,-1},
				{"isGVMCSteerCtrlModCfmdMainSts_1",2,489,-1},
				{"isWshrFldTankStsToHMI",1,417,416},
				{"isDoorRiReAcsKeylsSts",1,468,467},
				{"isDoorDrvrAcsKeylsSwtSts",1,425,424},
				{"isCenLockSwt_1",1,479,478},
				{"isKnkDetnSts_1",2,498,496},
				{"isDlyClsActv",1,383,382},
				{"isObstStrDetcnDrvr2_1",1,395,394},
				{"isRemAllowStrt",1,415,414},
				{"isRemChrgStrtReq",1,413,412},
				{"isDoorLeRePosnProgmReq_0",1,391,390},
				{"isDoorLeReRelsFailMechRels",1,433,-1},
				{"isDoorLeReAcsKeylsSts",1,441,440},
				{"isSunCurtMvngSts",1,423,422},
				{"isFrntSunCurtPosnSts",5,295,290},
				{"isDrvrDoorSpindleMotorFault_1",4,335,331},
				{"isTrsmNInp_1",15,55,-1},
				{"isCmptmtRelHum_1",8,247,352},
				{"isDoorDrvrSwtIntrLockgReq",2,444,442},
				{"isTrsmNInpOk_1",1,93,-1},
				{"isImobRemMgrChkImobDataRemMgrChk1",8,98,-1},
				{"isAutoManStsDoorPass",1,361,360},
				{"isTCSTmrOverSts",5,311,306},
				{"isGVMCSteerCtrlModCfmdGVMCSteerCtrlModCfmd_1",2,491,-1},
				{"isSunRoofMvngSts",1,421,420},
				{"isDoorLeReCinhIntFailInfCinchRestFlt_1",1,451,-1},
				{"isFrntWiprLvrCmd2FrntWiprLvrCrc_1",8,167,-1},
				{"isKickDetnLeReSts_1",2,501,499},
				{"isAltFltT_1",1,297,296},
				{"isAltFltMecl_1",1,289,288},
				{"isPanicAlrmSts",1,403,402},
				{"isAltFltElec_1",1,281,280},
				{"isDoorMaxOpnSetStsDrvr_1",7,255,248},
				{"isRowThrdRiSeatAutMovmtStsFunctionID",8,223,-1},
				{"isObstStrDrvr_1",1,407,406},
				{"isDoorDrvrCinhIntFailInfCinchRestFlt_1",1,446,-1},
				{"isObstStrDrvrRe_1",1,405,404},
				{"isCabPressPodCalc_0",3,359,356},
				{"isDoorOpenerDrvrReSts2_1",4,327,323},
				{"isDoorLeReRelsFailCinchOverTimed",1,435,-1},
				{"isMonrCycCmpl_1",1,399,398},
				{"isOnBdChrgrSt_1",4,343,339},
				{"isDoorPassAcsKeylsSts",1,449,448},
				{"isCnvnReq_1",3,429,426},
				{"isTrsmNCntr_1",4,81,-1},
				{"isTankFlapSts_2",2,367,365},
				{"isCrashUnlckFailrSts",2,322,320},
				{"isAgDataRawSafeYawRateQf_3",2,41,-1},
				{"isAgDataRawSafeRollRate_3",16,7,-1},
				{"isDoorDrvrReHoldingSts_1",1,381,380},
				{"isImobRemMgrChkImobDataRemMgrChk3",8,114,-1},
				{"isDoorPassAcsKeylsReq",2,460,458},
				{"isImobRemMgrChkSts",2,130,-1},
				{"isChdLockLeftPopUpReq",1,227,226},
				{"isDoorDrvrRelsFailFailure1",1,438,-1},
				{"isTCSTmrStrtSts",2,375,373},
				{"isTrsmNChks_1",8,73,-1},
				{"isAgDataRawSafeChks_3",8,39,-1},
				{"isDoorDrvrReCloseReqInsdSwt_1",2,186,184},
				{"isObstStrDetcnDrvrRe2_1",1,393,392},
				{"isFrntWiprLvrCmd2FrntWiprLvrQf_1",2,170,-1},
				{"isPassSeatInAutMovmt",1,401,400},
				{"isDrvrSeatHeatgAutoSts",2,465,466},
				{"isFrntWiprLvrCmd2FrntWiprLvrCmd1_1",3,175,-1},
				{"isRowSecLeSeatInAutMovmt",1,411,410},
				{"isAgDataRawSafeYawRate_3",16,23,-1},
				{"isImobRemMgrChkImobDataRemMgrChk0",8,90,-1},
				{"isDoorLeReRelsFailFailure1",1,434,-1},
				{"isDoorPassAcsKeylsSwtSts",1,457,456},
				{"isNotifForEmgyCall_1",1,397,396},
				{"isChdPrtnLeftFailStsToHmi",2,236,234},
				{"isDiagcSigLSM2_1",2,477,475},
				{"isImobRemMgrChkImobDataRemMgrChk2",8,106,-1},
				{"isGVMCSteerCtrlModCfmdCntr_1",4,495,-1},
				{"isAgDataRawSafeCntr_3",4,47,-1},
				{"isDoorDrvrAcsKeylsReq",2,338,336},
				{"isDigKeyPasEntryDiSts",1,370,369},
				{"isChdLockRightFailStsToHmi",2,239,237},
				{"isDoorDrvrCinhIntFailInfCinchFlt1_1",1,447,-1},
				{"isDoorPassPosnProgmReq",1,389,388}
			},
			{
				{"igGVMCSteerCtrlModCfmd_1","ZCUDZCUCANFD2SignalIPdu19",233},
				{"igDoorLeReRelsFail","ZCUDZCUCANFD2SignalIPdu19",432},
				{"igDoorDrvrRelsFail","ZCUDZCUCANFD2SignalIPdu19",436},
				{"igTrsmN_1","ZCUDZCUCANFD2SignalIPdu19",91},
				{"igRowThrdRiSeatAutMovmtSts","ZCUDZCUCANFD2SignalIPdu19",228},
				{"igAgDataRawSafe_3","ZCUDZCUCANFD2SignalIPdu19",232},
				{"igRowThrdLeSeatAutMovmtSts","ZCUDZCUCANFD2SignalIPdu19",208},
				{"igIDcDcActLoSide_2","ZCUDZCUCANFD2SignalIPdu19",368},
				{"igDoorLeReCinhIntFailInf_1","ZCUDZCUCANFD2SignalIPdu19",450},
				{"igFrntWiprLvrCmd2_1","ZCUDZCUCANFD2SignalIPdu19",168},
				{"igImobRemMgrChk","ZCUDZCUCANFD2SignalIPdu19",128},
				{"igDoorDrvrCinhIntFailInf_1","ZCUDZCUCANFD2SignalIPdu19",445}
			}
		},
		{
			"ZCU_CANFD2","ZCUDZCUCANFD2Fr26","Out",0x281,64,80,1,0,0,109,11,
			{
				{"isRowSecLeBtnPsd",1,231,230},
				{"isThrdRowSeatVentnDesPwrCnsLe_1",8,335,403},
				{"isPassSeatAdjmtLimnWarn",1,219,218},
				{"isSteerWhlInMovmt",1,95,94},
				{"isKeyEnaStsKey2",2,243,-1},
				{"isEmgyBrkLiIndcrTurn_0",2,127,125},
				{"isBattDchaAbty_1",2,99,97},
				{"isThrdRowSeatVentnDesPwrCnsRi_1",8,343,402},
				{"isThrdRowSeatHeatgActlPwrCnsRi_1",8,239,56},
				{"isLvlgFctAvl",1,131,130},
				{"isTrlrPrmntPwrActv_1",1,389,388},
				{"isSeatRowThrdRiSldPosPercSeatPosQf",2,293,-1},
				{"isKeyEnaStsKey8",2,263,-1},
				{"isTopPosHmiFeedBack_1",3,363,360},
				{"isRowSecLeSeatAutMovmtStsPosCtrlSts",3,196,-1},
				{"isDoorDrvrPercPosn2_1",7,23,16},
				{"isCmptmtFrntWindDewT",11,3,8},
				{"isBattAgeSts_1",3,103,100},
				{"isThrdRowSeatVentnActlPwrCnsLe_1",8,319,189},
				{"isActvnOfApproach_0",1,170,169},
				{"isPassSeatSwtSts2PassSeatSwtSldSts",2,47,-1},
				{"isThrdRowSeatVentnActlPwrCnsRi_1",8,327,192},
				{"isActnOfReRegPlateLamp",1,172,171},
				{"isDrvrSeatBtnPsd",1,105,104},
				{"isTrlrLiFltSts_1",3,371,368},
				{"isPassSeatAutMovmtStsFunctionID",8,159,-1},
				{"isRWA2SysStsR2FctModCfmd_1",5,479,-1},
				{"isTrlrFogLiSts_1",1,225,224},
				{"isTrlrLampActvtChk_1",1,379,378},
				{"isThrdSeatRiPosCalResp_1",3,367,364},
				{"isDrvrSeatAutMovmtStsPosCtrlSts",3,147,-1},
				{"isDoorLeReHndlCmd",2,93,91},
				{"isDstTrvldVldFromSftyBkp_1",1,135,134},
				{"isRowSecLeHeiPosPercSeatPosPerc_1",10,439,-1},
				{"isActvnOfRvsg",1,181,180},
				{"isTankFlapLockgCmd",3,359,356},
				{"isTrlrSrvReq_1",1,399,398},
				{"isAudWarn",1,179,178},
				{"isTrlrLeIndcrFltSts_1",1,377,376},
				{"isSteerWhlBtnPsd",1,65,64},
				{"isThrdRowSeatHeatgActlPwrCnsLe_1",8,87,49},
				{"isMobDevVentReq",1,191,190},
				{"isKeyEnaStsKey4",2,255,-1},
				{"isKeyEnaStsKey9",2,261,-1},
				{"isDrvrStrtReq",2,79,77},
				{"isKeyEnaStsKey1",2,245,-1},
				{"isSeatMassgFctDrvrOnOff_0",1,58,-1},
				{"isWinPosnStsAtDrvrRe",5,129,140},
				{"isDrvrSeatAdjmtLimnWarn",1,221,220},
				{"isTrlrRvsgLiSts_1",1,385,384},
				{"isRowSecRiBtnPsd",1,227,226},
				{"isPassSeatSwtSts2PassSeatSwtHeiSts",2,37,-1},
				{"isRWA2SysStsR2MaiSts_1",3,474,-1},
				{"isRowSecLeSeatAutMovmtStsFunctionID",8,188,-1},
				{"isDoorRiReHndlCmd",2,175,173},
				{"isSeatRowThrdLeSldPosPercSeatPosQf",2,277,-1},
				{"isLvlgFctSts",2,124,122},
				{"isTrlrLampChkSts_1",3,375,372},
				{"isChrgLidCombLockCmd",3,44,41},
				{"isTrlrIndcrTurnSts_1",2,274,272},
				{"isDstTrvldFromSftyBkp_1",21,415,426},
				{"isTrlrPosnLiSts_1",1,391,390},
				{"isRowSecRiSeatAutMovmtStsFunctionID",8,207,-1},
				{"isVehActvMsgToDrvr",2,290,288},
				{"isSeatRowThrdRiSldPosPercSeatPosPerc",10,287,-1},
				{"isKeyEnaStsKey6",2,251,-1},
				{"isPassSeatAutMovmtStsPosCtrlSts",3,167,-1},
				{"isTrlrBrkLiSts_1",1,121,120},
				{"isTopPosHmiFeedBack2_1",7,351,344},
				{"isPassSeatSwtSts2PassSeatSwtHdrstVertSts",2,25,-1},
				{"isRowSecRiSeatAutMovmtStsPosCtrlSts",3,215,-1},
				{"isKeyEnaStsKey11",2,257,-1},
				{"isSeatMassgFctDrvrMassgProg_0",3,63,-1},
				{"isThrdSeatLePosCalResp_1",3,355,352},
				{"isPassSeatSwtSts2PassSeatSwtHeiFrntSts",2,39,-1},
				{"isActvnOfSideLogo",2,55,53},
				{"isPassSeatSwtSts2PassSeatSwtAdjmtOfSpplFctHozlSts",2,31,-1},
				{"isChrgnLtgSts",2,52,50},
				{"isDoorHandleSensorSts",8,119,40},
				{"isWinFailrStsAtDrvrRe",1,405,404},
				{"isTrlrRiIndcrFltSts_1",1,387,386},
				{"isRowSecLeMassgRunng",1,229,228},
				{"isWinDsblRightCmd",1,407,406},
				{"isDrvrSeatAutMovmtStsFunctionID",8,139,-1},
				{"isTwbrRelsBtn_1",1,397,396},
				{"isDrvrMassgRunng",1,223,222},
				{"isSeatMassgFctDrvrMassgInten_0",2,60,-1},
				{"isRowSecLeHeiPosPercSeatPosQf_1",2,445,-1},
				{"isThermoTSteDeoSts2_1",8,471,96},
				{"isWelGbySetSts",1,395,394},
				{"isKeyEnaStsKey10",2,259,-1},
				{"isKeyEnaStsKey3",2,241,-1},
				{"isWelGbyModeSetSts",4,76,72},
				{"isThrdRowSeatHeatgDesPwrCnsLe_1",8,303,160},
				{"isSeatRowThrdLeSldPosPercSeatPosPerc",10,271,-1},
				{"isPassSeatBtnPsd",1,217,216},
				{"isPassSeatSwtSts2PassSeatSwtHdrstHozlSts",2,27,-1},
				{"isKeyEnaStsKey0",2,247,-1},
				{"isSemiElecTwbrPosn_1",3,211,208},
				{"isPassSeatSwtSts2PassSeatSwtInclSts",2,35,-1},
				{"isKeyEnaStsKey7",2,249,-1},
				{"isPassSeatSwtSts2PassSeatSwtSelnOfSpplFctStsSts",2,33,-1},
				{"isDoorPassHndlCmd",2,163,161},
				{"isThrdRowSeatHeatgDesPwrCnsRi_1",8,311,168},
				{"isKeyEnaStsKey5",2,253,-1},
				{"isWinDsblLeftCmd",1,393,392},
				{"isWinHwSwtDrvrReForPassRe",3,383,380},
				{"isPassSeatSwtSts2PassSeatSwtAdjmtOfSpplFctVerSts",2,29,-1},
				{"isDoorLeReOpenReqInsdSwt1",2,90,88}
			},
			{
				{"igSeatRowThrdLeSldPosPerc","ZCUDZCUCANFD2SignalIPdu26",275},
				{"igSeatRowThrdRiSldPosPerc","ZCUDZCUCANFD2SignalIPdu26",291},
				{"igRowSecLeSeatAutMovmtSts","ZCUDZCUCANFD2SignalIPdu26",193},
				{"igRowSecRiSeatAutMovmtSts","ZCUDZCUCANFD2SignalIPdu26",212},
				{"igSeatMassgFctDrvr_0","ZCUDZCUCANFD2SignalIPdu26",57},
				{"igPassSeatSwtSts2","ZCUDZCUCANFD2SignalIPdu26",45},
				{"igRowSecLeHeiPosPerc_1","ZCUDZCUCANFD2SignalIPdu26",443},
				{"igDrvrSeatAutMovmtSts","ZCUDZCUCANFD2SignalIPdu26",144},
				{"igPassSeatAutMovmtSts","ZCUDZCUCANFD2SignalIPdu26",164},
				{"igKeyEnaSts","ZCUDZCUCANFD2SignalIPdu26",48},
				{"igRWA2SysStsR2_1","ZCUDZCUCANFD2SignalIPdu26",111}
			}
		},
		{
			"ZCU_CANFD2","ZCUDZCUCANFD2Fr52","Out",0x4c2,64,1000,1,0,0,76,8,
			{
				{"isKeyTransportKline",1,421,420},
				{"isSteerLockReqNotSafeSteerLockDataReq1",8,66,-1},
				{"isIntLightTreadPlateSupply",7,255,248},
				{"isAmbTURaw_1",12,348,352},
				{"isSteerLockReqNotSafeSteerLockDataReq2",8,74,-1},
				{"isSteerLockReqNotSafeSteerLockDataReq0",8,58,-1},
				{"isZCUDDiagSignalFLTRecSts",1,418,-1},
				{"isWindCorrnValHud_1",8,319,-1},
				{"isWiprInWipgAr_1",1,333,332},
				{"isSteerLockEnagOfPrpsn_1",2,274,272},
				{"isReAdaptReq_1",1,291,290},
				{"isSteerLockReqNotSafeSteerLockDataReq6",8,106,-1},
				{"isPwrNormDesVisy",11,187,192},
				{"isSuspStabyCritFailrDetdCntr_1",4,383,-1},
				{"isSteerLockReqNotSafeSteerLockDataReq3",8,82,-1},
				{"isSteerLockReqSteerLockDataReq6_1",8,53,-1},
				{"isKeyReadReqFromKeyRmn",4,279,275},
				{"isWipgPwrActvnNotSafeAcsyMode",1,327,-1},
				{"isTrlrLiFogActvt_0",1,410,409},
				{"isSteerLockReqSteerLockDataReq5_1",8,45,-1},
				{"isSteerLockReqCommand_1",2,61,-1},
				{"isSteerLockReqSteerLockDataReq2_1",8,21,-1},
				{"isWiprInPrkgPosnLo_1",1,335,334},
				{"isSteerLockReqNotSafeSteerLockDataReq4",8,90,-1},
				{"isPropsEnabfromAlcoLock",1,293,292},
				{"isSteerLockEnagOfPrpsnNotSafe",2,282,280},
				{"isUsgModDeactvnQly",2,351,349},
				{"isPwrEstimdAtStbForVisy",11,183,188},
				{"isSunRoofAndCurtExtCmd",4,391,387},
				{"isZCUDDiagSignalFltCfmSts",1,419,-1},
				{"isSuspStabyCritFailrDetdChks_1",8,375,-1},
				{"isPwrCnsVisy",11,159,164},
				{"isTrlrLiPosnActvt_0",2,403,401},
				{"isPwrCritDesVisy",11,163,168},
				{"isWipgPwrActvnNotSafeDrvgMod",1,326,-1},
				{"isEgyLvlElecDrvInfo",2,429,427},
				{"isCarModDynoReq",3,447,444},
				{"isPanicAlrmToExtrLiVisReq",8,263,289},
				{"isTrlrLiRvsgActvt_0",1,423,422},
				{"isSteerLockReqSteerLockDataReq0_1",8,5,-1},
				{"isSteerLockReqSteerLockDataReq3_1",8,29,-1},
				{"isRelHumSnsrErr_1",1,496,384},
				{"isFltOfCenHiMntdStopLamp1",1,405,404},
				{"isMirrPosnAdjFromSetTarPosnDrvrMirrAdjUpDown",14,129,-1},
				{"isWindCorrnValFrnt_1",8,311,-1},
				{"isIntLightDrvSideDoorSupply",7,207,200},
				{"isIntLightLuggageSupply",7,231,224},
				{"isIntrBriStsFromIf",4,271,267},
				{"isRemStrtMsgToDrvrRemStrtDev1",2,459,-1},
				{"isTrlrLiBrkActvt_0",1,426,425},
				{"isIntLightReDrvSideSupply",7,247,240},
				{"isActnOfCenHiMntdStopLamp1",1,395,394},
				{"isSteerLockReqSteerLockDataReq4_1",8,37,-1},
				{"isRemStrtMsgToDrvrRemStrtBlkd1",4,463,-1},
				{"isIntLightFootwellSupply",7,223,216},
				{"isSteerLockReqSteerLockDataReq1_1",8,13,-1},
				{"isIntLightDrvSideSupply",7,215,208},
				{"isWiprActvMech",1,322,321},
				{"isTrlrModVMMFltSts",1,431,430},
				{"isKeyReadReqFromKeyWarn",4,287,283},
				{"isWindCorrnValAmb_1",8,303,-1},
				{"isRainSnsrLiThd_1",4,415,411},
				{"isRainSensActvn_1",1,386,385},
				{"isMirrSeldIndcn_0",2,266,264},
				{"isWiprActv_1",1,324,323},
				{"isWiprPosnForSrvReq_1",1,399,398},
				{"isHvActvForVehModReq_1",1,295,294},
				{"isSuspStabyCritFailrDetdSts_1",1,379,-1},
				{"isCarModDispdWdDispd",4,439,435},
				{"isMirrPosnAdjFromSetTarPosnDrvrMirrAdjLeRi",14,127,-1},
				{"isSumActv_0",1,7,6},
				{"isSteerLockReqNotSafeSteerLockDataReq5",8,98,-1},
				{"isSteerLockReqNotSafeCommand",2,114,-1},
				{"isIntLightReDrvDoorSupply",7,239,232},
				{"isTankFlapReqFromSwtIntrFild_1",1,377,376},
				{"isUsgModChgReqFromRFK",1,416,424}
			},
			{
				{"igMirrPosnAdjFromSetTarPosnDrvr","ZCUDZCUCANFD2SignalIPdu52",147},
				{"igRemStrtMsgToDrvr","ZCUDZCUCANFD2SignalIPdu52",457},
				{"igSteerLockReqNotSafe","ZCUDZCUCANFD2SignalIPdu52",112},
				{"igZCUDDiagSignal","ZCUDZCUCANFD2SignalIPdu52",417},
				{"igSuspStabyCritFailrDetd_1","ZCUDZCUCANFD2SignalIPdu52",378},
				{"igWipgPwrActvnNotSafe","ZCUDZCUCANFD2SignalIPdu52",325},
				{"igSteerLockReq_1","ZCUDZCUCANFD2SignalIPdu52",59},
				{"igWindCorrnVal_1","ZCUDZCUCANFD2SignalIPdu52",288}
			}
		},
		{"ZCU_CANFD2","ZcudSrsToDhuISO26021ZCUCanFD2ResFr","Out",0x7f9,8,0,1,4,0},
		{"ZCU_CANFD2","ZCUDZCUCANFD2PduR1000Fr29","Out",0x4e3,64,0,1,1,0},
		{"ZCU_CANFD2","ZCUDZCUCANFD2PduR1000Fr24","Out",0x4be,64,0,1,1,0},
		{"ZCU_CANFD2","ZCUDZCUCANFD2PduR10000Fr21","Out",0x4f0,64,0,1,1,0},
		{"ZCU_CANFD2","ZcudCrpmToDhuZCUCANFD2DiagResFr","Out",0x626,64,0,1,4,0},
		{"ZCU_CANFD2","ZCUDZCUCANFD2Fr73","Out",0x9a,64,0,1,1,0},
		{
			"ZCU_CANFD2","ZCUDZCUCANFD2Fr76","Out",0x264,64,80,1,0,0,118,12,
			{
				{"isKeyReadStsToLockgBLEKey11",2,17,-1},
				{"isLockgFbToExtLi",3,218,225},
				{"isKeyReadStsToLockgNFCKey26",2,131,-1},
				{"isKeyReadStsToLockgKey4",2,199,-1},
				{"isKeyReadStsToLockgBLEKey37",2,77,-1},
				{"isKeyReadStsToLockgBLEKey1",2,5,-1},
				{"isKeyReadStsToLockgBLEKey18",2,35,-1},
				{"isKeyReadStsToLockgBLEKey0",2,7,-1},
				{"isDigKeyApproachReqDigKeyApproaReq",4,223,-1},
				{"isKeyReadStsToLockgKey3",2,185,-1},
				{"isKeyReadStsToLockgNFCKey14",2,107,-1},
				{"isKeyReadStsToLockgNFCKey12",2,111,-1},
				{"isBLEKeyBtnTrStsAndKeyIdKeyId4",6,239,-1},
				{"isKeyReadStsToLockgNFCKey35",2,145,-1},
				{"isKeyReadStsToLockgNFCKey8",2,103,-1},
				{"isKeyReadStsToLockgBLEKey15",2,25,-1},
				{"isKeyReadStsToLockgBLEKey22",2,43,-1},
				{"isKeyReadStsToLockgNFCKey3",2,81,-1},
				{"isKeyReadStsToLockgNFCKey27",2,129,-1},
				{"isKeyReadStsToLockgBLEKey31",2,57,-1},
				{"isMobDevBtnUnlckStsAndKeyIdKeyId4",6,279,-1},
				{"isKeyReadStsToLockgNFCKey11",2,97,-1},
				{"isBtnUnlckStsAndKeyIdKeyId",4,231,-1},
				{"isKeyReadStsToLockgBLEKey28",2,63,-1},
				{"isKeyReadStsToLockgBLEKey10",2,19,-1},
				{"isDoorLockUnlockCmdNFCKeyPrsntSts1",2,169,-1},
				{"isKeyReadStsToLockgNFCKey1",2,85,-1},
				{"isKeyReadStsToLockgNFCKey30",2,139,-1},
				{"isKeyReadStsToLockgBLEKey4",2,15,-1},
				{"isDoorLockUnlockCmdNFCPsdNotPsd",1,183,-1},
				{"isKeyReadStsToLockgBLEKey24",2,55,-1},
				{"isKeyReadStsToLockgNFCKey25",2,133,-1},
				{"isKeyReadStsToLockgBLEKey25",2,53,-1},
				{"isBtnLockStsAndKeyIdKeyId",4,165,-1},
				{"isKeyReadStsToLockgNFCKey38",2,155,-1},
				{"isKeyReadStsToLockgBLEKey33",2,69,-1},
				{"isKeyReadStsToLockgBLEKey27",2,49,-1},
				{"isKeyReadStsToLockgBLEKey35",2,65,-1},
				{"isKeyReadStsToLockgNFCKey39",2,153,-1},
				{"isMobDevRoofOpnClsReq",2,250,248},
				{"isKeyReadStsToLockgBLEKey14",2,27,-1},
				{"isKeyReadStsToLockgNFCKey33",2,149,-1},
				{"isKeyReadStsToLockgNFCKey23",2,121,-1},
				{"isKeyReadStsToLockgNFCKey17",2,117,-1},
				{"isBtnLockStsAndKeyIdBtnSts",1,161,-1},
				{"isDigKeyApproachReqKeyId4",6,213,-1},
				{"isMobDevOpenClsCmftReq",2,287,285},
				{"isUWBApproachTailgateReqUWBApproachTailgateReq",3,258,-1},
				{"isKeyReadStsToLockgNFCKey34",2,147,-1},
				{"isKeyReadStsToLockgNFCKey32",2,151,-1},
				{"isOpenClsCmftReqOpenClsCmftReq",2,181,-1},
				{"isKeyReadStsToLockgNFCKey18",2,115,-1},
				{"isKeyReadStsToLockgKey9",2,205,-1},
				{"isKeyReadStsToLockgNFCKey10",2,99,-1},
				{"isMobDevBtnLockStsAndKeyIdKeyId4",6,247,-1},
				{"isOpenClsCmftReqOpenClsCmftTrigSrc",2,179,-1},
				{"isKeyReadStsToLockgNFCKey22",2,123,-1},
				{"isMobDevBtnTrReq",3,263,260},
				{"isKeyReadStsToLockgNFCKey0",2,87,-1},
				{"isKeyReadStsToLockgNFCKey19",2,113,-1},
				{"isKeyReadStsToLockgBLEKey21",2,45,-1},
				{"isKeyReadStsToLockgNFCKey7",2,89,-1},
				{"isKeyReadStsToLockgBLEKey3",2,1,-1},
				{"isKeyReadStsToLockgBLEKey30",2,59,-1},
				{"isKeyReadStsToLockgBLEKey29",2,61,-1},
				{"isKeyReadStsToLockgNFCKey37",2,157,-1},
				{"isKeyReadStsToLockgNFCKey16",2,119,-1},
				{"isKeyReadStsToLockgBLEKey9",2,21,-1},
				{"isKeyReadStsToLockgNFCKey6",2,91,-1},
				{"isKeyReadStsToLockgNFCKey31",2,137,-1},
				{"isKeyReadStsToLockgBLEKey32",2,71,-1},
				{"isKeyReadStsToLockgBLEKey34",2,67,-1},
				{"isKeyReadStsToLockgKey11",2,201,-1},
				{"isKeyReadStsToLockgBLEKey23",2,41,-1},
				{"isKeyReadStsToLockgKey10",2,203,-1},
				{"isKeyReadStsToLockgKey0",2,191,-1},
				{"isKeyReadStsToLockgBLEKey7",2,9,-1},
				{"isKeyReadStsToLockgKey7",2,193,-1},
				{"isKeyReadStsToLockgBLEKey2",2,3,-1},
				{"isKeyReadStsToLockgNFCKey9",2,101,-1},
				{"isBtnUnlckStsAndKeyIdBtnSts",1,227,-1},
				{"isBLEKeyBtnTrStsAndKeyIdBLEBtnSts",2,233,-1},
				{"isKeyReadStsToLockgNFCKey24",2,135,-1},
				{"isHoodSwt1",2,284,282},
				{"isKeyReadStsToLockgKey6",2,195,-1},
				{"isKeyReadStsToLockgKey1",2,189,-1},
				{"isDoorLockUnlockCmdNFCKeyId4",6,175,-1},
				{"isKeyReadStsToLockgNFCKey13",2,109,-1},
				{"isKeyReadStsToLockgNFCKey36",2,159,-1},
				{"isKeyReadStsToLockgBLEKey12",2,31,-1},
				{"isKeyReadStsToLockgBLEKey19",2,33,-1},
				{"isKeyReadStsToLockgNFCKey5",2,93,-1},
				{"isKeyReadStsToLockgKey8",2,207,-1},
				{"isTrHndlOutdOpenSts",1,215,214},
				{"isKeyReadStsToLockgBLEKey39",2,73,-1},
				{"isRearCurtOpenPosnCmd_1",5,255,265},
				{"isKeyReadStsToLockgBLEKey6",2,11,-1},
				{"isKeyReadStsToLockgNFCKey15",2,105,-1},
				{"isKeyReadStsToLockgNFCKey21",2,125,-1},
				{"isKeyReadStsToLockgNFCKey29",2,141,-1},
				{"isKeyReadStsToLockgBLEKey8",2,23,-1},
				{"isKeyReadStsToLockgKey2",2,187,-1},
				{"isKeyReadStsToLockgBLEKey38",2,75,-1},
				{"isKeyReadStsToLockgBLEKey16",2,39,-1},
				{"isUWBApproachTailgateReqKeyId4",6,271,-1},
				{"isKeyReadStsToLockgNFCKey28",2,143,-1},
				{"isKeyReadStsToLockgBLEKey20",2,47,-1},
				{"isKeyReadStsToLockgBLEKey26",2,51,-1},
				{"isMobDevBtnLockStsAndKeyIdPsdNotPsd",1,241,-1},
				{"isKeyReadStsToLockgNFCKey4",2,95,-1},
				{"isKeyReadStsToLockgBLEKey5",2,13,-1},
				{"isKeyReadStsToLockgNFCKey2",2,83,-1},
				{"isMobDevBtnUnlckStsAndKeyIdPsdNotPsd",1,273,-1},
				{"isKeyReadStsToLockgBLEKey36",2,79,-1},
				{"isKeyReadStsToLockgKey5",2,197,-1},
				{"isKeyReadStsToLockgBLEKey13",2,29,-1},
				{"isKeyReadStsToLockgBLEKey17",2,37,-1},
				{"isKeyReadStsToLockgNFCKey20",2,127,-1}
			},
			{
				{"igKeyReadStsToLockg","ZCUDZCUCANFD2SignalIPdu76",176},
				{"igUWBApproachTailgateReq","ZCUDZCUCANFD2SignalIPdu76",259},
				{"igBtnUnlckStsAndKeyId","ZCUDZCUCANFD2SignalIPdu76",226},
				{"igKeyReadStsToLockgNFC","ZCUDZCUCANFD2SignalIPdu76",166},
				{"igBLEKeyBtnTrStsAndKeyId","ZCUDZCUCANFD2SignalIPdu76",224},
				{"igMobDevBtnUnlckStsAndKeyId","ZCUDZCUCANFD2SignalIPdu76",272},
				{"igDigKeyApproachReq","ZCUDZCUCANFD2SignalIPdu76",219},
				{"igKeyReadStsToLockgBLE","ZCUDZCUCANFD2SignalIPdu76",167},
				{"igOpenClsCmftReq","ZCUDZCUCANFD2SignalIPdu76",177},
				{"igDoorLockUnlockCmdNFC","ZCUDZCUCANFD2SignalIPdu76",182},
				{"igBtnLockStsAndKeyId","ZCUDZCUCANFD2SignalIPdu76",160},
				{"igMobDevBtnLockStsAndKeyId","ZCUDZCUCANFD2SignalIPdu76",240}
			}
		},
		{
			"ZCU_CANFD2","ZCUDZCUCANFD2Fr55","Out",0x4c5,64,1000,1,0,0,166,14,
			{
				{"isActnOfRvsgLampDrv",1,393,392},
				{"isKeyReadStsToKeyRmnKey9",2,125,-1},
				{"isMobDevKeyEnaStsKey23",2,41,-1},
				{"isMirrCmdAtDrvrMirrFoldCmd",2,258,-1},
				{"isSunRoofEna_1",2,423,421},
				{"isWiprMotFrntLvrCmdSafeLvrInIntlPosn_1",1,315,-1},
				{"isBtnLockSts",1,435,434},
				{"isMobDevKeyEnaStsKey22",2,43,-1},
				{"isAlrmToExtrLiVisReq",8,231,280},
				{"isActnOfLoBeamDrvCntr",4,191,-1},
				{"isMobDevKeyEnaStsKey1",2,5,-1},
				{"isKeyReadStsToKeyRmnKey11",2,121,-1},
				{"isActnOfHiBeamDrv",1,329,328},
				{"isWshrHeatgSig",8,279,504},
				{"isMobDevKeyEnaStsKey27",2,49,-1},
				{"isTrOpenerReqTrigSrc_0",3,311,-1},
				{"isActnOfLoBeamDrvChks",8,183,-1},
				{"isKeyDiReqKey9",1,222,-1},
				{"isKeyReadStsToVmmKey7",2,161,-1},
				{"isTrNoKeyPrsntAcoustReq_0",1,481,480},
				{"isMobDevKeyEnaStsKey36",2,79,-1},
				{"isMobDevKeyEnaStsKey8",2,23,-1},
				{"isBattLoStsKey4",2,95,-1},
				{"isCarLoctrToExtrLiVisReq",8,247,304},
				{"isErsLockReqByKey",1,449,448},
				{"isMobDevKeyEnaStsKey19",2,33,-1},
				{"isSnsrInclnCmd_1",1,485,484},
				{"isMobDevKeyEnaStsKey13",2,29,-1},
				{"isWshngCycActv_1",1,499,498},
				{"isMobDevKeyEnaStsKey32",2,71,-1},
				{"isAmbTForVisy_1",8,239,288},
				{"isTrOpenerReqTrOpenerReq_0",3,308,-1},
				{"isKeyReadStsToVmmKey4",2,167,-1},
				{"isKeyDiReqKey4",1,211,-1},
				{"isSunRoofAndCurtPosnCmdOpenPerc",5,271,-1},
				{"isWiprMotFrntLvrCmdSafeLvrInHiSpdPosnSafe_1",2,319,-1},
				{"isActvnOfAlrmReqFromCmplxIf",1,409,408},
				{"isRlyActvnForRoofCurtClsAut",1,487,486},
				{"isMobDevKeyEnaStsKey17",2,37,-1},
				{"isBattLoStsKey6",2,91,-1},
				{"isMobDevKeyEnaStsKey2",2,3,-1},
				{"isWshrLvrPosnSafe_1",2,431,429},
				{"isMobDevKeyEnaStsKey16",2,39,-1},
				{"isActnOfStopLampDrv",1,401,400},
				{"isSnsrIntrScanCmdWinPosn_1",1,203,-1},
				{"isSnsrIntrScanCmdTemp_1",8,199,-1},
				{"isMobDevKeyEnaStsKey33",2,69,-1},
				{"isKeyDiReqKey3",1,212,-1},
				{"isKeyReadStsToVmmKey1",2,157,-1},
				{"isKeyDiReqKey5",1,210,-1},
				{"isKeyReadStsToKeyRmnKey0",2,111,-1},
				{"isMobDevKeyEnaStsKey30",2,59,-1},
				{"isSnsrSoundrBattBackedCmdSoundReq_1",1,298,-1},
				{"isKeyReadStsToKeyWarnKey9",2,149,-1},
				{"isActnOfRePosnLampDrv",1,337,336},
				{"isKeyReadStsToKeyWarnKey11",2,145,-1},
				{"isBattLoStsKey8",2,103,-1},
				{"isKeyReadStsToKeyRmnKey6",2,115,-1},
				{"isSunCurtEna_1",2,412,410},
				{"isKeyReadStsToKeyWarnKey8",2,151,-1},
				{"isActnOfLoBeamDrvOnOff",1,187,-1},
				{"isKeyReadStsToKeyWarnKey6",2,139,-1},
				{"isKeyDiReqKey6",1,209,-1},
				{"isKeyReadStsToKeyRmnKey7",2,113,-1},
				{"isActnOfFrntSideMkrLampDrv",1,321,320},
				{"isEnaOfflineMonitor_1",1,451,450},
				{"isBattLoStsKey7",2,89,-1},
				{"isMobDevKeyEnaStsKey5",2,13,-1},
				{"isKeyDiReqKey7",1,208,-1},
				{"isBattLoStsKey11",2,97,-1},
				{"isAlrmTrsnMode_1",1,426,425},
				{"isAlrmToExtrLiFbVisReq",3,367,364},
				{"isWiprMotErrSafeMech",2,420,418},
				{"isBattLoStsKey5",2,93,-1},
				{"isBattLoStsKey10",2,99,-1},
				{"isKeyReadStsToKeyRmnKey1",2,109,-1},
				{"isSnsrSoundrBattBackedCmdChrgReq_1",1,299,-1},
				{"isActnOfDaytiRunngLampDrv",1,185,184},
				{"isKeyReadStsToKeyRmnKey10",2,123,-1},
				{"isAntithftActvnReq",1,439,438},
				{"isKeyReadStsToKeyRmnKey4",2,119,-1},
				{"isSunRoofAndCurtPosnCmdSel",2,266,-1},
				{"isMobDevKeyEnaStsKey4",2,15,-1},
				{"isKeyReadStsToKeyRmnKey8",2,127,-1},
				{"isKeyReadStsToKeyWarnKey0",2,135,-1},
				{"isKeyReadStsToVmmKey8",2,175,-1},
				{"isKeyReadStsToVmmKey6",2,163,-1},
				{"isWshngCycActvMech",1,497,496},
				{"isSnsrIntrScanCmdArmReq_1",1,206,-1},
				{"isMobDevKeyEnaStsKey21",2,45,-1},
				{"isBattLoStsKey9",2,101,-1},
				{"isSnsrSoundrBattBackedCmdChirpTyp_1",3,303,-1},
				{"isKeyReadStsToVmmKey9",2,173,-1},
				{"isBattLoStsKey1",2,85,-1},
				{"isKeyReadStsToKeyRmnKey3",2,105,-1},
				{"isMobDevKeyEnaStsKey39",2,73,-1},
				{"isWiprMotFrntLvrCmdSafeLvrInSnglStrokePos_1",1,314,-1},
				{"isBattLoStsKey0",2,87,-1},
				{"isSnsrIntrScanCmdCurtRollUpDwn_1",1,205,-1},
				{"isBattLoStsKey2",2,83,-1},
				{"isKeyDiReqKey10",1,221,-1},
				{"isKeyReadStsToKeyWarnKey4",2,143,-1},
				{"isWipgPwrActvnSafeWipgPwrAcsyModSafe_1",2,351,-1},
				{"isMobDevKeyEnaStsKey14",2,27,-1},
				{"isMobDevKeyEnaStsKey31",2,57,-1},
				{"isMobDevKeyEnaStsKey3",2,1,-1},
				{"isMobDevKeyEnaStsKey35",2,65,-1},
				{"isMobDevKeyEnaStsKey38",2,75,-1},
				{"isWiprMotRelayMech",1,501,500},
				{"isKeyDiReqKey2",1,213,-1},
				{"isSnsrIntrScanCmdAirFanSts_1",1,207,-1},
				{"isKeyReadStsToVmmKey2",2,155,-1},
				{"isKeyReadStsToKeyWarnKey5",2,141,-1},
				{"isMobDevKeyEnaStsKey15",2,25,-1},
				{"isMobDevKeyEnaStsKey28",2,63,-1},
				{"isKeyDiReqKey0",1,215,-1},
				{"isKeyReadStsToKeyWarnKey7",2,137,-1},
				{"isMobDevKeyEnaStsKey26",2,51,-1},
				{"isFacQlyForDoorDrvrSts",2,415,413},
				{"isMirrCmdAtDrvrMirrDwnCmd",2,260,-1},
				{"isWiprMotFrntLvrCmdSafeLvrInLoSpdPosnSafe_1",2,317,-1},
				{"isKeyReadStsToKeyRmnKey5",2,117,-1},
				{"isKeyDiReqKey1",1,214,-1},
				{"isWshrLvrPosnNotSafe",1,509,508},
				{"isKeyReadStsToKeyWarnKey3",2,129,-1},
				{"isIceBreakDoorDrvrActv",1,477,476},
				{"isMobDevKeyEnaStsKey25",2,53,-1},
				{"isKeyDiReqKey11",1,220,-1},
				{"isMobDevKeyEnaStsKey9",2,21,-1},
				{"isMirrCmdAtDrvrMirrPosAdjCmd",3,263,-1},
				{"isMobDevKeyEnaStsKey6",2,11,-1},
				{"isKeyDiReqKey8",1,223,-1},
				{"isSnsrSoundrBattBackedCmdArmCmd_1",1,300,-1},
				{"isBtnErsReq",2,354,352},
				{"isMobDevKeyEnaStsKey18",2,35,-1},
				{"isKeyReadStsToVmmKey10",2,171,-1},
				{"isActnOfReSideMkrLampDrv",1,385,384},
				{"isBattLoStsKey3",2,81,-1},
				{"isMobDevKeyEnaStsKey0",2,7,-1},
				{"isWiprMotIntlCmd_1",3,379,376},
				{"isTrPosnUpprProgmReq_0",1,495,494},
				{"isMobDevKeyEnaStsKey34",2,67,-1},
				{"isKeyReadStsToKeyWarnKey2",2,131,-1},
				{"isMobDevKeyEnaStsKey20",2,47,-1},
				{"isKeyReadStsToKeyWarnKey1",2,133,-1},
				{"isMobDevKeyEnaStsKey12",2,31,-1},
				{"isKeyReadStsToKeyWarnKey10",2,147,-1},
				{"isWshrFldLvlDetdLo",1,511,510},
				{"isMobDevKeyEnaStsKey24",2,55,-1},
				{"isWipgPwrActvnSafeWipgPwrDrvgModSafe_1",2,349,-1},
				{"isKeyReadStsToVmmKey0",2,159,-1},
				{"isMobDevKeyEnaStsKey7",2,9,-1},
				{"isMobDevKeyEnaStsKey37",2,77,-1},
				{"isKeyPollingFailReason",5,335,330},
				{"isKeyReadStsToVmmKey5",2,165,-1},
				{"isSnsrIntrScanCmdRoofPosn_1",1,204,-1},
				{"isCarLoctrReq",2,391,389},
				{"isActnOfFrntPosnLampDrv",1,201,200},
				{"isMobDevKeyEnaStsKey10",2,19,-1},
				{"isKeyReadStsToVmmKey11",2,169,-1},
				{"isKeyReadStsToKeyRmnKey2",2,107,-1},
				{"isMobDevKeyEnaStsKey29",2,61,-1},
				{"isKeyReadStsToVmmKey3",2,153,-1},
				{"isMobDevKeyEnaStsKey11",2,17,-1},
				{"isWiprMotFrntOffsAg_1",4,359,355},
				{"isWiprInWipgArMech",1,489,488}
			},
			{
				{"igSnsrSoundrBattBackedCmd_1","ZCUDZCUCANFD2SignalIPdu55",297},
				{"igWiprMotFrntLvrCmdSafe_1","ZCUDZCUCANFD2SignalIPdu55",313},
				{"igSunRoofAndCurtPosnCmd","ZCUDZCUCANFD2SignalIPdu55",264},
				{"igBattLoSts","ZCUDZCUCANFD2SignalIPdu55",296},
				{"igKeyReadStsToKeyWarn","ZCUDZCUCANFD2SignalIPdu55",507},
				{"igActnOfLoBeamDrv","ZCUDZCUCANFD2SignalIPdu55",186},
				{"igTrOpenerReq_0","ZCUDZCUCANFD2SignalIPdu55",305},
				{"igKeyDiReq","ZCUDZCUCANFD2SignalIPdu55",219},
				{"igMirrCmdAtDrvr","ZCUDZCUCANFD2SignalIPdu55",256},
				{"igWipgPwrActvnSafe_1","ZCUDZCUCANFD2SignalIPdu55",347},
				{"igSnsrIntrScanCmd_1","ZCUDZCUCANFD2SignalIPdu55",202},
				{"igKeyReadStsToKeyRmn","ZCUDZCUCANFD2SignalIPdu55",424},
				{"igKeyReadStsToVmm","ZCUDZCUCANFD2SignalIPdu55",506},
				{"igMobDevKeyEnaSts","ZCUDZCUCANFD2SignalIPdu55",505}
			}
		},
		{
			"ZCU_CANFD2","ZCUDZCUCANFD2VFCVectorFr","Out",0x544,8,1000,1,0,0,63,1,
			{
				{"isVFCVectorZCUDMVFCid11_6",1,13,-1},
				{"isVFCVectorZCUDMVFCid59_6",1,61,-1},
				{"isVFCVectorZCUDMVFCid34_6",1,36,-1},
				{"isVFCVectorZCUDMVFCid43_6",1,45,-1},
				{"isVFCVectorZCUDMVFCid3_6",1,5,-1},
				{"isVFCVectorZCUDMVFCid13_6",1,15,-1},
				{"isVFCVectorZCUDMBlockID_6",2,1,-1},
				{"isVFCVectorZCUDMVFCid35_6",1,37,-1},
				{"isVFCVectorZCUDMVFCid19_6",1,21,-1},
				{"isVFCVectorZCUDMVFCid17_6",1,19,-1},
				{"isVFCVectorZCUDMVFCid44_6",1,46,-1},
				{"isVFCVectorZCUDMVFCid37_6",1,39,-1},
				{"isVFCVectorZCUDMVFCid46_6",1,48,-1},
				{"isVFCVectorZCUDMVFCid51_6",1,53,-1},
				{"isVFCVectorZCUDMVFCid61_6",1,63,-1},
				{"isVFCVectorZCUDMVFCid60_6",1,62,-1},
				{"isVFCVectorZCUDMVFCid27_6",1,29,-1},
				{"isVFCVectorZCUDMVFCid6_6",1,8,-1},
				{"isVFCVectorZCUDMVFCid22_6",1,24,-1},
				{"isVFCVectorZCUDMVFCid25_6",1,27,-1},
				{"isVFCVectorZCUDMVFCid54_6",1,56,-1},
				{"isVFCVectorZCUDMVFCid41_6",1,43,-1},
				{"isVFCVectorZCUDMVFCid33_6",1,35,-1},
				{"isVFCVectorZCUDMVFCid21_6",1,23,-1},
				{"isVFCVectorZCUDMVFCid7_6",1,9,-1},
				{"isVFCVectorZCUDMVFCid57_6",1,59,-1},
				{"isVFCVectorZCUDMVFCid0_6",1,2,-1},
				{"isVFCVectorZCUDMVFCid26_6",1,28,-1},
				{"isVFCVectorZCUDMVFCid1_6",1,3,-1},
				{"isVFCVectorZCUDMVFCid38_6",1,40,-1},
				{"isVFCVectorZCUDMVFCid52_6",1,54,-1},
				{"isVFCVectorZCUDMVFCid12_6",1,14,-1},
				{"isVFCVectorZCUDMVFCid18_6",1,20,-1},
				{"isVFCVectorZCUDMVFCid30_6",1,32,-1},
				{"isVFCVectorZCUDMVFCid4_6",1,6,-1},
				{"isVFCVectorZCUDMVFCid48_6",1,50,-1},
				{"isVFCVectorZCUDMVFCid32_6",1,34,-1},
				{"isVFCVectorZCUDMVFCid2_6",1,4,-1},
				{"isVFCVectorZCUDMVFCid20_6",1,22,-1},
				{"isVFCVectorZCUDMVFCid50_6",1,52,-1},
				{"isVFCVectorZCUDMVFCid49_6",1,51,-1},
				{"isVFCVectorZCUDMVFCid58_6",1,60,-1},
				{"isVFCVectorZCUDMVFCid29_6",1,31,-1},
				{"isVFCVectorZCUDMVFCid9_6",1,11,-1},
				{"isVFCVectorZCUDMVFCid14_6",1,16,-1},
				{"isVFCVectorZCUDMVFCid15_6",1,17,-1},
				{"isVFCVectorZCUDMVFCid56_6",1,58,-1},
				{"isVFCVectorZCUDMVFCid42_6",1,44,-1},
				{"isVFCVectorZCUDMVFCid36_6",1,38,-1},
				{"isVFCVectorZCUDMVFCid53_6",1,55,-1},
				{"isVFCVectorZCUDMVFCid16_6",1,18,-1},
				{"isVFCVectorZCUDMVFCid10_6",1,12,-1},
				{"isVFCVectorZCUDMVFCid5_6",1,7,-1},
				{"isVFCVectorZCUDMVFCid28_6",1,30,-1},
				{"isVFCVectorZCUDMVFCid39_6",1,41,-1},
				{"isVFCVectorZCUDMVFCid40_6",1,42,-1},
				{"isVFCVectorZCUDMVFCid45_6",1,47,-1},
				{"isVFCVectorZCUDMVFCid55_6",1,57,-1},
				{"isVFCVectorZCUDMVFCid31_6",1,33,-1},
				{"isVFCVectorZCUDMVFCid24_6",1,26,-1},
				{"isVFCVectorZCUDMVFCid47_6",1,49,-1},
				{"isVFCVectorZCUDMVFCid8_6",1,10,-1},
				{"isVFCVectorZCUDMVFCid23_6",1,25,-1}
			},
			{
				{"igVFCVectorZCUDM_6","ZCUDZCUCANFD2VFCVectorSignalIPdu",-1}
			}
		},
		{"ZCU_CANFD2","ZCUDZCUCANFD2PduR1000Fr12","Out",0x45f,64,0,1,1,0},
		{"ZCU_CANFD2","ZcudDdrmToDhuZCUCANFD2DiagResFr","Out",0x648,64,0,1,4,0},
		{"ZCU_CANFD2","ZcudOgmToDhuZCUCANFD2DiagResFr","Out",0x63c,64,0,1,4,0},
		{"ZCU_CANFD2","ZcudSdlToDhuZCUCANFD2DiagResFr","Out",0x623,64,0,1,4,0},
		{"ZCU_CANFD2","ZCUDZCUCANFD2PduR120Fr05","Out",0x28f,64,0,1,1,0},
		{"ZCU_CANFD2","ZcudTcmbToDhuZCUCANFD2DiagResFr","Out",0x62a,64,0,1,4,0},
		{"ZCU_CANFD2","ZCUDZCUCANFD2PduR500Fr08","Out",0x35b,64,0,1,1,0},
		{"ZCU_CANFD2","ZCUDZCUCANFD2PduR1000Fr30","Out",0x4e6,64,0,1,1,0},
		{"ZCU_CANFD2","ZCUDZCUCANFD2PduR1000Fr11","Out",0x46e,64,0,1,1,0},
		{"ZCU_CANFD2","ZCUDZCUCANFD2PduR1000Fr17","Out",0x3af,64,0,1,1,0},
		{"ZCU_CANFD2","ZcudBbsToDhuZCUCANFD2DiagResFr","Out",0x653,64,0,1,4,0},
		{"ZCU_CANFD2","ZCUDZCUCANFD2PduR1000Fr14","Out",0x3ca,64,0,1,1,0},
		{"ZCU_CANFD2","ZcudZcuCANFD2NmFr01","Out",0x504,8,0,1,3,0},
		{"ZCU_CANFD2","ZCUDZCUCANFD2PduR1000Fr10","Out",0x47c,64,0,1,1,0},
		{
			"ZCU_CANFD2","ZCUDZCUCANFD2Fr07","Out",0x5a,64,10,1,0,0,71,11,
			{
				{"isIntgtIMUDataRawSafeCntr_2",4,386,-1},
				{"isPtBrkTqReqToFriCntr_1",4,424,-1},
				{"isIsgTqReqTq_1",14,131,-1},
				{"isRecOfImpctImpctDvx_1",8,71,-1},
				{"isRecOfImpctCrashOffroadRT_1",1,88,-1},
				{"isRecOfImpctCrashOffroadA_1",1,90,-1},
				{"isDoorDrvrRelsReqOutdSnsr",2,479,477},
				{"isRecOfImpctCrashState_1",2,93,-1},
				{"isRecOfImpctCrashOffroadD_1",1,89,-1},
				{"isGVMCSteerWhlAgReqFrntChks_1",8,266,-1},
				{"isIndcrNoSeq_0",1,180,179},
				{"isRecOfImpctImpctRollAg_1",7,87,-1},
				{"isGVMCBrkTqDeltaReqChks_1",8,192,-1},
				{"isIntgtIMUDataRawSafeYawRate_2",16,327,-1},
				{"isGVMCSteerWhlAgReqFrntSteerWhlAgCtrl_1",15,247,-1},
				{"isGVMCSteerWhlAgReqFrntCntr_1",4,274,-1},
				{"isRecOfImpctCrashRe_1",1,101,-1},
				{"isSecDcDcActvdReq_1",1,97,181},
				{"isADL3LatCtrlStsDegraded_1",4,227,-1},
				{"isBrkPedlSnsrChks_1",8,463,-1},
				{"isGVMCBrkTqDeltaReqPtBrkTqRgnAtAxleReAct_1",15,191,-1},
				{"isIntgtIMUDataRawSafeAVertQf_2",2,394,-1},
				{"isBrkPedlSnsrCntr_1",4,471,-1},
				{"isIntgtIMUDataRawSafeChks_2",8,378,-1},
				{"isPtBrkTqReqToFriChks_1",8,416,-1},
				{"isADL3LatCtrlStsChks_1",8,223,-1},
				{"isIntgtIMUDataRawSafeAvert_2",15,361,-1},
				{"isIsgTqActIsgTqAct_1",14,111,-1},
				{"isIntgtIMUDataRawSafeALgt_2",15,344,-1},
				{"isIntgtIMUDataRawSafeALgt1Qf_2",2,396,-1},
				{"isBrkPedlSnsrQf_1",2,467,-1},
				{"isBrkPedlSnsrSt_1",2,465,-1},
				{"isIntgtIMUDataRawSafePitchRate_2",16,295,-1},
				{"isIntgtIMUDataRawSafeYawRateQf_2",2,404,-1},
				{"isGVMCBrkTqDeltaReqQf_1",2,212,-1},
				{"isRecOfImpctVehOri_1",3,80,-1},
				{"isGVMCSteerWhlAgReqFrntSteerWhlCtrlSts_1",2,286,-1},
				{"isGVMCBrkTqDeltaReqCntr_1",4,200,-1},
				{"isRecOfImpctCrashRollovr_1",1,100,-1},
				{"isADL3LatCtrlStsADMod_1",2,239,-1},
				{"isADL3LatCtrlStsCtrlSts_1",1,233,-1},
				{"isEpbLampReqSecChks_1",8,167,-1},
				{"isIntgtIMUDataRawSafeRollRate_2",16,311,-1},
				{"isRBUMonitorSignals_1",64,7,183},
				{"isRecOfImpctCrashFrnt_1",1,91,-1},
				{"isSecBrkSysStBrkSysSt_1",4,455,-1},
				{"isIsgTqReqChks_1",8,149,-1},
				{"isRecOfImpctCrashPed_1",1,102,-1},
				{"isRecOfImpctCrashSideRi_1",1,98,-1},
				{"isIsgTqActCntr_1",4,121,-1},
				{"isIsgTqActQualityFactor_1",2,133,-1},
				{"isIsgTqReqQf_1",2,153,-1},
				{"isSecBrkSysStChks_1",8,447,-1},
				{"isSecBrkSysStCntr_1",4,451,-1},
				{"isRecOfImpctCrashSideLe_1",1,99,-1},
				{"isIntgtIMUDataRawSafeALat1Qf_2",2,398,-1},
				{"isADL3LatCtrlStsCntr_1",4,231,-1},
				{"isADL3LatCtrlStsQf_1",2,237,-1},
				{"isEpbLampReqSecCntr_1",4,175,-1},
				{"isRecOfImpctCrashOffroadRTsevere_1",1,103,-1},
				{"isIntgtIMUDataRawSafeALat_2",15,343,-1},
				{"isIntgtIMUDataRawSafePitchRateQf_2",2,392,-1},
				{"isEpbLampReqSecEpbLampReq_1",2,171,-1},
				{"isADL3LatCtrlStsSts_1",2,235,-1},
				{"isIsgTqActChks_1",8,113,-1},
				{"isPtBrkTqReqToFriQf_1",2,436,-1},
				{"isGVMCSteerWhlAgReqFrntSteerWhlTqCtrl_1",14,248,-1},
				{"isPtBrkTqReqToFriPtBrkTqRgnAtAxleReAct_1",15,415,-1},
				{"isIsgTqReqCntr_1",4,157,-1},
				{"isIntgtIMUDataRawSafeRollRateQf_2",2,406,-1},
				{"isRecOfImpctImpctDvy_1",8,79,-1}
			},
			{
				{"igRecOfImpct_1","ZCUDZCUCANFD2SignalIPdu07",182},
				{"igIsgTqAct_1","ZCUDZCUCANFD2SignalIPdu07",168},
				{"igIntgtIMUDataRawSafe_2","ZCUDZCUCANFD2SignalIPdu07",402},
				{"igIsgTqReq_1","ZCUDZCUCANFD2SignalIPdu07",169},
				{"igADL3LatCtrlSts_1","ZCUDZCUCANFD2SignalIPdu07",232},
				{"igBrkPedlSnsr_1","ZCUDZCUCANFD2SignalIPdu07",433},
				{"igGVMCBrkTqDeltaReq_1","ZCUDZCUCANFD2SignalIPdu07",210},
				{"igPtBrkTqReqToFri_1","ZCUDZCUCANFD2SignalIPdu07",434},
				{"igGVMCSteerWhlAgReqFrnt_1","ZCUDZCUCANFD2SignalIPdu07",284},
				{"igEpbLampReqSec_1","ZCUDZCUCANFD2SignalIPdu07",96},
				{"igSecBrkSysSt_1","ZCUDZCUCANFD2SignalIPdu07",178}
			}
		},
		{"ZCU_CANFD2","ZcudToDhuZCUCANFD2DiagResFr","Out",0x601,64,0,1,4,0},
		{"ZCU_CANFD2","ZcudSmbToDhuZCUCANFD2DiagResFr","Out",0x629,64,0,1,4,0},
		{"ZCU_CANFD2","ZcudSmblToDhuZCUCANFD2DiagResFr","Out",0x631,64,0,1,4,0},
		{"ZCU_CANFD2","ZCUDZCUCANFD2Fr61","Out",0x255,64,0,1,1,0},
		{
			"ZCU_CANFD2","ZCUDZCUCANFD2Fr25","Out",0x220,64,60,1,0,0,148,18,
			{
				{"isNFCKeyReadStsToHMI2Key12",2,31,-1},
				{"isSUMDrvModPrsnlAdjmtDamprMedSts",1,298,-1},
				{"isNFCKeyReadStsToHMI2Key17",2,37,-1},
				{"isSecRowLeSeatHeatgIllmnLvl_0",2,423,421},
				{"isAltNoResp_1",1,447,446},
				{"isNFCKeyReadStsToHMI2Key22",2,43,-1},
				{"isActvnOfApproachInEITL",1,305,304},
				{"isSecRowSeatHeatgActlPwrCnsRi2_1",8,319,432},
				{"isBattFltStsPrimCntr_1",4,123,-1},
				{"isNFCKeyReadStsToHMI2Key21",2,45,-1},
				{"isSecRowSeatHeatgDesPwrCnsRi2_1",8,327,475},
				{"isNFCKeyReadStsToHMI2Key2",2,3,-1},
				{"isDoorSldngRiRePreConNotFulfil",1,463,462},
				{"isDrvrSeatSwtStsDrvrSeatSwtHeiFrntSts",2,495,-1},
				{"isNFCKeyReadStsToHMI2Key29",2,61,-1},
				{"isSecRowRiVentnAutoSts2_1",2,428,426},
				{"isNFCKeyReadStsToHMI2Key27",2,49,-1},
				{"isIndirectLifeDetnAndCareDiWarn",1,461,460},
				{"isOutdBriHwCntr",4,175,-1},
				{"isLockgAnlgAudReq",2,378,376},
				{"isInhbForEscSptModSts_1",1,187,-1},
				{"isChrgLidRearLockCmd",3,387,384},
				{"isOutdBriChks_1",8,151,-1},
				{"isSecRowRiHeatgAutoSts2_1",2,431,429},
				{"isActvnOfParkShowforEITL",1,434,433},
				{"isNFCKeyReadStsToHMI2Key18",2,35,-1},
				{"isSecRowSeatVentnDesPwrCnsRi2_1",8,343,473},
				{"isDoorLeOpenWarnReq",1,441,440},
				{"isSecRowLeSldPosSeatPosPerc",10,215,-1},
				{"isDoorSldngLeRePreConNotFulfil",1,449,448},
				{"isDoorLeReHndlSts",3,407,404},
				{"isSUMDrvModPrsnlAdjmtSuspLvlHL2Sts",1,310,-1},
				{"isDoorDrvrHndlSts",3,399,396},
				{"isSecRowSeatVentnActlPwrCnsRi2_1",8,335,474},
				{"isSbWCtrlWarnMsgReq",4,383,379},
				{"isInhbForEscSptModCntr_1",4,191,-1},
				{"isSeatRowThrdLeInclPosAngleAngleDeg180_0",8,250,-1},
				{"isNFCKeyReadStsToHMI2Key31",2,57,-1},
				{"isDrvrSeatSwtStsDrvrSeatSwtInclSts",2,491,-1},
				{"isCrashUnlckPosHldng",1,443,442},
				{"isFootwellLiSts",1,500,499},
				{"isWinDsblDrvrReSts",1,477,476},
				{"isNFCKeyReadStsToHMI2Key15",2,25,-1},
				{"isSUMDrvModPrsnlAdjmtDamprHardSts",1,299,-1},
				{"isDoorSldngRiReCinFailCinchRestFlt_1",1,345,-1},
				{"isNFCKeyReadStsToHMI2Key26",2,51,-1},
				{"isActvnOfGoodByeLi_0",1,425,424},
				{"isDrvrSeatSwtStsDrvrSeatSwtAdjmtOfSpplFctVertSts",2,485,-1},
				{"isInhbForEscSptModChks_1",8,183,-1},
				{"isShortDropWinDrvrReSts",2,439,437},
				{"isSecRowRiHeiPosSeatPosQf",2,237,-1},
				{"isDrvrSeatSwtStsDrvrSeatSwtHdrstVertSts",2,481,-1},
				{"isSecRowRiHeiPosSeatPosPerc",10,231,-1},
				{"isChdLockLeftSts",2,218,216},
				{"isNFCKeyReadStsToHMI2Key4",2,15,-1},
				{"isLampSigForCarMdl",16,135,168},
				{"isNFCKeyReadStsToHMI2Key38",2,75,-1},
				{"isDrvrSeatSwtStsDrvrSeatSwtHdrstHozlSts",2,483,-1},
				{"isNFCKeyReadStsToHMI2Key39",2,73,-1},
				{"isSeatRowThrdLeInclPosAngleQf1_0",2,258,-1},
				{"isNFCKeyReadStsToHMI2Key5",2,13,-1},
				{"isNFCKeyReadStsToHMI2Key23",2,41,-1},
				{"isDrvrSeatSwtStsDrvrSeatSwtSelnOfSpplFctSts",2,489,-1},
				{"isEITLActvnCaseDurgDrv",4,367,363},
				{"isDrvrSeatSwtStsDrvrSeatSwtHeiSts",2,493,-1},
				{"isNFCKeyReadStsToHMI2Key37",2,77,-1},
				{"isTechLiWakeup",1,479,478},
				{"isDoorLeReAntiPnch2",1,455,454},
				{"isNFCKeyReadStsToHMI2Key13",2,29,-1},
				{"isSUMDrvModPrsnlAdjmtDamprSts_Resv2",1,296,-1},
				{"isSecRowRiSldPosSeatPosQf",2,253,-1},
				{"isNFCKeyReadStsToHMI2Key3",2,1,-1},
				{"isActvnOfCarLoctrInEITL",1,417,416},
				{"isSUMDrvModPrsnlAdjmtSuspLvlNRHSts",1,307,-1},
				{"isNFCKeyReadStsToHMI2Key8",2,23,-1},
				{"isNFCKeyReadStsToHMI2Key36",2,79,-1},
				{"isOutdBriHwOutdBriSts",2,171,-1},
				{"isDoorDrvrReHndlSts",3,395,392},
				{"isChdLockDrvrReSts_0",2,202,200},
				{"isNFCKeyReadStsToHMI2Key32",2,71,-1},
				{"isSecRowRiInclPosQf1_0",2,303,-1},
				{"isSUMDrvModPrsnlAdjmtDamprCmftSts",1,300,-1},
				{"isSeatVentnLvlStsRowSecRi2_1",2,411,409},
				{"isNFCKeyReadStsToHMI2Key28",2,63,-1},
				{"isKeyRmnIndcn",1,457,456},
				{"isMagChrgLidTip1",1,469,468},
				{"isMagChrgLidTip2",1,467,466},
				{"isSeatRowThrdRiInclPosAngleAngleDeg180_0",8,271,-1},
				{"isSecRowLeHeiPosSeatPosQf",2,205,-1},
				{"isSecRowLeInclPosQf1_0",2,284,-1},
				{"isTailgCllsnRiskSts_1",1,465,464},
				{"isNFCKeyReadStsToHMI2Key19",2,33,-1},
				{"isNFCKeyReadStsToHMI2Key35",2,65,-1},
				{"isSecRowRiSldPosSeatPosPerc",10,247,-1},
				{"isSecRowLeInclPosAngleDeg180_0",8,276,-1},
				{"isNFCKeyReadStsToHMI2Key30",2,59,-1},
				{"isNFCKeyReadStsToHMI2Key34",2,67,-1},
				{"isOutdBriHwChks",8,167,-1},
				{"isCeilingShieldSwt1_1",1,445,444},
				{"isSUMDrvModPrsnlAdjmtSuspLvlLL1Sts",1,309,-1},
				{"isNFCKeyReadStsToHMI2Key7",2,9,-1},
				{"isSecRowLeHeiPosSeatPosPerc",10,199,-1},
				{"isDoorSldngLeReCinFailCinchRestFlt_1",1,233,-1},
				{"isNFCKeyReadStsToHMI2Key9",2,21,-1},
				{"isDoorSldngLeReCinFailCinchFlt1_1",1,234,-1},
				{"isHoodLockSts",2,362,360},
				{"isNFCKeyReadStsToHMI2Key1",2,5,-1},
				{"isBattFltStsPrimBattFltStsPrm_1",4,127,-1},
				{"isDoorRiOpenWarnReq",1,453,452},
				{"isCDCModIndcn",3,391,388},
				{"isOutdBriCntr_1",4,159,-1},
				{"isDrvrSeatSwtStsDrvrSeatSwtAdjmtOfSpplFctHozlSts",2,487,-1},
				{"isActvnOfMusicShowforEITL",1,436,435},
				{"isNFCKeyReadStsToHMI2Key11",2,17,-1},
				{"isOutdBriSts_1",2,155,-1},
				{"isSecRowLeSeatVentnIllmnLvl_0",2,420,418},
				{"isNFCKeyReadStsToHMI2Key24",2,55,-1},
				{"isDrvrSeatSwtStsDrvrSeatSwtSldSts",2,503,-1},
				{"isKeyScanActv_0",1,471,470},
				{"isLockgFbAudioReq",3,403,400},
				{"isNFCKeyReadStsToHMI2Key6",2,11,-1},
				{"isBattFltStsPrimChks_1",8,119,-1},
				{"isActnOfLedRePosnLampDyn",1,281,280},
				{"isDoorSldngRiReCinFailCinchFlt1_1",1,346,-1},
				{"isMirrPosnToSetTarPosnAtDrvrMirrAdjLeRi",14,87,-1},
				{"isNFCKeyReadStsToHMI2Key14",2,27,-1},
				{"isSecRowRiInclPosAngleDeg180_0",8,295,-1},
				{"isSeatVentAvlStsRowSecRi2_1",3,415,412},
				{"isMirrPosnToSetTarPosnAtDrvrMirrAdjUpDown",14,89,-1},
				{"isDoorOpenerLeReSts2",4,351,347},
				{"isSUMDrvModPrsnlAdjmtSuspLvlLL2Sts",1,308,-1},
				{"isNFCKeyReadStsToHMI2Key10",2,19,-1},
				{"isEngEffSts_1",2,354,352},
				{"isSeatRowThrdRiInclPosAngleQf1_0",2,279,-1},
				{"isNFCKeyReadStsToHMI2Key33",2,69,-1},
				{"isKeyLostWarnIndcn",2,370,368},
				{"isIndirectLifeDetnAndCareLvl1Warn",1,459,458},
				{"isNFCKeyReadStsToHMI2Key20",2,47,-1},
				{"isActvnOfVSTDInEITL",2,106,104},
				{"isSecRowLeSldPosSeatPosQf",2,221,-1},
				{"isDoorRiReAntiPnch2",1,451,450},
				{"isSUMDrvModPrsnlAdjmtSuspLvlHL1Sts",1,311,-1},
				{"isSUMDrvModPrsnlAdjmtDamprSts_Resv1",1,297,-1},
				{"isNFCKeyReadStsToHMI2Key0",2,7,-1},
				{"isNFCKeyReadStsToHMI2Key16",2,39,-1},
				{"isDoorOpenerRiReSts2",4,359,355},
				{"isNFCKeyReadStsToHMI2Key25",2,53,-1},
				{"isActnOfDynChrgnInEITL",1,185,184}
			},
			{
				{"igNFCKeyReadStsToHMI2","ZCUDZCUCANFD2SignalIPdu25",408},
				{"igOutdBriHw","ZCUDZCUCANFD2SignalIPdu25",169},
				{"igDrvrSeatSwtSts","ZCUDZCUCANFD2SignalIPdu25",501},
				{"igOutdBri_1","ZCUDZCUCANFD2SignalIPdu25",153},
				{"igSeatRowThrdRiInclPosAngle_0","ZCUDZCUCANFD2SignalIPdu25",277},
				{"igBattFltStsPrim_1","ZCUDZCUCANFD2SignalIPdu25",152},
				{"igSeatRowThrdLeInclPosAngle_0","ZCUDZCUCANFD2SignalIPdu25",256},
				{"igMirrPosnToSetTarPosnAtDrvr","ZCUDZCUCANFD2SignalIPdu25",107},
				{"igSecRowLeInclPos_0","ZCUDZCUCANFD2SignalIPdu25",282},
				{"igSUMDrvModPrsnlAdjmt","ZCUDZCUCANFD2SignalIPdu25",306},
				{"igSecRowRiInclPos_0","ZCUDZCUCANFD2SignalIPdu25",301},
				{"igSecRowLeHeiPos","ZCUDZCUCANFD2SignalIPdu25",203},
				{"igSecRowRiSldPos","ZCUDZCUCANFD2SignalIPdu25",251},
				{"igInhbForEscSptMod_1","ZCUDZCUCANFD2SignalIPdu25",186},
				{"igSecRowLeSldPos","ZCUDZCUCANFD2SignalIPdu25",219},
				{"igDoorSldngRiReCinFail_1","ZCUDZCUCANFD2SignalIPdu25",344},
				{"igSecRowRiHeiPos","ZCUDZCUCANFD2SignalIPdu25",235},
				{"igDoorSldngLeReCinFail_1","ZCUDZCUCANFD2SignalIPdu25",232}
			}
		},
		{
			"ZCU_CANFD2","ZCUDZCUCANFD2Fr41","Out",0x363,64,250,1,0,0,80,8,
			{
				{"isFrntIntHCMLiLe13LED8_1",6,301,-1},
				{"isFrntIntHCMLiLe13LED3_1",6,267,-1},
				{"isFrntIntHCMLiLe10LED7_1",6,99,-1},
				{"isFrntIntHCMLiLe16LED4_1",6,469,-1},
				{"isFrntIntHCMLiLe10LED4_1",6,85,-1},
				{"isFrntIntHCMLiLe10LED1_1",6,71,-1},
				{"isFrntIntHCMLiLe14LED7_1",6,355,-1},
				{"isFrntIntHCMLiLe14LED6_1",6,345,-1},
				{"isFrntIntHCMLiLe12LED7_1",6,227,-1},
				{"isFrntIntHCMLiLe15LED5_1",6,415,-1},
				{"isFrntIntHCMLiLe12LED2_1",6,193,-1},
				{"isFrntIntHCMLiLe14LED3_1",6,331,-1},
				{"isFrntIntHCMLiLe14LED8_1",6,365,-1},
				{"isFrntIntHCMLiLe14LED4_1",6,341,-1},
				{"isFrntIntHCMLiLe16LED6_1",6,473,-1},
				{"isFrntIntHCMLiLe10LED3_1",6,75,-1},
				{"isFrntIntHCMLiLe12LED10_1",6,241,-1},
				{"isFrntIntHCMLiLe16LED7_1",6,483,-1},
				{"isFrntIntHCMLiLe10LED10_1",6,113,-1},
				{"isFrntIntHCMLiLe15LED3_1",6,395,-1},
				{"isFrntIntHCMLiLe10LED2_1",6,65,-1},
				{"isFrntIntHCMLiLe12LED8_1",6,237,-1},
				{"isFrntIntHCMLiLe10LED5_1",6,95,-1},
				{"isFrntIntHCMLiLe15LED2_1",6,385,-1},
				{"isFrntIntHCMLiLe16LED3_1",6,459,-1},
				{"isFrntIntHCMLiLe9LED2_1",6,1,-1},
				{"isFrntIntHCMLiLe9LED8_1",6,45,-1},
				{"isFrntIntHCMLiLe9LED3_1",6,11,-1},
				{"isFrntIntHCMLiLe11LED5_1",6,159,-1},
				{"isFrntIntHCMLiLe11LED10_1",6,177,-1},
				{"isFrntIntHCMLiLe10LED8_1",6,109,-1},
				{"isFrntIntHCMLiLe16LED5_1",6,479,-1},
				{"isFrntIntHCMLiLe14LED5_1",6,351,-1},
				{"isFrntIntHCMLiLe14LED2_1",6,321,-1},
				{"isFrntIntHCMLiLe11LED7_1",6,163,-1},
				{"isFrntIntHCMLiLe10LED6_1",6,89,-1},
				{"isFrntIntHCMLiLe9LED9_1",6,55,-1},
				{"isFrntIntHCMLiLe15LED6_1",6,409,-1},
				{"isFrntIntHCMLiLe15LED4_1",6,405,-1},
				{"isFrntIntHCMLiLe15LED7_1",6,419,-1},
				{"isFrntIntHCMLiLe12LED5_1",6,223,-1},
				{"isFrntIntHCMLiLe11LED4_1",6,149,-1},
				{"isFrntIntHCMLiLe14LED9_1",6,375,-1},
				{"isFrntIntHCMLiLe16LED1_1",6,455,-1},
				{"isFrntIntHCMLiLe13LED10_1",6,305,-1},
				{"isFrntIntHCMLiLe13LED6_1",6,281,-1},
				{"isFrntIntHCMLiLe15LED1_1",6,391,-1},
				{"isFrntIntHCMLiLe9LED7_1",6,35,-1},
				{"isFrntIntHCMLiLe13LED2_1",6,257,-1},
				{"isFrntIntHCMLiLe12LED4_1",6,213,-1},
				{"isFrntIntHCMLiLe15LED9_1",6,439,-1},
				{"isFrntIntHCMLiLe16LED8_1",6,493,-1},
				{"isFrntIntHCMLiLe13LED1_1",6,263,-1},
				{"isFrntIntHCMLiLe9LED6_1",6,25,-1},
				{"isFrntIntHCMLiLe12LED9_1",6,247,-1},
				{"isFrntIntHCMLiLe9LED1_1",6,7,-1},
				{"isFrntIntHCMLiLe12LED1_1",6,199,-1},
				{"isFrntIntHCMLiLe11LED6_1",6,153,-1},
				{"isFrntIntHCMLiLe14LED1_1",6,327,-1},
				{"isFrntIntHCMLiLe11LED9_1",6,183,-1},
				{"isFrntIntHCMLiLe10LED9_1",6,119,-1},
				{"isFrntIntHCMLiLe9LED10_1",6,49,-1},
				{"isFrntIntHCMLiLe16LED2_1",6,449,-1},
				{"isFrntIntHCMLiLe15LED10_1",6,433,-1},
				{"isFrntIntHCMLiLe11LED2_1",6,129,-1},
				{"isFrntIntHCMLiLe11LED8_1",6,173,-1},
				{"isFrntIntHCMLiLe13LED9_1",6,311,-1},
				{"isFrntIntHCMLiLe16LED9_1",6,503,-1},
				{"isFrntIntHCMLiLe9LED4_1",6,21,-1},
				{"isFrntIntHCMLiLe13LED5_1",6,287,-1},
				{"isFrntIntHCMLiLe12LED6_1",6,217,-1},
				{"isFrntIntHCMLiLe13LED7_1",6,291,-1},
				{"isFrntIntHCMLiLe11LED1_1",6,135,-1},
				{"isFrntIntHCMLiLe13LED4_1",6,277,-1},
				{"isFrntIntHCMLiLe14LED10_1",6,369,-1},
				{"isFrntIntHCMLiLe15LED8_1",6,429,-1},
				{"isFrntIntHCMLiLe9LED5_1",6,31,-1},
				{"isFrntIntHCMLiLe12LED3_1",6,203,-1},
				{"isFrntIntHCMLiLe11LED3_1",6,139,-1},
				{"isFrntIntHCMLiLe16LED10_1",6,497,-1}
			},
			{
				{"igFrntIntHCMLiLe14_1","ZCUDZCUCANFD2SignalIPdu41",379},
				{"igFrntIntHCMLiLe10_1","ZCUDZCUCANFD2SignalIPdu41",123},
				{"igFrntIntHCMLiLe11_1","ZCUDZCUCANFD2SignalIPdu41",187},
				{"igFrntIntHCMLiLe12_1","ZCUDZCUCANFD2SignalIPdu41",251},
				{"igFrntIntHCMLiLe15_1","ZCUDZCUCANFD2SignalIPdu41",443},
				{"igFrntIntHCMLiLe9_1","ZCUDZCUCANFD2SignalIPdu41",59},
				{"igFrntIntHCMLiLe16_1","ZCUDZCUCANFD2SignalIPdu41",507},
				{"igFrntIntHCMLiLe13_1","ZCUDZCUCANFD2SignalIPdu41",315}
			}
		},
		{"ZCU_CANFD2","ZCUDZCUCANFD2DEVFr01","Out",0x562,64,0,1,1,0},
		{"ZCU_CANFD2","ZCUDZCUCANFD2PduR500Fr26","Out",0x3c3,64,0,1,1,0},
		{
			"ZCU_CANFD2","ZCUDZCUCANFD2Fr49","Out",0x380,64,400,1,0,0,12,0,
			{
				{"isMirrSelnReq_1",2,30,28},
				{"isPassMidSeatSts_1",2,15,13},
				{"isOxygenGenrErrInfo_1",3,3,0},
				{"isMirrDefrstAtDrvSts",1,27,26},
				{"isOGMIntErr_1",1,9,8},
				{"isOGMTempErr_1",2,19,17},
				{"isOGMUndVoltRangErr_1",1,5,4},
				{"isOxygenSplyErr_1",1,16,31},
				{"isOGMOvrVoltRangErr_1",1,7,6},
				{"isOxygenSplyAvlSts_1",3,23,20},
				{"isPinionSteerAgMax1_1",15,39,40},
				{"isStrtRemSts1WdStrtRemSts",2,12,10}
			},
			{
				{"","",-1}
			}
		},
		{"ZCU_CANFD2","ZcudHwasToDhuZCUCANFD2DiagResFr","Out",0x642,64,0,1,4,0},
		{
			"ZCU_CANFD2","ZCUDZCUCANFD2Fr68","Out",0x141,64,30,1,0,0,102,16,
			{
				{"isWhlTqDifMaxReCntr_1",4,341,-1},
				{"isRowThrdRiInclAdjmtSwt_1",2,79,77},
				{"isWhlTqDifMaxReGrdtMax_1",13,311,-1},
				{"isSecRowLeLegRotMotPosReqSpeed_0",8,234,-1},
				{"isRowSecRiMassgFctSwt2MassgInten_1",2,44,-1},
				{"isRowSecRiEasyInOutRstSwt_1",1,57,56},
				{"isRowReRiModSwt_1",1,20,19},
				{"isSuperCapMosStsBoolean9_1",1,367,-1},
				{"isSecRowLeLegRotMotMoveReq_0",2,231,229},
				{"isSecRowLeSeatHeatgBtn_1",1,81,80},
				{"isRowSecRiRotSwt2BtnModA_1",1,55,-1},
				{"isPassFootForSecMotPosReqSpeed",8,130,-1},
				{"isThrdRowRiMassgLimtStsFb_1",4,439,435},
				{"isRowSecLeMassgFctSwtMassgInten_1",2,28,-1},
				{"isSecRowRiLegRotMotPosReqSpeed_0",8,282,-1},
				{"isRowSecRiLieDwnSwt2_1",2,51,49},
				{"isSecRowRiLegRotMotPosReqTargPosReq_0",10,276,-1},
				{"isALgtReqForSbwFloat8",8,101,-1},
				{"isSuperCapMosStsBoolean11_1",1,365,-1},
				{"isRowSecRiRotSwt2BtnModC_1",1,53,-1},
				{"isDoorDrvrRe2Swt1DplyHndl",1,459,458},
				{"isLvlgSwtSetSrvSts",3,7,4},
				{"isThrdRowLeMassgLimtStsFb_1",4,380,376},
				{"isPassFootForSecMotPosReqTargPosReq",10,124,-1},
				{"isRowThrdLeMassgSwt_1",1,65,64},
				{"isSuperCapU1_1",8,399,32},
				{"isWhlTqDifMaxReGrdtMin_1",13,314,-1},
				{"isSwtExtrLi2LiExtFctCntr_1",2,453,-1},
				{"isSuperCapMosStsBoolean6_1",1,354,-1},
				{"isPVMCSteerAst_1",3,151,148},
				{"isSwtExtrLi2LiExtFctReq1_1",2,451,-1},
				{"isRowSecLeRotSwt2BtnModB_1",1,38,-1},
				{"isRowSecLeEasyInOutRstSwt_1",1,18,17},
				{"isDoorDrvr2Swt1DplyHndl",1,463,462},
				{"isWhlTqDifMaxReChks_1",8,333,-1},
				{"isRowSecLeLieDwnSwt_1",2,35,33},
				{"isSecRowLeLegExtMotMoveReq_0",2,207,205},
				{"isSeatOccptAtRowThrdRiSnsSts2_1",2,84,82},
				{"isALgtReqForSbwChks",8,93,-1},
				{"isSwtExtrLi2LiExtFctQf_1",2,455,-1},
				{"isVMCSpdLimReqSpdLimReq",8,289,-1},
				{"isPVMCToBrkReqPVMCTrctnCtrlLvlReq_1",3,164,-1},
				{"isSecRowLeLegExtMotPosReqTargPosReq_0",10,204,-1},
				{"isRowReLeModSwt_1",1,9,8},
				{"isSecRowRiLegExtMotPosReqTargPosReq_0",10,252,-1},
				{"isSuperCapMosStsBoolean14_1",1,362,-1},
				{"isSecRowRiLegExtMotPosReqSpeed_0",8,258,-1},
				{"isRowSecLeRotSwt2BtnModA_1",1,39,-1},
				{"isSecRowLeSeatVentnBtn_1",1,95,94},
				{"isRowReLeSldAdjmtSwt_1",2,15,13},
				{"isSecRowLeLegExtMotPosReqSpeed_0",8,210,-1},
				{"isSuperCapMosStsBoolean12_1",1,364,-1},
				{"isSuperCapMosStsBoolean3_1",1,357,-1},
				{"isPVMCToBrkReqChks_1",8,147,-1},
				{"isSbWBkpFctStsChks",8,175,-1},
				{"isSuperCapSoc_1",10,375,381},
				{"isSBWTqLimReq",13,191,194},
				{"isRowThrdLeSldAdjmtSwt_1",2,71,69},
				{"isDoorDrvr2Swt2DplyHndl",1,461,460},
				{"isRowThrdRiSldAdjmtSwt_1",2,76,74},
				{"isSuperCapMosStsBoolean13_1",1,363,-1},
				{"isSuperCapMosStsBoolean4_1",1,356,-1},
				{"isRowThrdRiMassgSwt_1",1,73,72},
				{"isDoorLeReSafeUnlckInsdSwtIf",2,119,117},
				{"isVMCSpdLimReqSpdLimSts",1,297,-1},
				{"isRowThrdLeFldRsdSwt_1",2,63,61},
				{"isSuperCapU2_1",8,407,40},
				{"isSuperCapU5_1",8,431,113},
				{"isRowSecLeMassgFctSwtMassgProgTyp_1",3,31,-1},
				{"isSuperCapU4_1",8,423,104},
				{"isSuperCapCurr_1",8,351,16},
				{"isPVMCToBrkReqCntr_1",4,155,-1},
				{"isRowSecLeMassgFctSwtStatus_1",1,26,-1},
				{"isRowSecRiMassgFctSwt2Status_1",1,42,-1},
				{"isSuperCapMosStsBoolean8_1",1,352,-1},
				{"isSuperCapMosStsBoolean1_1",1,359,-1},
				{"isRowSecLeRotSwt2BtnModC_1",1,37,-1},
				{"isSbWBkpFctStsCntr",4,183,-1},
				{"isRowThrdRiFldRsdSwt_1",2,68,66},
				{"isDoorDrvrRe2Swt2DplyHndl",1,457,456},
				{"isSecRowLeLegRotMotPosReqTargPosReq_0",10,228,-1},
				{"isSecRowRiLegExtMotMoveReq_0",2,255,253},
				{"isSuperCapTotU_1",8,391,24},
				{"isRowThrdLeInclAdjmtSwt_1",2,60,58},
				{"isSwtExtrLi2LiExtFctCrc_1",8,447,-1},
				{"isSuperCapMosStsBoolean5_1",1,355,-1},
				{"isDoorDrvrReSafeUnlckInsdSwtIf",2,116,114},
				{"isSuperCapU3_1",8,415,48},
				{"isSuperCapMosStsBoolean10_1",1,366,-1},
				{"isALgtReqForSbwCntr",4,109,-1},
				{"isSbWBkpFctStsFctSts",4,179,-1},
				{"isPVMCToBrkReqPVMCStbltyCtrlLvlReq_1",3,167,-1},
				{"isRowSecRiRotSwt2BtnModB_1",1,54,-1},
				{"isRowReRiSldAdjmtSwt_1",2,23,21},
				{"isSeatOccptAtRowThrdLeSnsSts2_1",2,87,85},
				{"isRowSecRiMassgFctSwt2MassgProgTyp_1",3,47,-1},
				{"isSuperCapMosStsBoolean7_1",1,353,-1},
				{"isRowReRiInclAdjmtSwt_1",2,12,10},
				{"isSecRowRiLegRotMotMoveReq_0",2,279,277},
				{"isSuperCapMosStsBoolean2_1",1,358,-1},
				{"isPassFootForSecMotMoveReq",2,127,125},
				{"isRowReLeInclAdjmtSwt_1",2,3,1}
			},
			{
				{"igWhlTqDifMaxRe_1","ZCUDZCUCANFD2SignalIPdu68",337},
				{"igRowSecRiMassgFctSwt2_1","ZCUDZCUCANFD2SignalIPdu68",41},
				{"igSecRowRiLegExtMotPosReq_0","ZCUDZCUCANFD2SignalIPdu68",266},
				{"igALgtReqForSbw","ZCUDZCUCANFD2SignalIPdu68",105},
				{"igPVMCToBrkReq_1","ZCUDZCUCANFD2SignalIPdu68",161},
				{"igVMCSpdLimReq","ZCUDZCUCANFD2SignalIPdu68",296},
				{"igPassFootForSecMotPosReq","ZCUDZCUCANFD2SignalIPdu68",138},
				{"igRowSecRiRotSwt2_1","ZCUDZCUCANFD2SignalIPdu68",52},
				{"igSuperCapMosSts_1","ZCUDZCUCANFD2SignalIPdu68",361},
				{"igSecRowLeLegRotMotPosReq_0","ZCUDZCUCANFD2SignalIPdu68",242},
				{"igRowSecLeMassgFctSwt_1","ZCUDZCUCANFD2SignalIPdu68",25},
				{"igRowSecLeRotSwt2_1","ZCUDZCUCANFD2SignalIPdu68",36},
				{"igSecRowLeLegExtMotPosReq_0","ZCUDZCUCANFD2SignalIPdu68",218},
				{"igSwtExtrLi2_1","ZCUDZCUCANFD2SignalIPdu68",449},
				{"igSecRowRiLegRotMotPosReq_0","ZCUDZCUCANFD2SignalIPdu68",290},
				{"igSbWBkpFctSts","ZCUDZCUCANFD2SignalIPdu68",0}
			}
		},
		{
			"ZCU_CANFD2","ZCUDZCUCANFD2Fr57","Out",0x4d1,64,1000,1,0,0,70,17,
			{
				{"isPtParkReqToWhlsRe_1",1,346,345},
				{"isWrmUpCyc_1",1,367,366},
				{"isTrsmClu0StsCntr_1",4,295,-1},
				{"isPrpsnTqReReqCntr_1",4,159,-1},
				{"isPrpsnTqFrntReqCntr_1",4,127,-1},
				{"isPropLgtCtrlModCfmdCntr_1",4,195,-1},
				{"isPropLgtCtrlModCfmdChks_1",8,187,-1},
				{"isPrpsnTqReReqQf_1",2,155,-1},
				{"isPrpsnTqReReqChks_1",8,151,-1},
				{"isPrpsnTqFrntReqTq_1",16,103,-1},
				{"isBattULiCellBattUCell3_1",13,387,-1},
				{"isImobBrkNrSerlReq_1",1,321,320},
				{"isPrpsnTqFrntReqQf_1",2,123,-1},
				{"isPtGearTar_1",4,335,331},
				{"isPtBrkTqCpTotQf_1",2,245,-1},
				{"isIsgSpdActSgnSafeCntr_1",4,63,-1},
				{"isPrpsnTqReReqTq_1",16,135,-1},
				{"isPtCoolgPostRunActv_1",1,348,347},
				{"isPropLgtCtrlModCfmdPropLgtCtrlModCfmd_1",3,204,-1},
				{"isParkByDrvrWhlsFrntSafeSts_1",1,323,-1},
				{"isAccrPedlLnrAccrPedlRat_1",15,167,-1},
				{"isDPAModStsCntr_1",4,487,-1},
				{"isRainSnsrDiagcRainSnsrHiVoltDetd_1",1,350,-1},
				{"isIsgSpdActSgnSafeQF_1",2,59,-1},
				{"isPtTqTotDrgAtWhls_1",16,271,56},
				{"isPrpsnBrkTqToTCntr_1",4,95,-1},
				{"isTrsmParkAutRdy_1",1,353,352},
				{"isAccrPedlLnrChks_1",8,168,-1},
				{"isRecOfImpct2ImpctDvxSigned_1",9,215,-1},
				{"isDPAModStsDPAModSts_1",3,483,-1},
				{"isPtReqToTrsmActr_1",3,343,340},
				{"isParkByDrvrWhlsFrntSafeCntr_1",4,327,-1},
				{"isAgDataRaw2SafeChks_2",8,23,-1},
				{"isTrsmClu0StsChks_1",8,287,-1},
				{"isIsgSpdActSgnSafeChks_1",8,55,-1},
				{"isDPAModStsChks_1",8,479,-1},
				{"isAccrPedlLnrCntr_1",4,176,-1},
				{"isBattULiCellBattUCell2_1",13,368,-1},
				{"isBattSOCLiCell1_1",10,423,-1},
				{"isPrpsnBrkTqToTChks_1",8,87,-1},
				{"isIsgSpdActSgnSafeIsgSpdActSgn800_1",16,39,-1},
				{"isPrpsnTqFrntReqChks_1",8,119,-1},
				{"isBattULiCellBattUCell4_1",13,406,-1},
				{"isBattULiCellBattUCell1_1",13,365,-1},
				{"isPrpsnBrkTqToTQf_1",2,91,-1},
				{"isPrpsnBrkTqToTTq_1",16,71,-1},
				{"isAgDataRaw2SafePitchRateQf_2",2,27,-1},
				{"isTrsmDtModAct_1",3,339,336},
				{"isParkByDrvrWhlsFrntSafeChks_1",8,319,-1},
				{"isBattSOCLiCell4_1",10,441,-1},
				{"isBattSOCLiCell3_1",10,435,-1},
				{"isAgDataRaw2SafePitchRate_2",16,7,-1},
				{"isRecOfImpct2ImpctDvySigned_1",9,222,-1},
				{"isRainSnsrDiagcRainSnsrHiTDetd_1",1,351,-1},
				{"isAgDataRaw2SafeCntr_2",4,31,-1},
				{"isIsgLimnIndcn_1",16,255,24},
				{"isPtBrkTqCpTot1_1",15,228,-1},
				{"isBrkLiReqRegenCntr_1",4,311,-1},
				{"isStandStillReqForCmftToBrkgForEPedl_1",1,357,356},
				{"isBattRlyStsPrimChks_1",8,463,-1},
				{"isDeactvtTestCom_1",1,305,304},
				{"isBattRlyStsPrimSwtSts_1",2,467,-1},
				{"isBattRlyStsPrimCntr_1",4,471,-1},
				{"isBattSOCLiCell2_1",10,429,-1},
				{"isBrkLiReqRegenOnOff_1",1,307,-1},
				{"isThermFctReq_1",1,355,354},
				{"isRainSnsCmd_1",1,359,358},
				{"isTrsmClu0StsTrsm0CluSts_1",2,291,-1},
				{"isBrkLiReqRegenChks_1",8,303,-1},
				{"isPropLgtCtrlModCfmdLgtDegradation_1",3,207,-1}
			},
			{
				{"igPrpsnTqReReq_1","ZCUDZCUCANFD2SignalIPdu57",153},
				{"igBattSOCLiCell_1","ZCUDZCUCANFD2SignalIPdu57",88},
				{"igPrpsnBrkTqToT_1","ZCUDZCUCANFD2SignalIPdu57",89},
				{"igParkByDrvrWhlsFrntSafe_1","ZCUDZCUCANFD2SignalIPdu57",322},
				{"igTrsmClu0Sts_1","ZCUDZCUCANFD2SignalIPdu57",289},
				{"igPtBrkTqCpTot_1","ZCUDZCUCANFD2SignalIPdu57",243},
				{"igPrpsnTqFrntReq_1","ZCUDZCUCANFD2SignalIPdu57",121},
				{"igIsgSpdActSgnSafe_1","ZCUDZCUCANFD2SignalIPdu57",57},
				{"igAccrPedlLnr_1","ZCUDZCUCANFD2SignalIPdu57",188},
				{"igRecOfImpct2_1","ZCUDZCUCANFD2SignalIPdu57",229},
				{"igBrkLiReqRegen_1","ZCUDZCUCANFD2SignalIPdu57",306},
				{"igRainSnsrDiagc_1","ZCUDZCUCANFD2SignalIPdu57",349},
				{"igBattULiCell_1","ZCUDZCUCANFD2SignalIPdu57",409},
				{"igPropLgtCtrlModCfmd_1","ZCUDZCUCANFD2SignalIPdu57",201},
				{"igBattRlyStsPrim_1","ZCUDZCUCANFD2SignalIPdu57",465},
				{"igAgDataRaw2Safe_2","ZCUDZCUCANFD2SignalIPdu57",25},
				{"igDPAModSts_1","ZCUDZCUCANFD2SignalIPdu57",480}
			}
		},
		{"ZCU_CANFD2","ZCUDZCUCANFD2PduR1000Fr19","Out",0x3a0,64,0,1,1,0},
		{
			"ZCU_CANFD2","ZCUDZCUCANFD2Fr77","Out",0x40a,64,700,1,0,0,23,1,
			{
				{"isActnOfLedGrilleLamp_0",1,13,12},
				{"isActnOfCenHiMntdStopLamp",1,7,6},
				{"isImobEngSts3_1",2,44,42},
				{"isActnOfLedDaytiRunngLamp_0",1,1,0},
				{"isActnOfLedFrntFogLamp_0",1,15,14},
				{"isActvnOfAfs",1,21,20},
				{"isActvnOfDbl",1,17,16},
				{"isActvnOfHndlDoorLiHndlDoorLiPassRe",1,36,-1},
				{"isActvnOfHndlDoorLiHndlDoorLiDrvr",1,39,-1},
				{"isImobEngSts1_1",2,47,45},
				{"isActvnOfAhl",1,19,18},
				{"isActvnOfDefrstFrnt",1,31,30},
				{"isActvnOfTouristMod",1,27,26},
				{"isActnOfLedGrilleLampDyn_0",1,11,10},
				{"isMirrDefrstAtDrvrCmd",1,25,24},
				{"isActnOfLedCornrgLampLe_0",1,5,4},
				{"isActnOfLedLeLogoLamp_0",1,9,8},
				{"isActvnOfDefrstRe",1,29,28},
				{"isActvnOfWiprMech",2,34,32},
				{"isActnOfLedCornrgLampRi_0",1,3,2},
				{"isActvnOfHndlDoorLiHndlDoorLiPass",1,37,-1},
				{"isActvnOfHndlDoorLiHndlDoorLiDrvrRe",1,38,-1},
				{"isActnOfLedRiLogoLamp_0",1,23,22}
			},
			{
				{"igActvnOfHndlDoorLi","ZCUDZCUCANFD2SignalIPdu77",35}
			}
		},
		{
			"ZCU_CANFD2","ZCUDZCUCANFD2Fr27","Out",0x322,64,150,1,0,0,81,5,
			{
				{"isDrvrSecRowHeatgAutoSts",2,92,90},
				{"isSuspTarHei",3,143,140},
				{"isWinDsblLeftSts",1,223,222},
				{"isGVMCWhlSlipRateActReRiAct",15,42,-1},
				{"isExtrLiShowActvnStsExtrLiShowActvnReRi2Fb",2,167,-1},
				{"isCircURawCh02",9,357,364},
				{"isEfuseCircStsChxxCh02",2,437,-1},
				{"isSunCurtImpctDetnSts2",3,501,448},
				{"isThermoTSteDeoSts",8,479,216},
				{"isSteerWhlPosnCurrentSteerWhlPosnX",12,107,-1},
				{"isDstTrvldVldFromBodyBkp_1",1,162,161},
				{"isEfuseCircStsChxxCh01",2,439,-1},
				{"isCircIRawCh05",16,319,208},
				{"isExtrLiShowActvnStsExtrLiShowActvnFrntLeFb",2,159,-1},
				{"isGVMCWhlSlipRateActFrntRiAct",15,8,-1},
				{"isDoorRiReHldExitRmm2",1,145,144},
				{"isPVMCTrackWinRmn",3,452,449},
				{"isExtrLiShowActvnStsExtrLiShowActvnReRiFb",2,165,-1},
				{"isGVMCWhlSlipRateActQf",2,59,-1},
				{"isSwtIntmIntlCmd_1",3,191,188},
				{"isErsDelayTiCfm",1,173,172},
				{"isEfuseCircStsChxxCh03",2,435,-1},
				{"isTrsmLockMgrWarnlndcn",2,199,197},
				{"isCircURawCh04",9,369,376},
				{"isCircURawCh06",9,397,404},
				{"isSteerWhlHeatgLvlSts",2,178,176},
				{"isExtLiShwDwnldSts",2,135,133},
				{"isEfuseCircFltStsForChxxCh05",4,431,-1},
				{"isEfuseCircFltStsForChxxCh03",4,423,-1},
				{"isGVMCWhlSlipRateActFrntLeAct",15,7,-1},
				{"isEfuseCircFltStsForChxxCh01",4,415,-1},
				{"isSplyFailrOfLeReKickSnsr_1",1,490,489},
				{"isPhoneForgottenRmnWPC5_1",1,465,464},
				{"isCircIRawCh06",16,335,221},
				{"isEfuseCircStsChxxCh06",2,445,-1},
				{"isExtrLiShowActvnStsExtrLiShowActvnReLeFb",2,153,-1},
				{"isSunRoofImpctDetnSts2",3,498,488},
				{"isExtrLiShowStoreStsOfEL",1,403,402},
				{"isDoorDrvrLatPosn_0",2,95,93},
				{"isWadeProtnSts_1",1,194,193},
				{"isWPCModuleStsWPC5_1",4,495,491},
				{"isSecRowLeMotSts",1,503,502},
				{"isVehSpdLimnWarn",4,487,483},
				{"isGVMCWhlSlipRateActReLeAct",15,25,-1},
				{"isExtrLiShowActvnStsExtrLiShowActvnReLe2Fb",2,155,-1},
				{"isCircURawCh05",9,391,398},
				{"isEfuseCircFltStsForChxxCh04",4,419,-1},
				{"isTrlrLiTurnIndcrActvt_0",2,187,185},
				{"isPCASSt",2,455,453},
				{"isCircIRawCh01",16,255,139},
				{"isSwtBeamHi_1",2,151,149},
				{"isCircIRawCh04",16,303,192},
				{"isStrtStopEna",1,169,168},
				{"isUsgModSts",4,127,123},
				{"isEfuseCircFltStsForChxxCh02",4,411,-1},
				{"isActtnCtrlActvFlg",1,89,88},
				{"isDoorLeReHldExitRmm2",1,130,129},
				{"isGVMCTrjctyTrackFlg",2,442,440},
				{"isTurnIndcrAndHwlByDrvInt_0",2,468,466},
				{"isEgyLvlChkWdReq",1,175,174},
				{"isExtrLiShowActvnStsExtrLiShowActvnFrntRiFb",2,157,-1},
				{"isDrvrSecRowVentnAutoSts",2,122,120},
				{"isSteerWhlPosnCurrentSteerWhlPosnAng",12,103,-1},
				{"isTarSoC",10,463,469},
				{"isCircIRawCh03",16,287,184},
				{"isCircURawCh01",9,351,358},
				{"isEfuseCircStsChxxCh04",2,433,-1},
				{"isEfuseCircStsChxxCh05",2,447,-1},
				{"isBevPwrOffFlag",1,132,131},
				{"isBattSnsrComFlt",1,81,80},
				{"isCircIRawCh02",16,271,160},
				{"isReWiprRotyCmd_1",2,148,146},
				{"isChrgnUReqMax_1",8,247,128},
				{"isImobMgrWarnIndcn",2,138,136},
				{"isSteerStsToCrabMov_1",2,482,480},
				{"isExtrLiShowActvnStsOfEL",2,219,217},
				{"isDstTrvldFromBodyBkp_1",21,71,82},
				{"isPassAirbStsChgNotifReq_1",1,401,400},
				{"isEfuseCircFltStsForChxxCh06",4,427,-1},
				{"isCircURawCh03",9,363,370},
				{"isRlyPwrDistbnCmd1WdBattSaveCmd",1,171,170}
			},
			{
				{"igGVMCWhlSlipRateAct","ZCUDZCUCANFD2SignalIPdu27",57},
				{"igEfuseCircStsChxx","ZCUDZCUCANFD2SignalIPdu27",443},
				{"igEfuseCircFltStsForChxx","ZCUDZCUCANFD2SignalIPdu27",220},
				{"igExtrLiShowActvnSts","ZCUDZCUCANFD2SignalIPdu27",163},
				{"igSteerWhlPosnCurrent","ZCUDZCUCANFD2SignalIPdu27",56}
			}
		},
		{"ZCU_CANFD2","ZcudPotToDhuZCUCANFD2DiagResFr","Out",0x615,64,0,1,4,0},
		{
			"ZCU_CANFD2","ZCUDZCUCANFD2Fr75","Out",0x1cf,64,50,1,0,0,59,8,
			{
				{"isTVCBrkTqReqWhlVAgrMinReqFrntLe_1",16,7,-1},
				{"isRWASteerLockChk2SteerLockDataChk1_1",8,311,-1},
				{"isTVCTqDistbnFaultForGVMCCntr_1",4,199,-1},
				{"isRWASteerLockChkSteerLockDataChk3_1",8,271,-1},
				{"isRWASteerLockChk2SteerLockDataChk5_1",8,343,-1},
				{"isRWASteerLockChk2SteerLockDataChk4_1",8,335,-1},
				{"isSeatMassgMachHwFailrDrvrTmrFlt_1",1,210,-1},
				{"isSeatMassgMachFltForEcuSecLe_1",1,161,160},
				{"isTVCReWhlSteerCtrlStsForTvcTVCReWhlSteerCtrlStsForTvc_1",3,179,-1},
				{"isRWASteerLockChkSteerLockChkSts_1",1,232,-1},
				{"isTVCBrkTqReqReLeCtrlMod_1",2,135,-1},
				{"isTVCBrkTqReqWhlVAgrMinReqReRi_1",16,55,-1},
				{"isSeatMassgMachHwFltSecLeActrFlt1_1",1,223,-1},
				{"isTVCBrkTqReqWhlVAgrMinReqFrntRi_1",16,23,-1},
				{"isRWASteerLockWarnIndcn2_1",2,236,234},
				{"isTVCBrkTqReqChks_1",8,119,-1},
				{"isTVCReWhlSteerCtrlStsForTvcCntr_1",4,183,-1},
				{"isTVCBrkTqReqCntr_1",4,127,-1},
				{"isSeatMassgMachHwFltSecLeActrFlt3_1",1,221,-1},
				{"isSeatMassgMachHwFailrDrvrActrFlt1_1",1,215,-1},
				{"isRWASteerLockChk2SteerLockDataChk2_1",8,319,-1},
				{"isTVCTqDistbnFaultForGVMCTVCTqDistbnFaultForGVMC_1",2,195,-1},
				{"isTVCRwsAngReqForTvcCntr_1",4,152,-1},
				{"isTVCPrpsnTqDistActv_1",1,130,129},
				{"isSeatMassgMachHwFltSecLeActrFlt5_1",1,219,-1},
				{"isRWASteerLockChk2SteerLockDataChk3_1",8,327,-1},
				{"isTVCPrpsnTqDistRatio_1",8,207,128},
				{"isSeatMassgMachHwFltSecLeTmrFlt_1",1,218,-1},
				{"isRWASteerLockChk2SteerLockDataChk6_1",8,351,-1},
				{"isSeatMassgMachHwFailrDrvrActrFlt5_1",1,211,-1},
				{"isTVCBrkTqReqReRi_1",12,99,-1},
				{"isSeatMassgMachFltForEcuDrvr_1",1,163,162},
				{"isSeatMassgMachHwFltSecLeActrFlt2_1",1,222,-1},
				{"isRWASteerLockWarnIndcn_1",2,239,237},
				{"isRWASteerLockChk2SteerLockChkSts_1",1,359,-1},
				{"isTVCRwsAngReqForTvcChks_1",8,144,-1},
				{"isTVCBrkTqReqFrntLeCtrlMod_1",2,123,-1},
				{"isRWASteerLockChkSteerLockDataChk4_1",8,279,-1},
				{"isRWASteerLockChkSteerLockDataChk2_1",8,263,-1},
				{"isSeatMassgMachHwFltSecLeActrFlt4_1",1,220,-1},
				{"isRWASteerLockChkSteerLockDataChk6_1",8,295,-1},
				{"isRWASteerLockSts_1",2,231,229},
				{"isRWASteerLockChk2SteerLockDataChk0_1",8,303,-1},
				{"isRWASteerLockChkSteerLockDataChk1_1",8,255,-1},
				{"isTVCTqDistbnFaultForGVMCChks_1",8,191,-1},
				{"isTVCBrkTqReqFrntRiCtrlMod_1",2,121,-1},
				{"isRWASteerLockChkSteerLockDataChk5_1",8,287,-1},
				{"isTVCBrkTqReqReLe_1",12,95,-1},
				{"isRWASteerLockSts2_1",2,228,226},
				{"isTVCRwsAngReqForTvcTVCRwsAngReqForTvc_1",15,143,-1},
				{"isSeatMassgMachHwFailrDrvrActrFlt3_1",1,213,-1},
				{"isTVCBrkTqReqWhlVAgrMinReqReLe_1",16,39,-1},
				{"isTVCBrkTqReqReRiCtrlMod_1",2,133,-1},
				{"isSeatMassgMachHwFailrDrvrActrFlt4_1",1,212,-1},
				{"isTVCBrkTqReqFrntLe_1",12,71,-1},
				{"isTVCBrkTqReqFrntRi_1",12,75,-1},
				{"isRWASteerLockChkSteerLockDataChk0_1",8,247,-1},
				{"isTVCReWhlSteerCtrlStsForTvcChks_1",8,175,-1},
				{"isSeatMassgMachHwFailrDrvrActrFlt2_1",1,214,-1}
			},
			{
				{"igSeatMassgMachHwFltSecLe_1","ZCUDZCUCANFD2SignalIPdu75",217},
				{"igSeatMassgMachHwFailrDrvr_1","ZCUDZCUCANFD2SignalIPdu75",209},
				{"igRWASteerLockChk_1","ZCUDZCUCANFD2SignalIPdu75",233},
				{"igTVCReWhlSteerCtrlStsForTvc_1","ZCUDZCUCANFD2SignalIPdu75",176},
				{"igTVCRwsAngReqForTvc_1","ZCUDZCUCANFD2SignalIPdu75",164},
				{"igTVCTqDistbnFaultForGVMC_1","ZCUDZCUCANFD2SignalIPdu75",193},
				{"igTVCBrkTqReq_1","ZCUDZCUCANFD2SignalIPdu75",131},
				{"igRWASteerLockChk2_1","ZCUDZCUCANFD2SignalIPdu75",358}
			}
		},
		{"ZCU_CANFD2","ZCUDZCUCANFD2PduR500Fr15","Out",0x39a,64,0,1,1,0},
		{
			"ZCU_CANFD2","ZCUDZCUCANFD2Fr58","Out",0x4ee,64,1000,1,0,0,67,13,
			{
				{"isPtTqAtAxleAvlFrntMin_1",13,351,354},
				{"isEpbAvlSecReserved5_1",1,220,-1},
				{"isWhlMotSysRiTqAvlTqAvlMax_1",14,439,-1},
				{"isPtRgnTarTqAtReAxleQf_1",2,232,-1},
				{"isAccrPedlNotCmplPsdCntr_1",4,311,-1},
				{"isEpbAvlSecReserved3_1",1,222,-1},
				{"isMotDynCtrlStsReRiDmcSWInfo_1",16,119,-1},
				{"isWhlMotSysRiSpdActSafeIsgSpdActSgn800_1",16,415,-1},
				{"isLatCtrlModCfmdChks_1",8,271,-1},
				{"isOvrdDecelByDrvrOvrdDecelByDrvr_1",1,323,-1},
				{"isMotDynCtrlStsReLeChks_1",8,87,-1},
				{"isPtTqAtAxleAvlReMin_1",15,287,288},
				{"isAccrPedlNotCmplPsd_1",1,307,-1},
				{"isPtTqAtAxleAvlReMax_1",13,367,370},
				{"isDmcStsFrntToEscCntr_1",4,47,-1},
				{"isPtTotRgnTarTq1_1",15,245,-1},
				{"isWhlMotSysRiSpdActSafeQF_1",2,401,-1},
				{"isLatCtrlModCfmdLatCtrlMod_1",4,275,-1},
				{"isEpbAvlSecReserved4_1",1,221,-1},
				{"isPtGearActtnReq3_1",4,172,168},
				{"isMotDynCtrlStsReLeDmcActAppTarTq_1",16,55,-1},
				{"isMotDynCtrlStsReRiDmcSts_1",4,139,-1},
				{"isDmcStsFrntToEscDmcSWInfo_1",16,23,-1},
				{"isDmcStsFrntToEscChks_1",8,39,-1},
				{"isEpbAvlSecChks_1",8,207,-1},
				{"isMotDynCtrlStsReLeDmcSts_1",4,91,-1},
				{"isWhlMotSysRiSpdActSafeChks_1",8,431,-1},
				{"isEngCooltLvl_1",1,337,336},
				{"isEpbAvlSecReserved2_1",1,223,-1},
				{"isEpbAvlSecHostAvailabilityRelOnly_1",1,209,-1},
				{"isEpbAvlSecReserved1_1",1,208,-1},
				{"isMotDynCtrlStsReRiChks_1",8,135,-1},
				{"isEngAmbTCalcd_1",9,369,376},
				{"isPtRgnTarTqAtReAxleAtReAxle_1",15,231,-1},
				{"isWhlMotSysRiModSts_1",4,459,471},
				{"isMotDynCtrlStsReRiCntr_1",4,143,-1},
				{"isEpbAvlSecReserved6_1",1,219,-1},
				{"isDmcStsFrntToEscDmcActAppTarTq_1",16,7,-1},
				{"isEpbAvlSecCommunicationAvailable_1",1,211,-1},
				{"isPtCluTqCpReq1_1",13,151,-1},
				{"isPtGearActtnAllwdSts1_1",2,199,-1},
				{"isAccrPedlNotCmplPsdChks_1",8,303,-1},
				{"isMotDynCtrlStsReLeDmcSWInfo_1",16,71,-1},
				{"isPtCluTqCpReq2_1",13,154,-1},
				{"isPtTotRgnTarTqQf_1",2,262,-1},
				{"isBattSnsrComActv",1,321,320},
				{"isEpbAvlSecReserved7_1",1,218,-1},
				{"isPtGearActtnPrio_1",1,193,-1},
				{"isLatCtrlModCfmdCntr_1",4,279,-1},
				{"isPtTqAtAxleAvlFrntMax_1",13,335,338},
				{"isPtGearActtnModReq_1",2,195,-1},
				{"isWhlMotSysRiSpdActSafeCntr_1",4,405,-1},
				{"isFloatDrvingModStsForManMod_1",3,259,256},
				{"isPtGearActtnReq2_1",4,187,-1},
				{"isAccrPedlNotCmplPsdSts_1",1,306,-1},
				{"isOvrdDecelByDrvrChks_1",8,319,-1},
				{"isPtGearActtnPfmncReq_1",8,183,-1},
				{"isEpbAvlSecCntr_1",4,215,-1},
				{"isEpbAvlSecHostAvailabilityFull_1",1,210,-1},
				{"isOvrdDecelByDrvrCntr_1",4,327,-1},
				{"isMotDynCtrlStsReRiDmcActAppTarTq_1",16,103,-1},
				{"isDmcStsFrntToEscDmcSts_1",4,43,-1},
				{"isPtTiToCluEngmt_1",8,391,407},
				{"isPtGearActtnReq1_1",4,191,-1},
				{"isWhlMotSysRiTqAvlTqAvlMin_1",14,441,-1},
				{"isPtGearActtnAllwdSts2_1",2,197,-1},
				{"isMotDynCtrlStsReLeCntr_1",4,95,-1}
			},
			{
				{"igLatCtrlModCfmd_1","ZCUDZCUCANFD2SignalIPdu58",304},
				{"igDmcStsFrntToEsc_1","ZCUDZCUCANFD2SignalIPdu58",216},
				{"igPtTotRgnTarTq_1","ZCUDZCUCANFD2SignalIPdu58",260},
				{"igOvrdDecelByDrvr_1","ZCUDZCUCANFD2SignalIPdu58",322},
				{"igMotDynCtrlStsReRi_1","ZCUDZCUCANFD2SignalIPdu58",352},
				{"igMotDynCtrlStsReLe_1","ZCUDZCUCANFD2SignalIPdu58",353},
				{"igWhlMotSysRiSpdActSafe_1","ZCUDZCUCANFD2SignalIPdu58",406},
				{"igPtCluTqCp_1","ZCUDZCUCANFD2SignalIPdu58",173},
				{"igAccrPedlNotCmpl_1","ZCUDZCUCANFD2SignalIPdu58",305},
				{"igPtGearActtn_1","ZCUDZCUCANFD2SignalIPdu58",192},
				{"igWhlMotSysRiTqAvl_1","ZCUDZCUCANFD2SignalIPdu58",470},
				{"igEpbAvlSec_1","ZCUDZCUCANFD2SignalIPdu58",217},
				{"igPtRgnTarTqAtReAxle_1","ZCUDZCUCANFD2SignalIPdu58",246}
			}
		},
		{
			"ZCU_CANFD2","ZCUDZCUCANFD2Fr67","Out",0x2d1,64,100,1,0,0,111,6,
			{
				{"isChrgHndlStrtEna_1",1,465,464},
				{"isFrntSunCurtMvngSts",1,20,19},
				{"isCenLockMacKeyReq",2,475,473},
				{"isMotStsFrmOGM_1",8,231,40},
				{"isSunCurtIninStsRF",1,109,-1},
				{"isReSunCurtImpctDetnSts",3,35,32},
				{"isSunRoofIninLrnSts",1,135,134},
				{"isSuperCapFltSts_1",10,415,421},
				{"isSunRoofIceBreakSts",1,97,96},
				{"isPressureSnsrErr_1",2,402,400},
				{"isSunCurtIninStsReserved",1,110,-1},
				{"isFrntSunCurtFailr2CurtMotHallFailr",1,6,-1},
				{"isSunCurtLossIninReas",5,61,56},
				{"isDigKeyIntrVldDetd",1,503,502},
				{"isBtnHoodSts",1,369,368},
				{"isReSunCurtFailr2CurtMotFailr",1,47,-1},
				{"isBLEKeyBtnHoodStsAndKeyIdBLEBtnSts",2,481,-1},
				{"isSunCurtOperReq",5,87,82},
				{"isOGMCmprSpdFb_1",16,303,153},
				{"isMosOvrTempErr_1",2,255,253},
				{"isBackflushVlvErr_1",2,133,131},
				{"isMotTempSnsrErr_1",2,263,261},
				{"isCfgPrmStsOfLeReKickSnsr_1",2,130,128},
				{"isChgFilElmWarn_1",2,159,157},
				{"isDecUsgModAut2",1,489,488},
				{"isSecRowLeHeatgAutoSts",2,55,53},
				{"isFrntSunCurtFailr2Resvd",1,2,-1},
				{"isSuperCapIntR_1",8,431,217},
				{"isPressureFlt_1",2,372,370},
				{"isFltOfStopLampPass",1,505,504},
				{"isBLEKeyBtnHoodStsAndKeyIdKeyId4",6,487,-1},
				{"isSunRoofTemProtnSts",2,114,112},
				{"isMoleculeVlv1_1",2,247,245},
				{"isOGMRunTi_1",32,271,168},
				{"isFrntSunCurtFailr2EcuFailrGen",1,3,-1},
				{"isActvnOfAhbc",1,257,256},
				{"isDrvrSeatVentnAutoSts",2,11,9},
				{"isCarLoctrExtrLiSts",1,441,440},
				{"isReSunCurtFailr2CurtMotNotAvl",1,44,-1},
				{"isSuperCapBuckSts_1",1,201,200},
				{"isSunRoofIninStsLP",1,119,-1},
				{"isVlvVoltFlt_1",2,420,418},
				{"isReSunCurtFailr2EcuFailrGen",1,43,-1},
				{"isSunRoofIninStsRF",1,117,-1},
				{"isOxygenConcSnsrStsFrmOGM_1",2,362,360},
				{"isDecUsgModAut",1,491,490},
				{"isMoleculeVlv2_1",2,244,242},
				{"isCoolgFanErr_1",2,156,154},
				{"isSunCurtOperSts",3,127,124},
				{"isSunCurtIninStsRP",1,108,-1},
				{"isActnOfLedLoBeamCntr_0",4,471,-1},
				{"isSunCurtDrvU",8,71,0},
				{"isSuperCapSoh_1",10,439,445},
				{"isMotTempFb_1",13,215,218},
				{"isSunRoofLossIninReas",5,95,90},
				{"isReSunCurtFailr2CurtMotHallNotAvl",1,45,-1},
				{"isFrntSunCurtFailr2CurtMotNotAvl",1,4,-1},
				{"isFltOfStopLampDrv",1,507,506},
				{"isMosTempFb_1",13,199,202},
				{"isSldngDoorLeReModSts_0",1,49,48},
				{"isPressureFb_1",12,399,403},
				{"isDoorDrvrHndlCmd",2,501,499},
				{"isSunRoofOperSts",3,123,120},
				{"isSunCurtIceBreakSts",1,81,80},
				{"isFrSunCurtImpctDetSts",3,15,12},
				{"isInpVoltFb_1",14,167,169},
				{"isBusCurrentFb_1",16,143,16},
				{"isMirrDwnStsAtDrvr",3,39,36},
				{"isSecRowLeVentnAutoSts",2,52,50},
				{"isACEIDLightReqFromRFK",1,233,232},
				{"isMcuOvrTempErr_1",2,239,237},
				{"isSecDrvrVentnHeatgWarn",2,444,442},
				{"isFrntSunCurtFailr2CurtMotFailr",1,7,-1},
				{"isOGMSwVers_1",16,335,185},
				{"isActnOfLedPosnLamp_0",1,249,248},
				{"isReSunCurtFailr2Resvd",1,42,-1},
				{"isGlvBoxIntrSwtSts",1,18,17},
				{"isSldngDoorRiReModSts_0",1,63,62},
				{"isOGMHwVers_1",16,319,152},
				{"isOxygenTubeBlk_1",2,375,373},
				{"isSunRoofOperReq",5,103,98},
				{"isHoodOutdSwtSts",2,23,21},
				{"isSunRoofIninStsRP",1,116,-1},
				{"isMcuTempSnsrErr_1",2,236,234},
				{"isHoodCinhRstSwt",1,31,30},
				{"isAutWinWipgCmd_2",3,479,476},
				{"isMosTempSnsrErr_1",2,252,250},
				{"isActnOfLedLoBeamActnOfLedLoBeam_0",1,467,-1},
				{"isSunRoofIninStsReserved",1,118,-1},
				{"isSuperCapTemp_1",8,455,216},
				{"isFrntSunCurtFailr2CurtMotHallNotAvl",1,5,-1},
				{"isDoorDrvrOpenReqOutdSwt1",2,498,496},
				{"isSunCurtIninLrnSts",1,89,88},
				{"isPhaseCurrentFb_1",16,383,184},
				{"isMcuTempFb_1",13,183,186},
				{"isFltOfRePosnLampDrv",1,509,508},
				{"isChrgLidDCorAcDctSwtReq",1,495,494},
				{"isHoodCinhTrgSwt",1,29,28},
				{"isBtnTrSts",1,417,416},
				{"isLockgCenStsForUsrFb",3,27,24},
				{"isActnOfLedLoBeamChks_0",8,463,-1},
				{"isFltOfCenHiMntdStopLamp",1,511,510},
				{"isSunCurtIninStsLP",1,111,-1},
				{"isOxygenConcFlt_1",2,260,258},
				{"isDCEIDLightReqFromRFK",1,493,492},
				{"isOxygenConcFbFrmOGM_1",10,357,363},
				{"isSunRoofDrvU",8,79,8},
				{"isSunCurtTemProtnSts",2,106,104},
				{"isOGMFlowFb_1",9,351,358},
				{"isReSunCurtFailr2CurtMotHallFailr",1,46,-1},
				{"isActnOfLedHiBeam_0",1,241,240}
			},
			{
				{"igFrntSunCurtFailr2","ZCUDZCUCANFD2SignalIPdu67",1},
				{"igSunCurtIninSts","ZCUDZCUCANFD2SignalIPdu67",107},
				{"igSunRoofIninSts","ZCUDZCUCANFD2SignalIPdu67",115},
				{"igReSunCurtFailr2","ZCUDZCUCANFD2SignalIPdu67",41},
				{"igBLEKeyBtnHoodStsAndKeyId","ZCUDZCUCANFD2SignalIPdu67",472},
				{"igActnOfLedLoBeam_0","ZCUDZCUCANFD2SignalIPdu67",466}
			}
		},
		{"ZCU_CANFD2","ZCUDZCUCANFD2PduR1000Fr13","Out",0x3bf,64,0,1,1,0},
		{
			"ZCU_CANFD2","ZCUDZCUCANFD2Fr47","Out",0x371,64,300,1,0,0,16,1,
			{
				{"isSteerWhlHeatgStrtAutCdnOk",1,10,9},
				{"isTrAntiPnch_1",1,39,38},
				{"isTrObstclDetn_1",1,26,25},
				{"isHmiDefrstrElecStsFrnt",3,20,-1},
				{"isClimaCmd",1,4,3},
				{"isSeatVentAvlStsRowSecLe",3,34,8},
				{"isSteerLockWarnIndcn_1",1,37,36},
				{"isStrtInProgs",2,7,5},
				{"isSftyAirbRollovrSuppSts_1",1,35,24},
				{"isHmiDefrstrElecStsRe",3,30,-1},
				{"isKeyNotPrsntMsgToDrvr",1,2,1},
				{"isErsCmdByKey",2,23,21},
				{"isSysDirIndcnFailr",1,45,44},
				{"isHmiDefrstrElecStsMirrr",3,17,-1},
				{"isStrtMsgToDrvr",4,15,11},
				{"isSeatVentnLvlStsRowSecLe",2,47,0}
			},
			{
				{"igHmiDefrstrElecSts","ZCUDZCUCANFD2SignalIPdu47",27}
			}
		},
		{"ZCU_CANFD2","ZCUDZCUCANFD2PduR1000Fr28","Out",0x4e1,64,0,1,1,0},
		{
			"ZCU_CANFD2","ZCUDZCUCANFD2Fr69","Out",0x25f,64,70,1,0,0,88,14,
			{
				{"isHwRowFrstDrvrMassSwt",1,12,11},
				{"isSeatRowThrdLeLegRstHeiPosPercSeatPosQf",2,117,-1},
				{"isBtnSldgRiReSts1KeyId",4,231,-1},
				{"isThrdRowFldRsdSwt",2,330,328},
				{"isSecRowRiRot180Swt2",1,325,324},
				{"isSeatRowSecRiSwtStsPassSeatSwtSelnOfSpplFctStsSts",2,81,-1},
				{"isLsmClimaPwrSwt_1",1,337,336},
				{"isInterLockCom2Data4_1",8,183,-1},
				{"isPassSeatIntgrSwtStsIntgrSwtHozlSts",2,39,-1},
				{"isImobVehRemMgrSts1SpdLimRemMgrSts",8,7,-1},
				{"isSWSStabyCtrlAlert",1,332,331},
				{"isDrvrSeatLegExtPosPercSeatPosPerc",10,239,-1},
				{"isSeatRowThrdRiCushFldPosPercSeatPosQf",2,133,-1},
				{"isSWSSoftSwtSts",2,335,333},
				{"isThrdRowRiLimtStsFb",8,359,320},
				{"isDrvrSeatLegRotMotSts",4,259,268},
				{"isSbWBackupLgtActvnReq",1,287,286},
				{"isBtnSldgLeReTrSts1BtnSts2",3,219,-1},
				{"isRoofCampingLiSts",2,46,44},
				{"isInterLockCom2Data8_1",8,215,-1},
				{"isSeatRowSecRiSwtStsPassSeatSwtHdrstVertSts",2,73,-1},
				{"isSeatRowThrdLeLegRstHeiPosPercSeatPosPerc",10,111,-1},
				{"isSeatRowSecRiSwtStsPassSeatSwtAdjmtOfSpplFctVerSts",2,77,-1},
				{"isSeatOccptAtRowSecDrSideSnsSts2_0",2,55,53},
				{"isSeatRowSecLeSwtStsPassSeatSwtAdjmtOfSpplFctVerSts",2,50,-1},
				{"isInterLockCom2Data7_1",8,207,-1},
				{"isSeatRowThrdLeCushFldPosPercSeatPosQf",2,98,-1},
				{"isPassSeatIntgrSwtStsIntgrSwtVertSts",2,33,-1},
				{"isBtnSldgLeReTrSts1KeyId",4,223,-1},
				{"isIntrMirrRespResdUInt6_1",6,31,-1},
				{"isSeatRowSecLeSwtStsPassSeatSwtSelnOfSpplFctStsSts",2,70,-1},
				{"isSeatRowSecRiSwtStsPassSeatSwtHdrstHozlSts",2,75,-1},
				{"isDrvrSeatLegExtPosPercSeatPosQf",2,245,-1},
				{"isSeatRowSecLeSwtStsPassSeatSwtHeiFrntSts",2,60,-1},
				{"isLsmMaxDefrstSwt_1",1,367,366},
				{"isRoofWarnLiSts",2,43,41},
				{"isSeatRowThrdRiLegRstHeiPosPercSeatPosQf",2,149,-1},
				{"isSeatRowSecRiSwtStsPassSeatSwtHeiSts",2,85,-1},
				{"isRowReRiModSwtSts_1",1,383,382},
				{"isDrvrSeatLegRotPosPercSeatPosPerc",10,255,-1},
				{"isSeatRowSecRiSwtStsPassSeatSwtInclSts",2,83,-1},
				{"isSWSPreCtrlAlert",2,323,321},
				{"isPassSeatIntgrSwtStsIntgrSwtRotSts",2,37,-1},
				{"isSbWEmgyFlasherReq",1,285,284},
				{"isInterLockCom2Data6_1",8,199,-1},
				{"isInterLockCom2Data3_1",8,175,-1},
				{"isSbWBackupLatActvnReq",1,129,128},
				{"isBtnSldgRiReSts1BtnSts2",3,227,-1},
				{"isIntrMirrRespIntrMirrIntFailr_1",1,25,-1},
				{"isThrdRowLeCushFldLckMotSts2",2,343,341},
				{"isIntrMirrRespResdBoolean_1",1,24,-1},
				{"isSeatRowSecLeSwtStsPassSeatSwtInclSts",2,56,-1},
				{"isPassSeatIntgrSwtStsIntgrSwtSelnSts",2,35,-1},
				{"isIndcrOfDeactvtReFog",1,10,9},
				{"isSecRowLeMassgLimtStsFb",4,311,307},
				{"isInterLockCom2Data2_1",8,167,-1},
				{"isSeatRowSecLeSwtStsPassSeatSwtAdjmtOfSpplFctHozlSts",2,52,-1},
				{"isImobVehRemMgrSts1ImobVehRemMgrSts",2,15,-1},
				{"isHwRowFrstDrvrLegRotSwt",2,267,265},
				{"isBBWBrkSysLampReq",2,114,112},
				{"isSeatRowThrdRiCushFldPosPercSeatPosPerc",10,127,-1},
				{"isInterLockCom2Data1_1",8,159,-1},
				{"isSecRowLeRot180Swt2",1,306,305},
				{"isDrvrSeatLimtStsFb",8,279,130},
				{"isSeatRowSecRiSwtStsPassSeatSwtSldSts",2,95,-1},
				{"isSecRowLeRot0Swt2",1,282,281},
				{"isDrvrLockContnSts_0",1,65,64},
				{"isSeatRowSecLeSwtStsPassSeatSwtHdrstVertSts",2,62,-1},
				{"isThrdRowLeLimtStsFb",8,351,304},
				{"isPassSeatLimtStsFb",8,295,264},
				{"isDrvrSeatLegRotPosPercSeatPosQf",2,261,-1},
				{"isSeatRowSecLeSwtStsPassSeatSwtHdrstHozlSts",2,48,-1},
				{"isSecRowRiRot0Swt2",1,327,326},
				{"isSeatRowSecRiSwtStsPassSeatSwtHeiFrntSts",2,87,-1},
				{"isOxygenSplyDesPwrCns_1",11,365,370},
				{"isInterLockCom2Data5_1",8,191,-1},
				{"isSeatRowThrdRiLegRstHeiPosPercSeatPosPerc",10,143,-1},
				{"isThrdRowRiCushFldLckMotSts2",2,340,338},
				{"isSecRowLeLimtStsFb",8,303,283},
				{"isSeatRowSecLeSwtStsPassSeatSwtSldSts",2,68,-1},
				{"isRowReLeModSwtSts_1",1,369,368},
				{"isHwRowFrstDrvrLegExtSwt",2,146,144},
				{"isIntrMirrRespIntrMirrDimPerc_1",8,23,-1},
				{"isSecRowRiLimtStsFb",8,319,280},
				{"isSeatRowSecRiSwtStsPassSeatSwtAdjmtOfSpplFctHozlSts",2,79,-1},
				{"isSeatRowThrdLeCushFldPosPercSeatPosPerc",10,92,-1},
				{"isSeatRowSecLeSwtStsPassSeatSwtHeiSts",2,58,-1},
				{"isDrvrSeatLegExtMotSts",4,243,270}
			},
			{
				{"igImobVehRemMgrSts1","ZCUDZCUCANFD2SignalIPdu69",13},
				{"igSeatRowThrdRiCushFldPosPerc","ZCUDZCUCANFD2SignalIPdu69",131},
				{"igDrvrSeatLegExtPosPerc","ZCUDZCUCANFD2SignalIPdu69",271},
				{"igSeatRowThrdLeCushFldPosPerc","ZCUDZCUCANFD2SignalIPdu69",96},
				{"igBtnSldgRiReSts1","ZCUDZCUCANFD2SignalIPdu69",224},
				{"igSeatRowThrdRiLegRstHeiPosPerc","ZCUDZCUCANFD2SignalIPdu69",147},
				{"igDrvrSeatLegRotPosPerc","ZCUDZCUCANFD2SignalIPdu69",269},
				{"igBtnSldgLeReTrSts1","ZCUDZCUCANFD2SignalIPdu69",216},
				{"igSeatRowSecRiSwtSts","ZCUDZCUCANFD2SignalIPdu69",93},
				{"igSeatRowThrdLeLegRstHeiPosPerc","ZCUDZCUCANFD2SignalIPdu69",115},
				{"igPassSeatIntgrSwtSts","ZCUDZCUCANFD2SignalIPdu69",47},
				{"igInterLockCom2_1","ZCUDZCUCANFD2SignalIPdu69",40},
				{"igSeatRowSecLeSwtSts","ZCUDZCUCANFD2SignalIPdu69",66},
				{"igIntrMirrResp_1","ZCUDZCUCANFD2SignalIPdu69",8}
			}
		},
		{"ZCU_CANFD2","ZCUDZCUCANFD2PduR1000Fr31","Out",0x4e9,64,0,1,1,0},
		{"ZCU_CANFD2","ZCUDZCUCANFD2PduR1000Fr18","Out",0x3a8,64,0,1,1,0},
		{
			"ZCU_CANFD2","ZCUDZCUCANFD2Fr38","Out",0x331,64,200,1,0,0,204,15,
			{
				{"isLeReDoorStopReazonThermalProtection",1,72,-1},
				{"isBltLockStAtRowThrdMidBltLockSt1_2",1,238,-1},
				{"isDrvrSeatHeatgAvlSts",3,235,232},
				{"isLeReDoorStopReazonPDOSensorFault",1,68,-1},
				{"isRiReDoorStopReazonSmallAngle",1,130,-1},
				{"isWiprMotErr",1,337,336},
				{"isDrvrReDoorSpindleMotorFault_1",4,140,136},
				{"isHybErrIndcnReqTelltlBattTracFailr_1",1,214,-1},
				{"isLeReDoorStopReazonAntiPlay",1,62,-1},
				{"isDrvrDoorStopReazonDriveTimeout",1,38,-1},
				{"isLeReDoorStopReazonSafeWindowsIsInactive",1,76,-1},
				{"isDrvrSeatVentnLvlSts",2,252,250},
				{"isRiReDoorStopReazonChildLockActive",1,116,-1},
				{"isDrvrSeatVentnDesPwrCns",8,207,240},
				{"isPassSeatActvSwtFctMod",2,279,277},
				{"isDrvrDoorStopReazonSmallAngle",1,54,-1},
				{"isLeReDoorStopReazonChildLockActive",1,60,-1},
				{"isRiReDoorStopReazonOtherDoorSmallAngle",1,126,-1},
				{"isBattSnsrStReq_1",2,281,289},
				{"isAMBStsHUDLiIllmnChks_1",8,8,-1},
				{"isStsOfIntegratedLvlgRiStsOfLvlgRiCntr",4,175,-1},
				{"isBltLockStAtRowFrthMidBltLockSt1_1",1,230,-1},
				{"isPassDoorStopReazonSmallAngle",1,111,-1},
				{"isDoorSldngRiReWarnSts_1",1,305,304},
				{"isRiReDoorStopReazonPositionUnkown",1,123,-1},
				{"isRiReDoorStopReazonAntiPlay",1,118,-1},
				{"isDrvrDoorStopReazonReserved1",1,45,-1},
				{"isPassDoorStopReazonEnvironmentTempOverLimit",1,94,-1},
				{"isRiReDoorStopReazonPDOFailure",1,125,-1},
				{"isBltLockStAtRowFrthRiBltLockEquid_1",1,227,-1},
				{"isDrvrDoorStopReazonPowerStatusAbnormal",1,46,-1},
				{"isDwnLoadStsFbOfIntegratedHdlampRi",2,260,258},
				{"isDrvrDoorStopReazonPDOFailure",1,33,-1},
				{"isVehLockComData2_0",8,399,-1},
				{"isDrvrDoorStopReazonMoveToExpectedPosition",1,35,-1},
				{"isPassDoorStopReazonUSSfault",1,108,-1},
				{"isRiReDoorStopReazonReserved2",1,120,-1},
				{"isDrvrDoorStopReazonPositionUnkown",1,47,-1},
				{"isStsOfIntegratedLedLoBeamRi",2,372,370},
				{"isRiReDoorStopReazonLatchFailure",1,112,-1},
				{"isPassDoorStopReazonStallHappened",1,110,-1},
				{"isPassDoorStopReazonVehMtnSt",1,107,-1},
				{"isStsOfIntegratedLedDaytiRunngLampRi",2,324,322},
				{"isVehLockComData4_0",8,415,-1},
				{"isVehLockComData3_0",8,407,-1},
				{"isSeatOccptAtRowFrthMid_1",2,287,285},
				{"isLeReDoorStopReazonAntiPinchhappend",1,63,-1},
				{"isBltLockStAtRowFrthLeBltLockSts_1",1,217,-1},
				{"isReCurtBtnSts_1",3,463,460},
				{"isPassDoorStopReazonPositionUnkown",1,88,-1},
				{"isRiReDoorStopReazonStallHappened",1,129,-1},
				{"isRoofBtnSts_1",3,459,456},
				{"isDrvrDoorStopReazonAvoidObstaclehappened",1,25,-1},
				{"isVehLockComData5_0",8,423,-1},
				{"isDrvrDoorStopReazonThermalProtection",1,52,-1},
				{"isDrvrDoorStopReazonPDOSensorFault",1,32,-1},
				{"isStsOfIntegratedLedFrntTurnIndcrLe",2,359,357},
				{"isBltLockStAtRowFrthLeBltLockEquid_1",1,219,-1},
				{"isPassDoorStopReazonSafeWindowsIsInactive",1,97,-1},
				{"isExtrLiShowStoreStsIntegratedFrntLe",1,105,104},
				{"isDrvrDoorStopReazonReserved5",1,41,-1},
				{"isPassDoorStopReazonReserved5",1,98,-1},
				{"isStsOfIntegratedWelGbyFrntRi",1,265,264},
				{"isRiReDoorStopReazonMoveToExpectedPosition",1,127,-1},
				{"isHybErrIndcnReqTelltlSysHybFailr_1",1,212,-1},
				{"isWiprWshrMgrErrDetd",1,353,352},
				{"isBltLockStAtRowFrthMidBltLockSts_1",1,229,-1},
				{"isPassDoorStopReazonReserved1",1,102,-1},
				{"isStsOfIntegratedLedFrntAutoDrvMkrLampLe",2,335,333},
				{"isStsOfIntegratedLvlgLeStsOfLvlgLe",2,155,-1},
				{"isLeReDoorStopReazonDriveTimeout",1,58,-1},
				{"isDrvrDoorStopReazonAntiPlay",1,26,-1},
				{"isDrvrDoorStopReazonOtherDoorSmallAngle",1,34,-1},
				{"isDrvrSeatVentnActlPwrCns",8,199,168},
				{"isStsOfIntegratedLedFrntFogLampLe",2,343,341},
				{"isRiReDoorStopReazonReserved3",1,135,-1},
				{"isBltLockStAtRowThrdMidBltLockSts_2",1,237,-1},
				{"isBltLockStAtPassMidBltLockSts_1",1,221,-1},
				{"isAMBStsHUDLiIllmnAMBStsHUDLiIllmn_1",15,7,-1},
				{"isLeReDoorStopReazonUSSfault",1,87,-1},
				{"isPassDoorStopReazonThermalProtection",1,109,-1},
				{"isDrvrDoorStopReazonReserved3",1,43,-1},
				{"isPassDoorStopReazonSlopeOverLimit",1,96,-1},
				{"isLeReDoorStopReazonCommandConflict",1,59,-1},
				{"isDrvrDoorStopReazonStallHappened",1,53,-1},
				{"isStsOfIntegratedLedFrntPosnLampRi",2,348,346},
				{"isSeatOccptAtRowFrthRi_1",2,284,282},
				{"isPassDoorStopReazonCommandConflict",1,80,-1},
				{"isStsOfIntegratedLedHiBeamRi",2,364,362},
				{"isBltLockStAtRowThrdMidBltLockEquid_2",1,239,-1},
				{"isDrvrDoorStopReazonVehMtnSt",1,50,-1},
				{"isPassDoorStopReazonReserved2",1,101,-1},
				{"isLeReDoorStopReazonPDOFailure",1,69,-1},
				{"isPassDoorStopReazonReserved3",1,100,-1},
				{"isFrCurtBtnSts_1",3,451,448},
				{"isStsOfIntegratedLedFrntAutoDrvMkrLampRi",2,332,330},
				{"isStsOfIntegratedLedFrntFogLampRi",2,340,338},
				{"isPassDoorStopReazonLatchFailure",1,93,-1},
				{"isLeReDoorStopReazonSmallAngle",1,74,-1},
				{"isStsOfIntegratedAhbcRi",2,300,298},
				{"isVehLockComData7_0",8,439,-1},
				{"isStsOfIntegratedFrntSideMkrLampRi",2,308,306},
				{"isHybErrIndcnReqTelltlBattTracCutOff_1",1,215,-1},
				{"isWiprLvrComErrDetd",1,313,312},
				{"isRiReDoorStopReazonThermalProtection",1,128,-1},
				{"isCurtBtnSts_1",3,455,452},
				{"isStsOfIntegratedLvlgLeStsOfLvlgLeChks",8,151,-1},
				{"isLeReDoorStopReazonPositionUnkown",1,67,-1},
				{"isDoorSldngLeReWarnSts_1",1,297,296},
				{"isRiReDoorStopReazonAntiPinchhappend",1,119,-1},
				{"isWiprLvrNodErrDetd",1,321,320},
				{"isVehLockComData8_0",8,447,-1},
				{"isStsOfIntegratedSwvlgRi",2,380,378},
				{"isBltLockStAtPassMidBltLockEquid_1",1,223,-1},
				{"isLeReDoorStopReazonStallHappened",1,73,-1},
				{"isRiReDoorStopReazonUSSfault",1,143,-1},
				{"isDrvrDoorStopReazonLatchFailure",1,36,-1},
				{"isDrvrSeatHeatgActlPwrCns",8,183,48},
				{"isDrvrDoorStopReazonReserved4",1,42,-1},
				{"isStsOfIntegratedAfsRi",2,292,290},
				{"isPassDoorStopReazonChildLockActive",1,81,-1},
				{"isDrvrSeatHeatgDesPwrCns",8,191,152},
				{"isStsOfIntegratedLvlgRiStsOfLvlgRi",2,171,-1},
				{"isSunRoofAndCurtBtnSts2Cntr_1",2,468,-1},
				{"isPassDoorStopReazonAntiPlay",1,83,-1},
				{"isPassDoorStopReazonPDOFailure",1,90,-1},
				{"isCfgPrmStsFromKnkSnsr_1",2,210,208},
				{"isDrvrDoorStopReazonUSSfault",1,51,-1},
				{"isRiReDoorStopReazonCommandConflict",1,115,-1},
				{"isRiReDoorStopReazonSafeWindowsIsInactive",1,132,-1},
				{"isStsOfIntegratedLedFrntTurnIndcrRi",2,356,354},
				{"isLeReDoorStopReazonLatchFailure",1,56,-1},
				{"isDrvrSeatVentAvlSts",3,247,244},
				{"isExtrLiShowStoreStsIntegratedFrntRi",1,249,248},
				{"isDrvrDoorStopReazonSlopeOverLimit",1,55,-1},
				{"isStsOfIntegratedLedHiBeamLe",2,367,365},
				{"isTrInsdOpenSwtSts_1",1,273,272},
				{"isExtrLiShowActvnIntegratedFrntLeFb",2,271,269},
				{"isRiReDoorStopReazonDriveTimeout",1,114,-1},
				{"isRiReDoorStopReazonSlopeOverLimit",1,131,-1},
				{"isSunRoofAndCurtBtnSts2Pos_1",3,471,-1},
				{"isExtrLiShowActvnIntegratedFrntRiFb",2,268,266},
				{"isDrvrDoorStopReazonEnvironmentTempOverLimit",1,37,-1},
				{"isBltLockStAtRowFrthRiBltLockSt1_1",1,226,-1},
				{"isLeReDoorStopReazonReserved4",1,78,-1},
				{"isStsOfIntegratedLvlgLeStsOfLvlgLeCntr",4,159,-1},
				{"isRiReDoorStopReazonEnvironmentTempOverLimit",1,113,-1},
				{"isRiReDoorStopReazonPDOSensorFault",1,124,-1},
				{"isPassDoorStopReazonPowerStatusAbnormal",1,103,-1},
				{"isDwnLoadStsFbOfIntegratedHdlampLe",2,263,261},
				{"isPassDoorStopReazonAntiPinchhappend",1,84,-1},
				{"isStsOfIntegratedFrntSideMkrLampLe",2,311,309},
				{"isPassDoorStopReazonMoveToExpectedPosition",1,92,-1},
				{"isPassDoorStopReazonReserved4",1,99,-1},
				{"isStsOfIntegratedAhbcLe",2,303,301},
				{"isHybErrIndcnReqTelltlElecDrvFailr_1",1,213,-1},
				{"isStsOfIntegratedLedLoBeamLe",2,375,373},
				{"isDrvrDoorStopReazonCommandConflict",1,39,-1},
				{"isRiReDoorStopReazonVehMtnSt",1,142,-1},
				{"isStsOfIntegratedSwvlgLe",2,383,381},
				{"isLeReDoorStopReazonMoveToExpectedPosition",1,71,-1},
				{"isPassDoorStopReazonDriveTimeout",1,95,-1},
				{"isAMBStsHUDLiIllmnCntr_1",4,16,-1},
				{"isStsOfIntegratedLedDaytiRunngLampLe",2,327,325},
				{"isBltLockStAtRowFrthLeBltLockSt1_1",1,218,-1},
				{"isWiprMotNodErrDetd",1,345,344},
				{"isDrvrDoorStopReazonReserved2",1,44,-1},
				{"isTrRelsReq_0",2,479,477},
				{"isPassDoorStopReazonAvoidObstaclehappened",1,82,-1},
				{"isStsOfIntegratedLvlgRiStsOfLvlgRiChks",8,167,-1},
				{"isLeReDoorStopReazonReserved2",1,64,-1},
				{"isStsOfIntegratedLedCornrgLampRi",2,316,314},
				{"isStsOfIntegratedWelGbyFrntLe",1,257,256},
				{"isLeReDoorStopReazonReserved1",1,65,-1},
				{"isBltLockStAtPassMidBltLockSt1_1",1,222,-1},
				{"isLeReDoorStopReazonAvoidObstaclehappened",1,61,-1},
				{"isLeReDoorStopReazonOtherDoorSmallAngle",1,70,-1},
				{"isStsOfIntegratedLedFrntPosnLampLe",2,351,349},
				{"isDrvrDoorStopReazonAntiPinchhappend",1,27,-1},
				{"isRiReDoorStopReazonReserved4",1,134,-1},
				{"isDrvrDoorStopReazonChildLockActive",1,24,-1},
				{"isVehLockComData6_0",8,431,-1},
				{"isPassDoorStopReazonPDOSensorFault",1,89,-1},
				{"isRiReDoorStopReazonReserved1",1,121,-1},
				{"isRiReDoorStopReazonPowerStatusAbnormal",1,122,-1},
				{"isDrvrDoorStopReazonSafeWindowsIsInactive",1,40,-1},
				{"isStsOfIntegratedLedCornrgLampLe",2,319,317},
				{"isRiReDoorStopReazonAvoidObstaclehappened",1,117,-1},
				{"isLeReDoorStopReazonPowerStatusAbnormal",1,66,-1},
				{"isStsOfIntegratedAfsLe",2,295,293},
				{"isLeReDoorStopReazonSlopeOverLimit",1,75,-1},
				{"isLeReDoorStopReazonReserved5",1,77,-1},
				{"isRiReDoorStopReazonReserved5",1,133,-1},
				{"isBltLockStAtRowFrthRiBltLockSts_1",1,225,-1},
				{"isDrvrSeatHeatgLvlSts",2,255,253},
				{"isVehLockComData1_0",8,391,-1},
				{"isLeReDoorStopReazonReserved3",1,79,-1},
				{"isSeatOccptAtRowFrthLe_1",2,276,274},
				{"isLeReDoorStopReazonEnvironmentTempOverLimit",1,57,-1},
				{"isBltLockStAtRowFrthMidBltLockEquid_1",1,231,-1},
				{"isWiprMotComErrDetd",1,329,328},
				{"isLeReDoorStopReazonVehMtnSt",1,86,-1},
				{"isDrvrSeatActvSwtFctMod",2,243,241},
				{"isPassDoorStopReazonOtherDoorSmallAngle",1,91,-1}
			},
			{
				{"igBltLockStAtRowThrdMid_2","ZCUDZCUCANFD2SignalIPdu38",236},
				{"igRiReDoorStopReazon","ZCUDZCUCANFD2SignalIPdu38",141},
				{"igLeReDoorStopReazon","ZCUDZCUCANFD2SignalIPdu38",85},
				{"igBltLockStAtRowFrthRi_1","ZCUDZCUCANFD2SignalIPdu38",224},
				{"igAMBStsHUDLiIllmn_1","ZCUDZCUCANFD2SignalIPdu38",28},
				{"igVehLockCom_0","ZCUDZCUCANFD2SignalIPdu38",288},
				{"igBltLockStAtRowFrthMid_1","ZCUDZCUCANFD2SignalIPdu38",228},
				{"igBltLockStAtPassMid_1","ZCUDZCUCANFD2SignalIPdu38",220},
				{"igSunRoofAndCurtBtnSts2_1","ZCUDZCUCANFD2SignalIPdu38",466},
				{"igPassDoorStopReazon","ZCUDZCUCANFD2SignalIPdu38",106},
				{"igStsOfIntegratedLvlgLe","ZCUDZCUCANFD2SignalIPdu38",153},
				{"igDrvrDoorStopReazon","ZCUDZCUCANFD2SignalIPdu38",49},
				{"igHybErrIndcnReq_1","ZCUDZCUCANFD2SignalIPdu38",211},
				{"igStsOfIntegratedLvlgRi","ZCUDZCUCANFD2SignalIPdu38",169},
				{"igBltLockStAtRowFrthLe_1","ZCUDZCUCANFD2SignalIPdu38",216}
			}
		},
		{"ZCU_CANFD2","ZCUDZCUCANFD2PduR1000Fr23","Out",0x4bc,64,0,1,1,0},
		{"ZCU_CANFD2","ZCUDZCUCANFD2PduR250Fr07","Out",0x300,64,0,1,1,0},
		{"ZCU_CANFD2","ZCUDZCUCANFD2PduR1000Fr20","Out",0x3ce,64,0,1,1,0},
		{"ZCU_CANFD2","ZcudSumToDhuZCUCANFD2DiagResFr","Out",0x641,64,0,1,4,0},
		{"ZCU_CANFD2","ZCUDZCUCANFD2PduR500Fr17","Out",0x4d2,64,0,1,1,0},
		{"ZCU_CANFD2","ZcudHwamToDhuZCUCANFD2DiagResFr","Out",0x640,64,0,1,4,0},
		{"ZCU_CANFD2","ZCUDZCUCANFD2PduR1000Fr02","Out",0x47f,64,0,1,1,0},
		{"ZCU_CANFD2","ZcudDpodToDhuZCUCANFD2DiagResFr","Out",0x649,64,0,1,4,0},
		{
			"ZCU_CANFD2","ZCUDZCUCANFD2Fr13","Out",0x80,64,30,1,0,0,87,14,
			{
				{"isPtTqAtWhlFrntActPtTqAtWhlFrntRiAct_1",16,39,-1},
				{"isSteerWhlEntertainmentSwtUpBtn_1",1,207,-1},
				{"isApproachLiSetSts",1,477,476},
				{"isSteerWhlEntertainmentSwtHomeBtn_1",1,184,-1},
				{"isSteerWhlCrsSwtReserveBtn2_1",1,142,-1},
				{"isSteerWhlEntertainmentSwtReserveBtn1_1",1,194,-1},
				{"isHudSnsrErrSnsrErr_1",1,169,-1},
				{"isHvSysRlyStsChks_1",8,343,-1},
				{"isDstEstimdToEmptyForDrvgElec_1",11,423,428},
				{"isHWAColAgMaxH1_1",15,311,312},
				{"isHvBattLimnIndcn_2",16,295,104},
				{"isSteerWhlEntertainmentSwtDwnBtn_1",1,185,-1},
				{"isSteerWhlCrsSwtQf_1",2,121,-1},
				{"isHvSysRlyStsCntr_1",4,351,-1},
				{"isSteerWhlEntertainmentSwtLeBtn_1",1,199,-1},
				{"isAutomaticHighBeamSetSts",1,473,472},
				{"isSteerWhlCrsSwtCntr_1",4,127,-1},
				{"isSteerWhlCrsSwtDwnBtn_1",1,129,-1},
				{"isHWASyncStsGroupH1SyncSts_2",2,444,-1},
				{"isSteerWhlEntertainmentSwtMenuBtn_1",1,198,-1},
				{"isDstToEmptyIndcdDstToEmpty2_1",13,407,410},
				{"isDstEstimdToEmptyForDrvgElecPredTyp2_1",11,427,432},
				{"isIsgIDc_1",14,375,377},
				{"isSteerWhlCrsSwtChks_1",8,119,-1},
				{"isPtTqAtWhlFrntActCntr_1",4,63,-1},
				{"isR290LeakSts_1",1,458,457},
				{"isEngNSafeEngNChks_1",8,88,-1},
				{"isEngNSafeEngNGrdt_1",16,71,-1},
				{"isActvOfElectcTriWarn",1,490,489},
				{"isSteerWhlEntertainmentSwtViewBtn_1",1,206,-1},
				{"isSteerWhlCrsSwtResuBtn_1",2,135,-1},
				{"isSteerWhlCrsSwtTimeGapBtn_1",1,139,-1},
				{"isSBWSysDegradationStsR2Cntr_1",4,335,-1},
				{"isPtTqAtWhlFrntActChks_1",8,55,-1},
				{"isSteerWhlCrsSwtSetAndCnclBtn_1",2,133,-1},
				{"isHWA1EgyCnsGroupIVal_1",13,203,-1},
				{"isPtTqAtWhlFrntActPtTqAtWhlFrntLeAct_1",16,23,-1},
				{"isSteerWhlCrsSwtRiBtn_1",1,141,-1},
				{"isSBWSysDegradationStsR2DegradationSts_1",4,331,-1},
				{"isEngNSafeEngNCntr_1",4,96,-1},
				{"isHvBattPreChrgReq_2",1,441,440},
				{"isHWASyncStsGroupH1SyncOvrdIndcn_2",3,447,-1},
				{"isSteerWhlCrsSwtSetBtn_1",1,140,-1},
				{"isSteerWhlEntertainmentSwtReserveBtn2_1",1,193,-1},
				{"isRWA2EgyCnsGroupUval_1",13,279,-1},
				{"isSteerWhlCrsSwtLeBtn_1",1,128,-1},
				{"isDstToEmptyIndcdDstToEmpty1_1",13,391,394},
				{"isRowSecRiHeiPosPercSeatPosPerc_1",10,487,-1},
				{"isSteerWhlEntertainmentSwtModBtn_1",1,197,-1},
				{"isSteerWhlEntertainmentSwtVoiceBtn_1",1,205,-1},
				{"isAssistantLightEnaSetSts",1,475,474},
				{"isSteerWhlEntertainmentSwtRiBtn_1",1,192,-1},
				{"isRWA2EgyCnsGroupIVal_1",13,260,-1},
				{"isHWA1EgyCnsGroupUval_1",13,222,-1},
				{"isSteerWhlEntertainmentSwtCustBtn_1",1,186,-1},
				{"isHvSysRlyStsHvSysRlySts_1",2,347,-1},
				{"isHudSnsrErrParChk_1",1,170,-1},
				{"isEpbDrvrDispSec_1",4,463,459},
				{"isSteerWhlCrsSwtUpAndResuBtn_1",2,131,-1},
				{"isRowSecRiHeiPosPercSeatPosQf_1",2,493,-1},
				{"isGearMovmtFlg_1",2,107,105},
				{"isPtGearAct_1",4,467,456},
				{"isRWA1EgyCnsGroupUval_1",13,242,-1},
				{"isSteerWhlCrsSwtCnclBtn_1",2,123,-1},
				{"isHWAMotTqGroupH1TarMotTq_1",14,153,-1},
				{"isSteerWhlEntertainmentSwtCmfBtn_1",1,187,-1},
				{"isHWARefHandWhlTqH1_1",14,359,361},
				{"isSteerWhlCrsSwtUpBtn_1",1,138,-1},
				{"isFuLvlLoIndcnECM_1",1,409,408},
				{"isSteerWhlEntertainmentSwtChks_1",8,183,-1},
				{"isSteerWhlCrsSwtAPABtn_1",1,143,-1},
				{"isEngNSafeEngN_1",15,87,-1},
				{"isHWASyncStsGroupH2SyncSts_1",2,452,-1},
				{"isSteerWhlEntertainmentSwtMuteBtn_1",1,196,-1},
				{"isHWAMotTqGroupH1EstimateMotTq_1",14,151,-1},
				{"isSteerWhlEntertainmentSwtCntr_1",4,191,-1},
				{"isRWA1EgyCnsGroupIVal_1",13,239,-1},
				{"isLiLvrSwt1_1",1,449,448},
				{"isSBWSysDegradationStsR2Chks_1",8,327,-1},
				{"isActnOfAssistantLi_0",1,479,478},
				{"isEboostModSts_1",1,393,392},
				{"isDrvgCycToClrPrmntDtc_1",1,281,280},
				{"isPtTqAtWhlFrntActPtTqAtWhlsFrntQly_1",3,59,-1},
				{"isSteerWhlEntertainmentSwtBoostBtn_1",1,195,-1},
				{"isHoodOpenerSts_1",4,471,344},
				{"isPtTqAtWhlFrntActPtTqAtAxleFrntAct_1",16,7,-1},
				{"isHWASyncStsGroupH2SyncOvrdIndcn_1",3,455,-1}
			},
			{
				{"igSBWSysDegradationStsR2_1","ZCUDZCUCANFD2SignalIPdu13",136},
				{"igHWA1EgyCnsGroup_1","ZCUDZCUCANFD2SignalIPdu13",225},
				{"igHWAMotTqGroupH1_1","ZCUDZCUCANFD2SignalIPdu13",171},
				{"igSteerWhlCrsSwt_1","ZCUDZCUCANFD2SignalIPdu13",137},
				{"igPtTqAtWhlFrntAct_1","ZCUDZCUCANFD2SignalIPdu13",56},
				{"igEngNSafe_1","ZCUDZCUCANFD2SignalIPdu13",108},
				{"igHudSnsrErr_1","ZCUDZCUCANFD2SignalIPdu13",168},
				{"igSteerWhlEntertainmentSwt_1","ZCUDZCUCANFD2SignalIPdu13",204},
				{"igRowSecRiHeiPosPerc_1","ZCUDZCUCANFD2SignalIPdu13",491},
				{"igHWASyncStsGroupH1_2","ZCUDZCUCANFD2SignalIPdu13",442},
				{"igRWA2EgyCnsGroup_1","ZCUDZCUCANFD2SignalIPdu13",282},
				{"igHvSysRlySts_1","ZCUDZCUCANFD2SignalIPdu13",345},
				{"igHWASyncStsGroupH2_1","ZCUDZCUCANFD2SignalIPdu13",450},
				{"igRWA1EgyCnsGroup_1","ZCUDZCUCANFD2SignalIPdu13",261}
			}
		},
		{"ZCU_CANFD2","ZcudWprlToDhuZCUCANFD2DiagResFr","Out",0x636,64,0,1,4,0},
		{
			"ZCU_CANFD2","ZCUDZCUCANFD2Fr20","Out",0x2e0,64,100,1,0,0,134,11,
			{
				{"isNewBattFltStsPrimThermRunawayFlt_1",1,471,-1},
				{"isGVMCBrkTqReqReLe_1",12,149,-1},
				{"isGVMCBrkTqReqWhlVAgrMinReqFrntLe_1",16,61,-1},
				{"isLiExtSwtLiExtFctCntr_1",2,439,-1},
				{"isLockgInhbStsLvlElecMai",4,287,-1},
				{"isActvnOfCarLoctr_0",1,359,358},
				{"isExtMirrAntiGlareSwtFbMirrPass",1,310,-1},
				{"isMobDevBtnHoodReq",3,511,508},
				{"isPassDiagcStopReq",1,251,250},
				{"isNewBattFltStsPrimOvCellFlt_1",1,463,-1},
				{"isHoodStsWithSftyCntr",4,279,-1},
				{"isWiprLvrDiagc_1",2,239,237},
				{"isActnOfFrntFogLampPass",1,263,262},
				{"isActvnOfHndlDoorLi1HndlDoorLiPass",2,363,-1},
				{"isActnOfLedPosnLampDyn_0",1,333,332},
				{"isRainDetected_2",1,259,258},
				{"isExtrMirrEnaStsAtDrvrDwnEna",1,422,-1},
				{"isDrvrSeatActvSpplFct",3,255,252},
				{"isDrvrSeatLumbDownFltSts",1,369,368},
				{"isLiExtSwtLiExtFctQf_1",2,437,-1},
				{"isNewBattFltStsPrimChks_1",8,447,-1},
				{"isActvnOfLiForComity",1,257,256},
				{"isTrRelsReqNotSafe",1,499,498},
				{"isGVMCBrkTqReqChks_1",8,173,-1},
				{"isMirrPosnAdjFromSetTarPosnPassMirrAdjLeRi",14,391,-1},
				{"isWinWshrLvrCmd_1",2,231,229},
				{"isActvnOfLiForWait",1,297,296},
				{"isCinhDrvrSts_0",1,327,326},
				{"isHoodStsWithSftyDoorSts2",2,275,-1},
				{"isChrgLidManvgDCorAcDcActPosn2",8,7,272},
				{"isDoorLeRePercPosn2",7,15,8},
				{"isThrdLeVentnHeatgWarn_1",2,418,416},
				{"isBDCstCntr_1",4,475,-1},
				{"isPassSeatAdjmtLimForFldWarn",1,261,260},
				{"isChdPrtnLeftStsToHmi",2,234,232},
				{"isTrApprchOpenFbToExtLi",3,507,504},
				{"isGVMCBrkTqReqFrntLe_1",12,125,-1},
				{"isDoorDrvrHldExitRmm2_1",1,353,352},
				{"isNewBattFltStsPrimUvCellFlt_1",1,470,-1},
				{"isIntrMirrAntiGlareSwtFb",1,236,235},
				{"isActvReSplrPosnCmd_1",3,39,36},
				{"isDcDcPwrLim_1",1,355,354},
				{"isGVMCBrkTqReqWhlVAgrMinReqFrntRi_1",16,77,-1},
				{"isGVMCBrkTqReqReLeCtrlMod_1",2,189,-1},
				{"isActvnOfSymIllmn_2",1,319,318},
				{"isPassSeatActvSpplFct",3,35,32},
				{"isDrvrSeatLumbVertSts",2,308,306},
				{"isTCSDoorSts_1",1,295,294},
				{"isNewBattFltStsPrimReserved1_1",1,459,-1},
				{"isActvnOfPudLi",1,305,304},
				{"isThrdRowLeSeatHeatgBtn_1",1,293,292},
				{"isDrvrSeatLumbHozlSts",2,243,241},
				{"isBDCstBDCst_1",3,495,-1},
				{"isNewBattFltStsPrimScFlt_1",1,456,-1},
				{"isActnOfLoBeamPassCntr",4,351,-1},
				{"isHoodRelsSlvFail",1,228,227},
				{"isLockgInhbStsLvlElecSubtyp",4,283,-1},
				{"isActnOfDaytiRunngLampPass",1,249,248},
				{"isChdLockRightStsToHmi",2,218,216},
				{"isThrdRiVentnHeatgWarn_1",2,410,408},
				{"isGVMCBrkTqReqWhlVAgrMinReqReRi_1",16,109,-1},
				{"isActnOfLoBeamPassChks",8,343,-1},
				{"isThrdRowRiSeatHeatgBtn_1",1,291,290},
				{"isRowSecLeSeatActvSpplFct",3,215,212},
				{"isThrdRowLeHeatgAutoSts_1",2,194,192},
				{"isExtrMirrEnaStsAtDrvrFoldEna",1,421,-1},
				{"isActnOfHiBeamPass",1,335,334},
				{"isGVMCBrkTqReqFrntRiCtrlMod_1",2,191,-1},
				{"isActvnOfHndlDoorLi1HndlDoorLiDrvrRe",2,365,-1},
				{"isWhlFailrSts",8,47,184},
				{"isPasAlrmSts",1,245,244},
				{"isLiExtSwtLiExtFctReq1_1",2,435,-1},
				{"isGVMCBrkTqReqWhlVAgrMinReqReLe_1",16,93,-1},
				{"isTrReqFromSwtIntr",1,497,496},
				{"isIntrBriSts_3",4,199,195},
				{"isActnOfRvsgLampPass",1,345,344},
				{"isActnOfReFogLampDrv",1,331,330},
				{"isGVMCBrkTqReqReRiCtrlMod_1",2,187,-1},
				{"isCalforAWMPosn_1",2,202,200},
				{"isLockgPrsnlSts",1,247,246},
				{"isTankFlapReqFromSwtIntr",1,501,500},
				{"isHoodRelsMstFail",1,220,219},
				{"isDoorRiRePercPosn2",7,31,24},
				{"isMirrPosnAdjFromSetTarPosnPassMirrAdjUpDown",14,393,-1},
				{"isActvnOfLiForSpkr",1,289,288},
				{"isGVMCBrkTqReqFrntLeCtrlMod_1",2,177,-1},
				{"isGVMCBrkTqReqReRi_1",12,153,-1},
				{"isNewBattFltStsPrimPreThermRunawayFlt_1",1,461,-1},
				{"isThrdSeatRiCushFldLckMotSts2_1",2,466,464},
				{"isActvnOfWaitMode_0",1,317,316},
				{"isNewBattFltStsPrimOcFlt_1",1,448,-1},
				{"isDrvrSeatLumbFwdFltSts",1,383,382},
				{"isAlcoLockMgrWarnlndcn",5,303,298},
				{"isNewBattFltStsPrimHiTFlt_1",1,449,-1},
				{"isActvnOfHndlDoorLi1HndlDoorLiDrvr",2,367,-1},
				{"isTCSFltSts_1",4,207,203},
				{"isDrvrSeatExtAdjAllowd",1,373,372},
				{"isNewBattFltStsPrimUvFlt_1",1,469,-1},
				{"isNewBattFltStsPrimResetActFlg_1",1,458,-1},
				{"isThrdRowRiHeatgAutoSts_1",2,223,221},
				{"isCinhDrvrReSwt_0",1,313,312},
				{"isDoorLeRePosn2",7,23,16},
				{"isRowSecRiSeatActvSpplFct",3,211,208},
				{"isDrvrSeatLumbUpFltSts",1,381,380},
				{"isBDCstChks_1",8,487,-1},
				{"isNewBattFltStsPrimFaultLevel_1",2,451,-1},
				{"isCinhDrvrSwt_0",1,357,356},
				{"isKeyReadReqFromLockg",4,492,488},
				{"isGVMCBrkTqReqFrntRi_1",12,129,-1},
				{"isNewBattFltStsPrimReserved0_1",1,460,-1},
				{"isExtMirrAntiGlareSwtFbMirrDrvr",1,311,-1},
				{"isEgyMeasRst_1",1,63,62},
				{"isNewBattFltStsPrimWakeupActvFlg_1",1,468,-1},
				{"isGVMCBrkTqReqCntr_1",4,181,-1},
				{"isDrvrSeatLumbBackwFltSts",1,371,370},
				{"isReFogLiSwt_1",1,479,478},
				{"isLiExtSwtLiExtFctCrc_1",8,431,-1},
				{"isHoodStsWithSftyChks",8,271,-1},
				{"isActnOfFrntPosnLampPass",1,321,320},
				{"isActnOfRePosnLampPass",1,329,328},
				{"isSwtAhbcReq_1",1,503,502},
				{"isNewBattFltStsPrimOvFlt_1",1,462,-1},
				{"isExtrMirrEnaStsAtDrvrReserved",1,420,-1},
				{"isDoorDrvrHoldingSts_1",1,375,374},
				{"isCinhDrvrReSts_0",1,315,314},
				{"isActvnOfHndlDoorLi1HndlDoorLiPassRe",2,361,-1},
				{"isThrdSeatLeCushFldLckMotSts2_1",2,379,377},
				{"isExtrMirrEnaStsAtDrvrAdjEna",1,423,-1},
				{"isDoorRiRePosn2",7,55,48},
				{"isNewBattFltStsPrimRlyOpenSoonIndcn_1",1,457,-1},
				{"isActnOfDynRePos",3,325,322},
				{"isActnOfLoBeamPassOnOff",1,347,-1},
				{"isNewBattFltStsPrimCntr_1",4,455,-1},
				{"isActvnOfHomeSafe",1,226,225}
			},
			{
				{"igMirrPosnAdjFromSetTarPosnPass","ZCUDZCUCANFD2SignalIPdu20",411},
				{"igHoodStsWithSfty","ZCUDZCUCANFD2SignalIPdu20",273},
				{"igActvnOfHndlDoorLi1","ZCUDZCUCANFD2SignalIPdu20",240},
				{"igExtMirrAntiGlareSwtFb","ZCUDZCUCANFD2SignalIPdu20",309},
				{"igExtrMirrEnaStsAtDrvr","ZCUDZCUCANFD2SignalIPdu20",419},
				{"igBDCst_1","ZCUDZCUCANFD2SignalIPdu20",476},
				{"igNewBattFltStsPrim_1","ZCUDZCUCANFD2SignalIPdu20",467},
				{"igLiExtSwt_1","ZCUDZCUCANFD2SignalIPdu20",433},
				{"igGVMCBrkTqReq_1","ZCUDZCUCANFD2SignalIPdu20",185},
				{"igLockgInhbSts","ZCUDZCUCANFD2SignalIPdu20",224},
				{"igActnOfLoBeamPass","ZCUDZCUCANFD2SignalIPdu20",346}
			}
		},
		{"ZCU_CANFD2","ZCUDZCUCANFD2Fr66","Out",0x53,64,0,1,1,0},
		{
			"ZCU_CANFD2","ZCUDZCUCANFD2Fr74","Out",0x4bb,64,1000,1,0,0,126,2,
			{
				{"isVFCVectorDSADVFCid45_1",1,40,-1},
				{"isVFCVectorHVFMVFCid35_1",1,98,-1},
				{"isVFCVectorDSADVFCid42_1",1,43,-1},
				{"isVFCVectorDSADVFCid49_1",1,52,-1},
				{"isVFCVectorDSADVFCid31_1",1,38,-1},
				{"isVFCVectorHVFMVFCid50_1",1,115,-1},
				{"isVFCVectorDSADVFCid30_1",1,39,-1},
				{"isVFCVectorHVFMVFCid47_1",1,118,-1},
				{"isVFCVectorHVFMVFCid13_1",1,72,-1},
				{"isVFCVectorDSADVFCid38_1",1,47,-1},
				{"isVFCVectorDSADVFCid43_1",1,42,-1},
				{"isVFCVectorDSADVFCid17_1",1,20,-1},
				{"isVFCVectorDSADVFCid46_1",1,55,-1},
				{"isVFCVectorHVFMVFCid10_1",1,75,-1},
				{"isVFCVectorHVFMVFCid43_1",1,106,-1},
				{"isVFCVectorHVFMVFCid44_1",1,105,-1},
				{"isVFCVectorDSADVFCid44_1",1,41,-1},
				{"isVFCVectorHVFMVFCid17_1",1,84,-1},
				{"isVFCVectorDSADVFCid39_1",1,46,-1},
				{"isVFCVectorHVFMVFCid34_1",1,99,-1},
				{"isVFCVectorDSADVFCid26_1",1,27,-1},
				{"isVFCVectorDSADVFCid12_1",1,9,-1},
				{"isVFCVectorDSADVFCid8_1",1,13,-1},
				{"isVFCVectorHVFMVFCid7_1",1,78,-1},
				{"isVFCVectorHVFMVFCid23_1",1,94,-1},
				{"isVFCVectorHVFMVFCid45_1",1,104,-1},
				{"isVFCVectorDSADVFCid29_1",1,24,-1},
				{"isVFCVectorDSADVFCid33_1",1,36,-1},
				{"isVFCVectorDSADVFCid22_1",1,31,-1},
				{"isVFCVectorDSADVFCid52_1",1,49,-1},
				{"isVFCVectorHVFMVFCid28_1",1,89,-1},
				{"isVFCVectorDSADVFCid9_1",1,12,-1},
				{"isVFCVectorDSADVFCid3_1",1,2,-1},
				{"isVFCVectorHVFMVFCid27_1",1,90,-1},
				{"isVFCVectorHVFMVFCid58_1",1,123,-1},
				{"isVFCVectorHVFMVFCid57_1",1,124,-1},
				{"isVFCVectorHVFMVFCid22_1",1,95,-1},
				{"isVFCVectorDSADVFCid51_1",1,50,-1},
				{"isVFCVectorHVFMVFCid26_1",1,91,-1},
				{"isVFCVectorHVFMVFCid61_1",1,120,-1},
				{"isVFCVectorHVFMVFCid16_1",1,85,-1},
				{"isVFCVectorHVFMVFCid36_1",1,97,-1},
				{"isVFCVectorHVFMVFCid29_1",1,88,-1},
				{"isVFCVectorDSADVFCid32_1",1,37,-1},
				{"isVFCVectorHVFMVFCid51_1",1,114,-1},
				{"isVFCVectorHVFMVFCid12_1",1,73,-1},
				{"isVFCVectorHVFMVFCid4_1",1,65,-1},
				{"isVFCVectorDSADVFCid27_1",1,26,-1},
				{"isVFCVectorHVFMVFCid20_1",1,81,-1},
				{"isVFCVectorHVFMVFCid6_1",1,79,-1},
				{"isVFCVectorDSADVFCid13_1",1,8,-1},
				{"isVFCVectorHVFMVFCid37_1",1,96,-1},
				{"isVFCVectorHVFMBlockID_1",2,71,-1},
				{"isVFCVectorHVFMVFCid56_1",1,125,-1},
				{"isVFCVectorDSADVFCid59_1",1,58,-1},
				{"isVFCVectorHVFMVFCid0_1",1,69,-1},
				{"isVFCVectorHVFMVFCid41_1",1,108,-1},
				{"isVFCVectorHVFMVFCid9_1",1,76,-1},
				{"isVFCVectorHVFMVFCid2_1",1,67,-1},
				{"isVFCVectorHVFMVFCid5_1",1,64,-1},
				{"isVFCVectorHVFMVFCid14_1",1,87,-1},
				{"isVFCVectorDSADVFCid20_1",1,17,-1},
				{"isVFCVectorDSADVFCid58_1",1,59,-1},
				{"isVFCVectorHVFMVFCid11_1",1,74,-1},
				{"isVFCVectorHVFMVFCid15_1",1,86,-1},
				{"isVFCVectorDSADVFCid7_1",1,14,-1},
				{"isVFCVectorDSADVFCid37_1",1,32,-1},
				{"isVFCVectorDSADVFCid23_1",1,30,-1},
				{"isVFCVectorDSADVFCid1_1",1,4,-1},
				{"isVFCVectorHVFMVFCid59_1",1,122,-1},
				{"isVFCVectorDSADVFCid60_1",1,57,-1},
				{"isVFCVectorHVFMVFCid46_1",1,119,-1},
				{"isVFCVectorHVFMVFCid31_1",1,102,-1},
				{"isVFCVectorHVFMVFCid55_1",1,126,-1},
				{"isVFCVectorHVFMVFCid19_1",1,82,-1},
				{"isVFCVectorDSADVFCid5_1",1,0,-1},
				{"isVFCVectorDSADVFCid56_1",1,61,-1},
				{"isVFCVectorDSADVFCid50_1",1,51,-1},
				{"isVFCVectorDSADVFCid0_1",1,5,-1},
				{"isVFCVectorDSADVFCid24_1",1,29,-1},
				{"isVFCVectorDSADVFCid25_1",1,28,-1},
				{"isVFCVectorDSADBlockID_1",2,7,-1},
				{"isVFCVectorDSADVFCid6_1",1,15,-1},
				{"isVFCVectorHVFMVFCid32_1",1,101,-1},
				{"isVFCVectorHVFMVFCid30_1",1,103,-1},
				{"isVFCVectorDSADVFCid61_1",1,56,-1},
				{"isVFCVectorDSADVFCid2_1",1,3,-1},
				{"isVFCVectorDSADVFCid18_1",1,19,-1},
				{"isVFCVectorDSADVFCid16_1",1,21,-1},
				{"isVFCVectorHVFMVFCid53_1",1,112,-1},
				{"isVFCVectorDSADVFCid36_1",1,33,-1},
				{"isVFCVectorDSADVFCid11_1",1,10,-1},
				{"isVFCVectorDSADVFCid4_1",1,1,-1},
				{"isVFCVectorDSADVFCid53_1",1,48,-1},
				{"isVFCVectorDSADVFCid57_1",1,60,-1},
				{"isVFCVectorHVFMVFCid48_1",1,117,-1},
				{"isVFCVectorHVFMVFCid40_1",1,109,-1},
				{"isVFCVectorDSADVFCid28_1",1,25,-1},
				{"isVFCVectorDSADVFCid40_1",1,45,-1},
				{"isVFCVectorDSADVFCid21_1",1,16,-1},
				{"isVFCVectorHVFMVFCid18_1",1,83,-1},
				{"isVFCVectorDSADVFCid15_1",1,22,-1},
				{"isVFCVectorHVFMVFCid3_1",1,66,-1},
				{"isVFCVectorDSADVFCid54_1",1,63,-1},
				{"isVFCVectorHVFMVFCid24_1",1,93,-1},
				{"isVFCVectorDSADVFCid41_1",1,44,-1},
				{"isVFCVectorDSADVFCid34_1",1,35,-1},
				{"isVFCVectorHVFMVFCid52_1",1,113,-1},
				{"isVFCVectorHVFMVFCid8_1",1,77,-1},
				{"isVFCVectorHVFMVFCid1_1",1,68,-1},
				{"isVFCVectorDSADVFCid10_1",1,11,-1},
				{"isVFCVectorDSADVFCid48_1",1,53,-1},
				{"isVFCVectorHVFMVFCid21_1",1,80,-1},
				{"isVFCVectorDSADVFCid47_1",1,54,-1},
				{"isVFCVectorHVFMVFCid33_1",1,100,-1},
				{"isVFCVectorDSADVFCid19_1",1,18,-1},
				{"isVFCVectorHVFMVFCid25_1",1,92,-1},
				{"isVFCVectorHVFMVFCid54_1",1,127,-1},
				{"isVFCVectorDSADVFCid55_1",1,62,-1},
				{"isVFCVectorHVFMVFCid42_1",1,107,-1},
				{"isVFCVectorHVFMVFCid49_1",1,116,-1},
				{"isVFCVectorHVFMVFCid38_1",1,111,-1},
				{"isVFCVectorDSADVFCid14_1",1,23,-1},
				{"isVFCVectorHVFMVFCid39_1",1,110,-1},
				{"isVFCVectorHVFMVFCid60_1",1,121,-1},
				{"isVFCVectorDSADVFCid35_1",1,34,-1}
			},
			{
				{"igVFCVectorDSAD_1","ZCUDZCUCANFD2SignalIPdu74",-1},
				{"igVFCVectorHVFM_1","ZCUDZCUCANFD2SignalIPdu74",-1}
			}
		},
		{"ZCU_CANFD2","ZCUDZCUCANFD2PduR1000Fr33","Out",0x4b7,64,0,1,1,0},
		{"ZCU_CANFD2","ZCUDZCUCANFD2PduR200Fr25","Out",0x338,64,0,1,1,0},
		{
			"ZCU_CANFD2","ZCUDZCUCANFD2Fr08","Out",0x132,64,20,1,0,0,100,11,
			{
				{"isCrashUnlckActvn_1",1,479,478},
				{"isDoorDrvrRePosnToObst2Chks_1",8,323,-1},
				{"isDoorDrvrRePosnToObst2AngleDeg11_1",8,315,-1},
				{"isSteerServoSts_1",1,444,463},
				{"isPubCANHWA1Group1TarRackPosnVel_1",14,79,-1},
				{"isSldngLeReWarnIndDisSldngDoorWarn_1",1,383,-1},
				{"isPubCANHWA1Group1ColAg_1",15,7,-1},
				{"isPubCANHWASysH1Group1SysDegradeReason_1",4,287,-1},
				{"isSldngRiReWarnIndEndNotSuccssWarn_1",1,387,-1},
				{"isPubCANHWA1Group1DrvrSteerWhlHldQly_1",4,123,-1},
				{"isPubCANHWASysH1Group1SysDegradeReasonVld_1",1,289,-1},
				{"isDoorDrvrObstPos2Cntr_1",4,227,-1},
				{"isPubCANHWA1Group1Cntr_1",4,127,-1},
				{"isPubCANHWA1Group1ColTqQf_1",2,140,-1},
				{"isSldngLeReWarnIndPreConNotFulfil_1",1,377,-1},
				{"isTankTurnActRotAng_1",10,361,465},
				{"isDoorOpenerDrvrSts2_1",4,397,454},
				{"isTrOpenerByFootOperSts_1",1,475,474},
				{"isSteerErrReq_1",3,436,462},
				{"isDrvgCyc_1",1,416,455},
				{"isSldngRiReWarnIndFltngDoorWarn_1",1,385,-1},
				{"isPubCANHWA1Group1ADASLvlCfmd_1",3,135,-1},
				{"isDoorDrvrReObstPos2ObjectPosZ_1",8,263,-1},
				{"isBrkPedlValBrkPedlVal_1",15,494,-1},
				{"isTqAssAddl_2",14,359,469},
				{"isDoorDrvrReObstPos2Chks_1",8,239,-1},
				{"isDoorDrvrPosn2_1",7,423,448},
				{"isIuprDenominatorInhb_1",1,424,456},
				{"isPubCANHWA1Group1ColAgSpd_1",14,25,-1},
				{"isDoorDrvrReObstPos2Cntr_1",4,271,-1},
				{"isSteerWhlSnsrAgSpd_2",14,175,-1},
				{"isSldngRiReWarnIndPreConNotFulfil_1",1,384,-1},
				{"isPubCANHWA1Group1HwaSts_1",8,89,-1},
				{"isPubCANHWASysH1Group1FltDateStoreFlag_1",1,290,-1},
				{"isAdjSpdLimnSts_1",3,439,440},
				{"isDoorDrvrObstPos2ObjectPosZ_1",8,219,-1},
				{"isPubCANHWA1Group1ColTq_1",14,43,-1},
				{"isDoorDrvrPosnToObst2Cntr_1",4,319,-1},
				{"isPubCANHWASysH1Group1FiveMinRuleSts_1",1,291,-1},
				{"isSteerWhlSnsrChks_2",8,177,-1},
				{"isSldngLeReWarnIndFltAndPitchWarn_1",1,379,-1},
				{"isPubCANHWASysH1Group1HealthSts_1",2,293,-1},
				{"isSteerWhlSnsrAg_2",15,158,-1},
				{"isDoorDrvrRePosnToObst2Cntr_1",4,331,-1},
				{"isPubCANHWASysH1Group1Chks_1",8,267,-1},
				{"isSldngRiReWarnIndStrMovngWarn_1",1,398,-1},
				{"isPubCANHWA1Group1DrvrInpFac_1",7,97,-1},
				{"isSldngLeReWarnIndDurngDoorMovWarn_1",1,381,-1},
				{"isPubCANHWA1Group1TankTurnSteerWhlCfm_1",3,129,-1},
				{"isDoorDrvrObstPos2Chks_1",8,195,-1},
				{"isDoorDrvrAntiPnch2_1",1,288,442},
				{"isPubCANHWA1Group1DrvrSteerWhlHld_1",2,136,-1},
				{"isSldngRiReWarnIndDurngDoorMovWarn_1",1,388,-1},
				{"isPubCANHWASysH1Group1Cntr_1",4,275,-1},
				{"isPubCANHWA1Group1TarRackPosn_1",15,8,-1},
				{"isLoadValCalcd_1",8,407,457},
				{"isDoorDrvrRePosn2_1",7,431,452},
				{"isDoorDrvrObstPos2ObjectPosY_1",8,211,-1},
				{"isDoorDrvrPosnToObst2Chks_1",8,311,-1},
				{"isDoorDrvrObstPos2ObjectPosX_1",8,203,-1},
				{"isPubCANHWA1Group1PwrCp_1",7,106,-1},
				{"isSldngRiReWarnIndStpDurngMovWarn_1",1,399,-1},
				{"isTankTurnRotateActRoad_1",3,447,467},
				{"isSldngRiReWarnIndDriveOpnDoorWarn_1",1,389,-1},
				{"isUBoostReqBySteerFrnt_1",2,433,470},
				{"isSldngLeReWarnIndEndNotSuccssWarn_1",1,380,-1},
				{"isSldngRiReWarnIndDisSldngDoorWarn_1",1,390,-1},
				{"isSldngLeReWarnIndDriveOpnDoorWarn_1",1,382,-1},
				{"isPubCANHWA1Group1Chks_1",8,81,-1},
				{"isPubCANHWA1Group1ColAgQf_1",2,142,-1},
				{"isAESCtrlSts_1",2,393,441},
				{"isThrPos_1",8,415,468},
				{"isSldngRiReWarnIndFltAndPitchWarn_1",1,386,-1},
				{"isSldngLeReWarnIndStpDurngMovWarn_1",1,376,-1},
				{"isSldngLeReWarnIndFltngDoorWarn_1",1,378,-1},
				{"isPubCANHWA1Group1AlignmentSts_1",1,146,-1},
				{"isTankTurnModStsCntr_1",4,351,-1},
				{"isPubCANHWA1Group1ActrCtrlSts_1",4,115,-1},
				{"isTankTurnModStsChks_1",8,343,-1},
				{"isPubCANHWA1Group1PwrCpVld_1",1,144,-1},
				{"isSldngLeReWarnIndStrMovngWarn_1",1,391,-1},
				{"isSteerSftyLimrSts_1",1,477,476},
				{"isDoorDrvrReObstPos2ObjectPosX_1",8,247,-1},
				{"isPubCANHWASysH1Group1FltSts_1",3,283,-1},
				{"isPubCANHWA1Group1DrvrSteerActv_1",1,145,-1},
				{"isPubCANHWASysH1Group1SteerErr_1",3,280,-1},
				{"isSBMHealthChkResp_1",8,487,471},
				{"isBrkPedlValQf_1",2,511,-1},
				{"isDoorDrvrPosnToObst2AngleDeg11_1",8,303,-1},
				{"isPubCANHWA1Group1SteerAstLvl_1",3,132,-1},
				{"isDoorDrvrReAntiPnch2_1",1,344,450},
				{"isPubCANHWA1Group1ColTqVld_1",2,138,-1},
				{"isDoorDrvrReObstPos2ObjectPosY_1",8,255,-1},
				{"isPubCANHWA1Group1TarRackPosnQf_1",2,148,-1},
				{"isPubCANHWA1Group1SteerSftyLimrSts_1",1,159,-1},
				{"isTankTurnModStsTankTurnModSts_1",3,347,-1},
				{"isPubCANHWA1Group1DrvrTq_1",14,61,-1},
				{"isPubCANHWA1Group1SteerStsToCrabMov_1",2,150,-1},
				{"isSteerWhlSnsrQf_2",2,197,-1},
				{"isSteerWhlSnsrCntr_2",4,185,-1}
			},
			{
				{"igSldngRiReWarnInd_1","ZCUDZCUCANFD2SignalIPdu08",461},
				{"igSteerWhlSnsr_2","ZCUDZCUCANFD2SignalIPdu08",464},
				{"igDoorDrvrRePosnToObst2_1","ZCUDZCUCANFD2SignalIPdu08",453},
				{"igBrkPedlVal_1","ZCUDZCUCANFD2SignalIPdu08",495},
				{"igPubCANHWASysH1Group1_1","ZCUDZCUCANFD2SignalIPdu08",459},
				{"igSldngLeReWarnInd_1","ZCUDZCUCANFD2SignalIPdu08",460},
				{"igDoorDrvrPosnToObst2_1","ZCUDZCUCANFD2SignalIPdu08",449},
				{"igPubCANHWA1Group1_1","ZCUDZCUCANFD2SignalIPdu08",458},
				{"igDoorDrvrReObstPos2_1","ZCUDZCUCANFD2SignalIPdu08",451},
				{"igDoorDrvrObstPos2_1","ZCUDZCUCANFD2SignalIPdu08",443},
				{"igTankTurnModSts_1","ZCUDZCUCANFD2SignalIPdu08",466}
			}
		},
		{"ZCU_CANFD2","DhuToZcudSrsZCUCANFD2DiagReqFr","In",0x739,64,0,1,4,0},
		{"ZCU_CANFD2","DhuToAllFuncZCUCANFD2DiagReqFr","In",0x7ff,8,0,1,4,0},
		{"ZCU_CANFD2","DhuZCUCANFD2Fr47","In",0x217,64,0,1,0,0},
		{"ZCU_CANFD2","DhuZCUCANFD2Fr28","In",0x330,64,0,1,0,0},
		{"ZCU_CANFD2","ZcupZCUCANFD2Fr22","In",0x259,64,0,1,0,0},
		{"ZCU_CANFD2","ZcupZCUCANFD2Fr15","In",0x3c2,64,0,1,0,0},
		{"ZCU_CANFD2","EtcZCUCANFD2Fr01","In",0x4fb,64,0,1,0,0},
		{"ZCU_CANFD2","ZcupZCUCANFD2Fr11","In",0x2f0,64,0,1,0,0},
		{"ZCU_CANFD2","DhuToZcudWpcZCUCANFD2DiagReqFr","In",0x72b,64,0,1,4,0},
		{"ZCU_CANFD2","DhuZCUCANFD2Fr37","In",0x4c0,64,0,1,0,0},
		{"ZCU_CANFD2","ZcupZCUCANFD2Fr19","In",0x3c7,64,0,1,0,0},
		{"ZCU_CANFD2","DhuToZcudSmblZCUCANFD2DiagReqFr","In",0x731,64,0,1,4,0},
		{"ZCU_CANFD2","DhuToZcudSrsISO26021ZCUCanFD2ReqFr","In",0x7f1,8,0,1,4,0},
		{"ZCU_CANFD2","DhuZCUCANFD2Fr02","In",0x1c3,64,0,1,0,0},
		{"ZCU_CANFD2","DhuZCUCANFD2Fr14","In",0x1c2,64,0,1,0,0},
		{"ZCU_CANFD2","DhuToZcudHwamZCUCANFD2DiagReqFr","In",0x740,64,0,1,4,0},
		{"ZCU_CANFD2","DhuZCUCANFD2Fr38","In",0x3b0,64,0,1,0,0},
		{"ZCU_CANFD2","ZcupZCUCANFD2Fr14","In",0x337,64,0,1,0,0},
		{"ZCU_CANFD2","ZcupZcuCANFD2NmFr01","In",0x506,8,0,1,3,0},
		{"ZCU_CANFD2","DhuToZcudDdrmZCUCANFD2DiagReqFr","In",0x748,64,0,1,4,0},
		{"ZCU_CANFD2","ZcupZCUCANFD2Fr04","In",0x62,64,0,1,0,0},
		{"ZCU_CANFD2","DhuZCUCANFD2Fr01","In",0x100,64,0,1,0,0},
		{"ZCU_CANFD2","DhuToZcudTrmZCUCANFD2DiagReqFr","In",0x717,64,0,1,4,0},
		{"ZCU_CANFD2","DhuZCUCANFD2Fr06","In",0x63,64,0,1,0,0},
		{"ZCU_CANFD2","DhuToZcudFtksZCUCANFD2DiagReqFr","In",0x771,64,0,1,4,0},
		{"ZCU_CANFD2","DhuZCUCANFD2Fr18","In",0x42,64,0,1,0,0},
		{"ZCU_CANFD2","DhuToZcudHcmlZCUCANFD2DiagReqFr","In",0x7b3,64,0,1,4,0},
		{"ZCU_CANFD2","ZcupZCUCANFD2Fr02","In",0x135,64,0,1,0,0},
		{"ZCU_CANFD2","DhuToZcudSmbrZCUCANFD2DiagReqFr","In",0x732,64,0,1,4,0},
		{"ZCU_CANFD2","ZcupZCUCANFD2Fr13","In",0x315,64,0,1,0,0},
		{"ZCU_CANFD2","DhuToZcudOgmZCUCANFD2DiagReqFr","In",0x73c,64,0,1,4,0},
		{"ZCU_CANFD2","DhuToZcudDpodZCUCANFD2DiagReqFr","In",0x749,64,0,1,4,0},
		{"ZCU_CANFD2","DhuToZcudSumZCUCANFD2DiagReqFr","In",0x741,64,0,1,4,0},
		{"ZCU_CANFD2","ZcupZCUCANFD2Fr18","In",0x304,64,0,1,0,0},
		{"ZCU_CANFD2","DhuZCUCANFD2Fr25","In",0x5f,64,0,1,0,0},
		{"ZCU_CANFD2","DhuToZcudRmrZCUCANFD2DiagReqFr","In",0x711,64,0,1,4,0},
		{"ZCU_CANFD2","DhuZCUCANFD2Fr10","In",0x140,64,0,1,0,0},
		{"ZCU_CANFD2","DhuZCUCANFD2Fr40","In",0x2c2,64,0,1,0,0},
		{"ZCU_CANFD2","ZcupZCUCANFD2Fr08","In",0x260,64,0,1,0,0},
		{"ZCU_CANFD2","DhuToZcudWprlZCUCANFD2DiagReqFr","In",0x736,64,0,1,4,0},
		{"ZCU_CANFD2","DhuZCUCANFD2Fr19","In",0x110,64,0,1,0,0},
		{"ZCU_CANFD2","DhuToZcudSmbZCUCANFD2DiagReqFr","In",0x729,64,0,1,4,0},
		{"ZCU_CANFD2","DhuZCUCANFD2Fr24","In",0x321,64,0,1,0,0},
		{"ZCU_CANFD2","DhuToZcudSdrZCUCANFD2DiagReqFr","In",0x724,64,0,1,4,0},
		{"ZCU_CANFD2","DhuZCUCANFD2Fr49","In",0x1d5,64,0,1,0,0},
		{"ZCU_CANFD2","DhuToZcudSdlZCUCANFD2DiagReqFr","In",0x723,64,0,1,4,0},
		{"ZCU_CANFD2","DhuToZcudHrmZCUCANFD2DiagReqFr","In",0x730,64,0,1,4,0},
		{"ZCU_CANFD2","DhuToZcudRmlZCUCANFD2DiagReqFr","In",0x710,64,0,1,4,0},
		{"ZCU_CANFD2","DhuToZcudRdrmZCUCANFD2DiagReqFr","In",0x74b,64,0,1,4,0},
		{"ZCU_CANFD2","DhuToZcudCrpmZCUCANFD2DiagReqFr","In",0x726,64,0,1,4,0},
		{"ZCU_CANFD2","DhuZCUCANFD2Fr17","In",0x1c1,64,0,1,0,0},
		{"ZCU_CANFD2","DhuToZcudBbsZCUCANFD2DiagReqFr","In",0x753,64,0,1,4,0},
		{"ZCU_CANFD2","DhuToZcudLpodZCUCANFD2DiagReqFr","In",0x74a,64,0,1,4,0},
		{"ZCU_CANFD2","DhuZCUCANFD2Fr03","In",0x1c4,64,0,1,0,0},
		{"ZCU_CANFD2","DhuZCUCANFD2Fr05","In",0x59,64,0,1,0,0},
		{"ZCU_CANFD2","ZcupZCUCANFD2Fr05","In",0x1ce,64,0,1,0,0},
		{"ZCU_CANFD2","DhuZCUCANFD2Fr07","In",0x67,64,0,1,0,0},
		{"ZCU_CANFD2","DhuZCUCANFD2Fr21","In",0x320,64,0,1,0,0},
		{"ZCU_CANFD2","DhuZCUCANFD2Fr39","In",0x370,64,0,1,0,0},
		{"ZCU_CANFD2","ZcupZCUCANFD2Fr10","In",0x2d2,64,0,1,0,0},
		{"ZCU_CANFD2","DhuToZcudWprrZCUCANFD2DiagReqFr","In",0x737,64,0,1,4,0},
		{"ZCU_CANFD2","DhuZCUCANFD2Fr11","In",0x200,64,0,1,0,0},
		{"ZCU_CANFD2","ZcupZCUCANFD2Fr09","In",0x340,64,0,1,0,0},
		{"ZCU_CANFD2","ETCZCUCANFD2DEVFr01","In",0x561,64,0,1,0,0},
		{"ZCU_CANFD2","ZcupZCUCANFD2Fr06","In",0x205,64,0,1,0,0},
		{"ZCU_CANFD2","DhuZCUCANFD2Fr26","In",0x350,64,0,1,0,0},
		{"ZCU_CANFD2","ZcupZCUCANFD2Fr07","In",0x2c8,64,0,1,0,0},
		{"ZCU_CANFD2","DhuToZcudRwamZCUCANFD2DiagReqFr","In",0x743,64,0,1,4,0},
		{"ZCU_CANFD2","DhuToZcudHwasZCUCANFD2DiagReqFr","In",0x742,64,0,1,4,0},
		{"ZCU_CANFD2","DhuZCUCANFD2Fr15","In",0x1b3,64,0,1,0,0},
		{"ZCU_CANFD2","DhuToZcudHvfmZCUCANFD2DiagReqFr","In",0x744,64,0,1,4,0},
		{"ZCU_CANFD2","ZcupZCUCANFD2Fr03","In",0x150,64,0,1,0,0},
		{"ZCU_CANFD2","DhuZCUCANFD2Fr04","In",0x55,64,0,1,0,0},
		{"ZCU_CANFD2","DhuZCUCANFD2Fr20","In",0x4a,64,0,1,0,0},
		{"ZCU_CANFD2","DhuToZcudTcmbZCUCANFD2DiagReqFr","In",0x72a,64,0,1,4,0},
		{"ZCU_CANFD2","ZcupZCUCANFD2Fr12","In",0x490,64,0,1,0,0},
		{"ZCU_CANFD2","DhuZCUCANFD2Fr42","In",0x2c0,64,0,1,0,0},
		{"ZCU_CANFD2","DhuToZcudImsZCUCANFD2DiagReqFr","In",0x752,64,0,1,4,0},
		{"ZCU_CANFD2","DhuToZcudZCUCANFD2DiagReqFr","In",0x701,64,0,1,4,0},
		{"ZCU_CANFD2","DhuZCUCANFD2Fr12","In",0x2c5,64,0,1,0,0},
		{"ZCU_CANFD2","DhuToZcudPotZCUCANFD2DiagReqFr","In",0x715,64,0,1,4,0},
		{"ZCU_CANFD2","DhuToZcudHcmrZCUCANFD2DiagReqFr","In",0x7b4,64,0,1,4,0},
		{"ZCU_CANFD2","DhuToZcudCmdZCUCANFD2DiagReqFr","In",0x71c,64,0,1,4,0},
		{"ZCU_CANFD2","ZcupZCUCANFD2Fr16","In",0x33,64,0,1,0,0},
		{
			"BodyExposedCAN","ZCUDBodyExpoFr14","Out",0x128,8,20,0,0,0,11,1,
			{
				{"isFrntIntHCMLiCntrLe12",4,59,-1},
				{"isFrntIntHCMLiLe12LED3_0",6,11,-1},
				{"isFrntIntHCMLiLe12LED10_0",6,49,-1},
				{"isFrntIntHCMLiLe12LED6_0",6,25,-1},
				{"isFrntIntHCMLiLe12LED5_0",6,31,-1},
				{"isFrntIntHCMLiLe12LED4_0",6,21,-1},
				{"isFrntIntHCMLiLe12LED1_0",6,7,-1},
				{"isFrntIntHCMLiLe12LED9_0",6,55,-1},
				{"isFrntIntHCMLiLe12LED7_0",6,35,-1},
				{"isFrntIntHCMLiLe12LED8_0",6,45,-1},
				{"isFrntIntHCMLiLe12LED2_0",6,1,-1}
			},
			{
				{"igFrntIntHCMLiLe12_0","ZCUDBodyExpoSignalIPdu14",-1}
			}
		},
		{
			"BodyExposedCAN","ZCUDBodyExpoFr33","Out",0x11b,8,20,0,0,0,11,1,
			{
				{"isFrntIntHCMLiRi6LED4_0",6,21,-1},
				{"isFrntIntHCMLiRi6LED1_0",6,7,-1},
				{"isFrntIntHCMLiCntrRi6",4,59,-1},
				{"isFrntIntHCMLiRi6LED3_0",6,11,-1},
				{"isFrntIntHCMLiRi6LED5_0",6,31,-1},
				{"isFrntIntHCMLiRi6LED6_0",6,25,-1},
				{"isFrntIntHCMLiRi6LED2_0",6,1,-1},
				{"isFrntIntHCMLiRi6LED8_0",6,45,-1},
				{"isFrntIntHCMLiRi6LED7_0",6,35,-1},
				{"isFrntIntHCMLiRi6LED10_0",6,49,-1},
				{"isFrntIntHCMLiRi6LED9_0",6,55,-1}
			},
			{
				{"igFrntIntHCMLiRi6_0","ZCUDBodyExpoSignalIPdu33",-1}
			}
		},
		{
			"BodyExposedCAN","ZCUDBodyExpoFr41","Out",0x12b,8,20,0,0,0,11,1,
			{
				{"isFrntIntHCMLiRi14LED2_0",6,1,-1},
				{"isFrntIntHCMLiRi14LED5_0",6,31,-1},
				{"isFrntIntHCMLiRi14LED1_0",6,7,-1},
				{"isFrntIntHCMLiRi14LED4_0",6,21,-1},
				{"isFrntIntHCMLiRi14LED7_0",6,35,-1},
				{"isFrntIntHCMLiCntrRi14",4,59,-1},
				{"isFrntIntHCMLiRi14LED9_0",6,55,-1},
				{"isFrntIntHCMLiRi14LED10_0",6,49,-1},
				{"isFrntIntHCMLiRi14LED6_0",6,25,-1},
				{"isFrntIntHCMLiRi14LED3_0",6,11,-1},
				{"isFrntIntHCMLiRi14LED8_0",6,45,-1}
			},
			{
				{"igFrntIntHCMLiRi14_0","ZCUDBodyExpoSignalIPdu41",-1}
			}
		},
		{
			"BodyExposedCAN","ZCUDBodyExpoFr26","Out",0x140,8,20,0,0,0,11,1,
			{
				{"isFrntIntHCMLiLe24LED5_0",6,31,-1},
				{"isFrntIntHCMLiLe24LED1_0",6,7,-1},
				{"isFrntIntHCMLiLe24LED10_0",6,49,-1},
				{"isFrntIntHCMLiLe24LED6_0",6,25,-1},
				{"isFrntIntHCMLiLe24LED7_0",6,35,-1},
				{"isFrntIntHCMLiLe24LED3_0",6,11,-1},
				{"isFrntIntHCMLiLe24LED2_0",6,1,-1},
				{"isFrntIntHCMLiLe24LED8_0",6,45,-1},
				{"isFrntIntHCMLiLe24LED9_0",6,55,-1},
				{"isFrntIntHCMLiLe24LED4_0",6,21,-1},
				{"isFrntIntHCMLiCntrLe24",4,59,-1}
			},
			{
				{"igFrntIntHCMLiLe24_0","ZCUDBodyExpoSignalIPdu26",-1}
			}
		},
		{
			"BodyExposedCAN","ZCUDBodyExpoFr34","Out",0x11d,8,20,0,0,0,11,1,
			{
				{"isFrntIntHCMLiRi7LED6_0",6,25,-1},
				{"isFrntIntHCMLiRi7LED3_0",6,11,-1},
				{"isFrntIntHCMLiRi7LED1_0",6,7,-1},
				{"isFrntIntHCMLiCntrRi7",4,59,-1},
				{"isFrntIntHCMLiRi7LED9_0",6,55,-1},
				{"isFrntIntHCMLiRi7LED8_0",6,45,-1},
				{"isFrntIntHCMLiRi7LED7_0",6,35,-1},
				{"isFrntIntHCMLiRi7LED10_0",6,49,-1},
				{"isFrntIntHCMLiRi7LED2_0",6,1,-1},
				{"isFrntIntHCMLiRi7LED4_0",6,21,-1},
				{"isFrntIntHCMLiRi7LED5_0",6,31,-1}
			},
			{
				{"igFrntIntHCMLiRi7_0","ZCUDBodyExpoSignalIPdu34",-1}
			}
		},
		{
			"BodyExposedCAN","ZCUDBodyExpoFr42","Out",0x12d,8,20,0,0,0,11,1,
			{
				{"isFrntIntHCMLiRi15LED4_0",6,21,-1},
				{"isFrntIntHCMLiRi15LED9_0",6,55,-1},
				{"isFrntIntHCMLiRi15LED2_0",6,1,-1},
				{"isFrntIntHCMLiRi15LED10_0",6,49,-1},
				{"isFrntIntHCMLiCntrRi15",4,59,-1},
				{"isFrntIntHCMLiRi15LED8_0",6,45,-1},
				{"isFrntIntHCMLiRi15LED7_0",6,35,-1},
				{"isFrntIntHCMLiRi15LED6_0",6,25,-1},
				{"isFrntIntHCMLiRi15LED1_0",6,7,-1},
				{"isFrntIntHCMLiRi15LED3_0",6,11,-1},
				{"isFrntIntHCMLiRi15LED5_0",6,31,-1}
			},
			{
				{"igFrntIntHCMLiRi15_0","ZCUDBodyExpoSignalIPdu42",-1}
			}
		},
		{
			"BodyExposedCAN","ZCUDBodyExpoFr57","Out",0x14b,8,20,0,0,0,18,1,
			{
				{"isFrntIntHCMChEnaRi1ActnOfLedLoBeam_0",1,11,-1},
				{"isFrntIntHCMChEnaRi3_0",1,23,22},
				{"isClrDTCOfHCMR3",1,33,32},
				{"isFrntIntHCMChEnaRi9_0",1,27,26},
				{"isFrntIntHCMChEnaRi8_0",1,29,28},
				{"isFrntIntHCMChEnaRi6_0",1,17,16},
				{"isDigOutpPWMRiReq",7,55,48},
				{"isFrntIntHCMChEnaRi12_0",1,37,36},
				{"isFrntIntHCMChEnaRi10_0",1,25,24},
				{"isClrDTCOfHCML3",1,35,34},
				{"isFrntIntHCMChEnaRi1ActnOfLedLoBeamChks_0",8,7,-1},
				{"isFrntIntHCMChEnaRi1ActnOfLedLoBeamCntr_0",4,15,-1},
				{"isFrntIntHCMChEnaRi7_0",1,31,30},
				{"isFrntIntHCMChEnaRi2_0",1,9,8},
				{"isFrntIntHCMChEnaRi5_0",1,19,18},
				{"isFrntIntHCMChEnaRi4_0",1,21,20},
				{"isFrntIntHCMChEnaRi11_0",1,39,38},
				{"isDigOutpPWMLeReq",7,47,40}
			},
			{
				{"igFrntIntHCMChEnaRi1_0","ZCUDBodyExpoSignalIPdu57",10}
			}
		},
		{
			"BodyExposedCAN","ZCUDBodyExpoFr01","Out",0x3a1,8,450,0,0,0,4,1,
			{
				{"isVehSpdLgtCntr_1",4,31,-1},
				{"isVehSpdLgtQf_1",2,27,-1},
				{"isVehSpdLgtChks_1",8,23,-1},
				{"isVehSpdLgtA_1",15,6,-1}
			},
			{
				{"igVehSpdLgt_1","ZCUDBodyExpoSignalIPdu01",7}
			}
		},
		{
			"BodyExposedCAN","ZCUDBodyExpoFr21","Out",0x136,8,20,0,0,0,11,1,
			{
				{"isFrntIntHCMLiLe19LED5_0",6,31,-1},
				{"isFrntIntHCMLiLe19LED2_0",6,1,-1},
				{"isFrntIntHCMLiLe19LED6_0",6,25,-1},
				{"isFrntIntHCMLiLe19LED4_0",6,21,-1},
				{"isFrntIntHCMLiCntrLe19",4,59,-1},
				{"isFrntIntHCMLiLe19LED8_0",6,45,-1},
				{"isFrntIntHCMLiLe19LED1_0",6,7,-1},
				{"isFrntIntHCMLiLe19LED10_0",6,49,-1},
				{"isFrntIntHCMLiLe19LED3_0",6,11,-1},
				{"isFrntIntHCMLiLe19LED9_0",6,55,-1},
				{"isFrntIntHCMLiLe19LED7_0",6,35,-1}
			},
			{
				{"igFrntIntHCMLiLe19_0","ZCUDBodyExpoSignalIPdu21",-1}
			}
		},
		{
			"BodyExposedCAN","ZCUDBodyExpoFr09","Out",0x11e,8,20,0,0,0,11,1,
			{
				{"isFrntIntHCMLiLe7LED7_0",6,35,-1},
				{"isFrntIntHCMLiLe7LED10_0",6,49,-1},
				{"isFrntIntHCMLiLe7LED3_0",6,11,-1},
				{"isFrntIntHCMLiLe7LED6_0",6,25,-1},
				{"isFrntIntHCMLiCntrLe7",4,59,-1},
				{"isFrntIntHCMLiLe7LED2_0",6,1,-1},
				{"isFrntIntHCMLiLe7LED9_0",6,55,-1},
				{"isFrntIntHCMLiLe7LED5_0",6,31,-1},
				{"isFrntIntHCMLiLe7LED8_0",6,45,-1},
				{"isFrntIntHCMLiLe7LED1_0",6,7,-1},
				{"isFrntIntHCMLiLe7LED4_0",6,21,-1}
			},
			{
				{"igFrntIntHCMLiLe7_0","ZCUDBodyExpoSignalIPdu09",-1}
			}
		},
		{
			"BodyExposedCAN","ZCUDBodyExpoFr58","Out",0x14d,8,20,0,0,0,8,0,
			{
				{"isSWDwnloadEna",1,45,44},
				{"isHSD2OutLePWM_0",8,23,37},
				{"isSwivelMotRefRunReq_0",1,43,42},
				{"isHCMCommReq_0",3,35,32},
				{"isHSD2OutRiPWM_0",8,31,36},
				{"isHSD1OutLePWM_0",8,7,39},
				{"isHSD1OutRiPWM_0",8,15,38},
				{"isLevelMotRefRunReq_0",1,47,46}
			},
			{
				{"","",-1}
			}
		},
		{
			"BodyExposedCAN","ZCUDBodyExpoFr44","Out",0x131,8,20,0,0,0,11,1,
			{
				{"isFrntIntHCMLiRi17LED2_0",6,1,-1},
				{"isFrntIntHCMLiRi17LED9_0",6,55,-1},
				{"isFrntIntHCMLiRi17LED8_0",6,45,-1},
				{"isFrntIntHCMLiRi17LED10_0",6,49,-1},
				{"isFrntIntHCMLiRi17LED6_0",6,25,-1},
				{"isFrntIntHCMLiRi17LED4_0",6,21,-1},
				{"isFrntIntHCMLiCntrRi17",4,59,-1},
				{"isFrntIntHCMLiRi17LED3_0",6,11,-1},
				{"isFrntIntHCMLiRi17LED1_0",6,7,-1},
				{"isFrntIntHCMLiRi17LED7_0",6,35,-1},
				{"isFrntIntHCMLiRi17LED5_0",6,31,-1}
			},
			{
				{"igFrntIntHCMLiRi17_0","ZCUDBodyExpoSignalIPdu44",-1}
			}
		},
		{
			"BodyExposedCAN","ZCUDBodyExpoFr02","Out",0x3c1,8,500,0,0,0,10,1,
			{
				{"isVehModMngtGlbSafe1PwrLvlElecSubtyp_1",4,31,-1},
				{"isVehModMngtGlbSafe1EgyLvlElecMai_1",4,11,-1},
				{"isVehModMngtGlbSafe1PwrLvlElecMai_1",4,19,-1},
				{"isVehModMngtGlbSafe1EgyLvlElecSubtyp_1",4,23,-1},
				{"isVehModMngtGlbSafe1CarModSts1_1",3,39,-1},
				{"isVehModMngtGlbSafe1Cntr_1",4,15,-1},
				{"isVehModMngtGlbSafe1CarModSubtypWdCarModSubtyp_1",3,36,-1},
				{"isVehModMngtGlbSafe1Chks_1",8,7,-1},
				{"isVehModMngtGlbSafe1UsgModSts_1",4,27,-1},
				{"isVehModMngtGlbSafe1FltEgyCnsWdSts_1",1,33,-1}
			},
			{
				{"igVehModMngtGlbSafe1_1","ZCUDBodyExpoSignalIPdu02",32}
			}
		},
		{
			"BodyExposedCAN","ZCUDBodyExpoFr40","Out",0x129,8,20,0,0,0,11,1,
			{
				{"isFrntIntHCMLiRi13LED1_0",6,7,-1},
				{"isFrntIntHCMLiRi13LED2_0",6,1,-1},
				{"isFrntIntHCMLiRi13LED8_0",6,45,-1},
				{"isFrntIntHCMLiRi13LED7_0",6,35,-1},
				{"isFrntIntHCMLiRi13LED6_0",6,25,-1},
				{"isFrntIntHCMLiRi13LED10_0",6,49,-1},
				{"isFrntIntHCMLiCntrRi13",4,59,-1},
				{"isFrntIntHCMLiRi13LED4_0",6,21,-1},
				{"isFrntIntHCMLiRi13LED9_0",6,55,-1},
				{"isFrntIntHCMLiRi13LED5_0",6,31,-1},
				{"isFrntIntHCMLiRi13LED3_0",6,11,-1}
			},
			{
				{"igFrntIntHCMLiRi13_0","ZCUDBodyExpoSignalIPdu40",-1}
			}
		},
		{
			"BodyExposedCAN","ZCUDBodyExpoFr08","Out",0x11c,8,20,0,0,0,11,1,
			{
				{"isFrntIntHCMLiLe6LED2_0",6,1,-1},
				{"isFrntIntHCMLiLe6LED10_0",6,49,-1},
				{"isFrntIntHCMLiLe6LED7_0",6,35,-1},
				{"isFrntIntHCMLiLe6LED9_0",6,55,-1},
				{"isFrntIntHCMLiLe6LED5_0",6,31,-1},
				{"isFrntIntHCMLiLe6LED1_0",6,7,-1},
				{"isFrntIntHCMLiCntrLe6",4,59,-1},
				{"isFrntIntHCMLiLe6LED4_0",6,21,-1},
				{"isFrntIntHCMLiLe6LED8_0",6,45,-1},
				{"isFrntIntHCMLiLe6LED3_0",6,11,-1},
				{"isFrntIntHCMLiLe6LED6_0",6,25,-1}
			},
			{
				{"igFrntIntHCMLiLe6_0","ZCUDBodyExpoSignalIPdu08",-1}
			}
		},
		{
			"BodyExposedCAN","ZCUDBodyExpoFr38","Out",0x125,8,20,0,0,0,11,1,
			{
				{"isFrntIntHCMLiCntrRi11",4,59,-1},
				{"isFrntIntHCMLiRi11LED3_0",6,11,-1},
				{"isFrntIntHCMLiRi11LED4_0",6,21,-1},
				{"isFrntIntHCMLiRi11LED10_0",6,49,-1},
				{"isFrntIntHCMLiRi11LED2_0",6,1,-1},
				{"isFrntIntHCMLiRi11LED6_0",6,25,-1},
				{"isFrntIntHCMLiRi11LED7_0",6,35,-1},
				{"isFrntIntHCMLiRi11LED9_0",6,55,-1},
				{"isFrntIntHCMLiRi11LED5_0",6,31,-1},
				{"isFrntIntHCMLiRi11LED8_0",6,45,-1},
				{"isFrntIntHCMLiRi11LED1_0",6,7,-1}
			},
			{
				{"igFrntIntHCMLiRi11_0","ZCUDBodyExpoSignalIPdu38",-1}
			}
		},
		{
			"BodyExposedCAN","ZCUDBodyExpoFr54","Out",0x145,8,20,0,0,0,8,0,
			{
				{"isFrntIntHCMChIntenLe9_0",7,7,0},
				{"isFrntIntHCMChIntenRi11_0",7,55,48},
				{"isFrntIntHCMChIntenLe12_0",7,31,24},
				{"isFrntIntHCMChIntenLe11_0",7,23,16},
				{"isFrntIntHCMChIntenRi10_0",7,47,40},
				{"isFrntIntHCMChIntenLe10_0",7,15,8},
				{"isFrntIntHCMChIntenRi12_0",7,63,56},
				{"isFrntIntHCMChIntenRi9_0",7,39,32}
			},
			{
				{"","",-1}
			}
		},
		{
			"BodyExposedCAN","ZCUDBodyExpoFr19","Out",0x132,8,20,0,0,0,11,1,
			{
				{"isFrntIntHCMLiLe17LED3_0",6,11,-1},
				{"isFrntIntHCMLiLe17LED10_0",6,49,-1},
				{"isFrntIntHCMLiLe17LED9_0",6,55,-1},
				{"isFrntIntHCMLiLe17LED7_0",6,35,-1},
				{"isFrntIntHCMLiLe17LED4_0",6,21,-1},
				{"isFrntIntHCMLiLe17LED2_0",6,1,-1},
				{"isFrntIntHCMLiLe17LED5_0",6,31,-1},
				{"isFrntIntHCMLiLe17LED1_0",6,7,-1},
				{"isFrntIntHCMLiLe17LED8_0",6,45,-1},
				{"isFrntIntHCMLiLe17LED6_0",6,25,-1},
				{"isFrntIntHCMLiCntrLe17",4,59,-1}
			},
			{
				{"igFrntIntHCMLiLe17_0","ZCUDBodyExpoSignalIPdu19",-1}
			}
		},
		{
			"BodyExposedCAN","ZCUDBodyExpoFr22","Out",0x138,8,20,0,0,0,11,1,
			{
				{"isFrntIntHCMLiLe20LED10_0",6,49,-1},
				{"isFrntIntHCMLiLe20LED7_0",6,35,-1},
				{"isFrntIntHCMLiLe20LED4_0",6,21,-1},
				{"isFrntIntHCMLiLe20LED2_0",6,1,-1},
				{"isFrntIntHCMLiCntrLe20",4,59,-1},
				{"isFrntIntHCMLiLe20LED8_0",6,45,-1},
				{"isFrntIntHCMLiLe20LED9_0",6,55,-1},
				{"isFrntIntHCMLiLe20LED5_0",6,31,-1},
				{"isFrntIntHCMLiLe20LED1_0",6,7,-1},
				{"isFrntIntHCMLiLe20LED6_0",6,25,-1},
				{"isFrntIntHCMLiLe20LED3_0",6,11,-1}
			},
			{
				{"igFrntIntHCMLiLe20_0","ZCUDBodyExpoSignalIPdu22",-1}
			}
		},
		{
			"BodyExposedCAN","ZCUDBodyExpoFr25","Out",0x13e,8,20,0,0,0,11,1,
			{
				{"isFrntIntHCMLiLe23LED9_0",6,55,-1},
				{"isFrntIntHCMLiLe23LED1_0",6,7,-1},
				{"isFrntIntHCMLiLe23LED6_0",6,25,-1},
				{"isFrntIntHCMLiLe23LED3_0",6,11,-1},
				{"isFrntIntHCMLiLe23LED7_0",6,35,-1},
				{"isFrntIntHCMLiLe23LED8_0",6,45,-1},
				{"isFrntIntHCMLiLe23LED2_0",6,1,-1},
				{"isFrntIntHCMLiLe23LED5_0",6,31,-1},
				{"isFrntIntHCMLiLe23LED10_0",6,49,-1},
				{"isFrntIntHCMLiLe23LED4_0",6,21,-1},
				{"isFrntIntHCMLiCntrLe23",4,59,-1}
			},
			{
				{"igFrntIntHCMLiLe23_0","ZCUDBodyExpoSignalIPdu25",-1}
			}
		},
		{
			"BodyExposedCAN","ZCUDBodyExpoFr20","Out",0x134,8,20,0,0,0,11,1,
			{
				{"isFrntIntHCMLiLe18LED2_0",6,1,-1},
				{"isFrntIntHCMLiLe18LED8_0",6,45,-1},
				{"isFrntIntHCMLiLe18LED5_0",6,31,-1},
				{"isFrntIntHCMLiLe18LED6_0",6,25,-1},
				{"isFrntIntHCMLiLe18LED1_0",6,7,-1},
				{"isFrntIntHCMLiLe18LED7_0",6,35,-1},
				{"isFrntIntHCMLiLe18LED10_0",6,49,-1},
				{"isFrntIntHCMLiLe18LED3_0",6,11,-1},
				{"isFrntIntHCMLiCntrLe18",4,59,-1},
				{"isFrntIntHCMLiLe18LED4_0",6,21,-1},
				{"isFrntIntHCMLiLe18LED9_0",6,55,-1}
			},
			{
				{"igFrntIntHCMLiLe18_0","ZCUDBodyExpoSignalIPdu20",-1}
			}
		},
		{"BodyExposedCAN","ZcudToHcmlBodyCanExposedDiagReqFrame","Out",0x7b3,8,0,0,4,0},
		{
			"BodyExposedCAN","ZCUDBodyExpoFr36","Out",0x121,8,20,0,0,0,11,1,
			{
				{"isFrntIntHCMLiRi9LED6_0",6,25,-1},
				{"isFrntIntHCMLiRi9LED9_0",6,55,-1},
				{"isFrntIntHCMLiCntrRi9",4,59,-1},
				{"isFrntIntHCMLiRi9LED10_0",6,49,-1},
				{"isFrntIntHCMLiRi9LED7_0",6,35,-1},
				{"isFrntIntHCMLiRi9LED1_0",6,7,-1},
				{"isFrntIntHCMLiRi9LED5_0",6,31,-1},
				{"isFrntIntHCMLiRi9LED3_0",6,11,-1},
				{"isFrntIntHCMLiRi9LED4_0",6,21,-1},
				{"isFrntIntHCMLiRi9LED2_0",6,1,-1},
				{"isFrntIntHCMLiRi9LED8_0",6,45,-1}
			},
			{
				{"igFrntIntHCMLiRi9_0","ZCUDBodyExpoSignalIPdu36",-1}
			}
		},
		{
			"BodyExposedCAN","ZCUDBodyExpoFr12","Out",0x124,8,20,0,0,0,11,1,
			{
				{"isFrntIntHCMLiLe10LED4_0",6,21,-1},
				{"isFrntIntHCMLiLe10LED3_0",6,11,-1},
				{"isFrntIntHCMLiLe10LED9_0",6,55,-1},
				{"isFrntIntHCMLiLe10LED5_0",6,31,-1},
				{"isFrntIntHCMLiLe10LED6_0",6,25,-1},
				{"isFrntIntHCMLiLe10LED7_0",6,35,-1},
				{"isFrntIntHCMLiLe10LED10_0",6,49,-1},
				{"isFrntIntHCMLiLe10LED1_0",6,7,-1},
				{"isFrntIntHCMLiLe10LED2_0",6,1,-1},
				{"isFrntIntHCMLiLe10LED8_0",6,45,-1},
				{"isFrntIntHCMLiCntrLe10",4,59,-1}
			},
			{
				{"igFrntIntHCMLiLe10_0","ZCUDBodyExpoSignalIPdu12",-1}
			}
		},
		{
			"BodyExposedCAN","ZCUDBodyExpoFr31","Out",0x117,8,20,0,0,0,11,1,
			{
				{"isFrntIntHCMLiRi4LED2_0",6,1,-1},
				{"isFrntIntHCMLiRi4LED5_0",6,31,-1},
				{"isFrntIntHCMLiRi4LED4_0",6,21,-1},
				{"isFrntIntHCMLiCntrRi4",4,59,-1},
				{"isFrntIntHCMLiRi4LED10_0",6,49,-1},
				{"isFrntIntHCMLiRi4LED8_0",6,45,-1},
				{"isFrntIntHCMLiRi4LED6_0",6,25,-1},
				{"isFrntIntHCMLiRi4LED3_0",6,11,-1},
				{"isFrntIntHCMLiRi4LED1_0",6,7,-1},
				{"isFrntIntHCMLiRi4LED7_0",6,35,-1},
				{"isFrntIntHCMLiRi4LED9_0",6,55,-1}
			},
			{
				{"igFrntIntHCMLiRi4_0","ZCUDBodyExpoSignalIPdu31",-1}
			}
		},
		{
			"BodyExposedCAN","ZCUDBodyExpoFr56","Out",0x149,8,20,0,0,0,18,1,
			{
				{"isFrntIntHCMChEnaLe11_0",1,39,38},
				{"isFrntIntHCMChEnaLe2_0",1,9,8},
				{"isFrntIntHCMChEnaLe1ActnOfLedLoBeam_0",1,11,-1},
				{"isDCLevelMotAgRiReq_0",8,55,32},
				{"isFunActvnStsForSurfaceShare",6,63,57},
				{"isFrntIntHCMChEnaLe8_0",1,29,28},
				{"isFrntIntHCMChEnaLe6_0",1,17,16},
				{"isFrntIntHCMChEnaLe1ActnOfLedLoBeamChks_0",8,7,-1},
				{"isDCLevelMotAgLeReq_0",8,47,33},
				{"isFrntIntHCMChEnaLe9_0",1,27,26},
				{"isFrntIntHCMChEnaLe10_0",1,25,24},
				{"isChAndPixelMatchInfoReq_0",1,35,34},
				{"isFrntIntHCMChEnaLe5_0",1,19,18},
				{"isFrntIntHCMChEnaLe4_0",1,21,20},
				{"isFrntIntHCMChEnaLe1ActnOfLedLoBeamCntr_0",4,15,-1},
				{"isFrntIntHCMChEnaLe12_0",1,37,36},
				{"isFrntIntHCMChEnaLe7_0",1,31,30},
				{"isFrntIntHCMChEnaLe3_0",1,23,22}
			},
			{
				{"igFrntIntHCMChEnaLe1_0","ZCUDBodyExpoSignalIPdu56",10}
			}
		},
		{
			"BodyExposedCAN","ZCUDBodyExpoFr37","Out",0x123,8,20,0,0,0,11,1,
			{
				{"isFrntIntHCMLiRi10LED3_0",6,11,-1},
				{"isFrntIntHCMLiRi10LED6_0",6,25,-1},
				{"isFrntIntHCMLiRi10LED4_0",6,21,-1},
				{"isFrntIntHCMLiRi10LED1_0",6,7,-1},
				{"isFrntIntHCMLiRi10LED2_0",6,1,-1},
				{"isFrntIntHCMLiRi10LED9_0",6,55,-1},
				{"isFrntIntHCMLiRi10LED5_0",6,31,-1},
				{"isFrntIntHCMLiRi10LED10_0",6,49,-1},
				{"isFrntIntHCMLiRi10LED7_0",6,35,-1},
				{"isFrntIntHCMLiRi10LED8_0",6,45,-1},
				{"isFrntIntHCMLiCntrRi10",4,59,-1}
			},
			{
				{"igFrntIntHCMLiRi10_0","ZCUDBodyExpoSignalIPdu37",-1}
			}
		},
		{
			"BodyExposedCAN","ZCUDBodyExpoFr49","Out",0x13b,8,20,0,0,0,11,1,
			{
				{"isFrntIntHCMLiRi22LED3_0",6,11,-1},
				{"isFrntIntHCMLiRi22LED8_0",6,45,-1},
				{"isFrntIntHCMLiRi22LED9_0",6,55,-1},
				{"isFrntIntHCMLiRi22LED6_0",6,25,-1},
				{"isFrntIntHCMLiRi22LED10_0",6,49,-1},
				{"isFrntIntHCMLiRi22LED7_0",6,35,-1},
				{"isFrntIntHCMLiRi22LED5_0",6,31,-1},
				{"isFrntIntHCMLiRi22LED2_0",6,1,-1},
				{"isFrntIntHCMLiCntrRi22",4,59,-1},
				{"isFrntIntHCMLiRi22LED4_0",6,21,-1},
				{"isFrntIntHCMLiRi22LED1_0",6,7,-1}
			},
			{
				{"igFrntIntHCMLiRi22_0","ZCUDBodyExpoSignalIPdu49",-1}
			}
		},
		{
			"BodyExposedCAN","ZCUDBodyExpoFr04","Out",0x112,8,20,0,0,0,11,1,
			{
				{"isFrntIntHCMLiLe2LED6_0",6,25,-1},
				{"isFrntIntHCMLiLe2LED8_0",6,45,-1},
				{"isFrntIntHCMLiLe2LED1_0",6,7,-1},
				{"isFrntIntHCMLiLe2LED7_0",6,35,-1},
				{"isFrntIntHCMLiCntrLe2",4,59,-1},
				{"isFrntIntHCMLiLe2LED3_0",6,11,-1},
				{"isFrntIntHCMLiLe2LED2_0",6,1,-1},
				{"isFrntIntHCMLiLe2LED10_0",6,49,-1},
				{"isFrntIntHCMLiLe2LED4_0",6,21,-1},
				{"isFrntIntHCMLiLe2LED9_0",6,55,-1},
				{"isFrntIntHCMLiLe2LED5_0",6,31,-1}
			},
			{
				{"igFrntIntHCMLiLe2_0","ZCUDBodyExpoSignalIPdu04",-1}
			}
		},
		{
			"BodyExposedCAN","ZCUDBodyExpoFr53","Out",0x143,8,20,0,0,0,8,0,
			{
				{"isFrntIntHCMChIntenLe1_0",7,7,0},
				{"isFrntIntHCMChIntenLe2_0",7,15,8},
				{"isFrntIntHCMChIntenLe5_0",7,39,32},
				{"isFrntIntHCMChIntenLe8_0",7,63,56},
				{"isFrntIntHCMChIntenLe4_0",7,31,24},
				{"isFrntIntHCMChIntenLe3_0",7,23,16},
				{"isFrntIntHCMChIntenLe6_0",7,47,40},
				{"isFrntIntHCMChIntenLe7_0",7,55,48}
			},
			{
				{"","",-1}
			}
		},
		{
			"BodyExposedCAN","ZCUDBodyExpoFr23","Out",0x13a,8,20,0,0,0,11,1,
			{
				{"isFrntIntHCMLiLe21LED5_0",6,31,-1},
				{"isFrntIntHCMLiLe21LED1_0",6,7,-1},
				{"isFrntIntHCMLiLe21LED2_0",6,1,-1},
				{"isFrntIntHCMLiLe21LED4_0",6,21,-1},
				{"isFrntIntHCMLiLe21LED3_0",6,11,-1},
				{"isFrntIntHCMLiLe21LED9_0",6,55,-1},
				{"isFrntIntHCMLiCntrLe21",4,59,-1},
				{"isFrntIntHCMLiLe21LED8_0",6,45,-1},
				{"isFrntIntHCMLiLe21LED10_0",6,49,-1},
				{"isFrntIntHCMLiLe21LED7_0",6,35,-1},
				{"isFrntIntHCMLiLe21LED6_0",6,25,-1}
			},
			{
				{"igFrntIntHCMLiLe21_0","ZCUDBodyExpoSignalIPdu23",-1}
			}
		},
		{"BodyExposedCAN","ZcudToHcmrBodyCanExposedDiagReqFrame","Out",0x7b4,8,0,0,4,0},
		{
			"BodyExposedCAN","ZCUDBodyExpoFr51","Out",0x13f,8,20,0,0,0,11,1,
			{
				{"isFrntIntHCMLiRi24LED2_0",6,1,-1},
				{"isFrntIntHCMLiRi24LED1_0",6,7,-1},
				{"isFrntIntHCMLiRi24LED8_0",6,45,-1},
				{"isFrntIntHCMLiCntrRi24",4,59,-1},
				{"isFrntIntHCMLiRi24LED4_0",6,21,-1},
				{"isFrntIntHCMLiRi24LED3_0",6,11,-1},
				{"isFrntIntHCMLiRi24LED9_0",6,55,-1},
				{"isFrntIntHCMLiRi24LED7_0",6,35,-1},
				{"isFrntIntHCMLiRi24LED6_0",6,25,-1},
				{"isFrntIntHCMLiRi24LED5_0",6,31,-1},
				{"isFrntIntHCMLiRi24LED10_0",6,49,-1}
			},
			{
				{"igFrntIntHCMLiRi24_0","ZCUDBodyExpoSignalIPdu51",-1}
			}
		},
		{
			"BodyExposedCAN","ZCUDBodyExpoFr28","Out",0x111,8,20,0,0,0,11,1,
			{
				{"isFrntIntHCMLiRi1LED7_0",6,35,-1},
				{"isFrntIntHCMLiRi1LED4_0",6,21,-1},
				{"isFrntIntHCMLiCntrRi1",4,59,-1},
				{"isFrntIntHCMLiRi1LED2_0",6,1,-1},
				{"isFrntIntHCMLiRi1LED5_0",6,31,-1},
				{"isFrntIntHCMLiRi1LED1_0",6,7,-1},
				{"isFrntIntHCMLiRi1LED9_0",6,55,-1},
				{"isFrntIntHCMLiRi1LED10_0",6,49,-1},
				{"isFrntIntHCMLiRi1LED8_0",6,45,-1},
				{"isFrntIntHCMLiRi1LED3_0",6,11,-1},
				{"isFrntIntHCMLiRi1LED6_0",6,25,-1}
			},
			{
				{"igFrntIntHCMLiRi1_0","ZCUDBodyExpoSignalIPdu28",-1}
			}
		},
		{
			"BodyExposedCAN","ZCUDBodyExpoFr10","Out",0x120,8,20,0,0,0,11,1,
			{
				{"isFrntIntHCMLiLe8LED1_0",6,7,-1},
				{"isFrntIntHCMLiLe8LED6_0",6,25,-1},
				{"isFrntIntHCMLiLe8LED9_0",6,55,-1},
				{"isFrntIntHCMLiLe8LED4_0",6,21,-1},
				{"isFrntIntHCMLiLe8LED8_0",6,45,-1},
				{"isFrntIntHCMLiLe8LED5_0",6,31,-1},
				{"isFrntIntHCMLiCntrLe8",4,59,-1},
				{"isFrntIntHCMLiLe8LED3_0",6,11,-1},
				{"isFrntIntHCMLiLe8LED2_0",6,1,-1},
				{"isFrntIntHCMLiLe8LED10_0",6,49,-1},
				{"isFrntIntHCMLiLe8LED7_0",6,35,-1}
			},
			{
				{"igFrntIntHCMLiLe8_0","ZCUDBodyExpoSignalIPdu10",-1}
			}
		},
		{
			"BodyExposedCAN","ZCUDBodyExpoFr52","Out",0x141,8,20,0,0,0,11,1,
			{
				{"isFrntIntHCMLiRi25LED3_0",6,11,-1},
				{"isFrntIntHCMLiRi25LED7_0",6,35,-1},
				{"isFrntIntHCMLiRi25LED8_0",6,45,-1},
				{"isFrntIntHCMLiRi25LED5_0",6,31,-1},
				{"isFrntIntHCMLiCntrRi25",4,59,-1},
				{"isFrntIntHCMLiRi25LED2_0",6,1,-1},
				{"isFrntIntHCMLiRi25LED10_0",6,49,-1},
				{"isFrntIntHCMLiRi25LED9_0",6,55,-1},
				{"isFrntIntHCMLiRi25LED1_0",6,7,-1},
				{"isFrntIntHCMLiRi25LED4_0",6,21,-1},
				{"isFrntIntHCMLiRi25LED6_0",6,25,-1}
			},
			{
				{"igFrntIntHCMLiRi25_0","ZCUDBodyExpoSignalIPdu52",-1}
			}
		},
		{
			"BodyExposedCAN","ZCUDBodyExpoFr45","Out",0x133,8,20,0,0,0,11,1,
			{
				{"isFrntIntHCMLiRi18LED9_0",6,55,-1},
				{"isFrntIntHCMLiCntrRi18",4,59,-1},
				{"isFrntIntHCMLiRi18LED8_0",6,45,-1},
				{"isFrntIntHCMLiRi18LED6_0",6,25,-1},
				{"isFrntIntHCMLiRi18LED4_0",6,21,-1},
				{"isFrntIntHCMLiRi18LED1_0",6,7,-1},
				{"isFrntIntHCMLiRi18LED3_0",6,11,-1},
				{"isFrntIntHCMLiRi18LED5_0",6,31,-1},
				{"isFrntIntHCMLiRi18LED10_0",6,49,-1},
				{"isFrntIntHCMLiRi18LED7_0",6,35,-1},
				{"isFrntIntHCMLiRi18LED2_0",6,1,-1}
			},
			{
				{"igFrntIntHCMLiRi18_0","ZCUDBodyExpoSignalIPdu45",-1}
			}
		},
		{
			"BodyExposedCAN","ZCUDBodyExpoFr24","Out",0x13c,8,20,0,0,0,11,1,
			{
				{"isFrntIntHCMLiLe22LED1_0",6,7,-1},
				{"isFrntIntHCMLiLe22LED3_0",6,11,-1},
				{"isFrntIntHCMLiCntrLe22",4,59,-1},
				{"isFrntIntHCMLiLe22LED9_0",6,55,-1},
				{"isFrntIntHCMLiLe22LED7_0",6,35,-1},
				{"isFrntIntHCMLiLe22LED10_0",6,49,-1},
				{"isFrntIntHCMLiLe22LED8_0",6,45,-1},
				{"isFrntIntHCMLiLe22LED6_0",6,25,-1},
				{"isFrntIntHCMLiLe22LED5_0",6,31,-1},
				{"isFrntIntHCMLiLe22LED4_0",6,21,-1},
				{"isFrntIntHCMLiLe22LED2_0",6,1,-1}
			},
			{
				{"igFrntIntHCMLiLe22_0","ZCUDBodyExpoSignalIPdu24",-1}
			}
		},
		{
			"BodyExposedCAN","ZCUDBodyExpoFr39","Out",0x127,8,20,0,0,0,11,1,
			{
				{"isFrntIntHCMLiRi12LED1_0",6,7,-1},
				{"isFrntIntHCMLiRi12LED6_0",6,25,-1},
				{"isFrntIntHCMLiCntrRi12",4,59,-1},
				{"isFrntIntHCMLiRi12LED4_0",6,21,-1},
				{"isFrntIntHCMLiRi12LED9_0",6,55,-1},
				{"isFrntIntHCMLiRi12LED10_0",6,49,-1},
				{"isFrntIntHCMLiRi12LED8_0",6,45,-1},
				{"isFrntIntHCMLiRi12LED2_0",6,1,-1},
				{"isFrntIntHCMLiRi12LED5_0",6,31,-1},
				{"isFrntIntHCMLiRi12LED3_0",6,11,-1},
				{"isFrntIntHCMLiRi12LED7_0",6,35,-1}
			},
			{
				{"igFrntIntHCMLiRi12_0","ZCUDBodyExpoSignalIPdu39",-1}
			}
		},
		{
			"BodyExposedCAN","ZCUDBodyExpoFr30","Out",0x115,8,20,0,0,0,11,1,
			{
				{"isFrntIntHCMLiRi3LED2_0",6,1,-1},
				{"isFrntIntHCMLiRi3LED7_0",6,35,-1},
				{"isFrntIntHCMLiRi3LED6_0",6,25,-1},
				{"isFrntIntHCMLiRi3LED3_0",6,11,-1},
				{"isFrntIntHCMLiRi3LED8_0",6,45,-1},
				{"isFrntIntHCMLiRi3LED9_0",6,55,-1},
				{"isFrntIntHCMLiRi3LED4_0",6,21,-1},
				{"isFrntIntHCMLiRi3LED10_0",6,49,-1},
				{"isFrntIntHCMLiRi3LED1_0",6,7,-1},
				{"isFrntIntHCMLiRi3LED5_0",6,31,-1},
				{"isFrntIntHCMLiCntrRi3",4,59,-1}
			},
			{
				{"igFrntIntHCMLiRi3_0","ZCUDBodyExpoSignalIPdu30",-1}
			}
		},
		{
			"BodyExposedCAN","ZCUDBodyExpoFr59","Out",0x14f,8,20,0,0,0,4,0,
			{
				{"isStepLevelMotAgRiReq_0",12,11,54},
				{"isSwivelMotAgRiReq_0",12,35,52},
				{"isSwivelMotAgLeReq_0",12,31,53},
				{"isStepLevelMotAgLeReq_0",12,7,55}
			},
			{
				{"","",-1}
			}
		},
		{
			"BodyExposedCAN","ZCUDBodyExpoFr07","Out",0x11a,8,20,0,0,0,11,1,
			{
				{"isFrntIntHCMLiLe5LED9_0",6,55,-1},
				{"isFrntIntHCMLiLe5LED2_0",6,1,-1},
				{"isFrntIntHCMLiLe5LED10_0",6,49,-1},
				{"isFrntIntHCMLiLe5LED4_0",6,21,-1},
				{"isFrntIntHCMLiCntrLe5",4,59,-1},
				{"isFrntIntHCMLiLe5LED3_0",6,11,-1},
				{"isFrntIntHCMLiLe5LED6_0",6,25,-1},
				{"isFrntIntHCMLiLe5LED1_0",6,7,-1},
				{"isFrntIntHCMLiLe5LED8_0",6,45,-1},
				{"isFrntIntHCMLiLe5LED7_0",6,35,-1},
				{"isFrntIntHCMLiLe5LED5_0",6,31,-1}
			},
			{
				{"igFrntIntHCMLiLe5_0","ZCUDBodyExpoSignalIPdu07",-1}
			}
		},
		{
			"BodyExposedCAN","ZCUDBodyExpoFr05","Out",0x114,8,20,0,0,0,11,1,
			{
				{"isFrntIntHCMLiLe3LED6_0",6,25,-1},
				{"isFrntIntHCMLiLe3LED4_0",6,21,-1},
				{"isFrntIntHCMLiLe3LED5_0",6,31,-1},
				{"isFrntIntHCMLiLe3LED10_0",6,49,-1},
				{"isFrntIntHCMLiLe3LED9_0",6,55,-1},
				{"isFrntIntHCMLiLe3LED3_0",6,11,-1},
				{"isFrntIntHCMLiLe3LED7_0",6,35,-1},
				{"isFrntIntHCMLiCntrLe3",4,59,-1},
				{"isFrntIntHCMLiLe3LED8_0",6,45,-1},
				{"isFrntIntHCMLiLe3LED2_0",6,1,-1},
				{"isFrntIntHCMLiLe3LED1_0",6,7,-1}
			},
			{
				{"igFrntIntHCMLiLe3_0","ZCUDBodyExpoSignalIPdu05",-1}
			}
		},
		{
			"BodyExposedCAN","ZCUDBodyExpoFr32","Out",0x119,8,20,0,0,0,11,1,
			{
				{"isFrntIntHCMLiRi5LED6_0",6,25,-1},
				{"isFrntIntHCMLiRi5LED9_0",6,55,-1},
				{"isFrntIntHCMLiCntrRi5",4,59,-1},
				{"isFrntIntHCMLiRi5LED2_0",6,1,-1},
				{"isFrntIntHCMLiRi5LED5_0",6,31,-1},
				{"isFrntIntHCMLiRi5LED1_0",6,7,-1},
				{"isFrntIntHCMLiRi5LED8_0",6,45,-1},
				{"isFrntIntHCMLiRi5LED3_0",6,11,-1},
				{"isFrntIntHCMLiRi5LED10_0",6,49,-1},
				{"isFrntIntHCMLiRi5LED7_0",6,35,-1},
				{"isFrntIntHCMLiRi5LED4_0",6,21,-1}
			},
			{
				{"igFrntIntHCMLiRi5_0","ZCUDBodyExpoSignalIPdu32",-1}
			}
		},
		{"BodyExposedCAN","ZcudBodyExposedNMFr","Out",0x502,8,0,0,3,0},
		{
			"BodyExposedCAN","ZCUDBodyExpoFr29","Out",0x113,8,20,0,0,0,11,1,
			{
				{"isFrntIntHCMLiRi2LED1_0",6,7,-1},
				{"isFrntIntHCMLiRi2LED8_0",6,45,-1},
				{"isFrntIntHCMLiRi2LED4_0",6,21,-1},
				{"isFrntIntHCMLiRi2LED2_0",6,1,-1},
				{"isFrntIntHCMLiCntrRi2",4,59,-1},
				{"isFrntIntHCMLiRi2LED5_0",6,31,-1},
				{"isFrntIntHCMLiRi2LED7_0",6,35,-1},
				{"isFrntIntHCMLiRi2LED10_0",6,49,-1},
				{"isFrntIntHCMLiRi2LED9_0",6,55,-1},
				{"isFrntIntHCMLiRi2LED6_0",6,25,-1},
				{"isFrntIntHCMLiRi2LED3_0",6,11,-1}
			},
			{
				{"igFrntIntHCMLiRi2_0","ZCUDBodyExpoSignalIPdu29",-1}
			}
		},
		{"BodyExposedCAN","ZcudToAllFuncBodyCanExposedDiagReqFrame","Out",0x7ff,8,0,0,4,0},
		{
			"BodyExposedCAN","ZCUDBodyExpoFr03","Out",0x110,8,20,0,0,0,11,1,
			{
				{"isFrntIntHCMLiLe1LED2_0",6,1,-1},
				{"isFrntIntHCMLiLe1LED5_0",6,31,-1},
				{"isFrntIntHCMLiLe1LED9_0",6,55,-1},
				{"isFrntIntHCMLiLe1LED3_0",6,11,-1},
				{"isFrntIntHCMLiLe1LED10_0",6,49,-1},
				{"isFrntIntHCMLiLe1LED8_0",6,45,-1},
				{"isFrntIntHCMLiLe1LED4_0",6,21,-1},
				{"isFrntIntHCMLiLe1LED1_0",6,7,-1},
				{"isFrntIntHCMLiLe1LED7_0",6,35,-1},
				{"isFrntIntHCMLiCntrLe1",4,59,-1},
				{"isFrntIntHCMLiLe1LED6_0",6,25,-1}
			},
			{
				{"igFrntIntHCMLiLe1_0","ZCUDBodyExpoSignalIPdu03",-1}
			}
		},
		{
			"BodyExposedCAN","ZCUDBodyExpoFr06","Out",0x118,8,20,0,0,0,11,1,
			{
				{"isFrntIntHCMLiLe4LED6_0",6,25,-1},
				{"isFrntIntHCMLiLe4LED3_0",6,11,-1},
				{"isFrntIntHCMLiLe4LED5_0",6,31,-1},
				{"isFrntIntHCMLiLe4LED9_0",6,55,-1},
				{"isFrntIntHCMLiLe4LED2_0",6,1,-1},
				{"isFrntIntHCMLiLe4LED10_0",6,49,-1},
				{"isFrntIntHCMLiLe4LED8_0",6,45,-1},
				{"isFrntIntHCMLiLe4LED1_0",6,7,-1},
				{"isFrntIntHCMLiCntrLe4",4,59,-1},
				{"isFrntIntHCMLiLe4LED4_0",6,21,-1},
				{"isFrntIntHCMLiLe4LED7_0",6,35,-1}
			},
			{
				{"igFrntIntHCMLiLe4_0","ZCUDBodyExpoSignalIPdu06",-1}
			}
		},
		{
			"BodyExposedCAN","ZCUDBodyExpoFr47","Out",0x137,8,20,0,0,0,11,1,
			{
				{"isFrntIntHCMLiRi20LED6_0",6,25,-1},
				{"isFrntIntHCMLiRi20LED2_0",6,1,-1},
				{"isFrntIntHCMLiRi20LED1_0",6,7,-1},
				{"isFrntIntHCMLiRi20LED4_0",6,21,-1},
				{"isFrntIntHCMLiRi20LED3_0",6,11,-1},
				{"isFrntIntHCMLiCntrRi20",4,59,-1},
				{"isFrntIntHCMLiRi20LED9_0",6,55,-1},
				{"isFrntIntHCMLiRi20LED10_0",6,49,-1},
				{"isFrntIntHCMLiRi20LED8_0",6,45,-1},
				{"isFrntIntHCMLiRi20LED7_0",6,35,-1},
				{"isFrntIntHCMLiRi20LED5_0",6,31,-1}
			},
			{
				{"igFrntIntHCMLiRi20_0","ZCUDBodyExpoSignalIPdu47",-1}
			}
		},
		{
			"BodyExposedCAN","ZCUDBodyExpoFr55","Out",0x147,8,20,0,0,0,8,0,
			{
				{"isFrntIntHCMChIntenRi1_0",7,7,0},
				{"isFrntIntHCMChIntenRi4_0",7,31,24},
				{"isFrntIntHCMChIntenRi8_0",7,63,56},
				{"isFrntIntHCMChIntenRi6_0",7,47,40},
				{"isFrntIntHCMChIntenRi7_0",7,55,48},
				{"isFrntIntHCMChIntenRi2_0",7,15,8},
				{"isFrntIntHCMChIntenRi3_0",7,23,16},
				{"isFrntIntHCMChIntenRi5_0",7,39,32}
			},
			{
				{"","",-1}
			}
		},
		{
			"BodyExposedCAN","ZCUDBodyExpoFr43","Out",0x12f,8,20,0,0,0,11,1,
			{
				{"isFrntIntHCMLiRi16LED3_0",6,11,-1},
				{"isFrntIntHCMLiRi16LED9_0",6,55,-1},
				{"isFrntIntHCMLiRi16LED10_0",6,49,-1},
				{"isFrntIntHCMLiRi16LED4_0",6,21,-1},
				{"isFrntIntHCMLiRi16LED7_0",6,35,-1},
				{"isFrntIntHCMLiRi16LED8_0",6,45,-1},
				{"isFrntIntHCMLiRi16LED6_0",6,25,-1},
				{"isFrntIntHCMLiRi16LED5_0",6,31,-1},
				{"isFrntIntHCMLiRi16LED2_0",6,1,-1},
				{"isFrntIntHCMLiRi16LED1_0",6,7,-1},
				{"isFrntIntHCMLiCntrRi16",4,59,-1}
			},
			{
				{"igFrntIntHCMLiRi16_0","ZCUDBodyExpoSignalIPdu43",-1}
			}
		},
		{
			"BodyExposedCAN","ZCUDBodyExpoFr50","Out",0x13d,8,20,0,0,0,11,1,
			{
				{"isFrntIntHCMLiRi23LED4_0",6,21,-1},
				{"isFrntIntHCMLiRi23LED7_0",6,35,-1},
				{"isFrntIntHCMLiRi23LED2_0",6,1,-1},
				{"isFrntIntHCMLiRi23LED6_0",6,25,-1},
				{"isFrntIntHCMLiRi23LED8_0",6,45,-1},
				{"isFrntIntHCMLiRi23LED3_0",6,11,-1},
				{"isFrntIntHCMLiRi23LED5_0",6,31,-1},
				{"isFrntIntHCMLiRi23LED9_0",6,55,-1},
				{"isFrntIntHCMLiRi23LED10_0",6,49,-1},
				{"isFrntIntHCMLiRi23LED1_0",6,7,-1},
				{"isFrntIntHCMLiCntrRi23",4,59,-1}
			},
			{
				{"igFrntIntHCMLiRi23_0","ZCUDBodyExpoSignalIPdu50",-1}
			}
		},
		{
			"BodyExposedCAN","ZCUDBodyExpoFr18","Out",0x130,8,20,0,0,0,11,1,
			{
				{"isFrntIntHCMLiLe16LED10_0",6,49,-1},
				{"isFrntIntHCMLiLe16LED4_0",6,21,-1},
				{"isFrntIntHCMLiLe16LED9_0",6,55,-1},
				{"isFrntIntHCMLiLe16LED7_0",6,35,-1},
				{"isFrntIntHCMLiCntrLe16",4,59,-1},
				{"isFrntIntHCMLiLe16LED1_0",6,7,-1},
				{"isFrntIntHCMLiLe16LED3_0",6,11,-1},
				{"isFrntIntHCMLiLe16LED5_0",6,31,-1},
				{"isFrntIntHCMLiLe16LED8_0",6,45,-1},
				{"isFrntIntHCMLiLe16LED6_0",6,25,-1},
				{"isFrntIntHCMLiLe16LED2_0",6,1,-1}
			},
			{
				{"igFrntIntHCMLiLe16_0","ZCUDBodyExpoSignalIPdu18",-1}
			}
		},
		{
			"BodyExposedCAN","ZCUDBodyExpoFr48","Out",0x139,8,20,0,0,0,11,1,
			{
				{"isFrntIntHCMLiRi21LED9_0",6,55,-1},
				{"isFrntIntHCMLiRi21LED3_0",6,11,-1},
				{"isFrntIntHCMLiCntrRi21",4,59,-1},
				{"isFrntIntHCMLiRi21LED10_0",6,49,-1},
				{"isFrntIntHCMLiRi21LED6_0",6,25,-1},
				{"isFrntIntHCMLiRi21LED1_0",6,7,-1},
				{"isFrntIntHCMLiRi21LED8_0",6,45,-1},
				{"isFrntIntHCMLiRi21LED5_0",6,31,-1},
				{"isFrntIntHCMLiRi21LED7_0",6,35,-1},
				{"isFrntIntHCMLiRi21LED2_0",6,1,-1},
				{"isFrntIntHCMLiRi21LED4_0",6,21,-1}
			},
			{
				{"igFrntIntHCMLiRi21_0","ZCUDBodyExpoSignalIPdu48",-1}
			}
		},
		{
			"BodyExposedCAN","ZCUDBodyExpoFr13","Out",0x126,8,20,0,0,0,11,1,
			{
				{"isFrntIntHCMLiCntrLe11",4,59,-1},
				{"isFrntIntHCMLiLe11LED1_0",6,7,-1},
				{"isFrntIntHCMLiLe11LED4_0",6,21,-1},
				{"isFrntIntHCMLiLe11LED7_0",6,35,-1},
				{"isFrntIntHCMLiLe11LED10_0",6,49,-1},
				{"isFrntIntHCMLiLe11LED6_0",6,25,-1},
				{"isFrntIntHCMLiLe11LED8_0",6,45,-1},
				{"isFrntIntHCMLiLe11LED3_0",6,11,-1},
				{"isFrntIntHCMLiLe11LED5_0",6,31,-1},
				{"isFrntIntHCMLiLe11LED2_0",6,1,-1},
				{"isFrntIntHCMLiLe11LED9_0",6,55,-1}
			},
			{
				{"igFrntIntHCMLiLe11_0","ZCUDBodyExpoSignalIPdu13",-1}
			}
		},
		{
			"BodyExposedCAN","ZCUDBodyExpoFr35","Out",0x11f,8,20,0,0,0,11,1,
			{
				{"isFrntIntHCMLiCntrRi8",4,59,-1},
				{"isFrntIntHCMLiRi8LED2_0",6,1,-1},
				{"isFrntIntHCMLiRi8LED3_0",6,11,-1},
				{"isFrntIntHCMLiRi8LED6_0",6,25,-1},
				{"isFrntIntHCMLiRi8LED9_0",6,55,-1},
				{"isFrntIntHCMLiRi8LED8_0",6,45,-1},
				{"isFrntIntHCMLiRi8LED7_0",6,35,-1},
				{"isFrntIntHCMLiRi8LED1_0",6,7,-1},
				{"isFrntIntHCMLiRi8LED4_0",6,21,-1},
				{"isFrntIntHCMLiRi8LED10_0",6,49,-1},
				{"isFrntIntHCMLiRi8LED5_0",6,31,-1}
			},
			{
				{"igFrntIntHCMLiRi8_0","ZCUDBodyExpoSignalIPdu35",-1}
			}
		},
		{
			"BodyExposedCAN","ZCUDBodyExpoFr27","Out",0x142,8,20,0,0,0,11,1,
			{
				{"isFrntIntHCMLiLe25LED10_0",6,49,-1},
				{"isFrntIntHCMLiLe25LED7_0",6,35,-1},
				{"isFrntIntHCMLiLe25LED8_0",6,45,-1},
				{"isFrntIntHCMLiLe25LED3_0",6,11,-1},
				{"isFrntIntHCMLiLe25LED2_0",6,1,-1},
				{"isFrntIntHCMLiLe25LED5_0",6,31,-1},
				{"isFrntIntHCMLiLe25LED6_0",6,25,-1},
				{"isFrntIntHCMLiCntrLe25",4,59,-1},
				{"isFrntIntHCMLiLe25LED1_0",6,7,-1},
				{"isFrntIntHCMLiLe25LED9_0",6,55,-1},
				{"isFrntIntHCMLiLe25LED4_0",6,21,-1}
			},
			{
				{"igFrntIntHCMLiLe25_0","ZCUDBodyExpoSignalIPdu27",-1}
			}
		},
		{
			"BodyExposedCAN","ZCUDBodyExpoFr17","Out",0x12e,8,20,0,0,0,11,1,
			{
				{"isFrntIntHCMLiLe15LED9_0",6,55,-1},
				{"isFrntIntHCMLiCntrLe15",4,59,-1},
				{"isFrntIntHCMLiLe15LED1_0",6,7,-1},
				{"isFrntIntHCMLiLe15LED2_0",6,1,-1},
				{"isFrntIntHCMLiLe15LED3_0",6,11,-1},
				{"isFrntIntHCMLiLe15LED5_0",6,31,-1},
				{"isFrntIntHCMLiLe15LED8_0",6,45,-1},
				{"isFrntIntHCMLiLe15LED7_0",6,35,-1},
				{"isFrntIntHCMLiLe15LED4_0",6,21,-1},
				{"isFrntIntHCMLiLe15LED6_0",6,25,-1},
				{"isFrntIntHCMLiLe15LED10_0",6,49,-1}
			},
			{
				{"igFrntIntHCMLiLe15_0","ZCUDBodyExpoSignalIPdu17",-1}
			}
		},
		{
			"BodyExposedCAN","ZCUDBodyExpoCANVFCVectorFr","Out",0x542,8,1000,0,0,0,63,1,
			{
				{"isVFCVectorZCUDMVFCid40_0",1,42,-1},
				{"isVFCVectorZCUDMVFCid34_0",1,36,-1},
				{"isVFCVectorZCUDMVFCid7_0",1,9,-1},
				{"isVFCVectorZCUDMVFCid48_0",1,50,-1},
				{"isVFCVectorZCUDMVFCid59_0",1,61,-1},
				{"isVFCVectorZCUDMVFCid31_0",1,33,-1},
				{"isVFCVectorZCUDMVFCid47_0",1,49,-1},
				{"isVFCVectorZCUDMVFCid14_0",1,16,-1},
				{"isVFCVectorZCUDMVFCid27_0",1,29,-1},
				{"isVFCVectorZCUDMVFCid5_0",1,7,-1},
				{"isVFCVectorZCUDMVFCid33_0",1,35,-1},
				{"isVFCVectorZCUDMVFCid1_0",1,3,-1},
				{"isVFCVectorZCUDMVFCid53_0",1,55,-1},
				{"isVFCVectorZCUDMVFCid45_0",1,47,-1},
				{"isVFCVectorZCUDMVFCid44_0",1,46,-1},
				{"isVFCVectorZCUDMVFCid26_0",1,28,-1},
				{"isVFCVectorZCUDMVFCid25_0",1,27,-1},
				{"isVFCVectorZCUDMVFCid46_0",1,48,-1},
				{"isVFCVectorZCUDMVFCid60_0",1,62,-1},
				{"isVFCVectorZCUDMVFCid57_0",1,59,-1},
				{"isVFCVectorZCUDMVFCid22_0",1,24,-1},
				{"isVFCVectorZCUDMVFCid61_0",1,63,-1},
				{"isVFCVectorZCUDMVFCid9_0",1,11,-1},
				{"isVFCVectorZCUDMVFCid3_0",1,5,-1},
				{"isVFCVectorZCUDMVFCid58_0",1,60,-1},
				{"isVFCVectorZCUDMVFCid11_0",1,13,-1},
				{"isVFCVectorZCUDMVFCid29_0",1,31,-1},
				{"isVFCVectorZCUDMVFCid41_0",1,43,-1},
				{"isVFCVectorZCUDMVFCid43_0",1,45,-1},
				{"isVFCVectorZCUDMVFCid37_0",1,39,-1},
				{"isVFCVectorZCUDMVFCid10_0",1,12,-1},
				{"isVFCVectorZCUDMVFCid52_0",1,54,-1},
				{"isVFCVectorZCUDMVFCid12_0",1,14,-1},
				{"isVFCVectorZCUDMVFCid2_0",1,4,-1},
				{"isVFCVectorZCUDMVFCid56_0",1,58,-1},
				{"isVFCVectorZCUDMVFCid13_0",1,15,-1},
				{"isVFCVectorZCUDMVFCid39_0",1,41,-1},
				{"isVFCVectorZCUDMVFCid35_0",1,37,-1},
				{"isVFCVectorZCUDMVFCid17_0",1,19,-1},
				{"isVFCVectorZCUDMVFCid21_0",1,23,-1},
				{"isVFCVectorZCUDMVFCid4_0",1,6,-1},
				{"isVFCVectorZCUDMVFCid6_0",1,8,-1},
				{"isVFCVectorZCUDMVFCid54_0",1,56,-1},
				{"isVFCVectorZCUDMVFCid32_0",1,34,-1},
				{"isVFCVectorZCUDMVFCid0_0",1,2,-1},
				{"isVFCVectorZCUDMVFCid15_0",1,17,-1},
				{"isVFCVectorZCUDMVFCid19_0",1,21,-1},
				{"isVFCVectorZCUDMVFCid49_0",1,51,-1},
				{"isVFCVectorZCUDMVFCid16_0",1,18,-1},
				{"isVFCVectorZCUDMVFCid20_0",1,22,-1},
				{"isVFCVectorZCUDMVFCid55_0",1,57,-1},
				{"isVFCVectorZCUDMVFCid8_0",1,10,-1},
				{"isVFCVectorZCUDMBlockID_0",2,1,-1},
				{"isVFCVectorZCUDMVFCid24_0",1,26,-1},
				{"isVFCVectorZCUDMVFCid50_0",1,52,-1},
				{"isVFCVectorZCUDMVFCid18_0",1,20,-1},
				{"isVFCVectorZCUDMVFCid30_0",1,32,-1},
				{"isVFCVectorZCUDMVFCid28_0",1,30,-1},
				{"isVFCVectorZCUDMVFCid36_0",1,38,-1},
				{"isVFCVectorZCUDMVFCid38_0",1,40,-1},
				{"isVFCVectorZCUDMVFCid51_0",1,53,-1},
				{"isVFCVectorZCUDMVFCid23_0",1,25,-1},
				{"isVFCVectorZCUDMVFCid42_0",1,44,-1}
			},
			{
				{"igVFCVectorZCUDM_0","ZCUDBodyExpoCANVFCVectorSignalIPdu",-1}
			}
		},
		{
			"BodyExposedCAN","ZCUDBodyExpoFr46","Out",0x135,8,20,0,0,0,11,1,
			{
				{"isFrntIntHCMLiRi19LED1_0",6,7,-1},
				{"isFrntIntHCMLiCntrRi19",4,59,-1},
				{"isFrntIntHCMLiRi19LED10_0",6,49,-1},
				{"isFrntIntHCMLiRi19LED8_0",6,45,-1},
				{"isFrntIntHCMLiRi19LED5_0",6,31,-1},
				{"isFrntIntHCMLiRi19LED3_0",6,11,-1},
				{"isFrntIntHCMLiRi19LED6_0",6,25,-1},
				{"isFrntIntHCMLiRi19LED2_0",6,1,-1},
				{"isFrntIntHCMLiRi19LED9_0",6,55,-1},
				{"isFrntIntHCMLiRi19LED4_0",6,21,-1},
				{"isFrntIntHCMLiRi19LED7_0",6,35,-1}
			},
			{
				{"igFrntIntHCMLiRi19_0","ZCUDBodyExpoSignalIPdu46",-1}
			}
		},
		{
			"BodyExposedCAN","ZCUDBodyExpoFr15","Out",0x12a,8,20,0,0,0,11,1,
			{
				{"isFrntIntHCMLiCntrLe13",4,59,-1},
				{"isFrntIntHCMLiLe13LED4_0",6,21,-1},
				{"isFrntIntHCMLiLe13LED3_0",6,11,-1},
				{"isFrntIntHCMLiLe13LED10_0",6,49,-1},
				{"isFrntIntHCMLiLe13LED1_0",6,7,-1},
				{"isFrntIntHCMLiLe13LED5_0",6,31,-1},
				{"isFrntIntHCMLiLe13LED8_0",6,45,-1},
				{"isFrntIntHCMLiLe13LED7_0",6,35,-1},
				{"isFrntIntHCMLiLe13LED2_0",6,1,-1},
				{"isFrntIntHCMLiLe13LED9_0",6,55,-1},
				{"isFrntIntHCMLiLe13LED6_0",6,25,-1}
			},
			{
				{"igFrntIntHCMLiLe13_0","ZCUDBodyExpoSignalIPdu15",-1}
			}
		},
		{
			"BodyExposedCAN","ZCUDBodyExpoFr16","Out",0x12c,8,20,0,0,0,11,1,
			{
				{"isFrntIntHCMLiLe14LED8_0",6,45,-1},
				{"isFrntIntHCMLiCntrLe14",4,59,-1},
				{"isFrntIntHCMLiLe14LED5_0",6,31,-1},
				{"isFrntIntHCMLiLe14LED9_0",6,55,-1},
				{"isFrntIntHCMLiLe14LED7_0",6,35,-1},
				{"isFrntIntHCMLiLe14LED6_0",6,25,-1},
				{"isFrntIntHCMLiLe14LED3_0",6,11,-1},
				{"isFrntIntHCMLiLe14LED1_0",6,7,-1},
				{"isFrntIntHCMLiLe14LED2_0",6,1,-1},
				{"isFrntIntHCMLiLe14LED4_0",6,21,-1},
				{"isFrntIntHCMLiLe14LED10_0",6,49,-1}
			},
			{
				{"igFrntIntHCMLiLe14_0","ZCUDBodyExpoSignalIPdu16",-1}
			}
		},
		{
			"BodyExposedCAN","ZCUDBodyExpoFr11","Out",0x122,8,20,0,0,0,11,1,
			{
				{"isFrntIntHCMLiLe9LED5_0",6,31,-1},
				{"isFrntIntHCMLiLe9LED4_0",6,21,-1},
				{"isFrntIntHCMLiLe9LED7_0",6,35,-1},
				{"isFrntIntHCMLiLe9LED2_0",6,1,-1},
				{"isFrntIntHCMLiLe9LED1_0",6,7,-1},
				{"isFrntIntHCMLiLe9LED10_0",6,49,-1},
				{"isFrntIntHCMLiCntrLe9",4,59,-1},
				{"isFrntIntHCMLiLe9LED8_0",6,45,-1},
				{"isFrntIntHCMLiLe9LED9_0",6,55,-1},
				{"isFrntIntHCMLiLe9LED3_0",6,11,-1},
				{"isFrntIntHCMLiLe9LED6_0",6,25,-1}
			},
			{
				{"igFrntIntHCMLiLe9_0","ZCUDBodyExpoSignalIPdu11",-1}
			}
		},
		{"BodyExposedCAN","HcmrBodyExpoFr07","In",0x25f,8,0,0,0,0},
		{"BodyExposedCAN","HcmrBodyExpoFr04","In",0x252,8,0,0,0,0},
		{"BodyExposedCAN","HcmlBodyExpoFr03","In",0x105,8,0,0,0,0},
		{"BodyExposedCAN","HcmrBodyExpoFr05","In",0x256,8,0,0,0,0},
		{"BodyExposedCAN","HcmlBodyExpoFr01","In",0x101,8,0,0,0,0},
		{"BodyExposedCAN","HcmlBodyExpoFr05","In",0x255,8,0,0,0,0},
		{"BodyExposedCAN","HcmlToZcudBodyCanExposedDiagResFrame","In",0x6b3,8,0,0,4,0},
		{"BodyExposedCAN","HcmrToZcudBodyCanExposedDiagResFrame","In",0x6b4,8,0,0,4,0},
		{"BodyExposedCAN","HcmrBodyExpoFr06","In",0x25a,8,0,0,0,0},
		{"BodyExposedCAN","HcmrBodyExpoFr03","In",0x106,8,0,0,0,0},
		{"BodyExposedCAN","HcmrBodyExpoFr01","In",0x102,8,0,0,0,0},
		{"BodyExposedCAN","HcmlBodyExpoFr02","In",0x103,8,0,0,0,0},
		{"BodyExposedCAN","HcmlBodyExpoFr04","In",0x251,8,0,0,0,0},
		{"BodyExposedCAN","RpodBodyCanExposedNMFr","In",0x53b,8,0,0,3,0},
		{"BodyExposedCAN","HcmrBodyExpoFr02","In",0x104,8,0,0,0,0},
		{"BodyExposedCAN","HcmlBodyExpoFr07","In",0x25e,8,0,0,0,0},
		{"BodyExposedCAN","HcmlBodyExpoFr06","In",0x259,8,0,0,0,0}
	};

}

void CommMatrixInit()
{
  int i;  
	for(i=0;i<MsgNum_ZCUD5;i++)
	{
		if(strncmp(CommMatrix_ZCUD5[i].MsgDir,"Out",elcount("Out"))!=0)continue;
		memcpy(TxCommMatrix[txMsgNum],CommMatrix_ZCUD5[i]);
		txMsgNum++;
	}
	for(i=0;i<MsgNum_ZCUD5;i++)
	{
		if(strncmp(CommMatrix_ZCUD5[i].MsgDir,"In",elcount("In"))!=0)continue;
		memcpy(RxCommMatrix[rxMsgNum],CommMatrix_ZCUD5[i]);
		rxMsgNum++;
	}

  write("txMsgNum=%d",txMsgNum);	
  write("rxMsgNum=%d",rxMsgNum);	
}

