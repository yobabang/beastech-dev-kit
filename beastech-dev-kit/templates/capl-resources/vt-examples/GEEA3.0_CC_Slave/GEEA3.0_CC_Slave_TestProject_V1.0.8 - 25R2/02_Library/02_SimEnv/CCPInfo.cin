
/*@!Encoding:936*/
includes
{
	
}

variables
{
	
	struct ReceptionCCP
	{
		int CCPnumber;
		byte CCPValue[256];
		int NumOfValue;
	};

  const int NumOfCCP=335;       //DUT接收CCP的数量
  #pragma warning(disable: 2008)
  struct ReceptionCCP ValidCCPInfo[335]={
    {1,{0x01,0x02,0x03,0x04,0x05,0x06,0x07,0x08,0x09,0x0A,0x0B,0x0C,0x0D,0x0E,0x0F,0x10,0x80,0x81,0x82,0x83,0x84,0x85,0x86,0x87,0x88,0x8A,0x8B,0x8C,0x8D,0x8E,0x8F,0x90,0x91,0x92,0x93,0x94,0x98,0xA1,0xA2,0xA3,0xA4,0xA5,0xA6,0xA7,0xA8,0xA9,0xAA,0xAB,0xAC,0xAD,0xAE,0xAF,0xB0,0xB1,0xB2,0xB3,0xB4,0xB5,0xB6,0xB7,0xB8,0xB9,0xBA,0xBB,0xBC,0xBD,0xBE,0xBF,0xC0,0xC1,0xC2,0xC3,0xC4,0xC5,0xC6,0xC7,0xC8,0xC9,0xCB,0xCC,0xCD,0xCE,0xCF,0xD0,0xE0,0xE1,0xE2,0xE3,0xE4,0xE5,0xE6,0xE7,0xEA,0xEB,0xEC,0xEF,0xF0,0xF1,0xF3,0xF4,0xF5,0xF6,0xF7,0xF8,0xF9,0xFA,0xFB,0xFC,0xFD},109},
    {2,{0x01,0x02,0x03,0x04},4},
    {3,{0x01,0x02,0x80,0x81},4},
    {4,{0x01,0x02,0x03,0x04,0x05,0x06,0x07,0x08,0x80,0x81},10},
    {5,{0x01,0x02,0x03,0x04,0x05,0x06,0x07,0x08,0x09,0x0A,0x0B,0x0C,0x0D,0x0E,0x0F,0x10,0x11,0x12,0x13,0x14,0x15,0x16,0x17,0x18,0x19,0x1A,0x1B,0x1C,0x1D,0x1E,0x1F,0x20,0x21,0x22,0x23,0x24,0x25,0x26,0x27,0x28,0x29,0x2A,0x2B,0x2C,0x2D,0x2E,0x2F,0x30,0x31,0x32,0x33,0x34,0x36,0x37,0x38,0x39,0x3A,0x3C,0x3E,0x3F,0x40,0x41,0x42,0x43,0x44,0x45,0x46,0x47,0x48,0x4D,0x4E,0x4F,0x50,0x80,0x81,0x82,0x83,0x84,0x85,0x86,0x87,0x88,0x89,0x8A,0x8B,0x8C,0x8D,0x8E,0x8F,0x90,0x92,0x93,0x94,0x95,0x96,0x97,0xE0,0xFD},98},
    {6,{0x01,0x02,0x03,0x04,0x05},5},
    {8,{0x01,0x02},2},
    {9,{0x01,0x02,0x03,0x04,0x05,0x06,0x07,0x08,0x09,0x0A,0x0B,0x0C,0x0D,0xA1,0xA2,0xA3,0xA4,0xA5,0xA6,0xA7,0x7F,0x80,0x81,0x82,0x83,0x84,0x85,0x86,0x87,0x88,0x89,0x8A,0x8B,0x8C,0x8D,0x8E,0x8F,0x92,0x93},39},
    {10,{0x01,0x02},2},
    {12,{0x01,0x02,0x03},3},
    {13,{0x01,0x02,0x03,0x04,0x80,0x81},6},
    {19,{0x01,0x02,0x03,0x04,0x05,0x06},6},
    {22,{0x01,0x02,0x03,0x04},4},
    {23,{0x01,0x02,0x03,0x04,0x05,0x06,0x07,0x08,0x09},9},
    {24,{0x01,0x02,0x03,0x04,0x05,0x06,0x07,0x08,0x09,0x80,0x81},11},
    {25,{0x01,0x02,0x03,0x04,0x05,0x06,0x07,0x08,0x09,0x0A},10},
    {30,{0x01,0x02,0x03,0x04,0x05,0x06,0x07,0x08,0x09,0x0A,0x0B,0x0C,0x0D,0x0E,0x0F,0x80,0x81,0x82,0x83,0x84,0x85,0x86,0x87,0x88,0x89,0x8A,0x8B,0x8C,0x8D,0x8E,0x8F,0x90,0x91,0x92,0x93,0x94,0x95,0x96,0x97,0x98},40},
    {32,{0x01,0x02,0x03,0x04,0x05,0x06,0x07,0x08,0x09,0x0A,0x0B,0x0C,0x0D,0x0E},14},
    {36,{0x01,0x02,0x03,0x04},4},
    {39,{0x01,0x02,0x03,0x04,0x80,0x81,0x82,0x83},8},
    {43,{0x01,0x02,0x03,0x04,0x05,0x06,0x07,0x08,0x09,0x0A,0x0B,0x0C,0x0D,0x0E,0x0F,0x10,0x11,0x12,0x13,0x14,0x15,0x16,0x17,0x18,0x19,0x1A,0x1B,0x1C,0x1D,0x1E,0x1F,0x20,0x21,0x22,0x23,0x24,0x25,0x26,0x27,0x28,0x29,0x2A,0x2B,0x2C,0x2D,0x2E,0x2F,0x30,0x31,0x32,0x33,0x34,0x35,0x36,0x37,0x38,0x39,0x3A,0x3B,0x3C,0x3D,0x3E,0x3F,0x40,0x41,0x42,0x43,0x44,0x45,0x80},70},
    {44,{0x01,0x02,0x06,0x09,0x0C,0x11,0x20,0x7A,0x80,0x81,0x84},11},
    {45,{0x01,0x02,0x03,0x04,0x05,0x06,0x07},7},
    {52,{0x01,0x02},2},
    {53,{0x01,0x02},2},
    {58,{0x01,0x02,0x03,0x80,0x81},5},
    {59,{0x01,0x02,0x80,0x82},4},
    {60,{0x01,0x02,0x03,0x04,0x05,0x06,0x07,0x08,0x09,0x80,0x81},11},
    {64,{0x01,0x02,0x03,0x04,0x80},5},
    {65,{0x01,0x02,0x03},3},
    {66,{0x01,0x02},2},
    {67,{0x01,0x02,0x03},3},
    {68,{0x01,0x02,0x03},3},
    {69,{0x01,0x02,0x03,0x80},4},
    {70,{0x01,0x02},2},
    {72,{0x01,0x02,0x03},3},
    {73,{0x01,0x02},2},
    {74,{0x01,0x02,0x03},3},
    {75,{0x01,0x02},2},
    {78,{0x01,0x02,0x03,0x04,0x05,0x06,0x07,0x08,0x09,0x0A},10},
    {80,{0x01,0x02,0x03,0x04,0x80,0x81,0x82,0x83,0x84,0x85,0x86,0x87,0x88,0x89,0x90,0x91,0x92,0x93,0x94,0x95,0x96,0x97,0x98},23},
    {81,{0x01,0x02,0x03,0x81},4},
    {82,{0x01,0x80,0x81,0x82,0x83,0x84},6},
    {85,{0x01,0x02,0x80},3},
    {86,{0x01,0x02,0x03,0x80},4},
    {87,{0x01,0x02,0x80},3},
    {88,{0x01,0x02},2},
    {89,{0x01,0x02},2},
    {90,{0x01,0x02,0x03},3},
    {91,{0x01,0x02},2},
    {92,{0x01,0x02,0x03},3},
    {94,{0x01,0x02,0x80},3},
    {96,{0x01,0x02,0x03},3},
    {97,{0x01,0x02},2},
    {98,{0x01,0x02,0x03,0x04,0x80,0x81,0x82,0x83},8},
    {99,{0x01,0x02,0x03,0x04,0x05,0x80,0x81,0x82},8},
    {100,{0x01,0x02,0x03,0x80,0x81},5},
    {104,{0x01,0x02,0x80,0x81,0x82},5},
    {105,{0x01,0x02,0x03,0x04,0x05,0x06,0x07,0x08,0x80,0x81,0x82,0x83,0x84,0x85},14},
    {106,{0x01,0x02,0x03,0x04,0x05,0x06,0x07,0x08,0x09,0x0A,0x0B,0x0C,0x0D,0x0E,0x0F,0x10,0x11,0x12,0x13,0x80,0x81,0x82,0x83},23},
    {107,{0x01,0x02,0x03,0x04,0x05,0x06,0x80,0x81,0x82},9},
    {108,{0x01,0x02,0x03,0x04,0x05},5},
    {109,{0x01,0x02,0x03,0x04,0x05,0x06,0x07},7},
    {110,{0x01,0x02},2},
    {111,{0x01,0x02,0x03},3},
    {112,{0x01,0x02},2},
    {113,{0x01,0x02,0x03},3},
    {114,{0x01,0x02,0x03,0x04,0x05},5},
    {115,{0x01,0x02,0x03},3},
    {116,{0x01,0x02,0x03},3},
    {117,{0x01,0x02,0x80,0x81},4},
    {118,{0x01,0x02,0x03,0x80,0x81},5},
    {120,{0x01,0x02,0x03,0x04,0x05,0x06},6},
    {121,{0x01,0x02,0x03},3},
    {122,{0x01,0x02},2},
    {123,{0x01,0x02},2},
    {124,{0x01,0x02,0x80,0x81},4},
    {137,{0x01,0x02,0x80},3},
    {139,{0x01,0x02,0x03,0x04,0x80},5},
    {142,{0x01,0x02,0x03,0x04,0x05,0x06,0x07,0x08,0x09,0x0A,0x80,0x81,0x82,0x83,0x84,0x85,0x86},17},
    {146,{0x01,0x02,0x03,0x04,0x05,0x06,0x07,0x08,0x09,0x0A},10},
    {152,{0x01,0x02,0x03,0x04,0x80,0x81,0x82,0x83},8},
    {153,{0x01,0x02,0x03,0x04},4},
    {156,{0x01,0x02,0x03,0x80,0x81,0x82,0x83,0x85},8},
    {157,{0x01,0x02,0x03,0x04,0x80,0x81,0x82,0x83,0x84,0x85,0xFE},11},
    {165,{0x01,0x02,0x80},3},
    {169,{0x01,0x02},2},
    {170,{0x01,0x02,0x03,0x80,0x81,0x82,0x83,0x84,0x85},9},
    {171,{0x01,0x02},2},
    {173,{0x01,0x02,0x03,0x04,0x05,0x06,0x07,0x08,0x09,0x81},10},
    {174,{0x01,0x02,0x80,0x81,0x82,0x83,0x84,0x85},8},
    {175,{0x01,0x02,0x03,0x04,0x05,0x06,0x80,0x81,0x82,0x83,0x84,0x85,0x86,0x87,0x88,0x89,0x8B,0x8D,0x8E,0x93},20},
    {176,{0x01,0x02,0x03,0x80,0x81},5},
    {177,{0x01,0x02,0x03,0x04,0x05,0x06,0x80,0x81,0x82,0x83,0x84,0x85,0x87},13},
    {178,{0x01,0x02},2},
    {179,{0x01,0x02,0x03,0x80,0x81,0x82,0x83,0x84,0x85,0x86,0x89,0x8A,0x8B,0x8C,0x8D,0x8E,0x8F,0x90,0x91},19},
    {180,{0x01,0x02,0x80,0x81,0x82,0x83,0x84,0x85,0x87},9},
    {181,{0x01,0x02,0x03},3},
    {182,{0x01,0x02,0x03,0x04,0x80},5},
    {183,{0x01,0x02,0x03,0x11,0x12,0x13,0x80,0x81,0x82,0x83,0x84,0x85,0x86,0x87,0x88,0x89,0x8A,0x8B},18},
    {184,{0x01,0x02,0x03,0x04,0x80,0x81,0x82,0x83},8},
    {185,{0x01,0x02,0x03,0x80,0x81,0x82,0x83},7},
    {186,{0x01,0x02,0x80,0x81},4},
    {188,{0x01,0x02},2},
    {189,{0x01,0x02,0x80,0x81,0x83},5},
    {192,{0x01,0x02,0x03,0x04,0x05,0x06,0x07,0x08,0x09,0x0A,0x10,0x11},12},
    {211,{0x01,0x02,0x03,0x04,0x05,0x06,0x80,0x81},8},
    {212,{0x01,0x02,0x03},3},
    {213,{0x01,0x02,0x03,0x04},4},
    {220,{0x01,0x02,0x03,0x04,0x05,0x06,0x07,0x08,0x09,0x0A,0x0B,0x0C,0x0D,0x0E,0x0F,0x80,0x81,0x82},18},
    {223,{0x01,0x02,0x03,0x04},4},
    {225,{0x01,0x02,0x03,0x04,0x05,0x06,0x07,0x08,0x09,0x0A,0x0B,0x0C,0x0D,0x0E,0x0F,0x10,0x11},17},
    {226,{0x01,0x02,0x03,0x04,0x05,0x06,0x07,0x08,0x09,0x0A,0x0B,0x0C,0x0D,0x0E,0x0F,0x10,0x11},17},
    {227,{0x01,0x02,0x03,0x04,0x05,0x06,0x07,0x08,0x09,0x0A,0x0B,0x0C,0x0D,0x0E,0x0F,0x10,0x11},17},
    {228,{0x01,0x02,0x03,0x04,0x05,0x06,0x07,0x08,0x09,0x0A,0x0B,0x0C,0x0D,0x0E,0x0F,0x10,0x11},17},
    {229,{0x01,0x02,0x03,0x04,0x05,0x06,0x07,0x08,0x09,0x0A,0x0B,0x0C,0x0D,0x0E,0x0F,0x10,0x11},17},
    {230,{0x01,0x02,0x03,0x04,0x05,0x06,0x07,0x08,0x09,0x0A,0x0B,0x0C,0x0D,0x0E,0x0F,0x10,0x11},17},
    {231,{0x01,0x02,0x03,0x04,0x05,0x06,0x07,0x08,0x09,0x0A,0x0B,0x0C,0x0D,0x0E,0x0F,0x10,0x11},17},
    {232,{0x01,0x02,0x03,0x04,0x05,0x06,0x07,0x08,0x09,0x0A,0x0B,0x0C,0x0D,0x0E,0x0F,0x10,0x11},17},
    {239,{0x01,0x02,0x80,0x81,0x82,0x83,0x84,0x85,0x86,0x87,0x88},11},
    {240,{0x01,0x02,0x03,0x80,0x81,0x82,0x83,0x84,0x85,0x86},10},
    {241,{0x01,0x02,0x03,0x80},4},
    {242,{0x01,0x02,0x03,0x80,0x81,0x82,0x83},7},
    {243,{0x01,0x02,0x80,0x81,0x82,0x83,0x84,0x85,0x87,0x89},10},
    {245,{0x01,0x02,0x03,0x80},4},
    {247,{0x01,0x02,0x03,0x04},4},
    {248,{0x01,0x02},2},
    {249,{0x01,0x02,0x03,0x04,0x80},5},
    {253,{0x01,0x02,0x03,0x80},4},
    {254,{0x01,0x02,0x03,0x80,0x81,0x82,0x83},7},
    {255,{0x01,0x02,0x03,0x04,0x05,0x06},6},
    {256,{0x01,0x02,0x03,0x04},4},
    {257,{0x01,0x02,0x03,0x80,0x81,0x82},6},
    {258,{0x01,0x02,0x03},3},
    {259,{0x01,0x02,0x03,0x04,0x05},5},
    {262,{0x01,0x02},2},
    {263,{0x01,0x02,0x80},3},
    {267,{0x01,0x02,0x03,0x04,0x05,0x06,0x07,0x08},8},
    {274,{0x01,0x02,0x03,0x80,0x81,0x82,0x84,0x86},8},
    {311,{0x01,0x02,0x03,0x04,0x05,0x80},6},
    {316,{0x01,0x02,0x03,0x04,0x05,0x06,0x80,0x81,0x82,0x83,0x84},11},
    {317,{0x01,0x02,0x03,0x04},4},
    {319,{0x01,0x02,0x03},3},
    {335,{0x01,0x02},2},
    {338,{0x01,0x02,0x03,0x04,0x05,0x06,0x07,0x08,0x09},9},
    {339,{0x01,0x02,0x03,0x04,0x05},5},
    {340,{0x01,0x02,0x80,0x81,0x82,0x84},6},
    {341,{0x01,0x02},2},
    {342,{0x01,0x02},2},
    {343,{0x01,0x02},2},
    {344,{0x01,0x02,0x80,0x81},4},
    {345,{0x01,0x02,0x03},3},
    {347,{0x01,0x02,0x03,0x04,0x80,0x81,0x82},7},
    {348,{0x01,0x02},2},
    {349,{0x01,0x02,0x03},3},
    {350,{0x01,0x02,0x80},3},
    {352,{0x01,0x02,0x03,0x80,0x81},5},
    {353,{0x01,0x02},2},
    {354,{0x01,0x02,0x03,0x04,0x05},5},
    {355,{0x01,0x02,0x03,0x04,0x05,0x06,0x07,0x08},8},
    {356,{0x01,0x02,0x03},3},
    {366,{0x01,0x02,0x03,0x04,0x80,0x81,0x82,0x83,0x84,0x85},10},
    {371,{0x01,0x02,0x03},3},
    {372,{0x01,0x02,0x03},3},
    {401,{0x01,0x02,0x03},3},
    {407,{0x01,0x02},2},
    {409,{0x01,0x02,0x03,0x04},4},
    {415,{0x01,0x02,0x80,0x81,0x82,0x83,0x84},7},
    {441,{0x01,0x02,0x03,0x04},4},
    {460,{0x01,0x02,0x03,0x04,0x05,0x06,0x07,0x08,0x09,0x80,0x81,0x82,0x83,0x84,0x85,0x86,0x87,0x8A,0x9A,0x9B},20},
    {463,{0x01,0x02},2},
    {464,{0x01,0x02},2},
    {465,{0x01,0x02,0x03,0x80},4},
    {468,{0x01,0x02,0x03,0x04},4},
    {469,{0x01,0x02,0x03,0x04},4},
    {471,{0x01,0x02,0x03,0x04},4},
    {472,{0x01,0x02,0x03,0x04},4},
    {473,{0x01,0x02,0x03,0x04,0x80,0x82,0x8A},7},
    {474,{0x01,0x02,0x03,0x04,0x05,0x80,0x81,0x82,0x83,0x84,0x87,0x88,0x89,0x90},14},
    {475,{0x01,0x02,0x03,0x04,0x80,0x81,0x82},7},
    {476,{0x01,0x02,0x03,0x04,0x05,0x06,0x80,0x84,0x86,0x88},10},
    {477,{0x01,0x02,0x80,0x81,0x82,0x83,0x84},7},
    {478,{0x01,0x02},2},
    {479,{0x01,0x02,0x80},3},
    {480,{0x01,0x02,0x03,0x80},4},
    {481,{0x01,0x02,0x03,0x04,0x05,0x06,0x07,0x08,0x09,0x0A,0x80,0x81,0x82,0x83,0x84,0x85,0x86,0x87,0x88},19},
    {484,{0x01,0x02},2},
    {485,{0x01,0x02},2},
    {486,{0x01,0x02,0x03,0x04,0x05,0x06,0x07,0x08,0x80},9},
    {488,{0x01,0x02},2},
    {489,{0x01,0x02,0x03,0x04},4},
    {491,{0x01,0x02,0x03,0x04,0x05,0x06,0x07,0x08,0x09,0x80,0x81,0x82,0x83,0x84,0x85,0x86,0x87,0x88,0x89,0x8A,0x8B,0x8C,0x8D,0x8E,0x8F,0x90,0x91,0x92,0x93,0x94},30},
    {494,{0x01,0x02,0x03,0x04,0x05,0x80,0x81,0x82,0x83,0x84,0x85,0x86,0x87,0x88},14},
    {495,{0x01,0x02},2},
    {497,{0x01,0x02,0x80},3},
    {501,{0x01,0x02,0x80,0x81},4},
    {503,{0x01,0x02},2},
    {505,{0x01,0x02,0x03},3},
    {506,{0x01,0x02,0x03,0x04,0x06},5},
    {507,{0x01,0x02,0x03,0x04,0x05,0x80,0x81},7},
    {508,{0x01,0x02,0x03,0x05},4},
    {509,{0x01,0x02},2},
    {510,{0x01,0x02,0x03,0x04,0x05,0x06,0x07},7},
    {511,{0x01,0x02},2},
    {518,{0x01,0x02,0x03},3},
    {523,{0x01,0x02,0x03,0x04,0x05,0x06,0x07,0x08,0x09},9},
    {526,{0x01,0x02,0x03,0x04,0x05,0x06,0x07,0x08,0x09},9},
    {527,{0x01,0x02,0x03},3},
    {528,{0x01,0x02,0x03,0x04,0x05,0x06,0x07,0x08,0x09,0x11,0x0A,0x0B,0x0C,0x10,0x14,0x15,0xFE},17},
    {529,{0x01,0x02,0x03,0x04,0x05,0x06,0x07,0x08,0x09,0x11,0x0B,0x0C,0x14,0x15,0x16,0x17,0xFE},17},
    {531,{0x01,0x02,0x03,0x04,0x05,0x06,0x07,0x08,0x09,0x0A,0x0B,0x0C,0x0D,0x0E,0x0F,0x10},16},
    {532,{0x01,0x02,0x03,0x04,0x05,0x06,0x07,0x08,0x09,0x0A,0x0B,0x0C,0x0D,0x0E,0x0F,0x10},16},
    {533,{0x01,0x02,0x03,0x04,0x05,0x06,0x07,0x08,0x09,0x0A,0x0B,0x0C,0x0D,0x0E,0x0F,0x10},16},
    {534,{0x01,0x02,0x03,0x04,0x05,0x06,0x07,0x08,0x09,0x0A,0x0B,0x0C,0x0D,0x0E,0x0F,0x10},16},
    {535,{0x01,0x02,0x03,0x04},4},
    {540,{0x01,0x02},2},
    {541,{0x01,0x02,0x03},3},
    {543,{0x01,0x02,0x03,0x04,0x05},5},
    {544,{0x01,0x02},2},
    {545,{0x01,0x02,0x03,0x04,0x05,0x06},6},
    {546,{0x01,0x02,0x03},3},
    {547,{0x01,0x02},2},
    {551,{0x01,0x02},2},
    {561,{0x01,0x02,0x03},3},
    {565,{0x01,0x02,0x03},3},
    {566,{0x01,0x02,0x03,0x04,0x05,0x06,0x07,0x08,0x09,0x10,0x11,0x12,0x13,0x14,0x15,0x16,0x17,0x18,0x19,0x1A,0x1B,0x1C,0x1D,0x1E,0x1F,0x20,0x21,0x22,0x23,0x24,0x25,0x26,0x27,0x28,0x29,0x2A,0x2B,0x2C,0x2D,0x32,0x33,0x3A,0x3B,0x3C,0x3D,0x3E,0x3F,0x40,0x41,0x42,0x43,0x44,0x45,0x46,0x47,0x48,0x49,0x4A,0x50,0x51,0x52,0x53,0x54,0x55,0x56,0x57,0x58,0x59,0x5A,0x5B},70},
    {567,{0x01,0x02,0x03},3},
    {568,{0x01,0x02,0x03,0x04,0x05,0x06,0x80},7},
    {569,{0x01,0x02,0x03,0x04,0x05,0x06},6},
    {578,{0x01,0x02,0x03,0x04,0x05,0x06},6},
    {579,{0x01,0x02,0x03},3},
    {580,{0x01,0x02,0x03,0x04,0x05,0x06,0x07,0x08,0x09,0x0A,0x0B,0x0C,0x0D,0x0E,0x0F},15},
    {590,{0x01,0x02,0x03,0x04,0x05,0x06,0x07},7},
    {591,{0x01,0x02,0x03,0x04,0x05,0x06},6},
    {595,{0x01,0x02,0x03,0x04,0x05,0x80,0x81},7},
    {604,{0x01,0x02,0x03},3},
    {609,{0x01,0x02},2},
    {618,{0x01,0x02,0x03,0x04,0x05,0x06,0x07,0x08,0x09},9},
    {622,{0x01,0x02,0x03,0x04,0x80},5},
    {624,{0x01,0x02,0x03,0x04,0x05},5},
    {628,{0x01,0x02,0x03},3},
    {629,{0x01,0x02,0x03,0x04,0x05,0x06,0x07,0x08,0x0B},9},
    {630,{0x01,0x02},2},
    {634,{0x01,0x02,0x03,0x04,0x05,0x06,0x07},7},
    {635,{0x01,0x02,0x03,0x04},4},
    {639,{0x01,0x02,0x03,0x04,0x05,0x06,0x07,0x08},8},
    {640,{0x01,0x02,0x03,0x04,0x05,0x06,0x07,0x08,0x09},9},
    {642,{0x01,0x02,0x03},3},
    {644,{0x01,0x02,0x03,0x04,0x05,0x06,0x07,0x80,0x81},9},
    {646,{0x01,0x02,0x03},3},
    {648,{0x01,0x02,0x03,0x04},4},
    {650,{0x01,0x02,0x03,0x04,0x06,0x07,0x08,0x09,0x10,0x11,0x12,0x13,0x14,0x15,0x16,0x17},16},
    {651,{0x01,0x02,0x03,0x04,0x05,0x06,0x07,0x08,0x09,0x80,0x81,0x82},12},
    {652,{0x01,0x02,0x03,0x04,0x05,0x06,0x07,0x08,0x09,0x80,0x81,0x82},12},
    {659,{0x01,0x02,0x03},3},
    {660,{0x01,0x7E},2},
    {665,{0x01,0x02,0x03,0x04,0x05},5},
    {672,{0x01,0x02,0x03,0x04},4},
    {675,{0x01,0x02},2},
    {683,{0x01,0x02,0x03,0x04},4},
    {684,{0x01,0x02,0x03,0x04,0x05},5},
    {686,{0x01,0x02,0x03},3},
    {687,{0x01,0x02,0x03},3},
    {688,{0x01,0x02,0x03,0x04,0x05,0x06,0x07,0x08,0x09,0x0A,0x0B,0x0C,0x0D,0x0E,0x0F,0x10,0x11,0x12,0x13,0x14,0x15,0x17,0x19,0x20,0x21,0x24},26},
    {695,{0x01,0x02,0x03,0x04,0x05,0x06,0x07,0x08,0x09,0x0A,0x0B,0x0C},12},
    {697,{0x01,0x02,0x03,0x04,0x05,0x06},6},
    {698,{0x01,0x02},2},
    {699,{0x01,0x02,0x03,0x04},4},
    {701,{0x01,0x02,0x03,0x04,0x05},5},
    {705,{0x01,0x02,0x03},3},
    {709,{0x01,0x02,0x03,0x04,0x05,0x06,0x07,0x08,0x09,0x10,0x11,0x13,0x14},13},
    {714,{0x01,0x02},2},
    {715,{0x01,0x02,0x03},3},
    {718,{0x01,0x02},2},
    {719,{0x01,0x02,0x03,0x04},4},
    {720,{0x01,0x02,0x03,0x04,0x06,0x07,0x09,0x10,0x11,0x12,0x13,0x14,0x15,0x16},14},
    {721,{0x01,0x02,0x03},3},
    {726,{0x01,0x02},2},
    {732,{0x01,0x02,0x03,0x04},4},
    {733,{0x01,0x02,0x03,0x04},4},
    {734,{0x01,0x02},2},
    {742,{0x01,0x02,0x03,0x04,0x05,0x06,0x07,0x08,0x09,0x0A,0x0B,0x0C,0x0D,0x0E,0x0F,0x10,0x11,0x12,0x13,0x14},20},
    {746,{0x01,0x02,0x04,0x05,0x06,0x07,0x09,0x10,0x11,0x12,0x13,0x14,0x15,0x16,0x17,0x18,0x19,0x20,0x21,0x22,0x23,0x24,0x25,0x26,0x27,0x28,0x29,0x30,0x31,0x32,0x33,0x34,0x35,0x36,0x37,0x38,0x39,0x40,0x41,0x42,0x43,0x44,0x45,0x46,0x47,0x48,0x49,0x50,0x51,0x52,0x53,0x54,0x55,0x56,0x57,0x58,0x59,0x60,0x61,0x62,0x63,0x64,0x65,0x66,0x67,0x68,0x69,0x70,0x71,0x72,0x73,0x74,0x75,0x76,0x77,0x78,0x79,0x80,0x81,0x82,0x83,0x84,0x85,0x86,0x87,0x88,0x89,0x90,0x91,0x92,0x93,0x94,0x95,0x96,0x97,0x98,0x99,0xA1,0xA2,0xA3,0xA4,0xA5,0xA6,0xA7,0xA8,0xA9,0xAA,0xAB,0xAC,0xAD,0xAE,0xAF,0xB1,0xB2,0xB3,0xB4,0xB5,0xB6,0xB7,0xB8,0xB9,0xBA,0xBB,0xBC,0xBD,0xBE,0xBF,0xC1,0xC2,0xC3,0xC4,0xC5,0xC6,0xC7,0xC8,0xC9,0xCA,0xCB,0xCC,0xCD,0xCE,0xD1,0xD2,0xD3,0xD4,0xD5,0xD6,0xD7,0xD8,0xD9,0xDA,0xDB,0xDC,0xE1,0xE2,0xE3,0xE4,0xE5,0xE6,0xE7,0xE8,0xE9,0xF1,0xF2,0xF3,0xF4,0xF5,0xF6,0xF7,0xF8},170},
    {753,{0x01,0x02,0x03},3},
    {755,{0x01,0x02},2},
    {756,{0x01,0x02,0x03,0x04},4},
    {763,{0x01,0x02,0x03},3},
    {766,{0x01,0x02,0x03},3},
    {768,{0x01,0x02},2},
    {770,{0x01,0x02},2},
    {773,{0x01,0x02,0x03,0x04,0x05,0x06,0x07,0x08},8},
    {776,{0x01,0x02},2},
    {779,{0x01,0x02,0x03},3},
    {787,{0x01,0x02},2},
    {789,{0x01,0x02,0x03,0x04,0x05,0x06,0x07,0x08,0x09},9},
    {790,{0x01,0x02},2},
    {793,{0x01,0x02},2},
    {794,{0x01,0x02},2},
    {798,{0x01,0x02,0x03,0x04,0x05},5},
    {811,{0x01,0x02},2},
    {814,{0x01,0x02},2},
    {816,{0x01,0x02,0x03,0x04,0x05},5},
    {822,{0x01,0x02,0x03,0x04,0x05,0x06,0x07},7},
    {826,{0x01,0x02},2},
    {829,{0x01,0x02,0x03,0x04,0x05,0x06},6},
    {831,{0x01,0x02},2},
    {834,{0x01,0x02},2},
    {835,{0x01,0x02},2},
    {837,{0x01,0x02,0x03,0x04,0x05,0x06,0x07},7},
    {839,{0x01,0x02},2},
    {841,{0x01,0x02},2},
    {842,{0x01,0x02,0x03,0x04,0x05,0x06,0x07},7},
    {846,{0x01,0x02,0x03,0x04,0x05,0x06,0x07,0x08,0x09,0x0A,0x0B,0x0C,0x0D,0x0E},14},
    {848,{0x01,0x02,0x03},3},
    {849,{0x01,0x02,0x03},3},
    {851,{0x01,0x02,0x03},3},
    {855,{0x01,0x02},2},
    {857,{0x01,0x02},2},
    {858,{0x01,0x02},2},
    {1258,{0x01,0x02,0x03,0x04},4},
    {1259,{0x01,0x02,0x03,0x04,0x05,0x06,0x07},7},
    {1260,{0x01,0x02,0x03,0x04},4},
    {1261,{0x01,0x02,0x03},3},
    {1264,{0x01,0x02},2},
    {1266,{0x01,0x02},2},
    {1267,{0x01,0x02},2},
    {1273,{0x01,0x02},2},
    {1275,{0x01,0x02},2},
    {1277,{0x01,0x02,0x03,0x04},4},
    {1278,{0x01,0x02,0x03,0x04,0x05,0x06,0x07,0x08,0x09},9},
    {1279,{0x01,0x02},2},
    {1283,{0x01,0x02},2},
    {1285,{0x01,0x02},2},
    {1286,{0x01,0x02},2},
    {1287,{0x01,0x02,0x03,0x04},4}

  };

  struct ReceptionCCP InvalidCCPInfo[335];

  struct ValidConfiguration
  {
    int CCPnumber;
    int CCPValue;
  };
			
  struct ValidConfiguration ValidState[335]={
    {1,0x01},
    {2,0x01},
    {3,0x01},
    {4,0x01},
    {5,0x01},
    {6,0x01},
    {8,0x01},
    {9,0x01},
    {10,0x01},
    {12,0x01},
    {13,0x01},
    {19,0x01},
    {22,0x01},
    {23,0x01},
    {24,0x01},
    {25,0x01},
    {30,0x01},
    {32,0x01},
    {36,0x01},
    {39,0x01},
    {43,0x01},
    {44,0x01},
    {45,0x01},
    {52,0x01},
    {53,0x01},
    {58,0x01},
    {59,0x01},
    {60,0x01},
    {64,0x01},
    {65,0x01},
    {66,0x01},
    {67,0x01},
    {68,0x01},
    {69,0x01},
    {70,0x01},
    {72,0x01},
    {73,0x01},
    {74,0x01},
    {75,0x01},
    {78,0x01},
    {80,0x01},
    {81,0x01},
    {82,0x01},
    {85,0x01},
    {86,0x01},
    {87,0x01},
    {88,0x01},
    {89,0x01},
    {90,0x01},
    {91,0x01},
    {92,0x01},
    {94,0x01},
    {96,0x01},
    {97,0x01},
    {98,0x01},
    {99,0x01},
    {100,0x01},
    {104,0x01},
    {105,0x01},
    {106,0x01},
    {107,0x01},
    {108,0x01},
    {109,0x01},
    {110,0x01},
    {111,0x01},
    {112,0x01},
    {113,0x01},
    {114,0x01},
    {115,0x01},
    {116,0x01},
    {117,0x01},
    {118,0x01},
    {120,0x01},
    {121,0x01},
    {122,0x01},
    {123,0x01},
    {124,0x01},
    {137,0x01},
    {139,0x01},
    {142,0x01},
    {146,0x01},
    {152,0x01},
    {153,0x01},
    {156,0x01},
    {157,0x01},
    {165,0x01},
    {169,0x01},
    {170,0x01},
    {171,0x01},
    {173,0x01},
    {174,0x01},
    {175,0x01},
    {176,0x01},
    {177,0x01},
    {178,0x01},
    {179,0x01},
    {180,0x01},
    {181,0x01},
    {182,0x01},
    {183,0x01},
    {184,0x01},
    {185,0x01},
    {186,0x01},
    {188,0x01},
    {189,0x01},
    {192,0x01},
    {211,0x01},
    {212,0x01},
    {213,0x01},
    {220,0x01},
    {223,0x01},
    {225,0x01},
    {226,0x01},
    {227,0x01},
    {228,0x01},
    {229,0x01},
    {230,0x01},
    {231,0x01},
    {232,0x01},
    {239,0x01},
    {240,0x01},
    {241,0x01},
    {242,0x01},
    {243,0x01},
    {245,0x01},
    {247,0x01},
    {248,0x01},
    {249,0x01},
    {253,0x01},
    {254,0x01},
    {255,0x01},
    {256,0x01},
    {257,0x01},
    {258,0x01},
    {259,0x01},
    {262,0x01},
    {263,0x01},
    {267,0x01},
    {274,0x01},
    {311,0x01},
    {316,0x01},
    {317,0x01},
    {319,0x01},
    {335,0x01},
    {338,0x01},
    {339,0x01},
    {340,0x01},
    {341,0x01},
    {342,0x01},
    {343,0x01},
    {344,0x01},
    {345,0x01},
    {347,0x01},
    {348,0x01},
    {349,0x01},
    {350,0x01},
    {352,0x01},
    {353,0x01},
    {354,0x01},
    {355,0x01},
    {356,0x01},
    {366,0x01},
    {371,0x01},
    {372,0x01},
    {401,0x01},
    {407,0x01},
    {409,0x01},
    {415,0x01},
    {441,0x01},
    {460,0x01},
    {463,0x01},
    {464,0x01},
    {465,0x01},
    {468,0x01},
    {469,0x01},
    {471,0x01},
    {472,0x01},
    {473,0x01},
    {474,0x01},
    {475,0x01},
    {476,0x01},
    {477,0x01},
    {478,0x01},
    {479,0x01},
    {480,0x01},
    {481,0x01},
    {484,0x01},
    {485,0x01},
    {486,0x01},
    {488,0x01},
    {489,0x01},
    {491,0x01},
    {494,0x01},
    {495,0x01},
    {497,0x01},
    {501,0x01},
    {503,0x01},
    {505,0x01},
    {506,0x01},
    {507,0x01},
    {508,0x01},
    {509,0x01},
    {510,0x01},
    {511,0x01},
    {518,0x01},
    {523,0x01},
    {526,0x01},
    {527,0x01},
    {528,0x01},
    {529,0x01},
    {531,0x01},
    {532,0x01},
    {533,0x01},
    {534,0x01},
    {535,0x01},
    {540,0x01},
    {541,0x01},
    {543,0x01},
    {544,0x01},
    {545,0x01},
    {546,0x01},
    {547,0x01},
    {551,0x01},
    {561,0x01},
    {565,0x01},
    {566,0x01},
    {567,0x01},
    {568,0x01},
    {569,0x01},
    {578,0x01},
    {579,0x01},
    {580,0x01},
    {590,0x01},
    {591,0x01},
    {595,0x01},
    {604,0x01},
    {609,0x01},
    {618,0x01},
    {622,0x01},
    {624,0x01},
    {628,0x01},
    {629,0x01},
    {630,0x01},
    {634,0x01},
    {635,0x01},
    {639,0x01},
    {640,0x01},
    {642,0x01},
    {644,0x01},
    {646,0x01},
    {648,0x01},
    {650,0x01},
    {651,0x01},
    {652,0x01},
    {659,0x01},
    {660,0x01},
    {665,0x01},
    {672,0x01},
    {675,0x01},
    {683,0x01},
    {684,0x01},
    {686,0x01},
    {687,0x01},
    {688,0x01},
    {695,0x01},
    {697,0x01},
    {698,0x01},
    {699,0x01},
    {701,0x01},
    {705,0x01},
    {709,0x01},
    {714,0x01},
    {715,0x01},
    {718,0x01},
    {719,0x01},
    {720,0x01},
    {721,0x01},
    {726,0x01},
    {732,0x01},
    {733,0x01},
    {734,0x01},
    {742,0x01},
    {746,0x01},
    {753,0x01},
    {755,0x01},
    {756,0x01},
    {763,0x01},
    {766,0x01},
    {768,0x01},
    {770,0x01},
    {773,0x01},
    {776,0x01},
    {779,0x01},
    {787,0x01},
    {789,0x01},
    {790,0x01},
    {793,0x01},
    {794,0x01},
    {798,0x01},
    {811,0x01},
    {814,0x01},
    {816,0x01},
    {822,0x01},
    {826,0x01},
    {829,0x01},
    {831,0x01},
    {834,0x01},
    {835,0x01},
    {837,0x01},
    {839,0x01},
    {841,0x01},
    {842,0x01},
    {846,0x01},
    {848,0x01},
    {849,0x01},
    {851,0x01},
    {855,0x01},
    {857,0x01},
    {858,0x01},
    {1258,0x01},
    {1259,0x01},
    {1260,0x01},
    {1261,0x01},
    {1264,0x01},
    {1266,0x01},
    {1267,0x01},
    {1273,0x01},
    {1275,0x01},
    {1277,0x01},
    {1278,0x01},
    {1279,0x01},
    {1283,0x01},
    {1285,0x01},
    {1286,0x01},
    {1287,0x01}
  };
}